AUTOSAR XML (schema 314)
package /PortInterface
  client server interface NvM_AC3_SRBS_Srv: is-service=true  # Port Interface for NVRAM Blocks of Management Types "NATIVE" or "REDUNDANT" without default values.
    6 x operation:
      EraseBlock: possible-error=E_NOT_OK
      GetErrorStatus
        arg ErrorStatus: type=NvM_RequestResultType, direction=OUT
      InvalidateNvBlock: possible-error=E_NOT_OK
      ReadBlock: possible-error=E_NOT_OK
        arg DstPtr: type=NvM_DestPtr, direction=OUT
      SetRamBlockStatus
        arg RamBlockStatus: type=Boolean, direction=IN
      WriteBlock: possible-error=E_NOT_OK
        arg DstPtr: type=NvM_DestPtr, direction=IN
    error E_NOT_OK: error-code=1
  client server interface SystemTime: is-service=true
    6 x operation:
      DtrmnElapsedTime_mS_u16  # Nexteer SystemTime Service
        arg InitialTime: type=UInt32, direction=IN
        arg ElapsedTime: type=UInt16, direction=OUT
      DtrmnElapsedTime_mS_u32
        arg InitialTime: type=UInt32, direction=IN
        arg ElapsedTime: type=UInt32, direction=OUT
      DtrmnElapsedTime_uS_u16
        arg InitialTime: type=UInt32, direction=IN
        arg ElapsedTime: type=UInt16, direction=OUT
      DtrmnElapsedTime_uS_u32
        arg InitialTime: type=UInt32, direction=IN
        arg ElapsedTime: type=UInt32, direction=OUT
      GetSystemTime_mS_u32
        arg CurrentTime: type=UInt32, direction=OUT
      GetSystemTime_uS_u32
        arg CurrentTime: type=UInt32, direction=OUT
  client server interface TSMit_SCom
    7 x operation:
      GainReset
      GetFcnDefeat
        arg FunctionDefeat_Cnt_lgc: type=Boolean, direction=OUT
      GetLongTermGains
        arg LTPosTransGain_HwNmpTransNm_f32: type=Float, direction=OUT
        arg LTNegTransGain_HwNmpTransNm_f32: type=Float, direction=OUT
      GetLrnDefeat
        arg LearningDefeat_Cnt_lgc: type=Boolean, direction=OUT
      SetFcnDefeat
        arg FunctionDefeat_Cnt_lgc: type=Boolean, direction=IN
      SetLongTermGains
        arg LTPosTransGain_HwNmpTransNm_f32: type=Float, direction=IN
        arg LTNegTransGain_HwNmpTransNm_f32: type=Float, direction=IN
      SetLrnDefeat
        arg LearningDefeat_Cnt_lgc: type=Boolean, direction=IN
  10 x sender receiver interface:
    Authority_Uls_f32
      data Uls_f32: sw-calibration-access=READ-ONLY, type=Float
    BoolStatusFlag_Cnt_lgc
      data Cnt_lgc: sw-calibration-access=READ-ONLY, type=Boolean
    Enable_Cnt_lgc
      data Cnt_lgc: sw-calibration-access=READ-ONLY, type=Boolean
    HwPos_HwDeg_f32
      data HwDeg_f32: sw-calibration-access=READ-ONLY, type=Float
    HwTrq_HwNm_f32
      data HwNm_f32: sw-calibration-access=READ-ONLY, type=Float
    HwVel_HwRadpS_f32
      data HwRadpS_f32: sw-calibration-access=READ-ONLY, type=Float
    MtrTrq_MtrNm_f32
      data MtrNm_f32: sw-calibration-access=READ-ONLY, type=Float
    TransTrq_TransNm_f32
      data TransNm_f32: type=Float
    VehSpd_Kph_f32
      data Kph_f32: sw-calibration-access=READ-ONLY, type=Float
    YawRate_DegpS_f32
      data DegpS_f32: sw-calibration-access=READ-ONLY, type=Float
