AUTOSAR XML (schema 3.0.1)
package /MICROSAR
  bsw implementation GenyBaseEnv_Impl: code-generator=cMICROSAR,GENy, ar-major-version=3, ar-minor-version=0, ar-patch-version=1, vendor-specific-module-def=GenyBaseEnv
  module definition GenyBaseEnv
    container GenyBaseEnvGeneral
      string GenyBaseEnvUserConfigFile
      integer ProjectType  # 0=single; 1=main;2=sub
      integer NumberOfSubProjects
