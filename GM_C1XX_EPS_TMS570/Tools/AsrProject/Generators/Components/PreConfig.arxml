AUTOSAR XML (schema 3.0.1)
package /MICROSAR
  module config FrTp_Pre: definition=FrTp, implementation-config-variant=VARIANT-PRE-COMPILE
    FrTpGeneral:
      FrTpUserConfigFile = (unset)
      FrTpPduRChangeParamConfCbk = false
      FrTpIsoExtChangeParameterRequest = false
      FrTpPduRCancelTransmitConfCbk = false
      FrTpHaveFastUnsegmStfUnsegRx = false
      FrTpSingleChannelOptimization = false
      FrTpSingleRxChannelOptimization = false
      FrTpSingleTxChannelOptimization = false
      FrTpSingleConnCtrlOptimization = false
      FrTpSingleTxPduPerPool = false
      FrTpSingleTxPduOptimization = false
      FrTpSingleTxPduPoolOptimization = false
      FrTpCheckAsr3RxPduLength = false
      FrTpAutosar4FrIfCbks = false
      FrTpMultiPurposeTp = false
      FrTpDisableOverlappingTxPduPools = false
      FrTpDisableDecoupledTx = false
      FrTpDisableMsgIdFiltering = false
      FrTpDisableFrIfRetry = true
      FrTpDisableBandwidthLimitation = true
      FrTpDisableSegmentedTx = false
      FrTpDisableFrTpChangeParameter = false
      FrTpDisableFrTpShutdown = false
  module config FrTp_Rec: definition=FrTp
    FrTpGeneral: FrTpVersionInfoApi=true, FrTpDevErrorDetect=true
  module config PduR_Pre: definition=PduR, implementation-config-variant=VARIANT-POST-BUILD
    PduRGeneral:
      PduRProdErrorDetect = true
      PduRUserConfigurationFile = (unset)
      PduRApplTpReceiveCancellation = false
      PduRDcmReceiveCancellation = false
      PduRCanTpReceiveCancellation = false
      PduRFrTpReceiveCancellation = false
      PduRLinTpReceiveCancellation = false
      PduRApplTpTransmitCancellation = false
      PduRDcmTransmitCancellation = false
      PduRCanTpTransmitCancellation = false
      PduRFrTpTransmitCancellation = false
      PduRLinTpTransmitCancellation = false
      PduRRoutingPathGroupSupport = false
  module config PduR_Rec: definition=PduR
    PduRGeneral: PduRDevErrorDetect=true, PduRVersionInfoApi=true
  module config Nm_Pre: definition=Nm, implementation-config-variant=VARIANT-PRE-COMPILE
    NmGlobalConfig: NmProdErrorDetect=true, NmUserConfigFile=(unset)
  module config Nm_Rec: definition=Nm
    NmGlobalConfig:
      NmDevErrorDetect = true
      NmVersionInfoApi = true
      NmBusSynchronizationEnabled = false
      NmNodeDetectionEnabled = false
      NmNodeIdEnabled = false
      NmPassiveModeEnabled = false
      NmPduRxIndicationEnabled = false
      NmRemoteSleepIndEnabled = false
      NmStateChangeIndEnabled = false
      NmUserDataEnabled = false
      NmComControlEnabled = false
      NmCoordinatorSupportEnabled = false
  module config LinSM_Pre: definition=LinSM, implementation-config-variant=VARIANT-PRE-COMPILE
    LinSMGeneral: LinSMProdErrorDetect=true, LinSMUserConfigurationFilePath=(unset), LinSMSupportRte=true
  module config LinSM_Rec: definition=LinSM
    LinSMGeneral: LinSMDevErrorDetect=true, LinSMVersionInfoApi=true
  module config LinIf_Pre: definition=LinIf, implementation-config-variant=VARIANT-POST-BUILD
    LinIfGeneral: LinIfProdErrorDetect=true, LinIfUserConfigFile=(unset), LinIfLinILHandling=false
  module config LinIf_Rec: definition=LinIf
    LinIfGeneral: LinIfDevErrorDetect=true, LinIfVersionInfoApi=true
  module config LinTp_Pre: definition=LinTp, implementation-config-variant=VARIANT-POST-BUILD
    LinTpGeneral: LinTpUseRte=true
  module config LinTp_Rec: definition=LinTp
    LinTpGeneral: LinTpVersionInfoApi=true
  module config IPduMplex_Pre: definition=IPduMplex, implementation-config-variant=VARIANT-POST-BUILD
    IPduMGeneral: IPduMUserConfigFile=(unset), IpduMVStdLibUsed=false
  module config FrSm_Pre: definition=FrSm, implementation-config-variant=VARIANT-PRE-COMPILE
    FrSmGeneral: FrSmProductionError=true, FrSmUserConfigurationFile=(unset)
  module config FrSm_Rec: definition=FrSm
    FrSmGeneral: FrSmDevErrorDetect=true, FrSmVersionInfoApi=true
  module config FrNm_Pre: definition=FrNm, implementation-config-variant=VARIANT-PRE-COMPILE
    FrNmGlobalConfig
      FrNmVendorSpecific: FrNmUserConfigFile=(unset), FrNmProdErrorDetect=true
  module config FrNm_Rec: definition=FrNm
    FrNmGlobalConfig
      FrNmGlobalProperties: FrNmDevErrorDetect=true, FrNmVersionInfoApi=true
      FrNmGlobalFeatures:
        FrNmBusSynchronizationEnabled = false
        FrNmNodeDetectionEnabled = false
        FrNmSourceNodeIdentifierEnabled = false
        FrNmPassiveModeEnabled = false
        FrNmPduRxIndicationEnabled = false
        FrNmRemoteSleepIndicationEnabled = false
        FrNmStateChangeIndicationEnabled = false
        FrNmUserDataEnabled = false
        FrNmControlBitVectorEnabled = false
        FrNmDualChannelPduEnable = false
  module config FrIf_Pre: definition=FrIf, implementation-config-variant=VARIANT-PRE-COMPILE
    FrIfGeneral:
      FrIfUserConfigFile = (unset)
      FrIfProdErrorDetect = true
      FrIfCancelTransmitSupport = false
      FrIfSingleChannelAPI = false
      FrIfWrapperAPIsAsMacro = false
      FrIfPduDirtyByteUsage = true
      FrIfJobConcatenationEnable = true
      FrIfTimeConversionDisable = false
      FrIfCounterLimitDisable = false
      FrIfUniformUpdateBytePosUsage = false
  module config FrIf_Rec: definition=FrIf
    FrIfGeneral: FrIfDevErrorDetect=true, FrIfVersionInfoApi=true
  module config FiM_Pre: definition=FiM, implementation-config-variant=VARIANT-PRE-COMPILE
    FimGeneral: FimSupportRTE=true, FimUserConfigFile=(unset)
  module config FiM_Rec: definition=FiM
    FimGeneral: FimVersionInfoApi=true, FimDevErrorDetect=true
  module config EcuM_Pre: definition=EcuM, implementation-config-variant=VARIANT-POST-BUILD
    EcuMGeneral
  module config EcuM_Rec: definition=EcuM
    EcuMGeneral: EcuMDevErrorDetect=true, EcuMVersionInfoApi=true
  module config Det_Pre: definition=Det, implementation-config-variant=VARIANT-PRE-COMPILE
    DetGlobalConfig
  module config Det_Rec: definition=Det
    DetGlobalConfig: DetEnableDet=true, DetVersionInfoApi=true
  module config Dem_Pre: definition=Dem, implementation-config-variant=VARIANT-LINK-TIME
    DemGeneral: DemUseRte=true, DemUserConfigFile=(unset)
  module config Dem_Rec: definition=Dem
    DemGeneral: DemDevErrorDetect=true, DemVersionInfoApi=true
  module config Dcm_Pre: definition=Dcm, implementation-config-variant=VARIANT-POST-BUILD
    DcmGeneral: DcmUseRte=true, DcmUserConfigFile=(unset)
  module config Dcm_Rec: definition=Dcm
    DcmGeneral: DcmDevErrorDetect=true, DcmVersionInfoApi=true
  module config ComM_Pre: definition=ComM, implementation-config-variant=VARIANT-PRE-COMPILE
    ComMGeneral: ComMProdErrorDetect=true, ComMUserConfigurationFilePath=(unset), ComMUseRte=true
  module config ComM_Rec: definition=ComM
    ComMGeneral: ComMDevErrorDetect=true, ComMVersionInfoApi=true
  module config Com_Pre: definition=Com, implementation-config-variant=VARIANT-POST-BUILD
    ComGeneral:
      ComVStdLibMemApi = false
      ComConfigurationUseDem = true
      ComUseRte = true
      ComUserConfigFile = (unset)
      ComEnableStateOnFlags = false
      ComSignalAccessMacroApi = false
      ComMissingSourceValueHandling = false
      ComGwSuspendIsrPerPdu = true
      ComTransportProtocolSupport = true
      ComLargeSignalSupport = true
  module config Com_Rec: definition=Com
    ComGeneral: ComVersionInfoApi=true, ComConfigurationUseDet=true, ComLargeSignalSupport=true
  module config CanTp_Pre: definition=CanTp, implementation-config-variant=VARIANT-POST-BUILD
    CanTpGeneral: CanTpProdErrorDetect=true, CanTpUserConfigFile=(unset), CanTpTc=false
  module config CanTp_Rec: definition=CanTp
    CanTpGeneral: CanTpDevErrorDetect=true, CanTpVersionInfoApi=true
  module config CanSM_Rec: definition=CanSM
    CanStateManagerConfiguration: CanSMVersionInfoApi=true, CanSMDevErrorDetect=true
  module config CanSM_Pre: definition=CanSM, implementation-config-variant=VARIANT-POST-BUILD
    CanStateManagerConfiguration: CanSMProdErrorDetect=true, CanSMUserConfigurationFile=(unset)
  module config CanNm_Pre: definition=CanNm, implementation-config-variant=VARIANT-POST-BUILD
    CanNmGlobalConfig: CanNmUserConfigFile=(unset), CanNmProdErrorDetect=true
  module config CanNm_Rec: definition=CanNm
    CanNmGlobalConfig:
      CanNmDevErrorDetect = true
      CanNmVersionInfoApi = true
      CanNmPassiveModeEnabled = false
      CanNmUserDataEnabled = false
      CanNmStateChangeIndEnabled = false
      CanNmRemoteSleepIndEnabled = false
      CanNmPduRxIndicationEnabled = false
      CanNmBusSynchronizationEnabled = false
      CanNmNodeDetectionEnabled = false
      CanNmNodeIdEnabled = false
      CanNmBusLoadReductionEnabled = false
      CanNmComControlEnabled = false
      CanNmImmediateRestartEnabled = false
      CanNmImmediateTxconfEnabled = false
      CanNmRepeatMsgIndEnabled = false
  module config CanIf_Pre: definition=CanIf, implementation-config-variant=VARIANT-POST-BUILD
    CanIfPublicConfiguration: CanIfProdErrorDetect=true
    CanIfPrivateConfiguration:
      CanIf_UserConfigFile = (unset)
      CanIfOptimizeOneController = false
      CanIfDlcFailedReportDem = true
      CanIf_Autosar21_ComM_Compliance = false
      CanIf_ExtendedStateMachine = false
      CanIf_BusOffRecovery = false
      CanIf_SupportNmOsek = false
  module config CanIf_Rec: definition=CanIf
    CanIfPublicConfiguration: CanIfDevErrorDetect=true, CanIfVersionInfoApi=true
    CanIfPrivateConfiguration: CanIf_TransmitCancellationAPI=false, CanIf_TransceiverHandling=true
  module config IPduMplex_Rec: definition=IPduMplex
    IPduMGeneral: IPduMDevErrorDetect=true, IPduMVersionInfoApi=true
  module config CanIf_Rec_Class1: definition=CanIf
    CanIfDriverConfig: CanIfTransmitCancellation=false
  module config Vmm_Pre: implementation-config-variant=VARIANT-PRE-COMPILE
  module config J1939Tp_Pre: definition=J1939Tp, implementation-config-variant=VARIANT-POST-BUILD
package /MICROSAR/Fr_Mcs12xMfr43xx
  module config Fr_Pre: definition=Fr, implementation-config-variant=VARIANT-PRE-COMPILE
    FrGeneral: FrUserConfigFile=(unset)
  module config Fr_Rec: definition=Fr
    FrGeneral: FrDevErrorDetect=true, FrVersionInfoApi=true
package /MICROSAR/FrTrcv_30_Tja1080
  module config FrTrcv_Pre: definition=FrTrcv, implementation-config-variant=VARIANT-PRE-COMPILE
    FrTrcvGeneral: FrTrcvUserConfigFile=(unset), FrTrcvProdErrorDetect=(unset)
  module config FrTrcv_Rec: definition=FrTrcv
    FrTrcvGeneral: FrTrcvDevErrorDetect=true, FrTrcvGetVersionInfo=true
package /MICROSAR/Can_Mcs12xMscan
  module config Can_Pre: definition=Can, implementation-config-variant=VARIANT-POST-BUILD
    CanGeneral: CanProdErrorDetection=true, CanUserConfigFile=(unset)
  module config Can_Rec: definition=Can
    CanGeneral: CanDevErrorDetection=true, CanVersionInfoApi=true, CanHardwareCancellation=false
package /MICROSAR/Lin_Mcs12x
  module config Lin_Pre: definition=Lin, implementation-config-variant=VARIANT-POST-BUILD
    LinGeneral: LinProdErrorDetect=true, LinUserConfigFile=(unset)
  module config Lin_Rec: definition=Lin
    LinGeneral: LinDevErrorDetect=true, LinVersionInfoApi=true
