AUTOSAR XML (schema 314)
package /ComponentType
  internal behavior NvM_InternalBehavior: component=NvM
    177 x operation invoked event:
      OIT_EraseBlock_PS_ConfigBlock_EraseBlock: start-on-event=EraseBlock, operation=PS_ConfigBlock.EraseBlock
      OIT_EraseBlock_PS_NVM_BLOCK_CMS_ECUHWPN_EraseBlock: start-on-event=EraseBlock, operation=PS_NVM_BLOCK_CMS_ECUHWPN.EraseBlock
      OIT_EraseBlock_PS_NVM_BLOCK_CMS_ECUSRLNUM_EraseBlock: start-on-event=EraseBlock, operation=PS_NVM_BLOCK_CMS_ECUSRLNUM.EraseBlock
      OIT_EraseBlock_PS_NVM_BLOCK_CMS_EPSDEFEATS_EraseBlock: start-on-event=EraseBlock, operation=PS_NVM_BLOCK_CMS_EPSDEFEATS.EraseBlock
      OIT_EraseBlock_PS_NVM_BLOCK_CMS_EPSSRLNUM_EraseBlock: start-on-event=EraseBlock, operation=PS_NVM_BLOCK_CMS_EPSSRLNUM.EraseBlock
      OIT_EraseBlock_PS_NVM_BLOCK_CMS_IGNCNTR_EraseBlock: start-on-event=EraseBlock, operation=PS_NVM_BLOCK_CMS_IGNCNTR.EraseBlock
      OIT_EraseBlock_PS_NVM_BLOCK_CMS_NXTRMANUFSCRATCHPAD_EraseBlock: start-on-event=EraseBlock, operation=PS_NVM_BLOCK_CMS_NXTRMANUFSCRATCHPAD.EraseBlock
      OIT_EraseBlock_PS_NVM_BLOCK_CMS_NXTRMEC_EraseBlock: start-on-event=EraseBlock, operation=PS_NVM_BLOCK_CMS_NXTRMEC.EraseBlock
      OIT_EraseBlock_PS_NVM_BLOCK_CMS_NXTRMECFLAG_EraseBlock: start-on-event=EraseBlock, operation=PS_NVM_BLOCK_CMS_NXTRMECFLAG.EraseBlock
      OIT_EraseBlock_PS_NVM_BLOCK_CMS_NXTRWIRSELECT_EraseBlock: start-on-event=EraseBlock, operation=PS_NVM_BLOCK_CMS_NXTRWIRSELECT.EraseBlock
      OIT_EraseBlock_PS_NVM_BLOCK_DIAGMGR_BLACKBOX_EraseBlock: start-on-event=EraseBlock, operation=PS_NVM_BLOCK_DIAGMGR_BLACKBOX.EraseBlock
      OIT_EraseBlock_PS_NVM_BLOCK_DIAGMGR_NTCSTRG_EraseBlock: start-on-event=EraseBlock, operation=PS_NVM_BLOCK_DIAGMGR_NTCSTRG.EraseBlock
      OIT_EraseBlock_PS_NVM_BLOCK_SER_APP_NBID_EraseBlock: start-on-event=EraseBlock, operation=PS_NVM_BLOCK_SER_APP_NBID.EraseBlock
      OIT_EraseBlock_PS_NVM_BLOCK_SER_BASEMODELPN_EraseBlock: start-on-event=EraseBlock, operation=PS_NVM_BLOCK_SER_BASEMODELPN.EraseBlock
      OIT_EraseBlock_PS_NVM_BLOCK_SER_BASEMODELPNAC_EraseBlock: start-on-event=EraseBlock, operation=PS_NVM_BLOCK_SER_BASEMODELPNAC.EraseBlock
      OIT_EraseBlock_PS_NVM_BLOCK_SER_BCID_EraseBlock: start-on-event=EraseBlock, operation=PS_NVM_BLOCK_SER_BCID.EraseBlock
      OIT_EraseBlock_PS_NVM_BLOCK_SER_CALPRGFLAG_EraseBlock: start-on-event=EraseBlock, operation=PS_NVM_BLOCK_SER_CALPRGFLAG.EraseBlock
      OIT_EraseBlock_PS_NVM_BLOCK_SER_CUSTMEC_EraseBlock: start-on-event=EraseBlock, operation=PS_NVM_BLOCK_SER_CUSTMEC.EraseBlock
      OIT_EraseBlock_PS_NVM_BLOCK_SER_DATAUNIVNUMSYSID_EraseBlock: start-on-event=EraseBlock, operation=PS_NVM_BLOCK_SER_DATAUNIVNUMSYSID.EraseBlock
      OIT_EraseBlock_PS_NVM_BLOCK_SER_ECU_ID_EraseBlock: start-on-event=EraseBlock, operation=PS_NVM_BLOCK_SER_ECU_ID.EraseBlock
      OIT_EraseBlock_PS_NVM_BLOCK_SER_ENDMODELPN_EraseBlock: start-on-event=EraseBlock, operation=PS_NVM_BLOCK_SER_ENDMODELPN.EraseBlock
      OIT_EraseBlock_PS_NVM_BLOCK_SER_ENDMODELPNAC_EraseBlock: start-on-event=EraseBlock, operation=PS_NVM_BLOCK_SER_ENDMODELPNAC.EraseBlock
      OIT_EraseBlock_PS_NVM_BLOCK_SER_KEY_CPID_EraseBlock: start-on-event=EraseBlock, operation=PS_NVM_BLOCK_SER_KEY_CPID.EraseBlock
      OIT_EraseBlock_PS_NVM_BLOCK_SER_KEY_DEPRECATED_EraseBlock: start-on-event=EraseBlock, operation=PS_NVM_BLOCK_SER_KEY_DEPRECATED.EraseBlock
      OIT_EraseBlock_PS_NVM_BLOCK_SER_KEY_NEXTEER_EraseBlock: start-on-event=EraseBlock, operation=PS_NVM_BLOCK_SER_KEY_NEXTEER.EraseBlock
      OIT_EraseBlock_PS_NVM_BLOCK_SER_KEY_SPS_EraseBlock: start-on-event=EraseBlock, operation=PS_NVM_BLOCK_SER_KEY_SPS.EraseBlock
      OIT_EraseBlock_PS_NVM_BLOCK_SER_MANFTRAC_EraseBlock: start-on-event=EraseBlock, operation=PS_NVM_BLOCK_SER_MANFTRAC.EraseBlock
      OIT_EraseBlock_PS_NVM_BLOCK_SER_PREVREPAIRSHOPCODE_EraseBlock: start-on-event=EraseBlock, operation=PS_NVM_BLOCK_SER_PREVREPAIRSHOPCODE.EraseBlock
      OIT_EraseBlock_PS_NVM_BLOCK_SER_PROGDATE_EraseBlock: start-on-event=EraseBlock, operation=PS_NVM_BLOCK_SER_PROGDATE.EraseBlock
      OIT_EraseBlock_PS_NVM_BLOCK_SER_REPAIRSHOPCODE_EraseBlock: start-on-event=EraseBlock, operation=PS_NVM_BLOCK_SER_REPAIRSHOPCODE.EraseBlock
      OIT_EraseBlock_PS_NVM_BLOCK_SER_SBAT_EraseBlock: start-on-event=EraseBlock, operation=PS_NVM_BLOCK_SER_SBAT.EraseBlock
      OIT_EraseBlock_PS_NVM_BLOCK_SER_SEED_CPID_EraseBlock: start-on-event=EraseBlock, operation=PS_NVM_BLOCK_SER_SEED_CPID.EraseBlock
      OIT_EraseBlock_PS_NVM_BLOCK_SER_SEED_DEPRECATED_EraseBlock: start-on-event=EraseBlock, operation=PS_NVM_BLOCK_SER_SEED_DEPRECATED.EraseBlock
      OIT_EraseBlock_PS_NVM_BLOCK_SER_SEED_NEXTEER_EraseBlock: start-on-event=EraseBlock, operation=PS_NVM_BLOCK_SER_SEED_NEXTEER.EraseBlock
      OIT_EraseBlock_PS_NVM_BLOCK_SER_SEED_SPS_EraseBlock: start-on-event=EraseBlock, operation=PS_NVM_BLOCK_SER_SEED_SPS.EraseBlock
      OIT_EraseBlock_PS_NVM_BLOCK_SER_SYSTEMNAME_EraseBlock: start-on-event=EraseBlock, operation=PS_NVM_BLOCK_SER_SYSTEMNAME.EraseBlock
      OIT_EraseBlock_PS_NVM_BLOCK_SER_SYSVERSCODEDDI_EraseBlock: start-on-event=EraseBlock, operation=PS_NVM_BLOCK_SER_SYSVERSCODEDDI.EraseBlock
      OIT_EraseBlock_PS_NVM_BLOCK_SER_VINDATA_EraseBlock: start-on-event=EraseBlock, operation=PS_NVM_BLOCK_SER_VINDATA.EraseBlock
      OIT_EraseBlock_PS_NVM_BLOCK_STAMD_CLOSECHECK_EraseBlock: start-on-event=EraseBlock, operation=PS_NVM_BLOCK_STAMD_CLOSECHECK.EraseBlock
      OIT_EraseBlock_PS_NVM_BLOCK_STAMD_TYPEH_EraseBlock: start-on-event=EraseBlock, operation=PS_NVM_BLOCK_STAMD_TYPEH.EraseBlock
      OIT_EraseBlock_PS_Rte_NvmBlock_AbsHwPos_EOLVehCntrOffset_EraseBlock: start-on-event=EraseBlock, operation=PS_Rte_NvmBlock_AbsHwPos_EOLVehCntrOffset.EraseBlock
      OIT_EraseBlock_PS_Rte_NvmBlock_Ap_AstLmt_SteerAsstDefeat_EraseBlock: start-on-event=EraseBlock, operation=PS_Rte_NvmBlock_Ap_AstLmt_SteerAsstDefeat.EraseBlock
      OIT_EraseBlock_PS_Rte_NvmBlock_Ap_AvgFricLrn_AvgFricLrnData_EraseBlock: start-on-event=EraseBlock, operation=PS_Rte_NvmBlock_Ap_AvgFricLrn_AvgFricLrnData.EraseBlock
      OIT_EraseBlock_PS_Rte_NvmBlock_Ap_LrnEOT_LearnedEOT_EraseBlock: start-on-event=EraseBlock, operation=PS_Rte_NvmBlock_Ap_LrnEOT_LearnedEOT.EraseBlock
      OIT_EraseBlock_PS_Rte_NvmBlock_Ap_TrqCanc_CogTrqCal_EraseBlock: start-on-event=EraseBlock, operation=PS_Rte_NvmBlock_Ap_TrqCanc_CogTrqCal.EraseBlock
      OIT_EraseBlock_PS_Rte_NvmBlock_Ap_TrqCanc_CogTrqRplComp_EraseBlock: start-on-event=EraseBlock, operation=PS_Rte_NvmBlock_Ap_TrqCanc_CogTrqRplComp.EraseBlock
      OIT_EraseBlock_PS_Rte_NvmBlock_Ap_TSMit_TSMitDisableEOL_EraseBlock: start-on-event=EraseBlock, operation=PS_Rte_NvmBlock_Ap_TSMit_TSMitDisableEOL.EraseBlock
      OIT_EraseBlock_PS_Rte_NvmBlock_Ap_TSMit_TSMitGainLrn_EraseBlock: start-on-event=EraseBlock, operation=PS_Rte_NvmBlock_Ap_TSMit_TSMitGainLrn.EraseBlock
      OIT_EraseBlock_PS_Rte_NvmBlock_BatteryVoltage_OvervoltageData_EraseBlock: start-on-event=EraseBlock, operation=PS_Rte_NvmBlock_BatteryVoltage_OvervoltageData.EraseBlock
      OIT_EraseBlock_PS_Rte_NvmBlock_CmMtrCurr_CurrTempOffset_EraseBlock: start-on-event=EraseBlock, operation=PS_Rte_NvmBlock_CmMtrCurr_CurrTempOffset.EraseBlock
      OIT_EraseBlock_PS_Rte_NvmBlock_CmMtrCurr_ShCurrCal_EraseBlock: start-on-event=EraseBlock, operation=PS_Rte_NvmBlock_CmMtrCurr_ShCurrCal.EraseBlock
      OIT_EraseBlock_PS_Rte_NvmBlock_CurrParamComp_EOLNomMtrParam_EraseBlock: start-on-event=EraseBlock, operation=PS_Rte_NvmBlock_CurrParamComp_EOLNomMtrParam.EraseBlock
      OIT_EraseBlock_PS_Rte_NvmBlock_DigColPs_DigColPsEOL_EraseBlock: start-on-event=EraseBlock, operation=PS_Rte_NvmBlock_DigColPs_DigColPsEOL.EraseBlock
      OIT_EraseBlock_PS_Rte_NvmBlock_Polarity_Polarity_Cnt_Str_EraseBlock: start-on-event=EraseBlock, operation=PS_Rte_NvmBlock_Polarity_Polarity_Cnt_Str.EraseBlock
      OIT_EraseBlock_PS_Rte_NvmBlock_Sa_DigHwTrqSENT_DigTrqTrim_EraseBlock: start-on-event=EraseBlock, operation=PS_Rte_NvmBlock_Sa_DigHwTrqSENT_DigTrqTrim.EraseBlock
      OIT_EraseBlock_PS_Rte_NvmBlock_Sa_DigMSB_DigMSBEOLData_EraseBlock: start-on-event=EraseBlock, operation=PS_Rte_NvmBlock_Sa_DigMSB_DigMSBEOLData.EraseBlock
      OIT_EraseBlock_PS_Rte_NvmBlock_SrlComOutput_DTCTrigSts_EraseBlock: start-on-event=EraseBlock, operation=PS_Rte_NvmBlock_SrlComOutput_DTCTrigSts.EraseBlock
      OIT_EraseBlock_PS_Rte_NvmBlock_TrqCmdScl_TorqueCmdSF_Uls_f32_EraseBlock: start-on-event=EraseBlock, operation=PS_Rte_NvmBlock_TrqCmdScl_TorqueCmdSF_Uls_f32.EraseBlock
      OIT_EraseBlock_PS_Rte_NvmBlock_VehDyn_MotPosReset_EraseBlock: start-on-event=EraseBlock, operation=PS_Rte_NvmBlock_VehDyn_MotPosReset.EraseBlock
      OIT_GetErrorStatus_PS_ConfigBlock_GetErrorStatus: start-on-event=GetErrorStatus, operation=PS_ConfigBlock.GetErrorStatus
      OIT_GetErrorStatus_PS_NVM_BLOCK_CMS_ECUHWPN_GetErrorStatus: start-on-event=GetErrorStatus, operation=PS_NVM_BLOCK_CMS_ECUHWPN.GetErrorStatus
      OIT_GetErrorStatus_PS_NVM_BLOCK_CMS_ECUSRLNUM_GetErrorStatus: start-on-event=GetErrorStatus, operation=PS_NVM_BLOCK_CMS_ECUSRLNUM.GetErrorStatus
      OIT_GetErrorStatus_PS_NVM_BLOCK_CMS_EPSDEFEATS_GetErrorStatus: start-on-event=GetErrorStatus, operation=PS_NVM_BLOCK_CMS_EPSDEFEATS.GetErrorStatus
      OIT_GetErrorStatus_PS_NVM_BLOCK_CMS_EPSSRLNUM_GetErrorStatus: start-on-event=GetErrorStatus, operation=PS_NVM_BLOCK_CMS_EPSSRLNUM.GetErrorStatus
      OIT_GetErrorStatus_PS_NVM_BLOCK_CMS_IGNCNTR_GetErrorStatus: start-on-event=GetErrorStatus, operation=PS_NVM_BLOCK_CMS_IGNCNTR.GetErrorStatus
      OIT_GetErrorStatus_PS_NVM_BLOCK_CMS_NXTRMANUFSCRATCHPAD_GetErrorStatus: start-on-event=GetErrorStatus, operation=PS_NVM_BLOCK_CMS_NXTRMANUFSCRATCHPAD.GetErrorStatus
      OIT_GetErrorStatus_PS_NVM_BLOCK_CMS_NXTRMEC_GetErrorStatus: start-on-event=GetErrorStatus, operation=PS_NVM_BLOCK_CMS_NXTRMEC.GetErrorStatus
      OIT_GetErrorStatus_PS_NVM_BLOCK_CMS_NXTRMECFLAG_GetErrorStatus: start-on-event=GetErrorStatus, operation=PS_NVM_BLOCK_CMS_NXTRMECFLAG.GetErrorStatus
      OIT_GetErrorStatus_PS_NVM_BLOCK_CMS_NXTRWIRSELECT_GetErrorStatus: start-on-event=GetErrorStatus, operation=PS_NVM_BLOCK_CMS_NXTRWIRSELECT.GetErrorStatus
      OIT_GetErrorStatus_PS_NVM_BLOCK_DIAGMGR_BLACKBOX_GetErrorStatus: start-on-event=GetErrorStatus, operation=PS_NVM_BLOCK_DIAGMGR_BLACKBOX.GetErrorStatus
      OIT_GetErrorStatus_PS_NVM_BLOCK_DIAGMGR_NTCSTRG_GetErrorStatus: start-on-event=GetErrorStatus, operation=PS_NVM_BLOCK_DIAGMGR_NTCSTRG.GetErrorStatus
      OIT_GetErrorStatus_PS_NVM_BLOCK_SER_APP_NBID_GetErrorStatus: start-on-event=GetErrorStatus, operation=PS_NVM_BLOCK_SER_APP_NBID.GetErrorStatus
      OIT_GetErrorStatus_PS_NVM_BLOCK_SER_BASEMODELPN_GetErrorStatus: start-on-event=GetErrorStatus, operation=PS_NVM_BLOCK_SER_BASEMODELPN.GetErrorStatus
      OIT_GetErrorStatus_PS_NVM_BLOCK_SER_BASEMODELPNAC_GetErrorStatus: start-on-event=GetErrorStatus, operation=PS_NVM_BLOCK_SER_BASEMODELPNAC.GetErrorStatus
      OIT_GetErrorStatus_PS_NVM_BLOCK_SER_BCID_GetErrorStatus: start-on-event=GetErrorStatus, operation=PS_NVM_BLOCK_SER_BCID.GetErrorStatus
      OIT_GetErrorStatus_PS_NVM_BLOCK_SER_CALPRGFLAG_GetErrorStatus: start-on-event=GetErrorStatus, operation=PS_NVM_BLOCK_SER_CALPRGFLAG.GetErrorStatus
      OIT_GetErrorStatus_PS_NVM_BLOCK_SER_CUSTMEC_GetErrorStatus: start-on-event=GetErrorStatus, operation=PS_NVM_BLOCK_SER_CUSTMEC.GetErrorStatus
      OIT_GetErrorStatus_PS_NVM_BLOCK_SER_DATAUNIVNUMSYSID_GetErrorStatus: start-on-event=GetErrorStatus, operation=PS_NVM_BLOCK_SER_DATAUNIVNUMSYSID.GetErrorStatus
      OIT_GetErrorStatus_PS_NVM_BLOCK_SER_ECU_ID_GetErrorStatus: start-on-event=GetErrorStatus, operation=PS_NVM_BLOCK_SER_ECU_ID.GetErrorStatus
      OIT_GetErrorStatus_PS_NVM_BLOCK_SER_ENDMODELPN_GetErrorStatus: start-on-event=GetErrorStatus, operation=PS_NVM_BLOCK_SER_ENDMODELPN.GetErrorStatus
      OIT_GetErrorStatus_PS_NVM_BLOCK_SER_ENDMODELPNAC_GetErrorStatus: start-on-event=GetErrorStatus, operation=PS_NVM_BLOCK_SER_ENDMODELPNAC.GetErrorStatus
      OIT_GetErrorStatus_PS_NVM_BLOCK_SER_KEY_CPID_GetErrorStatus: start-on-event=GetErrorStatus, operation=PS_NVM_BLOCK_SER_KEY_CPID.GetErrorStatus
      OIT_GetErrorStatus_PS_NVM_BLOCK_SER_KEY_DEPRECATED_GetErrorStatus: start-on-event=GetErrorStatus, operation=PS_NVM_BLOCK_SER_KEY_DEPRECATED.GetErrorStatus
      OIT_GetErrorStatus_PS_NVM_BLOCK_SER_KEY_NEXTEER_GetErrorStatus: start-on-event=GetErrorStatus, operation=PS_NVM_BLOCK_SER_KEY_NEXTEER.GetErrorStatus
      OIT_GetErrorStatus_PS_NVM_BLOCK_SER_KEY_SPS_GetErrorStatus: start-on-event=GetErrorStatus, operation=PS_NVM_BLOCK_SER_KEY_SPS.GetErrorStatus
      OIT_GetErrorStatus_PS_NVM_BLOCK_SER_MANFTRAC_GetErrorStatus: start-on-event=GetErrorStatus, operation=PS_NVM_BLOCK_SER_MANFTRAC.GetErrorStatus
      OIT_GetErrorStatus_PS_NVM_BLOCK_SER_PREVREPAIRSHOPCODE_GetErrorStatus: start-on-event=GetErrorStatus, operation=PS_NVM_BLOCK_SER_PREVREPAIRSHOPCODE.GetErrorStatus
      OIT_GetErrorStatus_PS_NVM_BLOCK_SER_PROGDATE_GetErrorStatus: start-on-event=GetErrorStatus, operation=PS_NVM_BLOCK_SER_PROGDATE.GetErrorStatus
      OIT_GetErrorStatus_PS_NVM_BLOCK_SER_REPAIRSHOPCODE_GetErrorStatus: start-on-event=GetErrorStatus, operation=PS_NVM_BLOCK_SER_REPAIRSHOPCODE.GetErrorStatus
      OIT_GetErrorStatus_PS_NVM_BLOCK_SER_SBAT_GetErrorStatus: start-on-event=GetErrorStatus, operation=PS_NVM_BLOCK_SER_SBAT.GetErrorStatus
      OIT_GetErrorStatus_PS_NVM_BLOCK_SER_SEED_CPID_GetErrorStatus: start-on-event=GetErrorStatus, operation=PS_NVM_BLOCK_SER_SEED_CPID.GetErrorStatus
      OIT_GetErrorStatus_PS_NVM_BLOCK_SER_SEED_DEPRECATED_GetErrorStatus: start-on-event=GetErrorStatus, operation=PS_NVM_BLOCK_SER_SEED_DEPRECATED.GetErrorStatus
      OIT_GetErrorStatus_PS_NVM_BLOCK_SER_SEED_NEXTEER_GetErrorStatus: start-on-event=GetErrorStatus, operation=PS_NVM_BLOCK_SER_SEED_NEXTEER.GetErrorStatus
      OIT_GetErrorStatus_PS_NVM_BLOCK_SER_SEED_SPS_GetErrorStatus: start-on-event=GetErrorStatus, operation=PS_NVM_BLOCK_SER_SEED_SPS.GetErrorStatus
      OIT_GetErrorStatus_PS_NVM_BLOCK_SER_SYSTEMNAME_GetErrorStatus: start-on-event=GetErrorStatus, operation=PS_NVM_BLOCK_SER_SYSTEMNAME.GetErrorStatus
      OIT_GetErrorStatus_PS_NVM_BLOCK_SER_SYSVERSCODEDDI_GetErrorStatus: start-on-event=GetErrorStatus, operation=PS_NVM_BLOCK_SER_SYSVERSCODEDDI.GetErrorStatus
      OIT_GetErrorStatus_PS_NVM_BLOCK_SER_VINDATA_GetErrorStatus: start-on-event=GetErrorStatus, operation=PS_NVM_BLOCK_SER_VINDATA.GetErrorStatus
      OIT_GetErrorStatus_PS_NVM_BLOCK_STAMD_CLOSECHECK_GetErrorStatus: start-on-event=GetErrorStatus, operation=PS_NVM_BLOCK_STAMD_CLOSECHECK.GetErrorStatus
      OIT_GetErrorStatus_PS_NVM_BLOCK_STAMD_TYPEH_GetErrorStatus: start-on-event=GetErrorStatus, operation=PS_NVM_BLOCK_STAMD_TYPEH.GetErrorStatus
      OIT_GetErrorStatus_PS_Rte_NvmBlock_AbsHwPos_EOLVehCntrOffset_GetErrorStatus: start-on-event=GetErrorStatus, operation=PS_Rte_NvmBlock_AbsHwPos_EOLVehCntrOffset.GetErrorStatus
      OIT_GetErrorStatus_PS_Rte_NvmBlock_Ap_AstLmt_SteerAsstDefeat_GetErrorStatus: start-on-event=GetErrorStatus, operation=PS_Rte_NvmBlock_Ap_AstLmt_SteerAsstDefeat.GetErrorStatus
      OIT_GetErrorStatus_PS_Rte_NvmBlock_Ap_AvgFricLrn_AvgFricLrnData_GetErrorStatus: start-on-event=GetErrorStatus, operation=PS_Rte_NvmBlock_Ap_AvgFricLrn_AvgFricLrnData.GetErrorStatus
      OIT_GetErrorStatus_PS_Rte_NvmBlock_Ap_LrnEOT_LearnedEOT_GetErrorStatus: start-on-event=GetErrorStatus, operation=PS_Rte_NvmBlock_Ap_LrnEOT_LearnedEOT.GetErrorStatus
      OIT_GetErrorStatus_PS_Rte_NvmBlock_Ap_TrqCanc_CogTrqCal_GetErrorStatus: start-on-event=GetErrorStatus, operation=PS_Rte_NvmBlock_Ap_TrqCanc_CogTrqCal.GetErrorStatus
      OIT_GetErrorStatus_PS_Rte_NvmBlock_Ap_TrqCanc_CogTrqRplComp_GetErrorStatus: start-on-event=GetErrorStatus, operation=PS_Rte_NvmBlock_Ap_TrqCanc_CogTrqRplComp.GetErrorStatus
      OIT_GetErrorStatus_PS_Rte_NvmBlock_Ap_TSMit_TSMitDisableEOL_GetErrorStatus: start-on-event=GetErrorStatus, operation=PS_Rte_NvmBlock_Ap_TSMit_TSMitDisableEOL.GetErrorStatus
      OIT_GetErrorStatus_PS_Rte_NvmBlock_Ap_TSMit_TSMitGainLrn_GetErrorStatus: start-on-event=GetErrorStatus, operation=PS_Rte_NvmBlock_Ap_TSMit_TSMitGainLrn.GetErrorStatus
      OIT_GetErrorStatus_PS_Rte_NvmBlock_BatteryVoltage_OvervoltageData_GetErrorStatus: start-on-event=GetErrorStatus, operation=PS_Rte_NvmBlock_BatteryVoltage_OvervoltageData.GetErrorStatus
      OIT_GetErrorStatus_PS_Rte_NvmBlock_CmMtrCurr_CurrTempOffset_GetErrorStatus: start-on-event=GetErrorStatus, operation=PS_Rte_NvmBlock_CmMtrCurr_CurrTempOffset.GetErrorStatus
      OIT_GetErrorStatus_PS_Rte_NvmBlock_CmMtrCurr_ShCurrCal_GetErrorStatus: start-on-event=GetErrorStatus, operation=PS_Rte_NvmBlock_CmMtrCurr_ShCurrCal.GetErrorStatus
      OIT_GetErrorStatus_PS_Rte_NvmBlock_CurrParamComp_EOLNomMtrParam_GetErrorStatus: start-on-event=GetErrorStatus, operation=PS_Rte_NvmBlock_CurrParamComp_EOLNomMtrParam.GetErrorStatus
      OIT_GetErrorStatus_PS_Rte_NvmBlock_DigColPs_DigColPsEOL_GetErrorStatus: start-on-event=GetErrorStatus, operation=PS_Rte_NvmBlock_DigColPs_DigColPsEOL.GetErrorStatus
      OIT_GetErrorStatus_PS_Rte_NvmBlock_Polarity_Polarity_Cnt_Str_GetErrorStatus: start-on-event=GetErrorStatus, operation=PS_Rte_NvmBlock_Polarity_Polarity_Cnt_Str.GetErrorStatus
      OIT_GetErrorStatus_PS_Rte_NvmBlock_Sa_DigHwTrqSENT_DigTrqTrim_GetErrorStatus: start-on-event=GetErrorStatus, operation=PS_Rte_NvmBlock_Sa_DigHwTrqSENT_DigTrqTrim.GetErrorStatus
      OIT_GetErrorStatus_PS_Rte_NvmBlock_Sa_DigMSB_DigMSBEOLData_GetErrorStatus: start-on-event=GetErrorStatus, operation=PS_Rte_NvmBlock_Sa_DigMSB_DigMSBEOLData.GetErrorStatus
      OIT_GetErrorStatus_PS_Rte_NvmBlock_SrlComOutput_DTCTrigSts_GetErrorStatus: start-on-event=GetErrorStatus, operation=PS_Rte_NvmBlock_SrlComOutput_DTCTrigSts.GetErrorStatus
      OIT_GetErrorStatus_PS_Rte_NvmBlock_TrqCmdScl_TorqueCmdSF_Uls_f32_GetErrorStatus: start-on-event=GetErrorStatus, operation=PS_Rte_NvmBlock_TrqCmdScl_TorqueCmdSF_Uls_f32.GetErrorStatus
      OIT_GetErrorStatus_PS_Rte_NvmBlock_VehDyn_MotPosReset_GetErrorStatus: start-on-event=GetErrorStatus, operation=PS_Rte_NvmBlock_VehDyn_MotPosReset.GetErrorStatus
      OIT_InvalidateNvBlock_PS_ConfigBlock_InvalidateNvBlock: start-on-event=InvalidateNvBlock, operation=PS_ConfigBlock.InvalidateNvBlock
      OIT_InvalidateNvBlock_PS_NVM_BLOCK_CMS_ECUHWPN_InvalidateNvBlock: start-on-event=InvalidateNvBlock, operation=PS_NVM_BLOCK_CMS_ECUHWPN.InvalidateNvBlock
      OIT_InvalidateNvBlock_PS_NVM_BLOCK_CMS_ECUSRLNUM_InvalidateNvBlock: start-on-event=InvalidateNvBlock, operation=PS_NVM_BLOCK_CMS_ECUSRLNUM.InvalidateNvBlock
      OIT_InvalidateNvBlock_PS_NVM_BLOCK_CMS_EPSDEFEATS_InvalidateNvBlock: start-on-event=InvalidateNvBlock, operation=PS_NVM_BLOCK_CMS_EPSDEFEATS.InvalidateNvBlock
      OIT_InvalidateNvBlock_PS_NVM_BLOCK_CMS_EPSSRLNUM_InvalidateNvBlock: start-on-event=InvalidateNvBlock, operation=PS_NVM_BLOCK_CMS_EPSSRLNUM.InvalidateNvBlock
      OIT_InvalidateNvBlock_PS_NVM_BLOCK_CMS_IGNCNTR_InvalidateNvBlock: start-on-event=InvalidateNvBlock, operation=PS_NVM_BLOCK_CMS_IGNCNTR.InvalidateNvBlock
      OIT_InvalidateNvBlock_PS_NVM_BLOCK_CMS_NXTRMANUFSCRATCHPAD_InvalidateNvBlock: start-on-event=InvalidateNvBlock, operation=PS_NVM_BLOCK_CMS_NXTRMANUFSCRATCHPAD.InvalidateNvBlock
      OIT_InvalidateNvBlock_PS_NVM_BLOCK_CMS_NXTRMEC_InvalidateNvBlock: start-on-event=InvalidateNvBlock, operation=PS_NVM_BLOCK_CMS_NXTRMEC.InvalidateNvBlock
      OIT_InvalidateNvBlock_PS_NVM_BLOCK_CMS_NXTRMECFLAG_InvalidateNvBlock: start-on-event=InvalidateNvBlock, operation=PS_NVM_BLOCK_CMS_NXTRMECFLAG.InvalidateNvBlock
      OIT_InvalidateNvBlock_PS_NVM_BLOCK_CMS_NXTRWIRSELECT_InvalidateNvBlock: start-on-event=InvalidateNvBlock, operation=PS_NVM_BLOCK_CMS_NXTRWIRSELECT.InvalidateNvBlock
      OIT_InvalidateNvBlock_PS_NVM_BLOCK_DIAGMGR_BLACKBOX_InvalidateNvBlock: start-on-event=InvalidateNvBlock, operation=PS_NVM_BLOCK_DIAGMGR_BLACKBOX.InvalidateNvBlock
      OIT_InvalidateNvBlock_PS_NVM_BLOCK_DIAGMGR_NTCSTRG_InvalidateNvBlock: start-on-event=InvalidateNvBlock, operation=PS_NVM_BLOCK_DIAGMGR_NTCSTRG.InvalidateNvBlock
      OIT_InvalidateNvBlock_PS_NVM_BLOCK_SER_APP_NBID_InvalidateNvBlock: start-on-event=InvalidateNvBlock, operation=PS_NVM_BLOCK_SER_APP_NBID.InvalidateNvBlock
      OIT_InvalidateNvBlock_PS_NVM_BLOCK_SER_BASEMODELPN_InvalidateNvBlock: start-on-event=InvalidateNvBlock, operation=PS_NVM_BLOCK_SER_BASEMODELPN.InvalidateNvBlock
      OIT_InvalidateNvBlock_PS_NVM_BLOCK_SER_BASEMODELPNAC_InvalidateNvBlock: start-on-event=InvalidateNvBlock, operation=PS_NVM_BLOCK_SER_BASEMODELPNAC.InvalidateNvBlock
      OIT_InvalidateNvBlock_PS_NVM_BLOCK_SER_BCID_InvalidateNvBlock: start-on-event=InvalidateNvBlock, operation=PS_NVM_BLOCK_SER_BCID.InvalidateNvBlock
      OIT_InvalidateNvBlock_PS_NVM_BLOCK_SER_CALPRGFLAG_InvalidateNvBlock: start-on-event=InvalidateNvBlock, operation=PS_NVM_BLOCK_SER_CALPRGFLAG.InvalidateNvBlock
      OIT_InvalidateNvBlock_PS_NVM_BLOCK_SER_CUSTMEC_InvalidateNvBlock: start-on-event=InvalidateNvBlock, operation=PS_NVM_BLOCK_SER_CUSTMEC.InvalidateNvBlock
      OIT_InvalidateNvBlock_PS_NVM_BLOCK_SER_DATAUNIVNUMSYSID_InvalidateNvBlock: start-on-event=InvalidateNvBlock, operation=PS_NVM_BLOCK_SER_DATAUNIVNUMSYSID.InvalidateNvBlock
      OIT_InvalidateNvBlock_PS_NVM_BLOCK_SER_ECU_ID_InvalidateNvBlock: start-on-event=InvalidateNvBlock, operation=PS_NVM_BLOCK_SER_ECU_ID.InvalidateNvBlock
      OIT_InvalidateNvBlock_PS_NVM_BLOCK_SER_ENDMODELPN_InvalidateNvBlock: start-on-event=InvalidateNvBlock, operation=PS_NVM_BLOCK_SER_ENDMODELPN.InvalidateNvBlock
      OIT_InvalidateNvBlock_PS_NVM_BLOCK_SER_ENDMODELPNAC_InvalidateNvBlock: start-on-event=InvalidateNvBlock, operation=PS_NVM_BLOCK_SER_ENDMODELPNAC.InvalidateNvBlock
      OIT_InvalidateNvBlock_PS_NVM_BLOCK_SER_KEY_CPID_InvalidateNvBlock: start-on-event=InvalidateNvBlock, operation=PS_NVM_BLOCK_SER_KEY_CPID.InvalidateNvBlock
      OIT_InvalidateNvBlock_PS_NVM_BLOCK_SER_KEY_DEPRECATED_InvalidateNvBlock: start-on-event=InvalidateNvBlock, operation=PS_NVM_BLOCK_SER_KEY_DEPRECATED.InvalidateNvBlock
      OIT_InvalidateNvBlock_PS_NVM_BLOCK_SER_KEY_NEXTEER_InvalidateNvBlock: start-on-event=InvalidateNvBlock, operation=PS_NVM_BLOCK_SER_KEY_NEXTEER.InvalidateNvBlock
      OIT_InvalidateNvBlock_PS_NVM_BLOCK_SER_KEY_SPS_InvalidateNvBlock: start-on-event=InvalidateNvBlock, operation=PS_NVM_BLOCK_SER_KEY_SPS.InvalidateNvBlock
      OIT_InvalidateNvBlock_PS_NVM_BLOCK_SER_MANFTRAC_InvalidateNvBlock: start-on-event=InvalidateNvBlock, operation=PS_NVM_BLOCK_SER_MANFTRAC.InvalidateNvBlock
      OIT_InvalidateNvBlock_PS_NVM_BLOCK_SER_PREVREPAIRSHOPCODE_InvalidateNvBlock: start-on-event=InvalidateNvBlock, operation=PS_NVM_BLOCK_SER_PREVREPAIRSHOPCODE.InvalidateNvBlock
      OIT_InvalidateNvBlock_PS_NVM_BLOCK_SER_PROGDATE_InvalidateNvBlock: start-on-event=InvalidateNvBlock, operation=PS_NVM_BLOCK_SER_PROGDATE.InvalidateNvBlock
      OIT_InvalidateNvBlock_PS_NVM_BLOCK_SER_REPAIRSHOPCODE_InvalidateNvBlock: start-on-event=InvalidateNvBlock, operation=PS_NVM_BLOCK_SER_REPAIRSHOPCODE.InvalidateNvBlock
      OIT_InvalidateNvBlock_PS_NVM_BLOCK_SER_SBAT_InvalidateNvBlock: start-on-event=InvalidateNvBlock, operation=PS_NVM_BLOCK_SER_SBAT.InvalidateNvBlock
      OIT_InvalidateNvBlock_PS_NVM_BLOCK_SER_SEED_CPID_InvalidateNvBlock: start-on-event=InvalidateNvBlock, operation=PS_NVM_BLOCK_SER_SEED_CPID.InvalidateNvBlock
      OIT_InvalidateNvBlock_PS_NVM_BLOCK_SER_SEED_DEPRECATED_InvalidateNvBlock: start-on-event=InvalidateNvBlock, operation=PS_NVM_BLOCK_SER_SEED_DEPRECATED.InvalidateNvBlock
      OIT_InvalidateNvBlock_PS_NVM_BLOCK_SER_SEED_NEXTEER_InvalidateNvBlock: start-on-event=InvalidateNvBlock, operation=PS_NVM_BLOCK_SER_SEED_NEXTEER.InvalidateNvBlock
      OIT_InvalidateNvBlock_PS_NVM_BLOCK_SER_SEED_SPS_InvalidateNvBlock: start-on-event=InvalidateNvBlock, operation=PS_NVM_BLOCK_SER_SEED_SPS.InvalidateNvBlock
      OIT_InvalidateNvBlock_PS_NVM_BLOCK_SER_SYSTEMNAME_InvalidateNvBlock: start-on-event=InvalidateNvBlock, operation=PS_NVM_BLOCK_SER_SYSTEMNAME.InvalidateNvBlock
      OIT_InvalidateNvBlock_PS_NVM_BLOCK_SER_SYSVERSCODEDDI_InvalidateNvBlock: start-on-event=InvalidateNvBlock, operation=PS_NVM_BLOCK_SER_SYSVERSCODEDDI.InvalidateNvBlock
      OIT_InvalidateNvBlock_PS_NVM_BLOCK_SER_VINDATA_InvalidateNvBlock: start-on-event=InvalidateNvBlock, operation=PS_NVM_BLOCK_SER_VINDATA.InvalidateNvBlock
      OIT_InvalidateNvBlock_PS_NVM_BLOCK_STAMD_CLOSECHECK_InvalidateNvBlock: start-on-event=InvalidateNvBlock, operation=PS_NVM_BLOCK_STAMD_CLOSECHECK.InvalidateNvBlock
      OIT_InvalidateNvBlock_PS_NVM_BLOCK_STAMD_TYPEH_InvalidateNvBlock: start-on-event=InvalidateNvBlock, operation=PS_NVM_BLOCK_STAMD_TYPEH.InvalidateNvBlock
      OIT_InvalidateNvBlock_PS_Rte_NvmBlock_AbsHwPos_EOLVehCntrOffset_InvalidateNvBlock: start-on-event=InvalidateNvBlock, operation=PS_Rte_NvmBlock_AbsHwPos_EOLVehCntrOffset.InvalidateNvBlock
      OIT_InvalidateNvBlock_PS_Rte_NvmBlock_Ap_AstLmt_SteerAsstDefeat_InvalidateNvBlock: start-on-event=InvalidateNvBlock, operation=PS_Rte_NvmBlock_Ap_AstLmt_SteerAsstDefeat.InvalidateNvBlock
      OIT_InvalidateNvBlock_PS_Rte_NvmBlock_Ap_AvgFricLrn_AvgFricLrnData_InvalidateNvBlock: start-on-event=InvalidateNvBlock, operation=PS_Rte_NvmBlock_Ap_AvgFricLrn_AvgFricLrnData.InvalidateNvBlock
      OIT_InvalidateNvBlock_PS_Rte_NvmBlock_Ap_LrnEOT_LearnedEOT_InvalidateNvBlock: start-on-event=InvalidateNvBlock, operation=PS_Rte_NvmBlock_Ap_LrnEOT_LearnedEOT.InvalidateNvBlock
      OIT_InvalidateNvBlock_PS_Rte_NvmBlock_Ap_TrqCanc_CogTrqCal_InvalidateNvBlock: start-on-event=InvalidateNvBlock, operation=PS_Rte_NvmBlock_Ap_TrqCanc_CogTrqCal.InvalidateNvBlock
      OIT_InvalidateNvBlock_PS_Rte_NvmBlock_Ap_TrqCanc_CogTrqRplComp_InvalidateNvBlock: start-on-event=InvalidateNvBlock, operation=PS_Rte_NvmBlock_Ap_TrqCanc_CogTrqRplComp.InvalidateNvBlock
      OIT_InvalidateNvBlock_PS_Rte_NvmBlock_Ap_TSMit_TSMitDisableEOL_InvalidateNvBlock: start-on-event=InvalidateNvBlock, operation=PS_Rte_NvmBlock_Ap_TSMit_TSMitDisableEOL.InvalidateNvBlock
      OIT_InvalidateNvBlock_PS_Rte_NvmBlock_Ap_TSMit_TSMitGainLrn_InvalidateNvBlock: start-on-event=InvalidateNvBlock, operation=PS_Rte_NvmBlock_Ap_TSMit_TSMitGainLrn.InvalidateNvBlock
      OIT_InvalidateNvBlock_PS_Rte_NvmBlock_BatteryVoltage_OvervoltageData_InvalidateNvBlock: start-on-event=InvalidateNvBlock, operation=PS_Rte_NvmBlock_BatteryVoltage_OvervoltageData.InvalidateNvBlock
      OIT_InvalidateNvBlock_PS_Rte_NvmBlock_CmMtrCurr_CurrTempOffset_InvalidateNvBlock: start-on-event=InvalidateNvBlock, operation=PS_Rte_NvmBlock_CmMtrCurr_CurrTempOffset.InvalidateNvBlock
      OIT_InvalidateNvBlock_PS_Rte_NvmBlock_CmMtrCurr_ShCurrCal_InvalidateNvBlock: start-on-event=InvalidateNvBlock, operation=PS_Rte_NvmBlock_CmMtrCurr_ShCurrCal.InvalidateNvBlock
      OIT_InvalidateNvBlock_PS_Rte_NvmBlock_CurrParamComp_EOLNomMtrParam_InvalidateNvBlock: start-on-event=InvalidateNvBlock, operation=PS_Rte_NvmBlock_CurrParamComp_EOLNomMtrParam.InvalidateNvBlock
      OIT_InvalidateNvBlock_PS_Rte_NvmBlock_DigColPs_DigColPsEOL_InvalidateNvBlock: start-on-event=InvalidateNvBlock, operation=PS_Rte_NvmBlock_DigColPs_DigColPsEOL.InvalidateNvBlock
      OIT_InvalidateNvBlock_PS_Rte_NvmBlock_Polarity_Polarity_Cnt_Str_InvalidateNvBlock: start-on-event=InvalidateNvBlock, operation=PS_Rte_NvmBlock_Polarity_Polarity_Cnt_Str.InvalidateNvBlock
      OIT_InvalidateNvBlock_PS_Rte_NvmBlock_Sa_DigHwTrqSENT_DigTrqTrim_InvalidateNvBlock: start-on-event=InvalidateNvBlock, operation=PS_Rte_NvmBlock_Sa_DigHwTrqSENT_DigTrqTrim.InvalidateNvBlock
      OIT_InvalidateNvBlock_PS_Rte_NvmBlock_Sa_DigMSB_DigMSBEOLData_InvalidateNvBlock: start-on-event=InvalidateNvBlock, operation=PS_Rte_NvmBlock_Sa_DigMSB_DigMSBEOLData.InvalidateNvBlock
      OIT_InvalidateNvBlock_PS_Rte_NvmBlock_SrlComOutput_DTCTrigSts_InvalidateNvBlock: start-on-event=InvalidateNvBlock, operation=PS_Rte_NvmBlock_SrlComOutput_DTCTrigSts.InvalidateNvBlock
      OIT_InvalidateNvBlock_PS_Rte_NvmBlock_TrqCmdScl_TorqueCmdSF_Uls_f32_InvalidateNvBlock: start-on-event=InvalidateNvBlock, operation=PS_Rte_NvmBlock_TrqCmdScl_TorqueCmdSF_Uls_f32.InvalidateNvBlock
      OIT_InvalidateNvBlock_PS_Rte_NvmBlock_VehDyn_MotPosReset_InvalidateNvBlock: start-on-event=InvalidateNvBlock, operation=PS_Rte_NvmBlock_VehDyn_MotPosReset.InvalidateNvBlock
    timing event TMT_NvM_MainFunction: start-on-event=NvM_MainFunction, period=0.01
    236 x operation invoked event:
      OIT_ReadBlock_PS_ConfigBlock_ReadBlock: start-on-event=ReadBlock, operation=PS_ConfigBlock.ReadBlock
      OIT_ReadBlock_PS_NVM_BLOCK_CMS_ECUHWPN_ReadBlock: start-on-event=ReadBlock, operation=PS_NVM_BLOCK_CMS_ECUHWPN.ReadBlock
      OIT_ReadBlock_PS_NVM_BLOCK_CMS_ECUSRLNUM_ReadBlock: start-on-event=ReadBlock, operation=PS_NVM_BLOCK_CMS_ECUSRLNUM.ReadBlock
      OIT_ReadBlock_PS_NVM_BLOCK_CMS_EPSDEFEATS_ReadBlock: start-on-event=ReadBlock, operation=PS_NVM_BLOCK_CMS_EPSDEFEATS.ReadBlock
      OIT_ReadBlock_PS_NVM_BLOCK_CMS_EPSSRLNUM_ReadBlock: start-on-event=ReadBlock, operation=PS_NVM_BLOCK_CMS_EPSSRLNUM.ReadBlock
      OIT_ReadBlock_PS_NVM_BLOCK_CMS_IGNCNTR_ReadBlock: start-on-event=ReadBlock, operation=PS_NVM_BLOCK_CMS_IGNCNTR.ReadBlock
      OIT_ReadBlock_PS_NVM_BLOCK_CMS_NXTRMANUFSCRATCHPAD_ReadBlock: start-on-event=ReadBlock, operation=PS_NVM_BLOCK_CMS_NXTRMANUFSCRATCHPAD.ReadBlock
      OIT_ReadBlock_PS_NVM_BLOCK_CMS_NXTRMEC_ReadBlock: start-on-event=ReadBlock, operation=PS_NVM_BLOCK_CMS_NXTRMEC.ReadBlock
      OIT_ReadBlock_PS_NVM_BLOCK_CMS_NXTRMECFLAG_ReadBlock: start-on-event=ReadBlock, operation=PS_NVM_BLOCK_CMS_NXTRMECFLAG.ReadBlock
      OIT_ReadBlock_PS_NVM_BLOCK_CMS_NXTRWIRSELECT_ReadBlock: start-on-event=ReadBlock, operation=PS_NVM_BLOCK_CMS_NXTRWIRSELECT.ReadBlock
      OIT_ReadBlock_PS_NVM_BLOCK_DIAGMGR_BLACKBOX_ReadBlock: start-on-event=ReadBlock, operation=PS_NVM_BLOCK_DIAGMGR_BLACKBOX.ReadBlock
      OIT_ReadBlock_PS_NVM_BLOCK_DIAGMGR_NTCSTRG_ReadBlock: start-on-event=ReadBlock, operation=PS_NVM_BLOCK_DIAGMGR_NTCSTRG.ReadBlock
      OIT_ReadBlock_PS_NVM_BLOCK_SER_APP_NBID_ReadBlock: start-on-event=ReadBlock, operation=PS_NVM_BLOCK_SER_APP_NBID.ReadBlock
      OIT_ReadBlock_PS_NVM_BLOCK_SER_BASEMODELPN_ReadBlock: start-on-event=ReadBlock, operation=PS_NVM_BLOCK_SER_BASEMODELPN.ReadBlock
      OIT_ReadBlock_PS_NVM_BLOCK_SER_BASEMODELPNAC_ReadBlock: start-on-event=ReadBlock, operation=PS_NVM_BLOCK_SER_BASEMODELPNAC.ReadBlock
      OIT_ReadBlock_PS_NVM_BLOCK_SER_BCID_ReadBlock: start-on-event=ReadBlock, operation=PS_NVM_BLOCK_SER_BCID.ReadBlock
      OIT_ReadBlock_PS_NVM_BLOCK_SER_CALPRGFLAG_ReadBlock: start-on-event=ReadBlock, operation=PS_NVM_BLOCK_SER_CALPRGFLAG.ReadBlock
      OIT_ReadBlock_PS_NVM_BLOCK_SER_CUSTMEC_ReadBlock: start-on-event=ReadBlock, operation=PS_NVM_BLOCK_SER_CUSTMEC.ReadBlock
      OIT_ReadBlock_PS_NVM_BLOCK_SER_DATAUNIVNUMSYSID_ReadBlock: start-on-event=ReadBlock, operation=PS_NVM_BLOCK_SER_DATAUNIVNUMSYSID.ReadBlock
      OIT_ReadBlock_PS_NVM_BLOCK_SER_ECU_ID_ReadBlock: start-on-event=ReadBlock, operation=PS_NVM_BLOCK_SER_ECU_ID.ReadBlock
      OIT_ReadBlock_PS_NVM_BLOCK_SER_ENDMODELPN_ReadBlock: start-on-event=ReadBlock, operation=PS_NVM_BLOCK_SER_ENDMODELPN.ReadBlock
      OIT_ReadBlock_PS_NVM_BLOCK_SER_ENDMODELPNAC_ReadBlock: start-on-event=ReadBlock, operation=PS_NVM_BLOCK_SER_ENDMODELPNAC.ReadBlock
      OIT_ReadBlock_PS_NVM_BLOCK_SER_KEY_CPID_ReadBlock: start-on-event=ReadBlock, operation=PS_NVM_BLOCK_SER_KEY_CPID.ReadBlock
      OIT_ReadBlock_PS_NVM_BLOCK_SER_KEY_DEPRECATED_ReadBlock: start-on-event=ReadBlock, operation=PS_NVM_BLOCK_SER_KEY_DEPRECATED.ReadBlock
      OIT_ReadBlock_PS_NVM_BLOCK_SER_KEY_NEXTEER_ReadBlock: start-on-event=ReadBlock, operation=PS_NVM_BLOCK_SER_KEY_NEXTEER.ReadBlock
      OIT_ReadBlock_PS_NVM_BLOCK_SER_KEY_SPS_ReadBlock: start-on-event=ReadBlock, operation=PS_NVM_BLOCK_SER_KEY_SPS.ReadBlock
      OIT_ReadBlock_PS_NVM_BLOCK_SER_MANFTRAC_ReadBlock: start-on-event=ReadBlock, operation=PS_NVM_BLOCK_SER_MANFTRAC.ReadBlock
      OIT_ReadBlock_PS_NVM_BLOCK_SER_PREVREPAIRSHOPCODE_ReadBlock: start-on-event=ReadBlock, operation=PS_NVM_BLOCK_SER_PREVREPAIRSHOPCODE.ReadBlock
      OIT_ReadBlock_PS_NVM_BLOCK_SER_PROGDATE_ReadBlock: start-on-event=ReadBlock, operation=PS_NVM_BLOCK_SER_PROGDATE.ReadBlock
      OIT_ReadBlock_PS_NVM_BLOCK_SER_REPAIRSHOPCODE_ReadBlock: start-on-event=ReadBlock, operation=PS_NVM_BLOCK_SER_REPAIRSHOPCODE.ReadBlock
      OIT_ReadBlock_PS_NVM_BLOCK_SER_SBAT_ReadBlock: start-on-event=ReadBlock, operation=PS_NVM_BLOCK_SER_SBAT.ReadBlock
      OIT_ReadBlock_PS_NVM_BLOCK_SER_SEED_CPID_ReadBlock: start-on-event=ReadBlock, operation=PS_NVM_BLOCK_SER_SEED_CPID.ReadBlock
      OIT_ReadBlock_PS_NVM_BLOCK_SER_SEED_DEPRECATED_ReadBlock: start-on-event=ReadBlock, operation=PS_NVM_BLOCK_SER_SEED_DEPRECATED.ReadBlock
      OIT_ReadBlock_PS_NVM_BLOCK_SER_SEED_NEXTEER_ReadBlock: start-on-event=ReadBlock, operation=PS_NVM_BLOCK_SER_SEED_NEXTEER.ReadBlock
      OIT_ReadBlock_PS_NVM_BLOCK_SER_SEED_SPS_ReadBlock: start-on-event=ReadBlock, operation=PS_NVM_BLOCK_SER_SEED_SPS.ReadBlock
      OIT_ReadBlock_PS_NVM_BLOCK_SER_SYSTEMNAME_ReadBlock: start-on-event=ReadBlock, operation=PS_NVM_BLOCK_SER_SYSTEMNAME.ReadBlock
      OIT_ReadBlock_PS_NVM_BLOCK_SER_SYSVERSCODEDDI_ReadBlock: start-on-event=ReadBlock, operation=PS_NVM_BLOCK_SER_SYSVERSCODEDDI.ReadBlock
      OIT_ReadBlock_PS_NVM_BLOCK_SER_VINDATA_ReadBlock: start-on-event=ReadBlock, operation=PS_NVM_BLOCK_SER_VINDATA.ReadBlock
      OIT_ReadBlock_PS_NVM_BLOCK_STAMD_CLOSECHECK_ReadBlock: start-on-event=ReadBlock, operation=PS_NVM_BLOCK_STAMD_CLOSECHECK.ReadBlock
      OIT_ReadBlock_PS_NVM_BLOCK_STAMD_TYPEH_ReadBlock: start-on-event=ReadBlock, operation=PS_NVM_BLOCK_STAMD_TYPEH.ReadBlock
      OIT_ReadBlock_PS_Rte_NvmBlock_AbsHwPos_EOLVehCntrOffset_ReadBlock: start-on-event=ReadBlock, operation=PS_Rte_NvmBlock_AbsHwPos_EOLVehCntrOffset.ReadBlock
      OIT_ReadBlock_PS_Rte_NvmBlock_Ap_AstLmt_SteerAsstDefeat_ReadBlock: start-on-event=ReadBlock, operation=PS_Rte_NvmBlock_Ap_AstLmt_SteerAsstDefeat.ReadBlock
      OIT_ReadBlock_PS_Rte_NvmBlock_Ap_AvgFricLrn_AvgFricLrnData_ReadBlock: start-on-event=ReadBlock, operation=PS_Rte_NvmBlock_Ap_AvgFricLrn_AvgFricLrnData.ReadBlock
      OIT_ReadBlock_PS_Rte_NvmBlock_Ap_LrnEOT_LearnedEOT_ReadBlock: start-on-event=ReadBlock, operation=PS_Rte_NvmBlock_Ap_LrnEOT_LearnedEOT.ReadBlock
      OIT_ReadBlock_PS_Rte_NvmBlock_Ap_TrqCanc_CogTrqCal_ReadBlock: start-on-event=ReadBlock, operation=PS_Rte_NvmBlock_Ap_TrqCanc_CogTrqCal.ReadBlock
      OIT_ReadBlock_PS_Rte_NvmBlock_Ap_TrqCanc_CogTrqRplComp_ReadBlock: start-on-event=ReadBlock, operation=PS_Rte_NvmBlock_Ap_TrqCanc_CogTrqRplComp.ReadBlock
      OIT_ReadBlock_PS_Rte_NvmBlock_Ap_TSMit_TSMitDisableEOL_ReadBlock: start-on-event=ReadBlock, operation=PS_Rte_NvmBlock_Ap_TSMit_TSMitDisableEOL.ReadBlock
      OIT_ReadBlock_PS_Rte_NvmBlock_Ap_TSMit_TSMitGainLrn_ReadBlock: start-on-event=ReadBlock, operation=PS_Rte_NvmBlock_Ap_TSMit_TSMitGainLrn.ReadBlock
      OIT_ReadBlock_PS_Rte_NvmBlock_BatteryVoltage_OvervoltageData_ReadBlock: start-on-event=ReadBlock, operation=PS_Rte_NvmBlock_BatteryVoltage_OvervoltageData.ReadBlock
      OIT_ReadBlock_PS_Rte_NvmBlock_CmMtrCurr_CurrTempOffset_ReadBlock: start-on-event=ReadBlock, operation=PS_Rte_NvmBlock_CmMtrCurr_CurrTempOffset.ReadBlock
      OIT_ReadBlock_PS_Rte_NvmBlock_CmMtrCurr_ShCurrCal_ReadBlock: start-on-event=ReadBlock, operation=PS_Rte_NvmBlock_CmMtrCurr_ShCurrCal.ReadBlock
      OIT_ReadBlock_PS_Rte_NvmBlock_CurrParamComp_EOLNomMtrParam_ReadBlock: start-on-event=ReadBlock, operation=PS_Rte_NvmBlock_CurrParamComp_EOLNomMtrParam.ReadBlock
      OIT_ReadBlock_PS_Rte_NvmBlock_DigColPs_DigColPsEOL_ReadBlock: start-on-event=ReadBlock, operation=PS_Rte_NvmBlock_DigColPs_DigColPsEOL.ReadBlock
      OIT_ReadBlock_PS_Rte_NvmBlock_Polarity_Polarity_Cnt_Str_ReadBlock: start-on-event=ReadBlock, operation=PS_Rte_NvmBlock_Polarity_Polarity_Cnt_Str.ReadBlock
      OIT_ReadBlock_PS_Rte_NvmBlock_Sa_DigHwTrqSENT_DigTrqTrim_ReadBlock: start-on-event=ReadBlock, operation=PS_Rte_NvmBlock_Sa_DigHwTrqSENT_DigTrqTrim.ReadBlock
      OIT_ReadBlock_PS_Rte_NvmBlock_Sa_DigMSB_DigMSBEOLData_ReadBlock: start-on-event=ReadBlock, operation=PS_Rte_NvmBlock_Sa_DigMSB_DigMSBEOLData.ReadBlock
      OIT_ReadBlock_PS_Rte_NvmBlock_SrlComOutput_DTCTrigSts_ReadBlock: start-on-event=ReadBlock, operation=PS_Rte_NvmBlock_SrlComOutput_DTCTrigSts.ReadBlock
      OIT_ReadBlock_PS_Rte_NvmBlock_TrqCmdScl_TorqueCmdSF_Uls_f32_ReadBlock: start-on-event=ReadBlock, operation=PS_Rte_NvmBlock_TrqCmdScl_TorqueCmdSF_Uls_f32.ReadBlock
      OIT_ReadBlock_PS_Rte_NvmBlock_VehDyn_MotPosReset_ReadBlock: start-on-event=ReadBlock, operation=PS_Rte_NvmBlock_VehDyn_MotPosReset.ReadBlock
      OIT_SetBlockProtection_PAdmin_ConfigBlock_SetBlockProtection: start-on-event=SetBlockProtection, operation=PAdmin_ConfigBlock.SetBlockProtection
      OIT_SetBlockProtection_PAdmin_NVM_BLOCK_CMS_ECUHWPN_SetBlockProtection: start-on-event=SetBlockProtection, operation=PAdmin_NVM_BLOCK_CMS_ECUHWPN.SetBlockProtection
      OIT_SetBlockProtection_PAdmin_NVM_BLOCK_CMS_ECUSRLNUM_SetBlockProtection: start-on-event=SetBlockProtection, operation=PAdmin_NVM_BLOCK_CMS_ECUSRLNUM.SetBlockProtection
      OIT_SetBlockProtection_PAdmin_NVM_BLOCK_CMS_EPSDEFEATS_SetBlockProtection: start-on-event=SetBlockProtection, operation=PAdmin_NVM_BLOCK_CMS_EPSDEFEATS.SetBlockProtection
      OIT_SetBlockProtection_PAdmin_NVM_BLOCK_CMS_EPSSRLNUM_SetBlockProtection: start-on-event=SetBlockProtection, operation=PAdmin_NVM_BLOCK_CMS_EPSSRLNUM.SetBlockProtection
      OIT_SetBlockProtection_PAdmin_NVM_BLOCK_CMS_IGNCNTR_SetBlockProtection: start-on-event=SetBlockProtection, operation=PAdmin_NVM_BLOCK_CMS_IGNCNTR.SetBlockProtection
      OIT_SetBlockProtection_PAdmin_NVM_BLOCK_CMS_NXTRMANUFSCRATCHPAD_SetBlockProtection: start-on-event=SetBlockProtection, operation=PAdmin_NVM_BLOCK_CMS_NXTRMANUFSCRATCHPAD.SetBlockProtection
      OIT_SetBlockProtection_PAdmin_NVM_BLOCK_CMS_NXTRMEC_SetBlockProtection: start-on-event=SetBlockProtection, operation=PAdmin_NVM_BLOCK_CMS_NXTRMEC.SetBlockProtection
      OIT_SetBlockProtection_PAdmin_NVM_BLOCK_CMS_NXTRMECFLAG_SetBlockProtection: start-on-event=SetBlockProtection, operation=PAdmin_NVM_BLOCK_CMS_NXTRMECFLAG.SetBlockProtection
      OIT_SetBlockProtection_PAdmin_NVM_BLOCK_CMS_NXTRWIRSELECT_SetBlockProtection: start-on-event=SetBlockProtection, operation=PAdmin_NVM_BLOCK_CMS_NXTRWIRSELECT.SetBlockProtection
      OIT_SetBlockProtection_PAdmin_NVM_BLOCK_DIAGMGR_BLACKBOX_SetBlockProtection: start-on-event=SetBlockProtection, operation=PAdmin_NVM_BLOCK_DIAGMGR_BLACKBOX.SetBlockProtection
      OIT_SetBlockProtection_PAdmin_NVM_BLOCK_DIAGMGR_NTCSTRG_SetBlockProtection: start-on-event=SetBlockProtection, operation=PAdmin_NVM_BLOCK_DIAGMGR_NTCSTRG.SetBlockProtection
      OIT_SetBlockProtection_PAdmin_NVM_BLOCK_SER_APP_NBID_SetBlockProtection: start-on-event=SetBlockProtection, operation=PAdmin_NVM_BLOCK_SER_APP_NBID.SetBlockProtection
      OIT_SetBlockProtection_PAdmin_NVM_BLOCK_SER_BASEMODELPN_SetBlockProtection: start-on-event=SetBlockProtection, operation=PAdmin_NVM_BLOCK_SER_BASEMODELPN.SetBlockProtection
      OIT_SetBlockProtection_PAdmin_NVM_BLOCK_SER_BASEMODELPNAC_SetBlockProtection: start-on-event=SetBlockProtection, operation=PAdmin_NVM_BLOCK_SER_BASEMODELPNAC.SetBlockProtection
      OIT_SetBlockProtection_PAdmin_NVM_BLOCK_SER_BCID_SetBlockProtection: start-on-event=SetBlockProtection, operation=PAdmin_NVM_BLOCK_SER_BCID.SetBlockProtection
      OIT_SetBlockProtection_PAdmin_NVM_BLOCK_SER_CALPRGFLAG_SetBlockProtection: start-on-event=SetBlockProtection, operation=PAdmin_NVM_BLOCK_SER_CALPRGFLAG.SetBlockProtection
      OIT_SetBlockProtection_PAdmin_NVM_BLOCK_SER_CUSTMEC_SetBlockProtection: start-on-event=SetBlockProtection, operation=PAdmin_NVM_BLOCK_SER_CUSTMEC.SetBlockProtection
      OIT_SetBlockProtection_PAdmin_NVM_BLOCK_SER_DATAUNIVNUMSYSID_SetBlockProtection: start-on-event=SetBlockProtection, operation=PAdmin_NVM_BLOCK_SER_DATAUNIVNUMSYSID.SetBlockProtection
      OIT_SetBlockProtection_PAdmin_NVM_BLOCK_SER_ECU_ID_SetBlockProtection: start-on-event=SetBlockProtection, operation=PAdmin_NVM_BLOCK_SER_ECU_ID.SetBlockProtection
      OIT_SetBlockProtection_PAdmin_NVM_BLOCK_SER_ENDMODELPN_SetBlockProtection: start-on-event=SetBlockProtection, operation=PAdmin_NVM_BLOCK_SER_ENDMODELPN.SetBlockProtection
      OIT_SetBlockProtection_PAdmin_NVM_BLOCK_SER_ENDMODELPNAC_SetBlockProtection: start-on-event=SetBlockProtection, operation=PAdmin_NVM_BLOCK_SER_ENDMODELPNAC.SetBlockProtection
      OIT_SetBlockProtection_PAdmin_NVM_BLOCK_SER_KEY_CPID_SetBlockProtection: start-on-event=SetBlockProtection, operation=PAdmin_NVM_BLOCK_SER_KEY_CPID.SetBlockProtection
      OIT_SetBlockProtection_PAdmin_NVM_BLOCK_SER_KEY_DEPRECATED_SetBlockProtection: start-on-event=SetBlockProtection, operation=PAdmin_NVM_BLOCK_SER_KEY_DEPRECATED.SetBlockProtection
      OIT_SetBlockProtection_PAdmin_NVM_BLOCK_SER_KEY_NEXTEER_SetBlockProtection: start-on-event=SetBlockProtection, operation=PAdmin_NVM_BLOCK_SER_KEY_NEXTEER.SetBlockProtection
      OIT_SetBlockProtection_PAdmin_NVM_BLOCK_SER_KEY_SPS_SetBlockProtection: start-on-event=SetBlockProtection, operation=PAdmin_NVM_BLOCK_SER_KEY_SPS.SetBlockProtection
      OIT_SetBlockProtection_PAdmin_NVM_BLOCK_SER_MANFTRAC_SetBlockProtection: start-on-event=SetBlockProtection, operation=PAdmin_NVM_BLOCK_SER_MANFTRAC.SetBlockProtection
      OIT_SetBlockProtection_PAdmin_NVM_BLOCK_SER_PREVREPAIRSHOPCODE_SetBlockProtection: start-on-event=SetBlockProtection, operation=PAdmin_NVM_BLOCK_SER_PREVREPAIRSHOPCODE.SetBlockProtection
      OIT_SetBlockProtection_PAdmin_NVM_BLOCK_SER_PROGDATE_SetBlockProtection: start-on-event=SetBlockProtection, operation=PAdmin_NVM_BLOCK_SER_PROGDATE.SetBlockProtection
      OIT_SetBlockProtection_PAdmin_NVM_BLOCK_SER_REPAIRSHOPCODE_SetBlockProtection: start-on-event=SetBlockProtection, operation=PAdmin_NVM_BLOCK_SER_REPAIRSHOPCODE.SetBlockProtection
      OIT_SetBlockProtection_PAdmin_NVM_BLOCK_SER_SBAT_SetBlockProtection: start-on-event=SetBlockProtection, operation=PAdmin_NVM_BLOCK_SER_SBAT.SetBlockProtection
      OIT_SetBlockProtection_PAdmin_NVM_BLOCK_SER_SEED_CPID_SetBlockProtection: start-on-event=SetBlockProtection, operation=PAdmin_NVM_BLOCK_SER_SEED_CPID.SetBlockProtection
      OIT_SetBlockProtection_PAdmin_NVM_BLOCK_SER_SEED_DEPRECATED_SetBlockProtection: start-on-event=SetBlockProtection, operation=PAdmin_NVM_BLOCK_SER_SEED_DEPRECATED.SetBlockProtection
      OIT_SetBlockProtection_PAdmin_NVM_BLOCK_SER_SEED_NEXTEER_SetBlockProtection: start-on-event=SetBlockProtection, operation=PAdmin_NVM_BLOCK_SER_SEED_NEXTEER.SetBlockProtection
      OIT_SetBlockProtection_PAdmin_NVM_BLOCK_SER_SEED_SPS_SetBlockProtection: start-on-event=SetBlockProtection, operation=PAdmin_NVM_BLOCK_SER_SEED_SPS.SetBlockProtection
      OIT_SetBlockProtection_PAdmin_NVM_BLOCK_SER_SYSTEMNAME_SetBlockProtection: start-on-event=SetBlockProtection, operation=PAdmin_NVM_BLOCK_SER_SYSTEMNAME.SetBlockProtection
      OIT_SetBlockProtection_PAdmin_NVM_BLOCK_SER_SYSVERSCODEDDI_SetBlockProtection: start-on-event=SetBlockProtection, operation=PAdmin_NVM_BLOCK_SER_SYSVERSCODEDDI.SetBlockProtection
      OIT_SetBlockProtection_PAdmin_NVM_BLOCK_SER_VINDATA_SetBlockProtection: start-on-event=SetBlockProtection, operation=PAdmin_NVM_BLOCK_SER_VINDATA.SetBlockProtection
      OIT_SetBlockProtection_PAdmin_NVM_BLOCK_STAMD_CLOSECHECK_SetBlockProtection: start-on-event=SetBlockProtection, operation=PAdmin_NVM_BLOCK_STAMD_CLOSECHECK.SetBlockProtection
      OIT_SetBlockProtection_PAdmin_NVM_BLOCK_STAMD_TYPEH_SetBlockProtection: start-on-event=SetBlockProtection, operation=PAdmin_NVM_BLOCK_STAMD_TYPEH.SetBlockProtection
      OIT_SetBlockProtection_PAdmin_Rte_NvmBlock_AbsHwPos_EOLVehCntrOffset_SetBlockProtection: start-on-event=SetBlockProtection, operation=PAdmin_Rte_NvmBlock_AbsHwPos_EOLVehCntrOffset.SetBlockProtection
      OIT_SetBlockProtection_PAdmin_Rte_NvmBlock_Ap_AstLmt_SteerAsstDefeat_SetBlockProtection: start-on-event=SetBlockProtection, operation=PAdmin_Rte_NvmBlock_Ap_AstLmt_SteerAsstDefeat.SetBlockProtection
      OIT_SetBlockProtection_PAdmin_Rte_NvmBlock_Ap_AvgFricLrn_AvgFricLrnData_SetBlockProtection: start-on-event=SetBlockProtection, operation=PAdmin_Rte_NvmBlock_Ap_AvgFricLrn_AvgFricLrnData.SetBlockProtection
      OIT_SetBlockProtection_PAdmin_Rte_NvmBlock_Ap_LrnEOT_LearnedEOT_SetBlockProtection: start-on-event=SetBlockProtection, operation=PAdmin_Rte_NvmBlock_Ap_LrnEOT_LearnedEOT.SetBlockProtection
      OIT_SetBlockProtection_PAdmin_Rte_NvmBlock_Ap_TrqCanc_CogTrqCal_SetBlockProtection: start-on-event=SetBlockProtection, operation=PAdmin_Rte_NvmBlock_Ap_TrqCanc_CogTrqCal.SetBlockProtection
      OIT_SetBlockProtection_PAdmin_Rte_NvmBlock_Ap_TrqCanc_CogTrqRplComp_SetBlockProtection: start-on-event=SetBlockProtection, operation=PAdmin_Rte_NvmBlock_Ap_TrqCanc_CogTrqRplComp.SetBlockProtection
      OIT_SetBlockProtection_PAdmin_Rte_NvmBlock_Ap_TSMit_TSMitDisableEOL_SetBlockProtection: start-on-event=SetBlockProtection, operation=PAdmin_Rte_NvmBlock_Ap_TSMit_TSMitDisableEOL.SetBlockProtection
      OIT_SetBlockProtection_PAdmin_Rte_NvmBlock_Ap_TSMit_TSMitGainLrn_SetBlockProtection: start-on-event=SetBlockProtection, operation=PAdmin_Rte_NvmBlock_Ap_TSMit_TSMitGainLrn.SetBlockProtection
      OIT_SetBlockProtection_PAdmin_Rte_NvmBlock_BatteryVoltage_OvervoltageData_SetBlockProtection: start-on-event=SetBlockProtection, operation=PAdmin_Rte_NvmBlock_BatteryVoltage_OvervoltageData.SetBlockProtection
      OIT_SetBlockProtection_PAdmin_Rte_NvmBlock_CmMtrCurr_CurrTempOffset_SetBlockProtection: start-on-event=SetBlockProtection, operation=PAdmin_Rte_NvmBlock_CmMtrCurr_CurrTempOffset.SetBlockProtection
      OIT_SetBlockProtection_PAdmin_Rte_NvmBlock_CmMtrCurr_ShCurrCal_SetBlockProtection: start-on-event=SetBlockProtection, operation=PAdmin_Rte_NvmBlock_CmMtrCurr_ShCurrCal.SetBlockProtection
      OIT_SetBlockProtection_PAdmin_Rte_NvmBlock_CurrParamComp_EOLNomMtrParam_SetBlockProtection: start-on-event=SetBlockProtection, operation=PAdmin_Rte_NvmBlock_CurrParamComp_EOLNomMtrParam.SetBlockProtection
      OIT_SetBlockProtection_PAdmin_Rte_NvmBlock_DigColPs_DigColPsEOL_SetBlockProtection: start-on-event=SetBlockProtection, operation=PAdmin_Rte_NvmBlock_DigColPs_DigColPsEOL.SetBlockProtection
      OIT_SetBlockProtection_PAdmin_Rte_NvmBlock_Polarity_Polarity_Cnt_Str_SetBlockProtection: start-on-event=SetBlockProtection, operation=PAdmin_Rte_NvmBlock_Polarity_Polarity_Cnt_Str.SetBlockProtection
      OIT_SetBlockProtection_PAdmin_Rte_NvmBlock_Sa_DigHwTrqSENT_DigTrqTrim_SetBlockProtection: start-on-event=SetBlockProtection, operation=PAdmin_Rte_NvmBlock_Sa_DigHwTrqSENT_DigTrqTrim.SetBlockProtection
      OIT_SetBlockProtection_PAdmin_Rte_NvmBlock_Sa_DigMSB_DigMSBEOLData_SetBlockProtection: start-on-event=SetBlockProtection, operation=PAdmin_Rte_NvmBlock_Sa_DigMSB_DigMSBEOLData.SetBlockProtection
      OIT_SetBlockProtection_PAdmin_Rte_NvmBlock_SrlComOutput_DTCTrigSts_SetBlockProtection: start-on-event=SetBlockProtection, operation=PAdmin_Rte_NvmBlock_SrlComOutput_DTCTrigSts.SetBlockProtection
      OIT_SetBlockProtection_PAdmin_Rte_NvmBlock_TrqCmdScl_TorqueCmdSF_Uls_f32_SetBlockProtection: start-on-event=SetBlockProtection, operation=PAdmin_Rte_NvmBlock_TrqCmdScl_TorqueCmdSF_Uls_f32.SetBlockProtection
      OIT_SetBlockProtection_PAdmin_Rte_NvmBlock_VehDyn_MotPosReset_SetBlockProtection: start-on-event=SetBlockProtection, operation=PAdmin_Rte_NvmBlock_VehDyn_MotPosReset.SetBlockProtection
      OIT_SetRamBlockStatus_PS_ConfigBlock_SetRamBlockStatus: start-on-event=SetRamBlockStatus, operation=PS_ConfigBlock.SetRamBlockStatus
      OIT_SetRamBlockStatus_PS_NVM_BLOCK_CMS_ECUHWPN_SetRamBlockStatus: start-on-event=SetRamBlockStatus, operation=PS_NVM_BLOCK_CMS_ECUHWPN.SetRamBlockStatus
      OIT_SetRamBlockStatus_PS_NVM_BLOCK_CMS_ECUSRLNUM_SetRamBlockStatus: start-on-event=SetRamBlockStatus, operation=PS_NVM_BLOCK_CMS_ECUSRLNUM.SetRamBlockStatus
      OIT_SetRamBlockStatus_PS_NVM_BLOCK_CMS_EPSDEFEATS_SetRamBlockStatus: start-on-event=SetRamBlockStatus, operation=PS_NVM_BLOCK_CMS_EPSDEFEATS.SetRamBlockStatus
      OIT_SetRamBlockStatus_PS_NVM_BLOCK_CMS_EPSSRLNUM_SetRamBlockStatus: start-on-event=SetRamBlockStatus, operation=PS_NVM_BLOCK_CMS_EPSSRLNUM.SetRamBlockStatus
      OIT_SetRamBlockStatus_PS_NVM_BLOCK_CMS_IGNCNTR_SetRamBlockStatus: start-on-event=SetRamBlockStatus, operation=PS_NVM_BLOCK_CMS_IGNCNTR.SetRamBlockStatus
      OIT_SetRamBlockStatus_PS_NVM_BLOCK_CMS_NXTRMANUFSCRATCHPAD_SetRamBlockStatus: start-on-event=SetRamBlockStatus, operation=PS_NVM_BLOCK_CMS_NXTRMANUFSCRATCHPAD.SetRamBlockStatus
      OIT_SetRamBlockStatus_PS_NVM_BLOCK_CMS_NXTRMEC_SetRamBlockStatus: start-on-event=SetRamBlockStatus, operation=PS_NVM_BLOCK_CMS_NXTRMEC.SetRamBlockStatus
      OIT_SetRamBlockStatus_PS_NVM_BLOCK_CMS_NXTRMECFLAG_SetRamBlockStatus: start-on-event=SetRamBlockStatus, operation=PS_NVM_BLOCK_CMS_NXTRMECFLAG.SetRamBlockStatus
      OIT_SetRamBlockStatus_PS_NVM_BLOCK_CMS_NXTRWIRSELECT_SetRamBlockStatus: start-on-event=SetRamBlockStatus, operation=PS_NVM_BLOCK_CMS_NXTRWIRSELECT.SetRamBlockStatus
      OIT_SetRamBlockStatus_PS_NVM_BLOCK_DIAGMGR_BLACKBOX_SetRamBlockStatus: start-on-event=SetRamBlockStatus, operation=PS_NVM_BLOCK_DIAGMGR_BLACKBOX.SetRamBlockStatus
      OIT_SetRamBlockStatus_PS_NVM_BLOCK_DIAGMGR_NTCSTRG_SetRamBlockStatus: start-on-event=SetRamBlockStatus, operation=PS_NVM_BLOCK_DIAGMGR_NTCSTRG.SetRamBlockStatus
      OIT_SetRamBlockStatus_PS_NVM_BLOCK_SER_APP_NBID_SetRamBlockStatus: start-on-event=SetRamBlockStatus, operation=PS_NVM_BLOCK_SER_APP_NBID.SetRamBlockStatus
      OIT_SetRamBlockStatus_PS_NVM_BLOCK_SER_BASEMODELPN_SetRamBlockStatus: start-on-event=SetRamBlockStatus, operation=PS_NVM_BLOCK_SER_BASEMODELPN.SetRamBlockStatus
      OIT_SetRamBlockStatus_PS_NVM_BLOCK_SER_BASEMODELPNAC_SetRamBlockStatus: start-on-event=SetRamBlockStatus, operation=PS_NVM_BLOCK_SER_BASEMODELPNAC.SetRamBlockStatus
      OIT_SetRamBlockStatus_PS_NVM_BLOCK_SER_BCID_SetRamBlockStatus: start-on-event=SetRamBlockStatus, operation=PS_NVM_BLOCK_SER_BCID.SetRamBlockStatus
      OIT_SetRamBlockStatus_PS_NVM_BLOCK_SER_CALPRGFLAG_SetRamBlockStatus: start-on-event=SetRamBlockStatus, operation=PS_NVM_BLOCK_SER_CALPRGFLAG.SetRamBlockStatus
      OIT_SetRamBlockStatus_PS_NVM_BLOCK_SER_CUSTMEC_SetRamBlockStatus: start-on-event=SetRamBlockStatus, operation=PS_NVM_BLOCK_SER_CUSTMEC.SetRamBlockStatus
      OIT_SetRamBlockStatus_PS_NVM_BLOCK_SER_DATAUNIVNUMSYSID_SetRamBlockStatus: start-on-event=SetRamBlockStatus, operation=PS_NVM_BLOCK_SER_DATAUNIVNUMSYSID.SetRamBlockStatus
      OIT_SetRamBlockStatus_PS_NVM_BLOCK_SER_ECU_ID_SetRamBlockStatus: start-on-event=SetRamBlockStatus, operation=PS_NVM_BLOCK_SER_ECU_ID.SetRamBlockStatus
      OIT_SetRamBlockStatus_PS_NVM_BLOCK_SER_ENDMODELPN_SetRamBlockStatus: start-on-event=SetRamBlockStatus, operation=PS_NVM_BLOCK_SER_ENDMODELPN.SetRamBlockStatus
      OIT_SetRamBlockStatus_PS_NVM_BLOCK_SER_ENDMODELPNAC_SetRamBlockStatus: start-on-event=SetRamBlockStatus, operation=PS_NVM_BLOCK_SER_ENDMODELPNAC.SetRamBlockStatus
      OIT_SetRamBlockStatus_PS_NVM_BLOCK_SER_KEY_CPID_SetRamBlockStatus: start-on-event=SetRamBlockStatus, operation=PS_NVM_BLOCK_SER_KEY_CPID.SetRamBlockStatus
      OIT_SetRamBlockStatus_PS_NVM_BLOCK_SER_KEY_DEPRECATED_SetRamBlockStatus: start-on-event=SetRamBlockStatus, operation=PS_NVM_BLOCK_SER_KEY_DEPRECATED.SetRamBlockStatus
      OIT_SetRamBlockStatus_PS_NVM_BLOCK_SER_KEY_NEXTEER_SetRamBlockStatus: start-on-event=SetRamBlockStatus, operation=PS_NVM_BLOCK_SER_KEY_NEXTEER.SetRamBlockStatus
      OIT_SetRamBlockStatus_PS_NVM_BLOCK_SER_KEY_SPS_SetRamBlockStatus: start-on-event=SetRamBlockStatus, operation=PS_NVM_BLOCK_SER_KEY_SPS.SetRamBlockStatus
      OIT_SetRamBlockStatus_PS_NVM_BLOCK_SER_MANFTRAC_SetRamBlockStatus: start-on-event=SetRamBlockStatus, operation=PS_NVM_BLOCK_SER_MANFTRAC.SetRamBlockStatus
      OIT_SetRamBlockStatus_PS_NVM_BLOCK_SER_PREVREPAIRSHOPCODE_SetRamBlockStatus: start-on-event=SetRamBlockStatus, operation=PS_NVM_BLOCK_SER_PREVREPAIRSHOPCODE.SetRamBlockStatus
      OIT_SetRamBlockStatus_PS_NVM_BLOCK_SER_PROGDATE_SetRamBlockStatus: start-on-event=SetRamBlockStatus, operation=PS_NVM_BLOCK_SER_PROGDATE.SetRamBlockStatus
      OIT_SetRamBlockStatus_PS_NVM_BLOCK_SER_REPAIRSHOPCODE_SetRamBlockStatus: start-on-event=SetRamBlockStatus, operation=PS_NVM_BLOCK_SER_REPAIRSHOPCODE.SetRamBlockStatus
      OIT_SetRamBlockStatus_PS_NVM_BLOCK_SER_SBAT_SetRamBlockStatus: start-on-event=SetRamBlockStatus, operation=PS_NVM_BLOCK_SER_SBAT.SetRamBlockStatus
      OIT_SetRamBlockStatus_PS_NVM_BLOCK_SER_SEED_CPID_SetRamBlockStatus: start-on-event=SetRamBlockStatus, operation=PS_NVM_BLOCK_SER_SEED_CPID.SetRamBlockStatus
      OIT_SetRamBlockStatus_PS_NVM_BLOCK_SER_SEED_DEPRECATED_SetRamBlockStatus: start-on-event=SetRamBlockStatus, operation=PS_NVM_BLOCK_SER_SEED_DEPRECATED.SetRamBlockStatus
      OIT_SetRamBlockStatus_PS_NVM_BLOCK_SER_SEED_NEXTEER_SetRamBlockStatus: start-on-event=SetRamBlockStatus, operation=PS_NVM_BLOCK_SER_SEED_NEXTEER.SetRamBlockStatus
      OIT_SetRamBlockStatus_PS_NVM_BLOCK_SER_SEED_SPS_SetRamBlockStatus: start-on-event=SetRamBlockStatus, operation=PS_NVM_BLOCK_SER_SEED_SPS.SetRamBlockStatus
      OIT_SetRamBlockStatus_PS_NVM_BLOCK_SER_SYSTEMNAME_SetRamBlockStatus: start-on-event=SetRamBlockStatus, operation=PS_NVM_BLOCK_SER_SYSTEMNAME.SetRamBlockStatus
      OIT_SetRamBlockStatus_PS_NVM_BLOCK_SER_SYSVERSCODEDDI_SetRamBlockStatus: start-on-event=SetRamBlockStatus, operation=PS_NVM_BLOCK_SER_SYSVERSCODEDDI.SetRamBlockStatus
      OIT_SetRamBlockStatus_PS_NVM_BLOCK_SER_VINDATA_SetRamBlockStatus: start-on-event=SetRamBlockStatus, operation=PS_NVM_BLOCK_SER_VINDATA.SetRamBlockStatus
      OIT_SetRamBlockStatus_PS_NVM_BLOCK_STAMD_CLOSECHECK_SetRamBlockStatus: start-on-event=SetRamBlockStatus, operation=PS_NVM_BLOCK_STAMD_CLOSECHECK.SetRamBlockStatus
      OIT_SetRamBlockStatus_PS_NVM_BLOCK_STAMD_TYPEH_SetRamBlockStatus: start-on-event=SetRamBlockStatus, operation=PS_NVM_BLOCK_STAMD_TYPEH.SetRamBlockStatus
      OIT_SetRamBlockStatus_PS_Rte_NvmBlock_AbsHwPos_EOLVehCntrOffset_SetRamBlockStatus: start-on-event=SetRamBlockStatus, operation=PS_Rte_NvmBlock_AbsHwPos_EOLVehCntrOffset.SetRamBlockStatus
      OIT_SetRamBlockStatus_PS_Rte_NvmBlock_Ap_AstLmt_SteerAsstDefeat_SetRamBlockStatus: start-on-event=SetRamBlockStatus, operation=PS_Rte_NvmBlock_Ap_AstLmt_SteerAsstDefeat.SetRamBlockStatus
      OIT_SetRamBlockStatus_PS_Rte_NvmBlock_Ap_AvgFricLrn_AvgFricLrnData_SetRamBlockStatus: start-on-event=SetRamBlockStatus, operation=PS_Rte_NvmBlock_Ap_AvgFricLrn_AvgFricLrnData.SetRamBlockStatus
      OIT_SetRamBlockStatus_PS_Rte_NvmBlock_Ap_LrnEOT_LearnedEOT_SetRamBlockStatus: start-on-event=SetRamBlockStatus, operation=PS_Rte_NvmBlock_Ap_LrnEOT_LearnedEOT.SetRamBlockStatus
      OIT_SetRamBlockStatus_PS_Rte_NvmBlock_Ap_TrqCanc_CogTrqCal_SetRamBlockStatus: start-on-event=SetRamBlockStatus, operation=PS_Rte_NvmBlock_Ap_TrqCanc_CogTrqCal.SetRamBlockStatus
      OIT_SetRamBlockStatus_PS_Rte_NvmBlock_Ap_TrqCanc_CogTrqRplComp_SetRamBlockStatus: start-on-event=SetRamBlockStatus, operation=PS_Rte_NvmBlock_Ap_TrqCanc_CogTrqRplComp.SetRamBlockStatus
      OIT_SetRamBlockStatus_PS_Rte_NvmBlock_Ap_TSMit_TSMitDisableEOL_SetRamBlockStatus: start-on-event=SetRamBlockStatus, operation=PS_Rte_NvmBlock_Ap_TSMit_TSMitDisableEOL.SetRamBlockStatus
      OIT_SetRamBlockStatus_PS_Rte_NvmBlock_Ap_TSMit_TSMitGainLrn_SetRamBlockStatus: start-on-event=SetRamBlockStatus, operation=PS_Rte_NvmBlock_Ap_TSMit_TSMitGainLrn.SetRamBlockStatus
      OIT_SetRamBlockStatus_PS_Rte_NvmBlock_BatteryVoltage_OvervoltageData_SetRamBlockStatus: start-on-event=SetRamBlockStatus, operation=PS_Rte_NvmBlock_BatteryVoltage_OvervoltageData.SetRamBlockStatus
      OIT_SetRamBlockStatus_PS_Rte_NvmBlock_CmMtrCurr_CurrTempOffset_SetRamBlockStatus: start-on-event=SetRamBlockStatus, operation=PS_Rte_NvmBlock_CmMtrCurr_CurrTempOffset.SetRamBlockStatus
      OIT_SetRamBlockStatus_PS_Rte_NvmBlock_CmMtrCurr_ShCurrCal_SetRamBlockStatus: start-on-event=SetRamBlockStatus, operation=PS_Rte_NvmBlock_CmMtrCurr_ShCurrCal.SetRamBlockStatus
      OIT_SetRamBlockStatus_PS_Rte_NvmBlock_CurrParamComp_EOLNomMtrParam_SetRamBlockStatus: start-on-event=SetRamBlockStatus, operation=PS_Rte_NvmBlock_CurrParamComp_EOLNomMtrParam.SetRamBlockStatus
      OIT_SetRamBlockStatus_PS_Rte_NvmBlock_DigColPs_DigColPsEOL_SetRamBlockStatus: start-on-event=SetRamBlockStatus, operation=PS_Rte_NvmBlock_DigColPs_DigColPsEOL.SetRamBlockStatus
      OIT_SetRamBlockStatus_PS_Rte_NvmBlock_Polarity_Polarity_Cnt_Str_SetRamBlockStatus: start-on-event=SetRamBlockStatus, operation=PS_Rte_NvmBlock_Polarity_Polarity_Cnt_Str.SetRamBlockStatus
      OIT_SetRamBlockStatus_PS_Rte_NvmBlock_Sa_DigHwTrqSENT_DigTrqTrim_SetRamBlockStatus: start-on-event=SetRamBlockStatus, operation=PS_Rte_NvmBlock_Sa_DigHwTrqSENT_DigTrqTrim.SetRamBlockStatus
      OIT_SetRamBlockStatus_PS_Rte_NvmBlock_Sa_DigMSB_DigMSBEOLData_SetRamBlockStatus: start-on-event=SetRamBlockStatus, operation=PS_Rte_NvmBlock_Sa_DigMSB_DigMSBEOLData.SetRamBlockStatus
      OIT_SetRamBlockStatus_PS_Rte_NvmBlock_SrlComOutput_DTCTrigSts_SetRamBlockStatus: start-on-event=SetRamBlockStatus, operation=PS_Rte_NvmBlock_SrlComOutput_DTCTrigSts.SetRamBlockStatus
      OIT_SetRamBlockStatus_PS_Rte_NvmBlock_TrqCmdScl_TorqueCmdSF_Uls_f32_SetRamBlockStatus: start-on-event=SetRamBlockStatus, operation=PS_Rte_NvmBlock_TrqCmdScl_TorqueCmdSF_Uls_f32.SetRamBlockStatus
      OIT_SetRamBlockStatus_PS_Rte_NvmBlock_VehDyn_MotPosReset_SetRamBlockStatus: start-on-event=SetRamBlockStatus, operation=PS_Rte_NvmBlock_VehDyn_MotPosReset.SetRamBlockStatus
      OIT_WriteBlock_PS_ConfigBlock_WriteBlock: start-on-event=WriteBlock, operation=PS_ConfigBlock.WriteBlock
      OIT_WriteBlock_PS_NVM_BLOCK_CMS_ECUHWPN_WriteBlock: start-on-event=WriteBlock, operation=PS_NVM_BLOCK_CMS_ECUHWPN.WriteBlock
      OIT_WriteBlock_PS_NVM_BLOCK_CMS_ECUSRLNUM_WriteBlock: start-on-event=WriteBlock, operation=PS_NVM_BLOCK_CMS_ECUSRLNUM.WriteBlock
      OIT_WriteBlock_PS_NVM_BLOCK_CMS_EPSDEFEATS_WriteBlock: start-on-event=WriteBlock, operation=PS_NVM_BLOCK_CMS_EPSDEFEATS.WriteBlock
      OIT_WriteBlock_PS_NVM_BLOCK_CMS_EPSSRLNUM_WriteBlock: start-on-event=WriteBlock, operation=PS_NVM_BLOCK_CMS_EPSSRLNUM.WriteBlock
      OIT_WriteBlock_PS_NVM_BLOCK_CMS_IGNCNTR_WriteBlock: start-on-event=WriteBlock, operation=PS_NVM_BLOCK_CMS_IGNCNTR.WriteBlock
      OIT_WriteBlock_PS_NVM_BLOCK_CMS_NXTRMANUFSCRATCHPAD_WriteBlock: start-on-event=WriteBlock, operation=PS_NVM_BLOCK_CMS_NXTRMANUFSCRATCHPAD.WriteBlock
      OIT_WriteBlock_PS_NVM_BLOCK_CMS_NXTRMEC_WriteBlock: start-on-event=WriteBlock, operation=PS_NVM_BLOCK_CMS_NXTRMEC.WriteBlock
      OIT_WriteBlock_PS_NVM_BLOCK_CMS_NXTRMECFLAG_WriteBlock: start-on-event=WriteBlock, operation=PS_NVM_BLOCK_CMS_NXTRMECFLAG.WriteBlock
      OIT_WriteBlock_PS_NVM_BLOCK_CMS_NXTRWIRSELECT_WriteBlock: start-on-event=WriteBlock, operation=PS_NVM_BLOCK_CMS_NXTRWIRSELECT.WriteBlock
      OIT_WriteBlock_PS_NVM_BLOCK_DIAGMGR_BLACKBOX_WriteBlock: start-on-event=WriteBlock, operation=PS_NVM_BLOCK_DIAGMGR_BLACKBOX.WriteBlock
      OIT_WriteBlock_PS_NVM_BLOCK_DIAGMGR_NTCSTRG_WriteBlock: start-on-event=WriteBlock, operation=PS_NVM_BLOCK_DIAGMGR_NTCSTRG.WriteBlock
      OIT_WriteBlock_PS_NVM_BLOCK_SER_APP_NBID_WriteBlock: start-on-event=WriteBlock, operation=PS_NVM_BLOCK_SER_APP_NBID.WriteBlock
      OIT_WriteBlock_PS_NVM_BLOCK_SER_BASEMODELPN_WriteBlock: start-on-event=WriteBlock, operation=PS_NVM_BLOCK_SER_BASEMODELPN.WriteBlock
      OIT_WriteBlock_PS_NVM_BLOCK_SER_BASEMODELPNAC_WriteBlock: start-on-event=WriteBlock, operation=PS_NVM_BLOCK_SER_BASEMODELPNAC.WriteBlock
      OIT_WriteBlock_PS_NVM_BLOCK_SER_BCID_WriteBlock: start-on-event=WriteBlock, operation=PS_NVM_BLOCK_SER_BCID.WriteBlock
      OIT_WriteBlock_PS_NVM_BLOCK_SER_CALPRGFLAG_WriteBlock: start-on-event=WriteBlock, operation=PS_NVM_BLOCK_SER_CALPRGFLAG.WriteBlock
      OIT_WriteBlock_PS_NVM_BLOCK_SER_CUSTMEC_WriteBlock: start-on-event=WriteBlock, operation=PS_NVM_BLOCK_SER_CUSTMEC.WriteBlock
      OIT_WriteBlock_PS_NVM_BLOCK_SER_DATAUNIVNUMSYSID_WriteBlock: start-on-event=WriteBlock, operation=PS_NVM_BLOCK_SER_DATAUNIVNUMSYSID.WriteBlock
      OIT_WriteBlock_PS_NVM_BLOCK_SER_ECU_ID_WriteBlock: start-on-event=WriteBlock, operation=PS_NVM_BLOCK_SER_ECU_ID.WriteBlock
      OIT_WriteBlock_PS_NVM_BLOCK_SER_ENDMODELPN_WriteBlock: start-on-event=WriteBlock, operation=PS_NVM_BLOCK_SER_ENDMODELPN.WriteBlock
      OIT_WriteBlock_PS_NVM_BLOCK_SER_ENDMODELPNAC_WriteBlock: start-on-event=WriteBlock, operation=PS_NVM_BLOCK_SER_ENDMODELPNAC.WriteBlock
      OIT_WriteBlock_PS_NVM_BLOCK_SER_KEY_CPID_WriteBlock: start-on-event=WriteBlock, operation=PS_NVM_BLOCK_SER_KEY_CPID.WriteBlock
      OIT_WriteBlock_PS_NVM_BLOCK_SER_KEY_DEPRECATED_WriteBlock: start-on-event=WriteBlock, operation=PS_NVM_BLOCK_SER_KEY_DEPRECATED.WriteBlock
      OIT_WriteBlock_PS_NVM_BLOCK_SER_KEY_NEXTEER_WriteBlock: start-on-event=WriteBlock, operation=PS_NVM_BLOCK_SER_KEY_NEXTEER.WriteBlock
      OIT_WriteBlock_PS_NVM_BLOCK_SER_KEY_SPS_WriteBlock: start-on-event=WriteBlock, operation=PS_NVM_BLOCK_SER_KEY_SPS.WriteBlock
      OIT_WriteBlock_PS_NVM_BLOCK_SER_MANFTRAC_WriteBlock: start-on-event=WriteBlock, operation=PS_NVM_BLOCK_SER_MANFTRAC.WriteBlock
      OIT_WriteBlock_PS_NVM_BLOCK_SER_PREVREPAIRSHOPCODE_WriteBlock: start-on-event=WriteBlock, operation=PS_NVM_BLOCK_SER_PREVREPAIRSHOPCODE.WriteBlock
      OIT_WriteBlock_PS_NVM_BLOCK_SER_PROGDATE_WriteBlock: start-on-event=WriteBlock, operation=PS_NVM_BLOCK_SER_PROGDATE.WriteBlock
      OIT_WriteBlock_PS_NVM_BLOCK_SER_REPAIRSHOPCODE_WriteBlock: start-on-event=WriteBlock, operation=PS_NVM_BLOCK_SER_REPAIRSHOPCODE.WriteBlock
      OIT_WriteBlock_PS_NVM_BLOCK_SER_SBAT_WriteBlock: start-on-event=WriteBlock, operation=PS_NVM_BLOCK_SER_SBAT.WriteBlock
      OIT_WriteBlock_PS_NVM_BLOCK_SER_SEED_CPID_WriteBlock: start-on-event=WriteBlock, operation=PS_NVM_BLOCK_SER_SEED_CPID.WriteBlock
      OIT_WriteBlock_PS_NVM_BLOCK_SER_SEED_DEPRECATED_WriteBlock: start-on-event=WriteBlock, operation=PS_NVM_BLOCK_SER_SEED_DEPRECATED.WriteBlock
      OIT_WriteBlock_PS_NVM_BLOCK_SER_SEED_NEXTEER_WriteBlock: start-on-event=WriteBlock, operation=PS_NVM_BLOCK_SER_SEED_NEXTEER.WriteBlock
      OIT_WriteBlock_PS_NVM_BLOCK_SER_SEED_SPS_WriteBlock: start-on-event=WriteBlock, operation=PS_NVM_BLOCK_SER_SEED_SPS.WriteBlock
      OIT_WriteBlock_PS_NVM_BLOCK_SER_SYSTEMNAME_WriteBlock: start-on-event=WriteBlock, operation=PS_NVM_BLOCK_SER_SYSTEMNAME.WriteBlock
      OIT_WriteBlock_PS_NVM_BLOCK_SER_SYSVERSCODEDDI_WriteBlock: start-on-event=WriteBlock, operation=PS_NVM_BLOCK_SER_SYSVERSCODEDDI.WriteBlock
      OIT_WriteBlock_PS_NVM_BLOCK_SER_VINDATA_WriteBlock: start-on-event=WriteBlock, operation=PS_NVM_BLOCK_SER_VINDATA.WriteBlock
      OIT_WriteBlock_PS_NVM_BLOCK_STAMD_CLOSECHECK_WriteBlock: start-on-event=WriteBlock, operation=PS_NVM_BLOCK_STAMD_CLOSECHECK.WriteBlock
      OIT_WriteBlock_PS_NVM_BLOCK_STAMD_TYPEH_WriteBlock: start-on-event=WriteBlock, operation=PS_NVM_BLOCK_STAMD_TYPEH.WriteBlock
      OIT_WriteBlock_PS_Rte_NvmBlock_AbsHwPos_EOLVehCntrOffset_WriteBlock: start-on-event=WriteBlock, operation=PS_Rte_NvmBlock_AbsHwPos_EOLVehCntrOffset.WriteBlock
      OIT_WriteBlock_PS_Rte_NvmBlock_Ap_AstLmt_SteerAsstDefeat_WriteBlock: start-on-event=WriteBlock, operation=PS_Rte_NvmBlock_Ap_AstLmt_SteerAsstDefeat.WriteBlock
      OIT_WriteBlock_PS_Rte_NvmBlock_Ap_AvgFricLrn_AvgFricLrnData_WriteBlock: start-on-event=WriteBlock, operation=PS_Rte_NvmBlock_Ap_AvgFricLrn_AvgFricLrnData.WriteBlock
      OIT_WriteBlock_PS_Rte_NvmBlock_Ap_LrnEOT_LearnedEOT_WriteBlock: start-on-event=WriteBlock, operation=PS_Rte_NvmBlock_Ap_LrnEOT_LearnedEOT.WriteBlock
      OIT_WriteBlock_PS_Rte_NvmBlock_Ap_TrqCanc_CogTrqCal_WriteBlock: start-on-event=WriteBlock, operation=PS_Rte_NvmBlock_Ap_TrqCanc_CogTrqCal.WriteBlock
      OIT_WriteBlock_PS_Rte_NvmBlock_Ap_TrqCanc_CogTrqRplComp_WriteBlock: start-on-event=WriteBlock, operation=PS_Rte_NvmBlock_Ap_TrqCanc_CogTrqRplComp.WriteBlock
      OIT_WriteBlock_PS_Rte_NvmBlock_Ap_TSMit_TSMitDisableEOL_WriteBlock: start-on-event=WriteBlock, operation=PS_Rte_NvmBlock_Ap_TSMit_TSMitDisableEOL.WriteBlock
      OIT_WriteBlock_PS_Rte_NvmBlock_Ap_TSMit_TSMitGainLrn_WriteBlock: start-on-event=WriteBlock, operation=PS_Rte_NvmBlock_Ap_TSMit_TSMitGainLrn.WriteBlock
      OIT_WriteBlock_PS_Rte_NvmBlock_BatteryVoltage_OvervoltageData_WriteBlock: start-on-event=WriteBlock, operation=PS_Rte_NvmBlock_BatteryVoltage_OvervoltageData.WriteBlock
      OIT_WriteBlock_PS_Rte_NvmBlock_CmMtrCurr_CurrTempOffset_WriteBlock: start-on-event=WriteBlock, operation=PS_Rte_NvmBlock_CmMtrCurr_CurrTempOffset.WriteBlock
      OIT_WriteBlock_PS_Rte_NvmBlock_CmMtrCurr_ShCurrCal_WriteBlock: start-on-event=WriteBlock, operation=PS_Rte_NvmBlock_CmMtrCurr_ShCurrCal.WriteBlock
      OIT_WriteBlock_PS_Rte_NvmBlock_CurrParamComp_EOLNomMtrParam_WriteBlock: start-on-event=WriteBlock, operation=PS_Rte_NvmBlock_CurrParamComp_EOLNomMtrParam.WriteBlock
      OIT_WriteBlock_PS_Rte_NvmBlock_DigColPs_DigColPsEOL_WriteBlock: start-on-event=WriteBlock, operation=PS_Rte_NvmBlock_DigColPs_DigColPsEOL.WriteBlock
      OIT_WriteBlock_PS_Rte_NvmBlock_Polarity_Polarity_Cnt_Str_WriteBlock: start-on-event=WriteBlock, operation=PS_Rte_NvmBlock_Polarity_Polarity_Cnt_Str.WriteBlock
      OIT_WriteBlock_PS_Rte_NvmBlock_Sa_DigHwTrqSENT_DigTrqTrim_WriteBlock: start-on-event=WriteBlock, operation=PS_Rte_NvmBlock_Sa_DigHwTrqSENT_DigTrqTrim.WriteBlock
      OIT_WriteBlock_PS_Rte_NvmBlock_Sa_DigMSB_DigMSBEOLData_WriteBlock: start-on-event=WriteBlock, operation=PS_Rte_NvmBlock_Sa_DigMSB_DigMSBEOLData.WriteBlock
      OIT_WriteBlock_PS_Rte_NvmBlock_SrlComOutput_DTCTrigSts_WriteBlock: start-on-event=WriteBlock, operation=PS_Rte_NvmBlock_SrlComOutput_DTCTrigSts.WriteBlock
      OIT_WriteBlock_PS_Rte_NvmBlock_TrqCmdScl_TorqueCmdSF_Uls_f32_WriteBlock: start-on-event=WriteBlock, operation=PS_Rte_NvmBlock_TrqCmdScl_TorqueCmdSF_Uls_f32.WriteBlock
      OIT_WriteBlock_PS_Rte_NvmBlock_VehDyn_MotPosReset_WriteBlock: start-on-event=WriteBlock, operation=PS_Rte_NvmBlock_VehDyn_MotPosReset.WriteBlock
    port-api-option enable-take-address=false, indirect-api=false, port=PAdmin_ConfigBlock:
      port-arg-values:
        integer literal NvM_AdminBlockId_1: type=NvM_BlockIdType, value=1
    port-api-option enable-take-address=false, indirect-api=false, port=PAdmin_NVM_BLOCK_CMS_ECUHWPN:
      port-arg-values:
        integer literal NvM_AdminBlockId_30: type=NvM_BlockIdType, value=30
    port-api-option enable-take-address=false, indirect-api=false, port=PAdmin_NVM_BLOCK_CMS_ECUSRLNUM:
      port-arg-values:
        integer literal NvM_AdminBlockId_28: type=NvM_BlockIdType, value=28
    port-api-option enable-take-address=false, indirect-api=false, port=PAdmin_NVM_BLOCK_CMS_EPSDEFEATS:
      port-arg-values:
        integer literal NvM_AdminBlockId_13: type=NvM_BlockIdType, value=13
    port-api-option enable-take-address=false, indirect-api=false, port=PAdmin_NVM_BLOCK_CMS_EPSSRLNUM:
      port-arg-values:
        integer literal NvM_AdminBlockId_29: type=NvM_BlockIdType, value=29
    port-api-option enable-take-address=false, indirect-api=false, port=PAdmin_NVM_BLOCK_CMS_IGNCNTR:
      port-arg-values:
        integer literal NvM_AdminBlockId_32: type=NvM_BlockIdType, value=32
    port-api-option enable-take-address=false, indirect-api=false, port=PAdmin_NVM_BLOCK_CMS_NXTRMANUFSCRATCHPAD:
      port-arg-values:
        integer literal NvM_AdminBlockId_31: type=NvM_BlockIdType, value=31
    port-api-option enable-take-address=false, indirect-api=false, port=PAdmin_NVM_BLOCK_CMS_NXTRMEC:
      port-arg-values:
        integer literal NvM_AdminBlockId_27: type=NvM_BlockIdType, value=27
    port-api-option enable-take-address=false, indirect-api=false, port=PAdmin_NVM_BLOCK_CMS_NXTRMECFLAG:
      port-arg-values:
        integer literal NvM_AdminBlockId_48: type=NvM_BlockIdType, value=48
    port-api-option enable-take-address=false, indirect-api=false, port=PAdmin_NVM_BLOCK_CMS_NXTRWIRSELECT:
      port-arg-values:
        integer literal NvM_AdminBlockId_26: type=NvM_BlockIdType, value=26
    port-api-option enable-take-address=false, indirect-api=false, port=PAdmin_NVM_BLOCK_DIAGMGR_BLACKBOX:
      port-arg-values:
        integer literal NvM_AdminBlockId_35: type=NvM_BlockIdType, value=35
    port-api-option enable-take-address=false, indirect-api=false, port=PAdmin_NVM_BLOCK_DIAGMGR_NTCSTRG:
      port-arg-values:
        integer literal NvM_AdminBlockId_12: type=NvM_BlockIdType, value=12
    port-api-option enable-take-address=false, indirect-api=false, port=PAdmin_NVM_BLOCK_SER_APP_NBID:
      port-arg-values:
        integer literal NvM_AdminBlockId_57: type=NvM_BlockIdType, value=57
    port-api-option enable-take-address=false, indirect-api=false, port=PAdmin_NVM_BLOCK_SER_BASEMODELPN:
      port-arg-values:
        integer literal NvM_AdminBlockId_38: type=NvM_BlockIdType, value=38
    port-api-option enable-take-address=false, indirect-api=false, port=PAdmin_NVM_BLOCK_SER_BASEMODELPNAC:
      port-arg-values:
        integer literal NvM_AdminBlockId_39: type=NvM_BlockIdType, value=39
    port-api-option enable-take-address=false, indirect-api=false, port=PAdmin_NVM_BLOCK_SER_BCID:
      port-arg-values:
        integer literal NvM_AdminBlockId_58: type=NvM_BlockIdType, value=58
    port-api-option enable-take-address=false, indirect-api=false, port=PAdmin_NVM_BLOCK_SER_CALPRGFLAG:
      port-arg-values:
        integer literal NvM_AdminBlockId_40: type=NvM_BlockIdType, value=40
    port-api-option enable-take-address=false, indirect-api=false, port=PAdmin_NVM_BLOCK_SER_CUSTMEC:
      port-arg-values:
        integer literal NvM_AdminBlockId_19: type=NvM_BlockIdType, value=19
    port-api-option enable-take-address=false, indirect-api=false, port=PAdmin_NVM_BLOCK_SER_DATAUNIVNUMSYSID:
      port-arg-values:
        integer literal NvM_AdminBlockId_25: type=NvM_BlockIdType, value=25
    port-api-option enable-take-address=false, indirect-api=false, port=PAdmin_NVM_BLOCK_SER_ECU_ID:
      port-arg-values:
        integer literal NvM_AdminBlockId_56: type=NvM_BlockIdType, value=56
    port-api-option enable-take-address=false, indirect-api=false, port=PAdmin_NVM_BLOCK_SER_ENDMODELPN:
      port-arg-values:
        integer literal NvM_AdminBlockId_21: type=NvM_BlockIdType, value=21
    port-api-option enable-take-address=false, indirect-api=false, port=PAdmin_NVM_BLOCK_SER_ENDMODELPNAC:
      port-arg-values:
        integer literal NvM_AdminBlockId_22: type=NvM_BlockIdType, value=22
    port-api-option enable-take-address=false, indirect-api=false, port=PAdmin_NVM_BLOCK_SER_KEY_CPID:
      port-arg-values:
        integer literal NvM_AdminBlockId_52: type=NvM_BlockIdType, value=52
    port-api-option enable-take-address=false, indirect-api=false, port=PAdmin_NVM_BLOCK_SER_KEY_DEPRECATED:
      port-arg-values:
        integer literal NvM_AdminBlockId_24: type=NvM_BlockIdType, value=24
    port-api-option enable-take-address=false, indirect-api=false, port=PAdmin_NVM_BLOCK_SER_KEY_NEXTEER:
      port-arg-values:
        integer literal NvM_AdminBlockId_54: type=NvM_BlockIdType, value=54
    port-api-option enable-take-address=false, indirect-api=false, port=PAdmin_NVM_BLOCK_SER_KEY_SPS:
      port-arg-values:
        integer literal NvM_AdminBlockId_50: type=NvM_BlockIdType, value=50
    port-api-option enable-take-address=false, indirect-api=false, port=PAdmin_NVM_BLOCK_SER_MANFTRAC:
      port-arg-values:
        integer literal NvM_AdminBlockId_20: type=NvM_BlockIdType, value=20
    port-api-option enable-take-address=false, indirect-api=false, port=PAdmin_NVM_BLOCK_SER_PREVREPAIRSHOPCODE:
      port-arg-values:
        integer literal NvM_AdminBlockId_44: type=NvM_BlockIdType, value=44
    port-api-option enable-take-address=false, indirect-api=false, port=PAdmin_NVM_BLOCK_SER_PROGDATE:
      port-arg-values:
        integer literal NvM_AdminBlockId_17: type=NvM_BlockIdType, value=17
    port-api-option enable-take-address=false, indirect-api=false, port=PAdmin_NVM_BLOCK_SER_REPAIRSHOPCODE:
      port-arg-values:
        integer literal NvM_AdminBlockId_16: type=NvM_BlockIdType, value=16
    port-api-option enable-take-address=false, indirect-api=false, port=PAdmin_NVM_BLOCK_SER_SBAT:
      port-arg-values:
        integer literal NvM_AdminBlockId_59: type=NvM_BlockIdType, value=59
    port-api-option enable-take-address=false, indirect-api=false, port=PAdmin_NVM_BLOCK_SER_SEED_CPID:
      port-arg-values:
        integer literal NvM_AdminBlockId_51: type=NvM_BlockIdType, value=51
    port-api-option enable-take-address=false, indirect-api=false, port=PAdmin_NVM_BLOCK_SER_SEED_DEPRECATED:
      port-arg-values:
        integer literal NvM_AdminBlockId_23: type=NvM_BlockIdType, value=23
    port-api-option enable-take-address=false, indirect-api=false, port=PAdmin_NVM_BLOCK_SER_SEED_NEXTEER:
      port-arg-values:
        integer literal NvM_AdminBlockId_53: type=NvM_BlockIdType, value=53
    port-api-option enable-take-address=false, indirect-api=false, port=PAdmin_NVM_BLOCK_SER_SEED_SPS:
      port-arg-values:
        integer literal NvM_AdminBlockId_49: type=NvM_BlockIdType, value=49
    port-api-option enable-take-address=false, indirect-api=false, port=PAdmin_NVM_BLOCK_SER_SYSTEMNAME:
      port-arg-values:
        integer literal NvM_AdminBlockId_15: type=NvM_BlockIdType, value=15
    port-api-option enable-take-address=false, indirect-api=false, port=PAdmin_NVM_BLOCK_SER_SYSVERSCODEDDI:
      port-arg-values:
        integer literal NvM_AdminBlockId_18: type=NvM_BlockIdType, value=18
    port-api-option enable-take-address=false, indirect-api=false, port=PAdmin_NVM_BLOCK_SER_VINDATA:
      port-arg-values:
        integer literal NvM_AdminBlockId_14: type=NvM_BlockIdType, value=14
    port-api-option enable-take-address=false, indirect-api=false, port=PAdmin_NVM_BLOCK_STAMD_CLOSECHECK:
      port-arg-values:
        integer literal NvM_AdminBlockId_34: type=NvM_BlockIdType, value=34
    port-api-option enable-take-address=false, indirect-api=false, port=PAdmin_NVM_BLOCK_STAMD_TYPEH:
      port-arg-values:
        integer literal NvM_AdminBlockId_33: type=NvM_BlockIdType, value=33
    port-api-option enable-take-address=false, indirect-api=false, port=PAdmin_Rte_NvmBlock_AbsHwPos_EOLVehCntrOffset:
      port-arg-values:
        integer literal NvM_AdminBlockId_41: type=NvM_BlockIdType, value=41
    port-api-option enable-take-address=false, indirect-api=false, port=PAdmin_Rte_NvmBlock_Ap_AstLmt_SteerAsstDefeat:
      port-arg-values:
        integer literal NvM_AdminBlockId_45: type=NvM_BlockIdType, value=45
    port-api-option enable-take-address=false, indirect-api=false, port=PAdmin_Rte_NvmBlock_Ap_AvgFricLrn_AvgFricLrnData:
      port-arg-values:
        integer literal NvM_AdminBlockId_2: type=NvM_BlockIdType, value=2
    port-api-option enable-take-address=false, indirect-api=false, port=PAdmin_Rte_NvmBlock_Ap_LrnEOT_LearnedEOT:
      port-arg-values:
        integer literal NvM_AdminBlockId_3: type=NvM_BlockIdType, value=3
    port-api-option enable-take-address=false, indirect-api=false, port=PAdmin_Rte_NvmBlock_Ap_TrqCanc_CogTrqCal:
      port-arg-values:
        integer literal NvM_AdminBlockId_4: type=NvM_BlockIdType, value=4
    port-api-option enable-take-address=false, indirect-api=false, port=PAdmin_Rte_NvmBlock_Ap_TrqCanc_CogTrqRplComp:
      port-arg-values:
        integer literal NvM_AdminBlockId_43: type=NvM_BlockIdType, value=43
    port-api-option enable-take-address=false, indirect-api=false, port=PAdmin_Rte_NvmBlock_Ap_TSMit_TSMitDisableEOL:
      port-arg-values:
        integer literal NvM_AdminBlockId_46: type=NvM_BlockIdType, value=46
    port-api-option enable-take-address=false, indirect-api=false, port=PAdmin_Rte_NvmBlock_Ap_TSMit_TSMitGainLrn:
      port-arg-values:
        integer literal NvM_AdminBlockId_47: type=NvM_BlockIdType, value=47
    port-api-option enable-take-address=false, indirect-api=false, port=PAdmin_Rte_NvmBlock_BatteryVoltage_OvervoltageData:
      port-arg-values:
        integer literal NvM_AdminBlockId_10: type=NvM_BlockIdType, value=10
    port-api-option enable-take-address=false, indirect-api=false, port=PAdmin_Rte_NvmBlock_CmMtrCurr_CurrTempOffset:
      port-arg-values:
        integer literal NvM_AdminBlockId_5: type=NvM_BlockIdType, value=5
    port-api-option enable-take-address=false, indirect-api=false, port=PAdmin_Rte_NvmBlock_CmMtrCurr_ShCurrCal:
      port-arg-values:
        integer literal NvM_AdminBlockId_6: type=NvM_BlockIdType, value=6
    port-api-option enable-take-address=false, indirect-api=false, port=PAdmin_Rte_NvmBlock_CurrParamComp_EOLNomMtrParam:
      port-arg-values:
        integer literal NvM_AdminBlockId_7: type=NvM_BlockIdType, value=7
    port-api-option enable-take-address=false, indirect-api=false, port=PAdmin_Rte_NvmBlock_DigColPs_DigColPsEOL:
      port-arg-values:
        integer literal NvM_AdminBlockId_42: type=NvM_BlockIdType, value=42
    port-api-option enable-take-address=false, indirect-api=false, port=PAdmin_Rte_NvmBlock_Polarity_Polarity_Cnt_Str:
      port-arg-values:
        integer literal NvM_AdminBlockId_8: type=NvM_BlockIdType, value=8
    port-api-option enable-take-address=false, indirect-api=false, port=PAdmin_Rte_NvmBlock_Sa_DigHwTrqSENT_DigTrqTrim:
      port-arg-values:
        integer literal NvM_AdminBlockId_36: type=NvM_BlockIdType, value=36
    port-api-option enable-take-address=false, indirect-api=false, port=PAdmin_Rte_NvmBlock_Sa_DigMSB_DigMSBEOLData:
      port-arg-values:
        integer literal NvM_AdminBlockId_37: type=NvM_BlockIdType, value=37
    port-api-option enable-take-address=false, indirect-api=false, port=PAdmin_Rte_NvmBlock_SrlComOutput_DTCTrigSts:
      port-arg-values:
        integer literal NvM_AdminBlockId_61: type=NvM_BlockIdType, value=61
    port-api-option enable-take-address=false, indirect-api=false, port=PAdmin_Rte_NvmBlock_TrqCmdScl_TorqueCmdSF_Uls_f32:
      port-arg-values:
        integer literal NvM_AdminBlockId_9: type=NvM_BlockIdType, value=9
    port-api-option enable-take-address=false, indirect-api=false, port=PAdmin_Rte_NvmBlock_VehDyn_MotPosReset:
      port-arg-values:
        integer literal NvM_AdminBlockId_55: type=NvM_BlockIdType, value=55
    port-api-option enable-take-address=false, indirect-api=false, port=PS_ConfigBlock:
      port-arg-values:
        integer literal NvM_ServiceBlockId_1: type=NvM_BlockIdType, value=1
    port-api-option enable-take-address=false, indirect-api=false, port=PS_NVM_BLOCK_CMS_ECUHWPN:
      port-arg-values:
        integer literal NvM_ServiceBlockId_30: type=NvM_BlockIdType, value=30
    port-api-option enable-take-address=false, indirect-api=false, port=PS_NVM_BLOCK_CMS_ECUSRLNUM:
      port-arg-values:
        integer literal NvM_ServiceBlockId_28: type=NvM_BlockIdType, value=28
    port-api-option enable-take-address=false, indirect-api=false, port=PS_NVM_BLOCK_CMS_EPSDEFEATS:
      port-arg-values:
        integer literal NvM_ServiceBlockId_13: type=NvM_BlockIdType, value=13
    port-api-option enable-take-address=false, indirect-api=false, port=PS_NVM_BLOCK_CMS_EPSSRLNUM:
      port-arg-values:
        integer literal NvM_ServiceBlockId_29: type=NvM_BlockIdType, value=29
    port-api-option enable-take-address=false, indirect-api=false, port=PS_NVM_BLOCK_CMS_IGNCNTR:
      port-arg-values:
        integer literal NvM_ServiceBlockId_32: type=NvM_BlockIdType, value=32
    port-api-option enable-take-address=false, indirect-api=false, port=PS_NVM_BLOCK_CMS_NXTRMANUFSCRATCHPAD:
      port-arg-values:
        integer literal NvM_ServiceBlockId_31: type=NvM_BlockIdType, value=31
    port-api-option enable-take-address=false, indirect-api=false, port=PS_NVM_BLOCK_CMS_NXTRMEC:
      port-arg-values:
        integer literal NvM_ServiceBlockId_27: type=NvM_BlockIdType, value=27
    port-api-option enable-take-address=false, indirect-api=false, port=PS_NVM_BLOCK_CMS_NXTRMECFLAG:
      port-arg-values:
        integer literal NvM_ServiceBlockId_48: type=NvM_BlockIdType, value=48
    port-api-option enable-take-address=false, indirect-api=false, port=PS_NVM_BLOCK_CMS_NXTRWIRSELECT:
      port-arg-values:
        integer literal NvM_ServiceBlockId_26: type=NvM_BlockIdType, value=26
    port-api-option enable-take-address=false, indirect-api=false, port=PS_NVM_BLOCK_DIAGMGR_BLACKBOX:
      port-arg-values:
        integer literal NvM_ServiceBlockId_35: type=NvM_BlockIdType, value=35
    port-api-option enable-take-address=false, indirect-api=false, port=PS_NVM_BLOCK_DIAGMGR_NTCSTRG:
      port-arg-values:
        integer literal NvM_ServiceBlockId_12: type=NvM_BlockIdType, value=12
    port-api-option enable-take-address=false, indirect-api=false, port=PS_NVM_BLOCK_SER_APP_NBID:
      port-arg-values:
        integer literal NvM_ServiceBlockId_57: type=NvM_BlockIdType, value=57
    port-api-option enable-take-address=false, indirect-api=false, port=PS_NVM_BLOCK_SER_BASEMODELPN:
      port-arg-values:
        integer literal NvM_ServiceBlockId_38: type=NvM_BlockIdType, value=38
    port-api-option enable-take-address=false, indirect-api=false, port=PS_NVM_BLOCK_SER_BASEMODELPNAC:
      port-arg-values:
        integer literal NvM_ServiceBlockId_39: type=NvM_BlockIdType, value=39
    port-api-option enable-take-address=false, indirect-api=false, port=PS_NVM_BLOCK_SER_BCID:
      port-arg-values:
        integer literal NvM_ServiceBlockId_58: type=NvM_BlockIdType, value=58
    port-api-option enable-take-address=false, indirect-api=false, port=PS_NVM_BLOCK_SER_CALPRGFLAG:
      port-arg-values:
        integer literal NvM_ServiceBlockId_40: type=NvM_BlockIdType, value=40
    port-api-option enable-take-address=false, indirect-api=false, port=PS_NVM_BLOCK_SER_CUSTMEC:
      port-arg-values:
        integer literal NvM_ServiceBlockId_19: type=NvM_BlockIdType, value=19
    port-api-option enable-take-address=false, indirect-api=false, port=PS_NVM_BLOCK_SER_DATAUNIVNUMSYSID:
      port-arg-values:
        integer literal NvM_ServiceBlockId_25: type=NvM_BlockIdType, value=25
    port-api-option enable-take-address=false, indirect-api=false, port=PS_NVM_BLOCK_SER_ECU_ID:
      port-arg-values:
        integer literal NvM_ServiceBlockId_56: type=NvM_BlockIdType, value=56
    port-api-option enable-take-address=false, indirect-api=false, port=PS_NVM_BLOCK_SER_ENDMODELPN:
      port-arg-values:
        integer literal NvM_ServiceBlockId_21: type=NvM_BlockIdType, value=21
    port-api-option enable-take-address=false, indirect-api=false, port=PS_NVM_BLOCK_SER_ENDMODELPNAC:
      port-arg-values:
        integer literal NvM_ServiceBlockId_22: type=NvM_BlockIdType, value=22
    port-api-option enable-take-address=false, indirect-api=false, port=PS_NVM_BLOCK_SER_KEY_CPID:
      port-arg-values:
        integer literal NvM_ServiceBlockId_52: type=NvM_BlockIdType, value=52
    port-api-option enable-take-address=false, indirect-api=false, port=PS_NVM_BLOCK_SER_KEY_DEPRECATED:
      port-arg-values:
        integer literal NvM_ServiceBlockId_24: type=NvM_BlockIdType, value=24
    port-api-option enable-take-address=false, indirect-api=false, port=PS_NVM_BLOCK_SER_KEY_NEXTEER:
      port-arg-values:
        integer literal NvM_ServiceBlockId_54: type=NvM_BlockIdType, value=54
    port-api-option enable-take-address=false, indirect-api=false, port=PS_NVM_BLOCK_SER_KEY_SPS:
      port-arg-values:
        integer literal NvM_ServiceBlockId_50: type=NvM_BlockIdType, value=50
    port-api-option enable-take-address=false, indirect-api=false, port=PS_NVM_BLOCK_SER_MANFTRAC:
      port-arg-values:
        integer literal NvM_ServiceBlockId_20: type=NvM_BlockIdType, value=20
    port-api-option enable-take-address=false, indirect-api=false, port=PS_NVM_BLOCK_SER_PREVREPAIRSHOPCODE:
      port-arg-values:
        integer literal NvM_ServiceBlockId_44: type=NvM_BlockIdType, value=44
    port-api-option enable-take-address=false, indirect-api=false, port=PS_NVM_BLOCK_SER_PROGDATE:
      port-arg-values:
        integer literal NvM_ServiceBlockId_17: type=NvM_BlockIdType, value=17
    port-api-option enable-take-address=false, indirect-api=false, port=PS_NVM_BLOCK_SER_REPAIRSHOPCODE:
      port-arg-values:
        integer literal NvM_ServiceBlockId_16: type=NvM_BlockIdType, value=16
    port-api-option enable-take-address=false, indirect-api=false, port=PS_NVM_BLOCK_SER_SBAT:
      port-arg-values:
        integer literal NvM_ServiceBlockId_59: type=NvM_BlockIdType, value=59
    port-api-option enable-take-address=false, indirect-api=false, port=PS_NVM_BLOCK_SER_SEED_CPID:
      port-arg-values:
        integer literal NvM_ServiceBlockId_51: type=NvM_BlockIdType, value=51
    port-api-option enable-take-address=false, indirect-api=false, port=PS_NVM_BLOCK_SER_SEED_DEPRECATED:
      port-arg-values:
        integer literal NvM_ServiceBlockId_23: type=NvM_BlockIdType, value=23
    port-api-option enable-take-address=false, indirect-api=false, port=PS_NVM_BLOCK_SER_SEED_NEXTEER:
      port-arg-values:
        integer literal NvM_ServiceBlockId_53: type=NvM_BlockIdType, value=53
    port-api-option enable-take-address=false, indirect-api=false, port=PS_NVM_BLOCK_SER_SEED_SPS:
      port-arg-values:
        integer literal NvM_ServiceBlockId_49: type=NvM_BlockIdType, value=49
    port-api-option enable-take-address=false, indirect-api=false, port=PS_NVM_BLOCK_SER_SYSTEMNAME:
      port-arg-values:
        integer literal NvM_ServiceBlockId_15: type=NvM_BlockIdType, value=15
    port-api-option enable-take-address=false, indirect-api=false, port=PS_NVM_BLOCK_SER_SYSVERSCODEDDI:
      port-arg-values:
        integer literal NvM_ServiceBlockId_18: type=NvM_BlockIdType, value=18
    port-api-option enable-take-address=false, indirect-api=false, port=PS_NVM_BLOCK_SER_VINDATA:
      port-arg-values:
        integer literal NvM_ServiceBlockId_14: type=NvM_BlockIdType, value=14
    port-api-option enable-take-address=false, indirect-api=false, port=PS_NVM_BLOCK_STAMD_CLOSECHECK:
      port-arg-values:
        integer literal NvM_ServiceBlockId_34: type=NvM_BlockIdType, value=34
    port-api-option enable-take-address=false, indirect-api=false, port=PS_NVM_BLOCK_STAMD_TYPEH:
      port-arg-values:
        integer literal NvM_ServiceBlockId_33: type=NvM_BlockIdType, value=33
    port-api-option enable-take-address=false, indirect-api=false, port=PS_Rte_NvmBlock_AbsHwPos_EOLVehCntrOffset:
      port-arg-values:
        integer literal NvM_ServiceBlockId_41: type=NvM_BlockIdType, value=41
    port-api-option enable-take-address=false, indirect-api=false, port=PS_Rte_NvmBlock_Ap_AstLmt_SteerAsstDefeat:
      port-arg-values:
        integer literal NvM_ServiceBlockId_45: type=NvM_BlockIdType, value=45
    port-api-option enable-take-address=false, indirect-api=false, port=PS_Rte_NvmBlock_Ap_AvgFricLrn_AvgFricLrnData:
      port-arg-values:
        integer literal NvM_ServiceBlockId_2: type=NvM_BlockIdType, value=2
    port-api-option enable-take-address=false, indirect-api=false, port=PS_Rte_NvmBlock_Ap_LrnEOT_LearnedEOT:
      port-arg-values:
        integer literal NvM_ServiceBlockId_3: type=NvM_BlockIdType, value=3
    port-api-option enable-take-address=false, indirect-api=false, port=PS_Rte_NvmBlock_Ap_TrqCanc_CogTrqCal:
      port-arg-values:
        integer literal NvM_ServiceBlockId_4: type=NvM_BlockIdType, value=4
    port-api-option enable-take-address=false, indirect-api=false, port=PS_Rte_NvmBlock_Ap_TrqCanc_CogTrqRplComp:
      port-arg-values:
        integer literal NvM_ServiceBlockId_43: type=NvM_BlockIdType, value=43
    port-api-option enable-take-address=false, indirect-api=false, port=PS_Rte_NvmBlock_Ap_TSMit_TSMitDisableEOL:
      port-arg-values:
        integer literal NvM_ServiceBlockId_46: type=NvM_BlockIdType, value=46
    port-api-option enable-take-address=false, indirect-api=false, port=PS_Rte_NvmBlock_Ap_TSMit_TSMitGainLrn:
      port-arg-values:
        integer literal NvM_ServiceBlockId_47: type=NvM_BlockIdType, value=47
    port-api-option enable-take-address=false, indirect-api=false, port=PS_Rte_NvmBlock_BatteryVoltage_OvervoltageData:
      port-arg-values:
        integer literal NvM_ServiceBlockId_10: type=NvM_BlockIdType, value=10
    port-api-option enable-take-address=false, indirect-api=false, port=PS_Rte_NvmBlock_CmMtrCurr_CurrTempOffset:
      port-arg-values:
        integer literal NvM_ServiceBlockId_5: type=NvM_BlockIdType, value=5
    port-api-option enable-take-address=false, indirect-api=false, port=PS_Rte_NvmBlock_CmMtrCurr_ShCurrCal:
      port-arg-values:
        integer literal NvM_ServiceBlockId_6: type=NvM_BlockIdType, value=6
    port-api-option enable-take-address=false, indirect-api=false, port=PS_Rte_NvmBlock_CurrParamComp_EOLNomMtrParam:
      port-arg-values:
        integer literal NvM_ServiceBlockId_7: type=NvM_BlockIdType, value=7
    port-api-option enable-take-address=false, indirect-api=false, port=PS_Rte_NvmBlock_DigColPs_DigColPsEOL:
      port-arg-values:
        integer literal NvM_ServiceBlockId_42: type=NvM_BlockIdType, value=42
    port-api-option enable-take-address=false, indirect-api=false, port=PS_Rte_NvmBlock_Polarity_Polarity_Cnt_Str:
      port-arg-values:
        integer literal NvM_ServiceBlockId_8: type=NvM_BlockIdType, value=8
    port-api-option enable-take-address=false, indirect-api=false, port=PS_Rte_NvmBlock_Sa_DigHwTrqSENT_DigTrqTrim:
      port-arg-values:
        integer literal NvM_ServiceBlockId_36: type=NvM_BlockIdType, value=36
    port-api-option enable-take-address=false, indirect-api=false, port=PS_Rte_NvmBlock_Sa_DigMSB_DigMSBEOLData:
      port-arg-values:
        integer literal NvM_ServiceBlockId_37: type=NvM_BlockIdType, value=37
    port-api-option enable-take-address=false, indirect-api=false, port=PS_Rte_NvmBlock_SrlComOutput_DTCTrigSts:
      port-arg-values:
        integer literal NvM_ServiceBlockId_61: type=NvM_BlockIdType, value=61
    port-api-option enable-take-address=false, indirect-api=false, port=PS_Rte_NvmBlock_TrqCmdScl_TorqueCmdSF_Uls_f32:
      port-arg-values:
        integer literal NvM_ServiceBlockId_9: type=NvM_BlockIdType, value=9
    port-api-option enable-take-address=false, indirect-api=false, port=PS_Rte_NvmBlock_VehDyn_MotPosReset:
      port-arg-values:
        integer literal NvM_ServiceBlockId_55: type=NvM_BlockIdType, value=55
    8 x runnable:
      EraseBlock: can-be-invoked-concurrently=true, symbol=NvM_EraseNvBlock
      GetErrorStatus: can-be-invoked-concurrently=true, symbol=NvM_GetErrorStatus
      InvalidateNvBlock: can-be-invoked-concurrently=true, symbol=NvM_InvalidateNvBlock
      NvM_MainFunction
      ReadBlock: can-be-invoked-concurrently=true, symbol=NvM_ReadBlock
      SetBlockProtection: can-be-invoked-concurrently=true, symbol=NvM_SetBlockProtection
      SetRamBlockStatus: can-be-invoked-concurrently=true, symbol=NvM_SetRamBlockStatus
      WriteBlock: can-be-invoked-concurrently=true, symbol=NvM_WriteBlock
  service component type NvM: category=ServiceComponent  # Software Component description for NvM generated from Ecuc Package: DaVinci_Project
    118 x provide port:
      PAdmin_ConfigBlock: server-com-spec{operation=SetBlockProtection, queue-length=1}, provided-interface=NvM_Administration  # P-Port Prototype of NvM_Administration for NVRAM Block ConfigBlock
      PAdmin_NVM_BLOCK_CMS_ECUHWPN: server-com-spec{operation=SetBlockProtection, queue-length=1}, provided-interface=NvM_Administration  # P-Port Prototype of NvM_Administration for NVRAM Block NVM_BLOCK_CMS_ECUHWPN
      PAdmin_NVM_BLOCK_CMS_ECUSRLNUM: server-com-spec{operation=SetBlockProtection, queue-length=1}, provided-interface=NvM_Administration  # P-Port Prototype of NvM_Administration for NVRAM Block NVM_BLOCK_CMS_ECUSRLNUM
      PAdmin_NVM_BLOCK_CMS_EPSDEFEATS: server-com-spec{operation=SetBlockProtection, queue-length=1}, provided-interface=NvM_Administration  # P-Port Prototype of NvM_Administration for NVRAM Block NVM_BLOCK_CMS_EPSDEFEATS
      PAdmin_NVM_BLOCK_CMS_EPSSRLNUM: server-com-spec{operation=SetBlockProtection, queue-length=1}, provided-interface=NvM_Administration  # P-Port Prototype of NvM_Administration for NVRAM Block NVM_BLOCK_CMS_EPSSRLNUM
      PAdmin_NVM_BLOCK_CMS_IGNCNTR: server-com-spec{operation=SetBlockProtection, queue-length=1}, provided-interface=NvM_Administration  # P-Port Prototype of NvM_Administration for NVRAM Block NVM_BLOCK_CMS_IGNCNTR
      PAdmin_NVM_BLOCK_CMS_NXTRMANUFSCRATCHPAD: server-com-spec{operation=SetBlockProtection, queue-length=1}, provided-interface=NvM_Administration  # P-Port Prototype of NvM_Administration for NVRAM Block NVM_BLOCK_CMS_NXTRMANUFSCRATCHPAD
      PAdmin_NVM_BLOCK_CMS_NXTRMEC: server-com-spec{operation=SetBlockProtection, queue-length=1}, provided-interface=NvM_Administration  # P-Port Prototype of NvM_Administration for NVRAM Block NVM_BLOCK_CMS_NXTRMEC
      PAdmin_NVM_BLOCK_CMS_NXTRMECFLAG: server-com-spec{operation=SetBlockProtection, queue-length=1}, provided-interface=NvM_Administration  # P-Port Prototype of NvM_Administration for NVRAM Block NVM_BLOCK_CMS_NXTRMECFLAG
      PAdmin_NVM_BLOCK_CMS_NXTRWIRSELECT: server-com-spec{operation=SetBlockProtection, queue-length=1}, provided-interface=NvM_Administration  # P-Port Prototype of NvM_Administration for NVRAM Block NVM_BLOCK_CMS_NXTRWIRSELECT
      PAdmin_NVM_BLOCK_DIAGMGR_BLACKBOX: server-com-spec{operation=SetBlockProtection, queue-length=1}, provided-interface=NvM_Administration  # P-Port Prototype of NvM_Administration for NVRAM Block NVM_BLOCK_DIAGMGR_BLACKBOX
      PAdmin_NVM_BLOCK_DIAGMGR_NTCSTRG: server-com-spec{operation=SetBlockProtection, queue-length=1}, provided-interface=NvM_Administration  # P-Port Prototype of NvM_Administration for NVRAM Block NVM_BLOCK_DIAGMGR_NTCSTRG
      PAdmin_NVM_BLOCK_SER_APP_NBID: server-com-spec{operation=SetBlockProtection, queue-length=1}, provided-interface=NvM_Administration  # P-Port Prototype of NvM_Administration for NVRAM Block NVM_BLOCK_SER_APP_NBID
      PAdmin_NVM_BLOCK_SER_BASEMODELPN: server-com-spec{operation=SetBlockProtection, queue-length=1}, provided-interface=NvM_Administration  # P-Port Prototype of NvM_Administration for NVRAM Block NVM_BLOCK_SER_BASEMODELPN
      PAdmin_NVM_BLOCK_SER_BASEMODELPNAC: server-com-spec{operation=SetBlockProtection, queue-length=1}, provided-interface=NvM_Administration  # P-Port Prototype of NvM_Administration for NVRAM Block NVM_BLOCK_SER_BASEMODELPNAC
      PAdmin_NVM_BLOCK_SER_BCID: server-com-spec{operation=SetBlockProtection, queue-length=1}, provided-interface=NvM_Administration  # P-Port Prototype of NvM_Administration for NVRAM Block NVM_BLOCK_SER_BCID
      PAdmin_NVM_BLOCK_SER_CALPRGFLAG: server-com-spec{operation=SetBlockProtection, queue-length=1}, provided-interface=NvM_Administration  # P-Port Prototype of NvM_Administration for NVRAM Block NVM_BLOCK_SER_CALPRGFLAG
      PAdmin_NVM_BLOCK_SER_CUSTMEC: server-com-spec{operation=SetBlockProtection, queue-length=1}, provided-interface=NvM_Administration  # P-Port Prototype of NvM_Administration for NVRAM Block NVM_BLOCK_SER_CUSTMEC
      PAdmin_NVM_BLOCK_SER_DATAUNIVNUMSYSID: server-com-spec{operation=SetBlockProtection, queue-length=1}, provided-interface=NvM_Administration  # P-Port Prototype of NvM_Administration for NVRAM Block NVM_BLOCK_SER_DATAUNIVNUMSYSID
      PAdmin_NVM_BLOCK_SER_ECU_ID: server-com-spec{operation=SetBlockProtection, queue-length=1}, provided-interface=NvM_Administration  # P-Port Prototype of NvM_Administration for NVRAM Block NVM_BLOCK_SER_ECU_ID
      PAdmin_NVM_BLOCK_SER_ENDMODELPN: server-com-spec{operation=SetBlockProtection, queue-length=1}, provided-interface=NvM_Administration  # P-Port Prototype of NvM_Administration for NVRAM Block NVM_BLOCK_SER_ENDMODELPN
      PAdmin_NVM_BLOCK_SER_ENDMODELPNAC: server-com-spec{operation=SetBlockProtection, queue-length=1}, provided-interface=NvM_Administration  # P-Port Prototype of NvM_Administration for NVRAM Block NVM_BLOCK_SER_ENDMODELPNAC
      PAdmin_NVM_BLOCK_SER_KEY_CPID: server-com-spec{operation=SetBlockProtection, queue-length=1}, provided-interface=NvM_Administration  # P-Port Prototype of NvM_Administration for NVRAM Block NVM_BLOCK_SER_KEY_CPID
      PAdmin_NVM_BLOCK_SER_KEY_DEPRECATED: server-com-spec{operation=SetBlockProtection, queue-length=1}, provided-interface=NvM_Administration  # P-Port Prototype of NvM_Administration for NVRAM Block NVM_BLOCK_SER_KEY_DEPRECATED
      PAdmin_NVM_BLOCK_SER_KEY_NEXTEER: server-com-spec{operation=SetBlockProtection, queue-length=1}, provided-interface=NvM_Administration  # P-Port Prototype of NvM_Administration for NVRAM Block NVM_BLOCK_SER_KEY_NEXTEER
      PAdmin_NVM_BLOCK_SER_KEY_SPS: server-com-spec{operation=SetBlockProtection, queue-length=1}, provided-interface=NvM_Administration  # P-Port Prototype of NvM_Administration for NVRAM Block NVM_BLOCK_SER_KEY_SPS
      PAdmin_NVM_BLOCK_SER_MANFTRAC: server-com-spec{operation=SetBlockProtection, queue-length=1}, provided-interface=NvM_Administration  # P-Port Prototype of NvM_Administration for NVRAM Block NVM_BLOCK_SER_MANFTRAC
      PAdmin_NVM_BLOCK_SER_PREVREPAIRSHOPCODE: server-com-spec{operation=SetBlockProtection, queue-length=1}, provided-interface=NvM_Administration  # P-Port Prototype of NvM_Administration for NVRAM Block NVM_BLOCK_SER_PREVREPAIRSHOPCODE
      PAdmin_NVM_BLOCK_SER_PROGDATE: server-com-spec{operation=SetBlockProtection, queue-length=1}, provided-interface=NvM_Administration  # P-Port Prototype of NvM_Administration for NVRAM Block NVM_BLOCK_SER_PROGDATE
      PAdmin_NVM_BLOCK_SER_REPAIRSHOPCODE: server-com-spec{operation=SetBlockProtection, queue-length=1}, provided-interface=NvM_Administration  # P-Port Prototype of NvM_Administration for NVRAM Block NVM_BLOCK_SER_REPAIRSHOPCODE
      PAdmin_NVM_BLOCK_SER_SBAT: server-com-spec{operation=SetBlockProtection, queue-length=1}, provided-interface=NvM_Administration  # P-Port Prototype of NvM_Administration for NVRAM Block NVM_BLOCK_SER_SBAT
      PAdmin_NVM_BLOCK_SER_SEED_CPID: server-com-spec{operation=SetBlockProtection, queue-length=1}, provided-interface=NvM_Administration  # P-Port Prototype of NvM_Administration for NVRAM Block NVM_BLOCK_SER_SEED_CPID
      PAdmin_NVM_BLOCK_SER_SEED_DEPRECATED: server-com-spec{operation=SetBlockProtection, queue-length=1}, provided-interface=NvM_Administration  # P-Port Prototype of NvM_Administration for NVRAM Block NVM_BLOCK_SER_SEED_DEPRECATED
      PAdmin_NVM_BLOCK_SER_SEED_NEXTEER: server-com-spec{operation=SetBlockProtection, queue-length=1}, provided-interface=NvM_Administration  # P-Port Prototype of NvM_Administration for NVRAM Block NVM_BLOCK_SER_SEED_NEXTEER
      PAdmin_NVM_BLOCK_SER_SEED_SPS: server-com-spec{operation=SetBlockProtection, queue-length=1}, provided-interface=NvM_Administration  # P-Port Prototype of NvM_Administration for NVRAM Block NVM_BLOCK_SER_SEED_SPS
      PAdmin_NVM_BLOCK_SER_SYSTEMNAME: server-com-spec{operation=SetBlockProtection, queue-length=1}, provided-interface=NvM_Administration  # P-Port Prototype of NvM_Administration for NVRAM Block NVM_BLOCK_SER_SYSTEMNAME
      PAdmin_NVM_BLOCK_SER_SYSVERSCODEDDI: server-com-spec{operation=SetBlockProtection, queue-length=1}, provided-interface=NvM_Administration  # P-Port Prototype of NvM_Administration for NVRAM Block NVM_BLOCK_SER_SYSVERSCODEDDI
      PAdmin_NVM_BLOCK_SER_VINDATA: server-com-spec{operation=SetBlockProtection, queue-length=1}, provided-interface=NvM_Administration  # P-Port Prototype of NvM_Administration for NVRAM Block NVM_BLOCK_SER_VINDATA
      PAdmin_NVM_BLOCK_STAMD_CLOSECHECK: server-com-spec{operation=SetBlockProtection, queue-length=1}, provided-interface=NvM_Administration  # P-Port Prototype of NvM_Administration for NVRAM Block NVM_BLOCK_STAMD_CLOSECHECK
      PAdmin_NVM_BLOCK_STAMD_TYPEH: server-com-spec{operation=SetBlockProtection, queue-length=1}, provided-interface=NvM_Administration  # P-Port Prototype of NvM_Administration for NVRAM Block NVM_BLOCK_STAMD_TYPEH
      PAdmin_Rte_NvmBlock_AbsHwPos_EOLVehCntrOffset: server-com-spec{operation=SetBlockProtection, queue-length=1}, provided-interface=NvM_Administration  # P-Port Prototype of NvM_Administration for NVRAM Block Rte_NvmBlock_AbsHwPos_EOLVehCntrOffset
      PAdmin_Rte_NvmBlock_Ap_AstLmt_SteerAsstDefeat: server-com-spec{operation=SetBlockProtection, queue-length=1}, provided-interface=NvM_Administration  # P-Port Prototype of NvM_Administration for NVRAM Block Rte_NvmBlock_Ap_AstLmt_SteerAsstDefeat
      PAdmin_Rte_NvmBlock_Ap_AvgFricLrn_AvgFricLrnData: server-com-spec{operation=SetBlockProtection, queue-length=1}, provided-interface=NvM_Administration  # P-Port Prototype of NvM_Administration for NVRAM Block Rte_NvmBlock_Ap_AvgFricLrn_AvgFricLrnData
      PAdmin_Rte_NvmBlock_Ap_LrnEOT_LearnedEOT: server-com-spec{operation=SetBlockProtection, queue-length=1}, provided-interface=NvM_Administration  # P-Port Prototype of NvM_Administration for NVRAM Block Rte_NvmBlock_Ap_LrnEOT_LearnedEOT
      PAdmin_Rte_NvmBlock_Ap_TrqCanc_CogTrqCal: server-com-spec{operation=SetBlockProtection, queue-length=1}, provided-interface=NvM_Administration  # P-Port Prototype of NvM_Administration for NVRAM Block Rte_NvmBlock_Ap_TrqCanc_CogTrqCal
      PAdmin_Rte_NvmBlock_Ap_TrqCanc_CogTrqRplComp: server-com-spec{operation=SetBlockProtection, queue-length=1}, provided-interface=NvM_Administration  # P-Port Prototype of NvM_Administration for NVRAM Block Rte_NvmBlock_Ap_TrqCanc_CogTrqRplComp
      PAdmin_Rte_NvmBlock_Ap_TSMit_TSMitDisableEOL: server-com-spec{operation=SetBlockProtection, queue-length=1}, provided-interface=NvM_Administration  # P-Port Prototype of NvM_Administration for NVRAM Block Rte_NvmBlock_Ap_TSMit_TSMitDisableEOL
      PAdmin_Rte_NvmBlock_Ap_TSMit_TSMitGainLrn: server-com-spec{operation=SetBlockProtection, queue-length=1}, provided-interface=NvM_Administration  # P-Port Prototype of NvM_Administration for NVRAM Block Rte_NvmBlock_Ap_TSMit_TSMitGainLrn
      PAdmin_Rte_NvmBlock_BatteryVoltage_OvervoltageData: server-com-spec{operation=SetBlockProtection, queue-length=1}, provided-interface=NvM_Administration  # P-Port Prototype of NvM_Administration for NVRAM Block Rte_NvmBlock_BatteryVoltage_OvervoltageData
      PAdmin_Rte_NvmBlock_CmMtrCurr_CurrTempOffset: server-com-spec{operation=SetBlockProtection, queue-length=1}, provided-interface=NvM_Administration  # P-Port Prototype of NvM_Administration for NVRAM Block Rte_NvmBlock_CmMtrCurr_CurrTempOffset
      PAdmin_Rte_NvmBlock_CmMtrCurr_ShCurrCal: server-com-spec{operation=SetBlockProtection, queue-length=1}, provided-interface=NvM_Administration  # P-Port Prototype of NvM_Administration for NVRAM Block Rte_NvmBlock_CmMtrCurr_ShCurrCal
      PAdmin_Rte_NvmBlock_CurrParamComp_EOLNomMtrParam: server-com-spec{operation=SetBlockProtection, queue-length=1}, provided-interface=NvM_Administration  # P-Port Prototype of NvM_Administration for NVRAM Block Rte_NvmBlock_CurrParamComp_EOLNomMtrParam
      PAdmin_Rte_NvmBlock_DigColPs_DigColPsEOL: server-com-spec{operation=SetBlockProtection, queue-length=1}, provided-interface=NvM_Administration  # P-Port Prototype of NvM_Administration for NVRAM Block Rte_NvmBlock_DigColPs_DigColPsEOL
      PAdmin_Rte_NvmBlock_Polarity_Polarity_Cnt_Str: server-com-spec{operation=SetBlockProtection, queue-length=1}, provided-interface=NvM_Administration  # P-Port Prototype of NvM_Administration for NVRAM Block Rte_NvmBlock_Polarity_Polarity_Cnt_Str
      PAdmin_Rte_NvmBlock_Sa_DigHwTrqSENT_DigTrqTrim: server-com-spec{operation=SetBlockProtection, queue-length=1}, provided-interface=NvM_Administration  # P-Port Prototype of NvM_Administration for NVRAM Block Rte_NvmBlock_Sa_DigHwTrqSENT_DigTrqTrim
      PAdmin_Rte_NvmBlock_Sa_DigMSB_DigMSBEOLData: server-com-spec{operation=SetBlockProtection, queue-length=1}, provided-interface=NvM_Administration  # P-Port Prototype of NvM_Administration for NVRAM Block Rte_NvmBlock_Sa_DigMSB_DigMSBEOLData
      PAdmin_Rte_NvmBlock_SrlComOutput_DTCTrigSts: server-com-spec{operation=SetBlockProtection, queue-length=1}, provided-interface=NvM_Administration  # P-Port Prototype of NvM_Administration for NVRAM Block Rte_NvmBlock_SrlComOutput_DTCTrigSts
      PAdmin_Rte_NvmBlock_TrqCmdScl_TorqueCmdSF_Uls_f32: server-com-spec{operation=SetBlockProtection, queue-length=1}, provided-interface=NvM_Administration  # P-Port Prototype of NvM_Administration for NVRAM Block Rte_NvmBlock_TrqCmdScl_TorqueCmdSF_Uls_f32
      PAdmin_Rte_NvmBlock_VehDyn_MotPosReset: server-com-spec{operation=SetBlockProtection, queue-length=1}, provided-interface=NvM_Administration  # P-Port Prototype of NvM_Administration for NVRAM Block Rte_NvmBlock_VehDyn_MotPosReset
      PS_ConfigBlock: provided-interface=NvM_AC3_SRBS_Srv  # P-Port Prototype of NvM_AC3_SRBS_Srv for NVRAM Block ConfigBlock
        provided-com-specs:
          operation=EraseBlock, queue-length=1
          operation=GetErrorStatus, queue-length=1
          operation=InvalidateNvBlock, queue-length=1
          operation=ReadBlock, queue-length=1
          operation=SetRamBlockStatus, queue-length=1
          operation=WriteBlock, queue-length=1
      PS_NVM_BLOCK_CMS_ECUHWPN: provided-interface=NvM_AC3_SRBS_Srv  # P-Port Prototype of NvM_AC3_SRBS_Srv for NVRAM Block NVM_BLOCK_CMS_ECUHWPN
        provided-com-specs:
          operation=EraseBlock, queue-length=1
          operation=GetErrorStatus, queue-length=1
          operation=InvalidateNvBlock, queue-length=1
          operation=ReadBlock, queue-length=1
          operation=SetRamBlockStatus, queue-length=1
          operation=WriteBlock, queue-length=1
      PS_NVM_BLOCK_CMS_ECUSRLNUM: provided-interface=NvM_AC3_SRBS_Srv  # P-Port Prototype of NvM_AC3_SRBS_Srv for NVRAM Block NVM_BLOCK_CMS_ECUSRLNUM
        provided-com-specs:
          operation=EraseBlock, queue-length=1
          operation=GetErrorStatus, queue-length=1
          operation=InvalidateNvBlock, queue-length=1
          operation=ReadBlock, queue-length=1
          operation=SetRamBlockStatus, queue-length=1
          operation=WriteBlock, queue-length=1
      PS_NVM_BLOCK_CMS_EPSDEFEATS: provided-interface=NvM_AC3_SRBS_Srv  # P-Port Prototype of NvM_AC3_SRBS_Srv for NVRAM Block NVM_BLOCK_CMS_EPSDEFEATS
        provided-com-specs:
          operation=EraseBlock, queue-length=1
          operation=GetErrorStatus, queue-length=1
          operation=InvalidateNvBlock, queue-length=1
          operation=ReadBlock, queue-length=1
          operation=SetRamBlockStatus, queue-length=1
          operation=WriteBlock, queue-length=1
      PS_NVM_BLOCK_CMS_EPSSRLNUM: provided-interface=NvM_AC3_SRBS_Srv  # P-Port Prototype of NvM_AC3_SRBS_Srv for NVRAM Block NVM_BLOCK_CMS_EPSSRLNUM
        provided-com-specs:
          operation=EraseBlock, queue-length=1
          operation=GetErrorStatus, queue-length=1
          operation=InvalidateNvBlock, queue-length=1
          operation=ReadBlock, queue-length=1
          operation=SetRamBlockStatus, queue-length=1
          operation=WriteBlock, queue-length=1
      PS_NVM_BLOCK_CMS_IGNCNTR: provided-interface=NvM_AC3_SRBS_Srv  # P-Port Prototype of NvM_AC3_SRBS_Srv for NVRAM Block NVM_BLOCK_CMS_IGNCNTR
        provided-com-specs:
          operation=EraseBlock, queue-length=1
          operation=GetErrorStatus, queue-length=1
          operation=InvalidateNvBlock, queue-length=1
          operation=ReadBlock, queue-length=1
          operation=SetRamBlockStatus, queue-length=1
          operation=WriteBlock, queue-length=1
      PS_NVM_BLOCK_CMS_NXTRMANUFSCRATCHPAD: provided-interface=NvM_AC3_SRBS_Srv  # P-Port Prototype of NvM_AC3_SRBS_Srv for NVRAM Block NVM_BLOCK_CMS_NXTRMANUFSCRATCHPAD
        provided-com-specs:
          operation=EraseBlock, queue-length=1
          operation=GetErrorStatus, queue-length=1
          operation=InvalidateNvBlock, queue-length=1
          operation=ReadBlock, queue-length=1
          operation=SetRamBlockStatus, queue-length=1
          operation=WriteBlock, queue-length=1
      PS_NVM_BLOCK_CMS_NXTRMEC: provided-interface=NvM_AC3_SRBS_Srv  # P-Port Prototype of NvM_AC3_SRBS_Srv for NVRAM Block NVM_BLOCK_CMS_NXTRMEC
        provided-com-specs:
          operation=EraseBlock, queue-length=1
          operation=GetErrorStatus, queue-length=1
          operation=InvalidateNvBlock, queue-length=1
          operation=ReadBlock, queue-length=1
          operation=SetRamBlockStatus, queue-length=1
          operation=WriteBlock, queue-length=1
      PS_NVM_BLOCK_CMS_NXTRMECFLAG: provided-interface=NvM_AC3_SRBS_Srv  # P-Port Prototype of NvM_AC3_SRBS_Srv for NVRAM Block NVM_BLOCK_CMS_NXTRMECFLAG
        provided-com-specs:
          operation=EraseBlock, queue-length=1
          operation=GetErrorStatus, queue-length=1
          operation=InvalidateNvBlock, queue-length=1
          operation=ReadBlock, queue-length=1
          operation=SetRamBlockStatus, queue-length=1
          operation=WriteBlock, queue-length=1
      PS_NVM_BLOCK_CMS_NXTRWIRSELECT: provided-interface=NvM_AC3_SRBS_Srv  # P-Port Prototype of NvM_AC3_SRBS_Srv for NVRAM Block NVM_BLOCK_CMS_NXTRWIRSELECT
        provided-com-specs:
          operation=EraseBlock, queue-length=1
          operation=GetErrorStatus, queue-length=1
          operation=InvalidateNvBlock, queue-length=1
          operation=ReadBlock, queue-length=1
          operation=SetRamBlockStatus, queue-length=1
          operation=WriteBlock, queue-length=1
      PS_NVM_BLOCK_DIAGMGR_BLACKBOX: provided-interface=NvM_AC3_SRBS_Srv  # P-Port Prototype of NvM_AC3_SRBS_Srv for NVRAM Block NVM_BLOCK_DIAGMGR_BLACKBOX
        provided-com-specs:
          operation=EraseBlock, queue-length=1
          operation=GetErrorStatus, queue-length=1
          operation=InvalidateNvBlock, queue-length=1
          operation=ReadBlock, queue-length=1
          operation=SetRamBlockStatus, queue-length=1
          operation=WriteBlock, queue-length=1
      PS_NVM_BLOCK_DIAGMGR_NTCSTRG: provided-interface=NvM_AC3_SRBS_Srv  # P-Port Prototype of NvM_AC3_SRBS_Srv for NVRAM Block NVM_BLOCK_DIAGMGR_NTCSTRG
        provided-com-specs:
          operation=EraseBlock, queue-length=1
          operation=GetErrorStatus, queue-length=1
          operation=InvalidateNvBlock, queue-length=1
          operation=ReadBlock, queue-length=1
          operation=SetRamBlockStatus, queue-length=1
          operation=WriteBlock, queue-length=1
      PS_NVM_BLOCK_SER_APP_NBID: provided-interface=NvM_AC3_SRBS_Srv  # P-Port Prototype of NvM_AC3_SRBS_Srv for NVRAM Block NVM_BLOCK_SER_APP_NBID
        provided-com-specs:
          operation=EraseBlock, queue-length=1
          operation=GetErrorStatus, queue-length=1
          operation=InvalidateNvBlock, queue-length=1
          operation=ReadBlock, queue-length=1
          operation=SetRamBlockStatus, queue-length=1
          operation=WriteBlock, queue-length=1
      PS_NVM_BLOCK_SER_BASEMODELPN: provided-interface=NvM_AC3_SRBS_Srv  # P-Port Prototype of NvM_AC3_SRBS_Srv for NVRAM Block NVM_BLOCK_SER_BASEMODELPN
        provided-com-specs:
          operation=EraseBlock, queue-length=1
          operation=GetErrorStatus, queue-length=1
          operation=InvalidateNvBlock, queue-length=1
          operation=ReadBlock, queue-length=1
          operation=SetRamBlockStatus, queue-length=1
          operation=WriteBlock, queue-length=1
      PS_NVM_BLOCK_SER_BASEMODELPNAC: provided-interface=NvM_AC3_SRBS_Srv  # P-Port Prototype of NvM_AC3_SRBS_Srv for NVRAM Block NVM_BLOCK_SER_BASEMODELPNAC
        provided-com-specs:
          operation=EraseBlock, queue-length=1
          operation=GetErrorStatus, queue-length=1
          operation=InvalidateNvBlock, queue-length=1
          operation=ReadBlock, queue-length=1
          operation=SetRamBlockStatus, queue-length=1
          operation=WriteBlock, queue-length=1
      PS_NVM_BLOCK_SER_BCID: provided-interface=NvM_AC3_SRBS_Srv  # P-Port Prototype of NvM_AC3_SRBS_Srv for NVRAM Block NVM_BLOCK_SER_BCID
        provided-com-specs:
          operation=EraseBlock, queue-length=1
          operation=GetErrorStatus, queue-length=1
          operation=InvalidateNvBlock, queue-length=1
          operation=ReadBlock, queue-length=1
          operation=SetRamBlockStatus, queue-length=1
          operation=WriteBlock, queue-length=1
      PS_NVM_BLOCK_SER_CALPRGFLAG: provided-interface=NvM_AC3_SRBS_Srv  # P-Port Prototype of NvM_AC3_SRBS_Srv for NVRAM Block NVM_BLOCK_SER_CALPRGFLAG
        provided-com-specs:
          operation=EraseBlock, queue-length=1
          operation=GetErrorStatus, queue-length=1
          operation=InvalidateNvBlock, queue-length=1
          operation=ReadBlock, queue-length=1
          operation=SetRamBlockStatus, queue-length=1
          operation=WriteBlock, queue-length=1
      PS_NVM_BLOCK_SER_CUSTMEC: provided-interface=NvM_AC3_SRBS_Srv  # P-Port Prototype of NvM_AC3_SRBS_Srv for NVRAM Block NVM_BLOCK_SER_CUSTMEC
        provided-com-specs:
          operation=EraseBlock, queue-length=1
          operation=GetErrorStatus, queue-length=1
          operation=InvalidateNvBlock, queue-length=1
          operation=ReadBlock, queue-length=1
          operation=SetRamBlockStatus, queue-length=1
          operation=WriteBlock, queue-length=1
      PS_NVM_BLOCK_SER_DATAUNIVNUMSYSID: provided-interface=NvM_AC3_SRBS_Srv  # P-Port Prototype of NvM_AC3_SRBS_Srv for NVRAM Block NVM_BLOCK_SER_DATAUNIVNUMSYSID
        provided-com-specs:
          operation=EraseBlock, queue-length=1
          operation=GetErrorStatus, queue-length=1
          operation=InvalidateNvBlock, queue-length=1
          operation=ReadBlock, queue-length=1
          operation=SetRamBlockStatus, queue-length=1
          operation=WriteBlock, queue-length=1
      PS_NVM_BLOCK_SER_ECU_ID: provided-interface=NvM_AC3_SRBS_Srv  # P-Port Prototype of NvM_AC3_SRBS_Srv for NVRAM Block NVM_BLOCK_SER_ECU_ID
        provided-com-specs:
          operation=EraseBlock, queue-length=1
          operation=GetErrorStatus, queue-length=1
          operation=InvalidateNvBlock, queue-length=1
          operation=ReadBlock, queue-length=1
          operation=SetRamBlockStatus, queue-length=1
          operation=WriteBlock, queue-length=1
      PS_NVM_BLOCK_SER_ENDMODELPN: provided-interface=NvM_AC3_SRBS_Srv  # P-Port Prototype of NvM_AC3_SRBS_Srv for NVRAM Block NVM_BLOCK_SER_ENDMODELPN
        provided-com-specs:
          operation=EraseBlock, queue-length=1
          operation=GetErrorStatus, queue-length=1
          operation=InvalidateNvBlock, queue-length=1
          operation=ReadBlock, queue-length=1
          operation=SetRamBlockStatus, queue-length=1
          operation=WriteBlock, queue-length=1
      PS_NVM_BLOCK_SER_ENDMODELPNAC: provided-interface=NvM_AC3_SRBS_Srv  # P-Port Prototype of NvM_AC3_SRBS_Srv for NVRAM Block NVM_BLOCK_SER_ENDMODELPNAC
        provided-com-specs:
          operation=EraseBlock, queue-length=1
          operation=GetErrorStatus, queue-length=1
          operation=InvalidateNvBlock, queue-length=1
          operation=ReadBlock, queue-length=1
          operation=SetRamBlockStatus, queue-length=1
          operation=WriteBlock, queue-length=1
      PS_NVM_BLOCK_SER_KEY_CPID: provided-interface=NvM_AC3_SRBS_Srv  # P-Port Prototype of NvM_AC3_SRBS_Srv for NVRAM Block NVM_BLOCK_SER_KEY_CPID
        provided-com-specs:
          operation=EraseBlock, queue-length=1
          operation=GetErrorStatus, queue-length=1
          operation=InvalidateNvBlock, queue-length=1
          operation=ReadBlock, queue-length=1
          operation=SetRamBlockStatus, queue-length=1
          operation=WriteBlock, queue-length=1
      PS_NVM_BLOCK_SER_KEY_DEPRECATED: provided-interface=NvM_AC3_SRBS_Srv  # P-Port Prototype of NvM_AC3_SRBS_Srv for NVRAM Block NVM_BLOCK_SER_KEY_DEPRECATED
        provided-com-specs:
          operation=EraseBlock, queue-length=1
          operation=GetErrorStatus, queue-length=1
          operation=InvalidateNvBlock, queue-length=1
          operation=ReadBlock, queue-length=1
          operation=SetRamBlockStatus, queue-length=1
          operation=WriteBlock, queue-length=1
      PS_NVM_BLOCK_SER_KEY_NEXTEER: provided-interface=NvM_AC3_SRBS_Srv  # P-Port Prototype of NvM_AC3_SRBS_Srv for NVRAM Block NVM_BLOCK_SER_KEY_NEXTEER
        provided-com-specs:
          operation=EraseBlock, queue-length=1
          operation=GetErrorStatus, queue-length=1
          operation=InvalidateNvBlock, queue-length=1
          operation=ReadBlock, queue-length=1
          operation=SetRamBlockStatus, queue-length=1
          operation=WriteBlock, queue-length=1
      PS_NVM_BLOCK_SER_KEY_SPS: provided-interface=NvM_AC3_SRBS_Srv  # P-Port Prototype of NvM_AC3_SRBS_Srv for NVRAM Block NVM_BLOCK_SER_KEY_SPS
        provided-com-specs:
          operation=EraseBlock, queue-length=1
          operation=GetErrorStatus, queue-length=1
          operation=InvalidateNvBlock, queue-length=1
          operation=ReadBlock, queue-length=1
          operation=SetRamBlockStatus, queue-length=1
          operation=WriteBlock, queue-length=1
      PS_NVM_BLOCK_SER_MANFTRAC: provided-interface=NvM_AC3_SRBS_Srv  # P-Port Prototype of NvM_AC3_SRBS_Srv for NVRAM Block NVM_BLOCK_SER_MANFTRAC
        provided-com-specs:
          operation=EraseBlock, queue-length=1
          operation=GetErrorStatus, queue-length=1
          operation=InvalidateNvBlock, queue-length=1
          operation=ReadBlock, queue-length=1
          operation=SetRamBlockStatus, queue-length=1
          operation=WriteBlock, queue-length=1
      PS_NVM_BLOCK_SER_PREVREPAIRSHOPCODE: provided-interface=NvM_AC3_SRBS_Srv  # P-Port Prototype of NvM_AC3_SRBS_Srv for NVRAM Block NVM_BLOCK_SER_PREVREPAIRSHOPCODE
        provided-com-specs:
          operation=EraseBlock, queue-length=1
          operation=GetErrorStatus, queue-length=1
          operation=InvalidateNvBlock, queue-length=1
          operation=ReadBlock, queue-length=1
          operation=SetRamBlockStatus, queue-length=1
          operation=WriteBlock, queue-length=1
      PS_NVM_BLOCK_SER_PROGDATE: provided-interface=NvM_AC3_SRBS_Srv  # P-Port Prototype of NvM_AC3_SRBS_Srv for NVRAM Block NVM_BLOCK_SER_PROGDATE
        provided-com-specs:
          operation=EraseBlock, queue-length=1
          operation=GetErrorStatus, queue-length=1
          operation=InvalidateNvBlock, queue-length=1
          operation=ReadBlock, queue-length=1
          operation=SetRamBlockStatus, queue-length=1
          operation=WriteBlock, queue-length=1
      PS_NVM_BLOCK_SER_REPAIRSHOPCODE: provided-interface=NvM_AC3_SRBS_Srv  # P-Port Prototype of NvM_AC3_SRBS_Srv for NVRAM Block NVM_BLOCK_SER_REPAIRSHOPCODE
        provided-com-specs:
          operation=EraseBlock, queue-length=1
          operation=GetErrorStatus, queue-length=1
          operation=InvalidateNvBlock, queue-length=1
          operation=ReadBlock, queue-length=1
          operation=SetRamBlockStatus, queue-length=1
          operation=WriteBlock, queue-length=1
      PS_NVM_BLOCK_SER_SBAT: provided-interface=NvM_AC3_SRBS_Srv  # P-Port Prototype of NvM_AC3_SRBS_Srv for NVRAM Block NVM_BLOCK_SER_SBAT
        provided-com-specs:
          operation=EraseBlock, queue-length=1
          operation=GetErrorStatus, queue-length=1
          operation=InvalidateNvBlock, queue-length=1
          operation=ReadBlock, queue-length=1
          operation=SetRamBlockStatus, queue-length=1
          operation=WriteBlock, queue-length=1
      PS_NVM_BLOCK_SER_SEED_CPID: provided-interface=NvM_AC3_SRBS_Srv  # P-Port Prototype of NvM_AC3_SRBS_Srv for NVRAM Block NVM_BLOCK_SER_SEED_CPID
        provided-com-specs:
          operation=EraseBlock, queue-length=1
          operation=GetErrorStatus, queue-length=1
          operation=InvalidateNvBlock, queue-length=1
          operation=ReadBlock, queue-length=1
          operation=SetRamBlockStatus, queue-length=1
          operation=WriteBlock, queue-length=1
      PS_NVM_BLOCK_SER_SEED_DEPRECATED: provided-interface=NvM_AC3_SRBS_Srv  # P-Port Prototype of NvM_AC3_SRBS_Srv for NVRAM Block NVM_BLOCK_SER_SEED_DEPRECATED
        provided-com-specs:
          operation=EraseBlock, queue-length=1
          operation=GetErrorStatus, queue-length=1
          operation=InvalidateNvBlock, queue-length=1
          operation=ReadBlock, queue-length=1
          operation=SetRamBlockStatus, queue-length=1
          operation=WriteBlock, queue-length=1
      PS_NVM_BLOCK_SER_SEED_NEXTEER: provided-interface=NvM_AC3_SRBS_Srv  # P-Port Prototype of NvM_AC3_SRBS_Srv for NVRAM Block NVM_BLOCK_SER_SEED_NEXTEER
        provided-com-specs:
          operation=EraseBlock, queue-length=1
          operation=GetErrorStatus, queue-length=1
          operation=InvalidateNvBlock, queue-length=1
          operation=ReadBlock, queue-length=1
          operation=SetRamBlockStatus, queue-length=1
          operation=WriteBlock, queue-length=1
      PS_NVM_BLOCK_SER_SEED_SPS: provided-interface=NvM_AC3_SRBS_Srv  # P-Port Prototype of NvM_AC3_SRBS_Srv for NVRAM Block NVM_BLOCK_SER_SEED_SPS
        provided-com-specs:
          operation=EraseBlock, queue-length=1
          operation=GetErrorStatus, queue-length=1
          operation=InvalidateNvBlock, queue-length=1
          operation=ReadBlock, queue-length=1
          operation=SetRamBlockStatus, queue-length=1
          operation=WriteBlock, queue-length=1
      PS_NVM_BLOCK_SER_SYSTEMNAME: provided-interface=NvM_AC3_SRBS_Srv  # P-Port Prototype of NvM_AC3_SRBS_Srv for NVRAM Block NVM_BLOCK_SER_SYSTEMNAME
        provided-com-specs:
          operation=EraseBlock, queue-length=1
          operation=GetErrorStatus, queue-length=1
          operation=InvalidateNvBlock, queue-length=1
          operation=ReadBlock, queue-length=1
          operation=SetRamBlockStatus, queue-length=1
          operation=WriteBlock, queue-length=1
      PS_NVM_BLOCK_SER_SYSVERSCODEDDI: provided-interface=NvM_AC3_SRBS_Srv  # P-Port Prototype of NvM_AC3_SRBS_Srv for NVRAM Block NVM_BLOCK_SER_SYSVERSCODEDDI
        provided-com-specs:
          operation=EraseBlock, queue-length=1
          operation=GetErrorStatus, queue-length=1
          operation=InvalidateNvBlock, queue-length=1
          operation=ReadBlock, queue-length=1
          operation=SetRamBlockStatus, queue-length=1
          operation=WriteBlock, queue-length=1
      PS_NVM_BLOCK_SER_VINDATA: provided-interface=NvM_AC3_SRBS_Srv  # P-Port Prototype of NvM_AC3_SRBS_Srv for NVRAM Block NVM_BLOCK_SER_VINDATA
        provided-com-specs:
          operation=EraseBlock, queue-length=1
          operation=GetErrorStatus, queue-length=1
          operation=InvalidateNvBlock, queue-length=1
          operation=ReadBlock, queue-length=1
          operation=SetRamBlockStatus, queue-length=1
          operation=WriteBlock, queue-length=1
      PS_NVM_BLOCK_STAMD_CLOSECHECK: provided-interface=NvM_AC3_SRBS_Srv  # P-Port Prototype of NvM_AC3_SRBS_Srv for NVRAM Block NVM_BLOCK_STAMD_CLOSECHECK
        provided-com-specs:
          operation=EraseBlock, queue-length=1
          operation=GetErrorStatus, queue-length=1
          operation=InvalidateNvBlock, queue-length=1
          operation=ReadBlock, queue-length=1
          operation=SetRamBlockStatus, queue-length=1
          operation=WriteBlock, queue-length=1
      PS_NVM_BLOCK_STAMD_TYPEH: provided-interface=NvM_AC3_SRBS_Srv  # P-Port Prototype of NvM_AC3_SRBS_Srv for NVRAM Block NVM_BLOCK_STAMD_TYPEH
        provided-com-specs:
          operation=EraseBlock, queue-length=1
          operation=GetErrorStatus, queue-length=1
          operation=InvalidateNvBlock, queue-length=1
          operation=ReadBlock, queue-length=1
          operation=SetRamBlockStatus, queue-length=1
          operation=WriteBlock, queue-length=1
      PS_Rte_NvmBlock_AbsHwPos_EOLVehCntrOffset: provided-interface=NvM_AC3_SRBS_Srv  # P-Port Prototype of NvM_AC3_SRBS_Srv for NVRAM Block Rte_NvmBlock_AbsHwPos_EOLVehCntrOffset
        provided-com-specs:
          operation=EraseBlock, queue-length=1
          operation=GetErrorStatus, queue-length=1
          operation=InvalidateNvBlock, queue-length=1
          operation=ReadBlock, queue-length=1
          operation=SetRamBlockStatus, queue-length=1
          operation=WriteBlock, queue-length=1
      PS_Rte_NvmBlock_Ap_AstLmt_SteerAsstDefeat: provided-interface=NvM_AC3_SRBS_Srv  # P-Port Prototype of NvM_AC3_SRBS_Srv for NVRAM Block Rte_NvmBlock_Ap_AstLmt_SteerAsstDefeat
        provided-com-specs:
          operation=EraseBlock, queue-length=1
          operation=GetErrorStatus, queue-length=1
          operation=InvalidateNvBlock, queue-length=1
          operation=ReadBlock, queue-length=1
          operation=SetRamBlockStatus, queue-length=1
          operation=WriteBlock, queue-length=1
      PS_Rte_NvmBlock_Ap_AvgFricLrn_AvgFricLrnData: provided-interface=NvM_AC3_SRBS_Srv  # P-Port Prototype of NvM_AC3_SRBS_Srv for NVRAM Block Rte_NvmBlock_Ap_AvgFricLrn_AvgFricLrnData
        provided-com-specs:
          operation=EraseBlock, queue-length=1
          operation=GetErrorStatus, queue-length=1
          operation=InvalidateNvBlock, queue-length=1
          operation=ReadBlock, queue-length=1
          operation=SetRamBlockStatus, queue-length=1
          operation=WriteBlock, queue-length=1
      PS_Rte_NvmBlock_Ap_LrnEOT_LearnedEOT: provided-interface=NvM_AC3_SRBS_Srv  # P-Port Prototype of NvM_AC3_SRBS_Srv for NVRAM Block Rte_NvmBlock_Ap_LrnEOT_LearnedEOT
        provided-com-specs:
          operation=EraseBlock, queue-length=1
          operation=GetErrorStatus, queue-length=1
          operation=InvalidateNvBlock, queue-length=1
          operation=ReadBlock, queue-length=1
          operation=SetRamBlockStatus, queue-length=1
          operation=WriteBlock, queue-length=1
      PS_Rte_NvmBlock_Ap_TrqCanc_CogTrqCal: provided-interface=NvM_AC3_SRBS_Srv  # P-Port Prototype of NvM_AC3_SRBS_Srv for NVRAM Block Rte_NvmBlock_Ap_TrqCanc_CogTrqCal
        provided-com-specs:
          operation=EraseBlock, queue-length=1
          operation=GetErrorStatus, queue-length=1
          operation=InvalidateNvBlock, queue-length=1
          operation=ReadBlock, queue-length=1
          operation=SetRamBlockStatus, queue-length=1
          operation=WriteBlock, queue-length=1
      PS_Rte_NvmBlock_Ap_TrqCanc_CogTrqRplComp: provided-interface=NvM_AC3_SRBS_Srv  # P-Port Prototype of NvM_AC3_SRBS_Srv for NVRAM Block Rte_NvmBlock_Ap_TrqCanc_CogTrqRplComp
        provided-com-specs:
          operation=EraseBlock, queue-length=1
          operation=GetErrorStatus, queue-length=1
          operation=InvalidateNvBlock, queue-length=1
          operation=ReadBlock, queue-length=1
          operation=SetRamBlockStatus, queue-length=1
          operation=WriteBlock, queue-length=1
      PS_Rte_NvmBlock_Ap_TSMit_TSMitDisableEOL: provided-interface=NvM_AC3_SRBS_Srv  # P-Port Prototype of NvM_AC3_SRBS_Srv for NVRAM Block Rte_NvmBlock_Ap_TSMit_TSMitDisableEOL
        provided-com-specs:
          operation=EraseBlock, queue-length=1
          operation=GetErrorStatus, queue-length=1
          operation=InvalidateNvBlock, queue-length=1
          operation=ReadBlock, queue-length=1
          operation=SetRamBlockStatus, queue-length=1
          operation=WriteBlock, queue-length=1
      PS_Rte_NvmBlock_Ap_TSMit_TSMitGainLrn: provided-interface=NvM_AC3_SRBS_Srv  # P-Port Prototype of NvM_AC3_SRBS_Srv for NVRAM Block Rte_NvmBlock_Ap_TSMit_TSMitGainLrn
        provided-com-specs:
          operation=EraseBlock, queue-length=1
          operation=GetErrorStatus, queue-length=1
          operation=InvalidateNvBlock, queue-length=1
          operation=ReadBlock, queue-length=1
          operation=SetRamBlockStatus, queue-length=1
          operation=WriteBlock, queue-length=1
      PS_Rte_NvmBlock_BatteryVoltage_OvervoltageData: provided-interface=NvM_AC3_SRBS_Srv  # P-Port Prototype of NvM_AC3_SRBS_Srv for NVRAM Block Rte_NvmBlock_BatteryVoltage_OvervoltageData
        provided-com-specs:
          operation=EraseBlock, queue-length=1
          operation=GetErrorStatus, queue-length=1
          operation=InvalidateNvBlock, queue-length=1
          operation=ReadBlock, queue-length=1
          operation=SetRamBlockStatus, queue-length=1
          operation=WriteBlock, queue-length=1
      PS_Rte_NvmBlock_CmMtrCurr_CurrTempOffset: provided-interface=NvM_AC3_SRBS_Srv  # P-Port Prototype of NvM_AC3_SRBS_Srv for NVRAM Block Rte_NvmBlock_CmMtrCurr_CurrTempOffset
        provided-com-specs:
          operation=EraseBlock, queue-length=1
          operation=GetErrorStatus, queue-length=1
          operation=InvalidateNvBlock, queue-length=1
          operation=ReadBlock, queue-length=1
          operation=SetRamBlockStatus, queue-length=1
          operation=WriteBlock, queue-length=1
      PS_Rte_NvmBlock_CmMtrCurr_ShCurrCal: provided-interface=NvM_AC3_SRBS_Srv  # P-Port Prototype of NvM_AC3_SRBS_Srv for NVRAM Block Rte_NvmBlock_CmMtrCurr_ShCurrCal
        provided-com-specs:
          operation=EraseBlock, queue-length=1
          operation=GetErrorStatus, queue-length=1
          operation=InvalidateNvBlock, queue-length=1
          operation=ReadBlock, queue-length=1
          operation=SetRamBlockStatus, queue-length=1
          operation=WriteBlock, queue-length=1
      PS_Rte_NvmBlock_CurrParamComp_EOLNomMtrParam: provided-interface=NvM_AC3_SRBS_Srv  # P-Port Prototype of NvM_AC3_SRBS_Srv for NVRAM Block Rte_NvmBlock_CurrParamComp_EOLNomMtrParam
        provided-com-specs:
          operation=EraseBlock, queue-length=1
          operation=GetErrorStatus, queue-length=1
          operation=InvalidateNvBlock, queue-length=1
          operation=ReadBlock, queue-length=1
          operation=SetRamBlockStatus, queue-length=1
          operation=WriteBlock, queue-length=1
      PS_Rte_NvmBlock_DigColPs_DigColPsEOL: provided-interface=NvM_AC3_SRBS_Srv  # P-Port Prototype of NvM_AC3_SRBS_Srv for NVRAM Block Rte_NvmBlock_DigColPs_DigColPsEOL
        provided-com-specs:
          operation=EraseBlock, queue-length=1
          operation=GetErrorStatus, queue-length=1
          operation=InvalidateNvBlock, queue-length=1
          operation=ReadBlock, queue-length=1
          operation=SetRamBlockStatus, queue-length=1
          operation=WriteBlock, queue-length=1
      PS_Rte_NvmBlock_Polarity_Polarity_Cnt_Str: provided-interface=NvM_AC3_SRBS_Srv  # P-Port Prototype of NvM_AC3_SRBS_Srv for NVRAM Block Rte_NvmBlock_Polarity_Polarity_Cnt_Str
        provided-com-specs:
          operation=EraseBlock, queue-length=1
          operation=GetErrorStatus, queue-length=1
          operation=InvalidateNvBlock, queue-length=1
          operation=ReadBlock, queue-length=1
          operation=SetRamBlockStatus, queue-length=1
          operation=WriteBlock, queue-length=1
      PS_Rte_NvmBlock_Sa_DigHwTrqSENT_DigTrqTrim: provided-interface=NvM_AC3_SRBS_Srv  # P-Port Prototype of NvM_AC3_SRBS_Srv for NVRAM Block Rte_NvmBlock_Sa_DigHwTrqSENT_DigTrqTrim
        provided-com-specs:
          operation=EraseBlock, queue-length=1
          operation=GetErrorStatus, queue-length=1
          operation=InvalidateNvBlock, queue-length=1
          operation=ReadBlock, queue-length=1
          operation=SetRamBlockStatus, queue-length=1
          operation=WriteBlock, queue-length=1
      PS_Rte_NvmBlock_Sa_DigMSB_DigMSBEOLData: provided-interface=NvM_AC3_SRBS_Srv  # P-Port Prototype of NvM_AC3_SRBS_Srv for NVRAM Block Rte_NvmBlock_Sa_DigMSB_DigMSBEOLData
        provided-com-specs:
          operation=EraseBlock, queue-length=1
          operation=GetErrorStatus, queue-length=1
          operation=InvalidateNvBlock, queue-length=1
          operation=ReadBlock, queue-length=1
          operation=SetRamBlockStatus, queue-length=1
          operation=WriteBlock, queue-length=1
      PS_Rte_NvmBlock_SrlComOutput_DTCTrigSts: provided-interface=NvM_AC3_SRBS_Srv  # P-Port Prototype of NvM_AC3_SRBS_Srv for NVRAM Block Rte_NvmBlock_SrlComOutput_DTCTrigSts
        provided-com-specs:
          operation=EraseBlock, queue-length=1
          operation=GetErrorStatus, queue-length=1
          operation=InvalidateNvBlock, queue-length=1
          operation=ReadBlock, queue-length=1
          operation=SetRamBlockStatus, queue-length=1
          operation=WriteBlock, queue-length=1
      PS_Rte_NvmBlock_TrqCmdScl_TorqueCmdSF_Uls_f32: provided-interface=NvM_AC3_SRBS_Srv  # P-Port Prototype of NvM_AC3_SRBS_Srv for NVRAM Block Rte_NvmBlock_TrqCmdScl_TorqueCmdSF_Uls_f32
        provided-com-specs:
          operation=EraseBlock, queue-length=1
          operation=GetErrorStatus, queue-length=1
          operation=InvalidateNvBlock, queue-length=1
          operation=ReadBlock, queue-length=1
          operation=SetRamBlockStatus, queue-length=1
          operation=WriteBlock, queue-length=1
      PS_Rte_NvmBlock_VehDyn_MotPosReset: provided-interface=NvM_AC3_SRBS_Srv  # P-Port Prototype of NvM_AC3_SRBS_Srv for NVRAM Block Rte_NvmBlock_VehDyn_MotPosReset
        provided-com-specs:
          operation=EraseBlock, queue-length=1
          operation=GetErrorStatus, queue-length=1
          operation=InvalidateNvBlock, queue-length=1
          operation=ReadBlock, queue-length=1
          operation=SetRamBlockStatus, queue-length=1
          operation=WriteBlock, queue-length=1
  swc implementation NvM_Implementation: behavior=NvM_InternalBehavior
    code-descriptors:
      code Code: type=SRC
