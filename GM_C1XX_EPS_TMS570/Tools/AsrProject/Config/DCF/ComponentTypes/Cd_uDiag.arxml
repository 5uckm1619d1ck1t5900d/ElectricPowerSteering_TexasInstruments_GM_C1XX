AUTOSAR XML (schema 314)
package /ComponentType
  complex device driver component type Cd_uDiag
    require port NxtrDiagMgr: required-com-specs=[GetNTCActive, GetNTCFailed, GetNTCStatus, SetNTCStatus], required-interface=NxtrDiagMgr
    require port uDiagLossOfExec_Per3_CP0: client-com-spec=CheckpointReached, required-interface=WdgM_CheckpointReached
    require port uDiagStaticRegs_Per_CP1: client-com-spec=CheckpointReached, required-interface=WdgM_CheckpointReached
  internal behavior Cd_uDiag_InternalBehavior: component=Cd_uDiag
    7 x timing event:
      TMT_uDiagECC_Per: start-on-event=uDiagECC_Per, period=0.01
      TMT_uDiagLossOfExec_Per2: start-on-event=uDiagLossOfExec_Per2, period=0.002
      TMT_uDiagLossOfExec_Per3: start-on-event=uDiagLossOfExec_Per3, period=0.004
      uDiagPeriphStartup_InitEvent: start-on-event=uDiagPeriphStartup_Init, period=0
      uDiagResetHandler_InitEvent: start-on-event=uDiagResetHandler_Init, period=0
      TMT_uDiagStaticRegs_Per: start-on-event=uDiagStaticRegs_Per, period=0.1
      TMT_uDiagVIM_Per: start-on-event=uDiagVIM_Per, period=0.01
    port-api-options:
      enable-take-address=false, indirect-api=false, port=NxtrDiagMgr
      enable-take-address=false, indirect-api=false, port=uDiagLossOfExec_Per3_CP0
      enable-take-address=false, indirect-api=false, port=uDiagStaticRegs_Per_CP1
    7 x runnable:
      uDiagECC_Per
      uDiagLossOfExec_Per2
      uDiagLossOfExec_Per3
        sync call SC_NxtrDiagMgr_SetNTCStatus: operation=NxtrDiagMgr.SetNTCStatus, timeout=0
        sync call SC_uDiagLossOfExec_Per3_CP0_CheckpointReached: operation=uDiagLossOfExec_Per3_CP0.CheckpointReached, timeout=0
      uDiagPeriphStartup_Init
        sync call SC_NxtrDiagMgr_SetNTCStatus: operation=NxtrDiagMgr.SetNTCStatus, timeout=0
      uDiagResetHandler_Init
        sync call SC_NxtrDiagMgr_SetNTCStatus: operation=NxtrDiagMgr.SetNTCStatus, timeout=0
      uDiagStaticRegs_Per
        sync call SC_uDiagStaticRegs_Per_CP1_CheckpointReached: operation=uDiagStaticRegs_Per_CP1.CheckpointReached, timeout=0
      uDiagVIM_Per
  swc implementation Cd_uDiag_Implementation: behavior=Cd_uDiag_InternalBehavior
    code-descriptors:
      code Code: type=SRC
