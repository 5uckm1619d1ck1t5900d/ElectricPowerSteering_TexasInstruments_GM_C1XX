AUTOSAR XML (schema 314)
package /ModeDclrGroup
  mode declaration group EcuM_Mode: initial-mode=STARTUP
    6 x mode:
      POST_RUN
      RUN
      SHUTDOWN
      SLEEP
      STARTUP
      WAKE_SLEEP
  mode declaration group StaMd_Mode: initial-mode=WARMINIT  # EPS System State mode declaration
    4 x mode:
      DISABLE
      OFF
      OPERATE
      WARMINIT
package /PortInterface
  65 x client server interface:
    AbsHwPos_SCom
      4 x operation:
        CustClrTrim
        CustSetTrim: possible-error=TrimNotPerformed
        NxtClearTrim
        NxtSetTrim: possible-error=[TrimNotPerformed, ValueNotAccepted]
          arg Offset_HwDeg_T_f32: type=Float, direction=IN
      error TrimNotPerformed: error-code=34
      error ValueNotAccepted: error-code=49
    ActivePull_SCom  # Serial communication port for setting and getting a sdoftware component parameter. The parameter is typically an EOL parameter.
      4 x operation:
        ReadParam
          4 x arg, all with direction=OUT:
            PullCompCmd_HwNm_f32: type=Float
            STComp_HwNm_f32: type=Float
            LTComp_HwNm_f32: type=Float
            EnableLearn_Cnt_lgc: type=Boolean
        Reset
        SetLTComp
          arg LTComp_HwNm_f32: type=Float, direction=IN
        SetSTComp
          arg STComp_HwNm_f32: type=Float, direction=IN
    AssistLmtFunc_Scom
      operation GetSteeringAssistDefeat
        arg SteeringAsstDefeat_Cnt_lgc: type=Boolean, direction=OUT
      operation ManualTrqCmd: possible-error=[RTE_E_MtrTrqLmt_SCom_VSTH, RTE_E_OK]
        arg EnableManualCtrl: type=Boolean, direction=IN
        arg MtrTrqCmd_MtrNm_f32: type=Float, direction=IN
      operation SetSteeringAssistDefeat
        arg SteeringAsstDefeat_Cnt_lgc: type=Boolean, direction=IN
      error RTE_E_MtrTrqLmt_SCom_VSTH: error-code=34
      error RTE_E_OK: error-code=1
    AvgFricLrn_SCom
      9 x operation:
        CaptureOnTheFly
        GetEOLFric
          arg EOLFric_HwNm_f32: type=Float, direction=OUT
        GetOffsetOutputDefeat
          arg DefeatOffsetOutput_Cnt_lgc: type=Boolean, direction=OUT
        GetSelect
          arg EnableFricLearning_Cnt_lgc: type=Boolean, direction=OUT
          arg EnableOffsetOutput_Cnt_lgc: type=Boolean, direction=OUT
          arg OpMode_Uls_u08: type=UInt8, direction=OUT
        InitLearnedTables
        ResetToZero
        SetEOLFric
          arg EOLFric_HwNm_f32: type=Float, direction=IN
        SetOffsetOutputDefeat
          arg DefeatOffsetOutput_Cnt_lgc: type=Boolean, direction=IN
        SetSelect
          arg EnableFricLearning_Cnt_lgc: type=Boolean, direction=IN
          arg EnableOffsetOutput_Cnt_lgc: type=Boolean, direction=IN
          arg OpMode_Uls_u08: type=UInt8, direction=IN
    BatteryVoltage_SCom
      operation ClearTransOvData
      operation ReadTransOvData
        arg OvervoltageCounter_Cnt_u16: type=UInt16, direction=OUT
        arg MaxBattVoltage_Volts_f32: type=Float, direction=OUT
    CDDPorts: is-service=true
      operation ApplyMtrElecMechPol
        arg MtrElecMechPol_Cnt_s8: type=SInt8, direction=IN
      operation ClearPhsReasSum
        arg DataAccessBfr_Cnt_T_u16: type=UInt16, direction=IN
    CmMtrCurr_SCom
      5 x operation:
        CalGain: possible-error=[ConditionNotCorrect, CurrentOutOfRange, VehSpdOutofRange]
        CalOffset: possible-error=[ConditionNotCorrect, CurrentOutOfRange, VehSpdOutofRange]
        MtrCurrOffReadStatus
          arg CurrOffStatus: type=MtrCurrOffProcessFlag, direction=OUT
        ReadMtrCurrCals
          arg ShCurrCalPtr: type=PhaseCurrCal_DataType, direction=OUT
        SetMtrCurrCals
          arg ShCurrCalPtr: type=PhaseCurrCal_DataType, direction=IN
      error ConditionNotCorrect: error-code=34
      error CurrentOutOfRange: error-code=20
      error VehSpdOutofRange: error-code=21
    ComM_ChannelLimitation: is-service=true
      operation GetInhibitionStatus: possible-error=ComM_ChannelLimitation/E_NOT_OK
        arg Status: type=ComM_InhibitionStatusType, direction=OUT
      operation LimitChannelToNoComMode: possible-error=ComM_ChannelLimitation/E_NOT_OK
        arg Status: type=Boolean, direction=IN
      error E_NOT_OK: error-code=1
    ComM_ChannelWakeUp: is-service=true
      operation PreventWakeUp: possible-error=ComM_ChannelWakeUp/E_NOT_OK
        arg Status: type=Boolean, direction=IN
      error E_NOT_OK: error-code=1
    ComM_ECUModeLimitation: is-service=true
      4 x operation, all with possible-error=ComM_ECUModeLimitation/E_NOT_OK:
        LimitECUToNoComMode
          arg Status: type=Boolean, direction=IN
        ReadInhibitCounter
          arg CounterValue: type=UInt16, direction=OUT
        ResetInhibitCounter
        SetECUGroupClassification
          arg Status: type=ComM_InhibitionStatusType, direction=IN
      error E_NOT_OK: error-code=1
    ComM_GetNumSendRcvAppl: is-service=true
      operation GetNumSendRcvAppl: possible-error=ComM_GetNumSendRcvAppl/E_NOT_OK
        arg sendRcvApplCount: type=UInt8, direction=OUT
      error E_NOT_OK: error-code=1
    ComM_UserRequest: is-service=true
      4 x operation:
        GetCurrentComMode: possible-error=ComM_UserRequest/E_NOT_OK
          arg ComMode: type=ComM_ModeType, direction=OUT
        GetMaxComMode: possible-error=ComM_UserRequest/E_NOT_OK
          arg ComMode: type=ComM_ModeType, direction=OUT
        GetRequestedComMode: possible-error=ComM_UserRequest/E_NOT_OK
          arg ComMode: type=ComM_ModeType, direction=OUT
        RequestComMode: possible-error=[COMM_E_MODE_LIMITATION, ComM_UserRequest/E_NOT_OK]
          arg ComMode: type=ComM_ModeType, direction=IN
      error COMM_E_MODE_LIMITATION: error-code=2
      error E_NOT_OK: error-code=1
    CustPerSrvcs_SCom
      operation ReadActivePullParam
      operation ReadLrnEOTParam
      operation ResetThrmlCntr
    DemIf
      4 x operation:
        DemShutdown
        RestartDem
        SetEventStatus: possible-error=DemIf/E_NOT_OK
          arg EventId: type=UInt8, direction=IN
          arg EventStatus: type=NxtrDiagMgrStatus, direction=IN
        SetOperationCycleState
          arg NxtrOperationCycleId: type=NxtrOpCycle, direction=IN
          arg NxtrCycleState: type=NxtrOpCycleState, direction=IN
      error E_NOT_OK: error-code=1
    DiagMgr_StaCtrl
      operation Shutdown
    DigColPs_SCom
      4 x operation:
        CustClearTrim
        CustSetTrim: possible-error=DigColPs_SCom/ConditionsNotCorrect
        NxtClrTrim
        NxtSetTrim: possible-error=DigColPs_SCom/ConditionsNotCorrect
      error ConditionsNotCorrect: error-code=34
    DigHwTrqSENT_SCom
      4 x operation:
        ClrTrqTrim: possible-error=DigHwTrqSENT_SCom/ConditionsNotCorrect
        SetTrqTrim: possible-error=DigHwTrqSENT_SCom/ConditionsNotCorrect
        TrimData
          arg EOLHwTrqTrim_HwNm_f32: type=Float, direction=OUT
          arg EOLHwTrqTrimPerformed_Cnt_Lgc: type=Boolean, direction=OUT
        WriteData
          arg HwTrqTrim_HwNm_f32: type=Float, direction=IN
      error ConditionsNotCorrect: error-code=34
    DigitalIn
      operation OP_SET: possible-error=DigitalIn/E_NOT_OK
        arg signal: type=IoHwAb_BoolType, direction=IN
      error E_NOT_OK: error-code=1
    DigitalInOut
      operation OP_GET: possible-error=DigitalInOut/E_NOT_OK
        arg signal: type=IoHwAb_BoolType, direction=OUT
      operation OP_SET: possible-error=DigitalInOut/E_NOT_OK
        arg signal: type=IoHwAb_BoolType, direction=IN
      error E_NOT_OK: error-code=1
    DigitalOut
      operation OP_SET: possible-error=DigitalOut/E_NOT_OK
        arg signal: type=IoHwAb_BoolType, direction=IN
      error E_NOT_OK: error-code=1
    EpsEn
      operation OP_GET: possible-error=EpsEn/E_NOT_OK
        arg signal: type=IoHwAb_BoolType, direction=OUT
      error E_NOT_OK: error-code=1
    FaultInjection_SCom
      operation FltInjection
        arg SignalPath_Uls_f32: type=Float, direction=INOUT
        arg LocationKey_Cnt_enum: type=FltInjectionLocType, direction=IN
    FetDrvCntl
      operation OP_GET: possible-error=FetDrvCntl/E_NOT_OK
        arg signal: type=IoHwAb_BoolType, direction=OUT
      error E_NOT_OK: error-code=1
    FetDrvReset
      operation OP_GET: possible-error=FetDrvReset/E_NOT_OK
        arg signal: type=IoHwAb_BoolType, direction=OUT
      operation OP_SET: possible-error=FetDrvReset/E_NOT_OK
        arg signal: type=IoHwAb_BoolType, direction=IN
      error E_NOT_OK: error-code=1
    FetFlt1Data
      operation OP_GET: possible-error=FetFlt1Data/E_NOT_OK
        arg signal: type=IoHwAb_BoolType, direction=OUT
      error E_NOT_OK: error-code=1
    FetFlt2Clk
      operation OP_GET: possible-error=FetFlt2Clk/E_NOT_OK
        arg signal: type=IoHwAb_BoolType, direction=OUT
      operation OP_SET: possible-error=FetFlt2Clk/E_NOT_OK
        arg signal: type=IoHwAb_BoolType, direction=IN
      error E_NOT_OK: error-code=1
    FltInjection_SCom
      operation FltInjection
        arg SignalPath_Uls_f32: type=Float, direction=INOUT
        arg LocationKey_Cnt_enum: type=FltInjectionLocType, direction=IN
    GeneratePosTraj_SCom  # Serial communication port for setting and getting a sdoftware component parameter. The parameter is typically an EOL parameter.
      operation SetInputParam
        arg PosServHwAngle_HwDeg_f32: type=Float, direction=IN
        arg TargetVelocity_HwDegpSec_f32: type=Float, direction=IN
        arg TargetAcceleration_HwDegpSecSqr_f32: type=Float, direction=IN
    IoHwAbPortConfig
      operation SetFetFlt2ToOutput: possible-error=IoHwAbPortConfig/E_NOT_OK
        arg signal: type=IoHwAb_BoolType, direction=IN
      error E_NOT_OK: error-code=1
    LrnEOT_Scom
      operation ResetEOT
      operation ResetRckCntrPrf
    MilestoneRequest
      operation WarmInitMilestoneComplete
        arg user: type=StaMd_Users, direction=IN
      operation WarmInitMilestoneNotComplete
        arg user: type=StaMd_Users, direction=IN
    MtrCurrTempOffset_Scom
      operation Get
        arg CurrTempOffCal: type=CurrTempOffsetType, direction=OUT
      operation Set
        arg CurrTempOffCal: type=CurrTempOffsetType, direction=IN
    NvM_AC3_SRBS_Srv: is-service=true  # Port Interface for NVRAM Blocks of Management Types "NATIVE" or "REDUNDANT" without default values.
      6 x operation:
        EraseBlock: possible-error=NvM_AC3_SRBS_Srv/E_NOT_OK
        GetErrorStatus
          arg ErrorStatus: type=NvM_RequestResultType, direction=OUT
        InvalidateNvBlock: possible-error=NvM_AC3_SRBS_Srv/E_NOT_OK
        ReadBlock: possible-error=NvM_AC3_SRBS_Srv/E_NOT_OK
          arg DstPtr: type=NvM_DestPtr, direction=OUT
        SetRamBlockStatus
          arg RamBlockStatus: type=Boolean, direction=IN
        WriteBlock: possible-error=NvM_AC3_SRBS_Srv/E_NOT_OK
          arg DstPtr: type=NvM_DestPtr, direction=IN
      error E_NOT_OK: error-code=1
    NvM_Administration: is-service=true
      operation SetBlockProtection
        arg ProtectionEnabled: type=Boolean, direction=IN
    NxtrDiagMgr
      4 x operation, all with possible-error=NxtrDiagMgr/E_NOT_OK:
        GetNTCActive
          arg NTC_Cnt_T_enum: type=NTCNumber, direction=IN
          arg NTCActive_Ptr_T_lgc: type=Boolean, direction=OUT
        GetNTCFailed
          arg NTC_Cnt_T_enum: type=NTCNumber, direction=IN
          arg NTCFailed_Ptr_T_lgc: type=Boolean, direction=OUT
        GetNTCStatus
          arg NTC_Cnt_T_enum: type=NTCNumber, direction=IN
          arg Status_Ptr_T_u08: type=UInt8, direction=OUT
        SetNTCStatus
          arg NTC_Cnt_T_enum: type=NTCNumber, direction=IN
          arg Param_Cnt_T_u08: type=UInt8, direction=IN
          arg Status_Cnt_T_enum: type=NxtrDiagMgrStatus, direction=IN
      error E_NOT_OK: error-code=1
    OvrVoltFdbk
      operation OP_GET: possible-error=OvrVoltFdbk/E_NOT_OK
        arg signal: type=IoHwAb_BoolType, direction=OUT
      error E_NOT_OK: error-code=1
    Polarity_SCom
      operation ReadPolarity
        arg Polarity_Ptr_T_b08: type=UInt8, direction=OUT
      operation SetPolarity
        arg Polarity_Cnt_T_b08: type=UInt8, direction=IN
    PwrSwitchEn
      operation OP_GET: possible-error=PwrSwitchEn/E_NOT_OK
        arg signal: type=IoHwAb_BoolType, direction=OUT
      error E_NOT_OK: error-code=1
    SCom_AnaMSBArbn_MtrPos
      operation ReadEOLMtrCals
        arg MtrCalDataPtr: type=MtrPosCal_DataType, direction=OUT
        arg Mtr2CalDataPtr: type=MtrPos2Cal_DataType, direction=OUT
      operation SetEOLMtrCals
        arg MtrCalDataPtr: type=MtrPosCal_DataType, direction=IN
        arg Mtr2CalDataPtr: type=MtrPos2Cal_DataType, direction=IN
    SCom_AnaMSBArbn_MtrPos3
      operation ReadEOLMtrCals
        arg Mtr3CalDataPtr: type=MtrPos3Cal_DataType, direction=OUT
      operation SetEOLMtrCals
        arg Mtr3CalDataPtr: type=MtrPos3Cal_DataType, direction=IN
    SCom_EOLNomMtrParam  # Serial communication port for setting and getting a sdoftware component parameter. The parameter is typically an EOL parameter.
      operation Get
        arg NomKe_VpRadpS_f32: type=Float, direction=OUT
        arg NomRmtr_Ohm_f32: type=Float, direction=OUT
      operation Set
        arg NomKe_VpRadpS_f32: type=Float, direction=IN
        arg NomRmtr_Ohm_f32: type=Float, direction=IN
      error ConditionsNotCorrect: error-code=34
      error RequestOutOfRange: error-code=49
    SCom_NxtrDiagMgr
      4 x operation:
        ClearBlackBox
        GetNTCInfo
          4 x arg:
            NTC_Cnt_T_enum: type=NTCNumber, direction=IN
            Param_Ptr_T_u08: type=UInt8, direction=OUT
            Status_Ptr_T_u08: type=UInt8, direction=OUT
            AgingCounter_Ptr_T_u08: type=UInt8, direction=OUT
        ReadStrgArray
        ResetNTCStatus
    SCom_ParEng  # Serial communication port for setting and getting a sdoftware component parameter. The parameter is typically an EOL parameter.
      operation Get
        arg Par_f32: type=Float, direction=OUT
      operation Set
        arg Par_f32: type=Float, direction=IN
      error ConditionsNotCorrect: error-code=34
      error RequestOutOfRange: error-code=49
    Spi_Ch: is-service=true
      operation SetupEB
        arg SrcDataBufferPtr: type=Spi_DataPtr, direction=IN
        arg DesDataBufferPtr: type=Spi_DataPtr, direction=IN
        arg Length: type=Spi_NumberOfDataType, direction=IN
    Spi_Notification: is-service=true
      operation JobEnd
      operation SequenceEnd
    Spi_Seq: is-service=true
      operation AsyncTransmit
      operation GetSequenceResult: possible-error=[SPI_SEQ_CANCELLED, SPI_SEQ_FAILED, SPI_SEQ_PENDING]
      error SPI_SEQ_CANCELLED: error-code=3
      error SPI_SEQ_FAILED: error-code=2
      error SPI_SEQ_PENDING: error-code=1
    SrlComInput_SCom
      4 x operation:
        GetSrlComWIRFltStatus
          arg SrlComWIRFltStatus: type=UInt16, direction=OUT
        ManualVehSpd
          arg VehSpd_Kph_f32: type=Float, direction=IN
        ResetBus1Timers
        ResetBus2Timers
    StaMd_SCom
      operation EcuReset
    StateRequest: is-service=true
      5 x operation, all with possible-error=StateRequest/E_NOT_OK:
        GetState
          arg state: type=EcuM_StateType, direction=OUT
        ReleasePOSTRUN
        ReleaseRUN
        RequestPOSTRUN
        RequestRUN
      error E_NOT_OK: error-code=1
    SysFault2
      operation OP_GET: possible-error=SysFault2/E_NOT_OK
        arg signal: type=IoHwAb_BoolType, direction=OUT
      operation OP_SET: possible-error=SysFault2/E_NOT_OK
        arg signal: type=IoHwAb_BoolType, direction=IN
      error E_NOT_OK: error-code=1
    SysFault3
      operation OP_GET: possible-error=SysFault3/E_NOT_OK
        arg signal: type=IoHwAb_BoolType, direction=OUT
      operation OP_SET: possible-error=SysFault3/E_NOT_OK
        arg signal: type=IoHwAb_BoolType, direction=IN
      error E_NOT_OK: error-code=1
    SystemTime: is-service=true
      6 x operation:
        DtrmnElapsedTime_mS_u16  # Nexteer SystemTime Service
          arg InitialTime: type=UInt32, direction=IN
          arg ElapsedTime: type=UInt16, direction=OUT
        DtrmnElapsedTime_mS_u32
          arg InitialTime: type=UInt32, direction=IN
          arg ElapsedTime: type=UInt32, direction=OUT
        DtrmnElapsedTime_uS_u16
          arg InitialTime: type=UInt32, direction=IN
          arg ElapsedTime: type=UInt16, direction=OUT
        DtrmnElapsedTime_uS_u32
          arg InitialTime: type=UInt32, direction=IN
          arg ElapsedTime: type=UInt32, direction=OUT
        GetSystemTime_mS_u32
          arg CurrentTime: type=UInt32, direction=OUT
        GetSystemTime_uS_u32
          arg CurrentTime: type=UInt32, direction=OUT
    TcCS
      operation OP_SET: possible-error=TcCS/E_NOT_OK
        arg signal: type=IoHwAb_BoolType, direction=IN
      error E_NOT_OK: error-code=1
    TcMCLR
      operation OP_SET: possible-error=TcMCLR/E_NOT_OK
        arg signal: type=IoHwAb_BoolType, direction=IN
      error E_NOT_OK: error-code=1
    TODReset
      operation OP_SET: possible-error=TODReset/E_NOT_OK
        arg signal: type=IoHwAb_BoolType, direction=IN
      error E_NOT_OK: error-code=1
    TrqCanc_Scom
      4 x operation:
        ReadCogTrqCal
          arg CogTrqCalPtr: type=CoggingCancTrq, direction=OUT
          arg ID: type=UInt16, direction=IN
        ReadCogTrqCalComp
          arg ID: type=UInt16, direction=IN
          arg CogTrqCalPtr: type=CoggingCancTrq, direction=OUT
        SetCogTrqCal
          arg CogTrqCalPtr: type=CoggingCancTrq, direction=IN
          arg ID: type=UInt16, direction=IN
        SetCogTrqCalComp
          arg ID: type=UInt16, direction=IN
          arg CogTrqCalPtr: type=CoggingCancTrq, direction=OUT
    TSMit_SCom
      7 x operation:
        GainReset
        GetFcnDefeat
          arg FunctionDefeat_Cnt_lgc: type=Boolean, direction=OUT
        GetLongTermGains
          arg LTPosTransGain_HwNmpTransNm_f32: type=Float, direction=OUT
          arg LTNegTransGain_HwNmpTransNm_f32: type=Float, direction=OUT
        GetLrnDefeat
          arg LearningDefeat_Cnt_lgc: type=Boolean, direction=OUT
        SetFcnDefeat
          arg FunctionDefeat_Cnt_lgc: type=Boolean, direction=IN
        SetLongTermGains
          arg LTPosTransGain_HwNmpTransNm_f32: type=Float, direction=IN
          arg LTNegTransGain_HwNmpTransNm_f32: type=Float, direction=IN
        SetLrnDefeat
          arg LearningDefeat_Cnt_lgc: type=Boolean, direction=IN
    VehDyn_SCom
      operation ForceCenter
      operation ResetCenter
    WdgM_AliveSupervision: is-service=true
      operation CheckpointReached: possible-error=WdgM_AliveSupervision/E_NOT_OK  # Indicates to the Watchdog Manager that a Checkpoint within a Supervised Entity has been reached.
      error E_NOT_OK: error-code=1
    WdgM_CheckpointReached: is-service=true
      operation CheckpointReached: possible-error=WdgM_CheckpointReached/E_NOT_OK  # Indicates to the Watchdog Manager that a Checkpoint within a Supervised Entity has been reached.
      error E_NOT_OK: error-code=1
    WdgM_GlobalMode: is-service=true
      7 x operation, all with possible-error=WdgM_GlobalMode/E_NOT_OK:
        GetGlobalStatus  # Returns the global monitoring status of the Watchdog Manager.
          arg Status: type=WdgM_GlobalStatusType, direction=OUT
        GetMode  # Returns the current mode of the Watchdog Manager.
          arg Mode: type=WdgM_ModeType, direction=OUT
        GlobalStateChangeCbk  # Global state change callback notification
          arg Status: type=WdgM_GlobalStatusType, direction=IN
        LocalStateChangeCbk  # Local state change callback notification
          arg Status: type=WdgM_LocalStatusType, direction=IN
        MainFunction  # Performs the processing of the cyclic Watchdog Manager jobs.
        PerformReset  # Instructs the Watchdog Manager to cause a watchdog reset.
        SetMode  # Sets the mode of the Watchdog Manager if the caller is allowed to do so.
      error E_NOT_OK: error-code=1
    WdgM_IndividualMode: is-service=true
      operation ActivateSupervisionEntity: possible-error=WdgM_IndividualMode/E_NOT_OK  # This function activates the monitoring of the given Supervised Entity
      operation DeactivateSupervisionEntity: possible-error=WdgM_IndividualMode/E_NOT_OK  # This function deactivates the monitoring of the given Supervised Entity
      operation GetLocalStatus: possible-error=WdgM_IndividualMode/E_NOT_OK  # Returns the monitoring status of an individual Supervised Entity.
        arg Status: type=WdgM_LocalStatusType, direction=OUT
      error E_NOT_OK: error-code=1
    WdMonitor
      operation OP_SET: possible-error=WdMonitor/E_NOT_OK
        arg signal: type=IoHwAb_BoolType, direction=IN
      error E_NOT_OK: error-code=1
    WdReset
      operation OP_SET: possible-error=WdReset/E_NOT_OK
        arg signal: type=IoHwAb_BoolType, direction=IN
      error E_NOT_OK: error-code=1
    WhlImbRej_SCom
      operation GetWIRInfo
        5 x arg, all with direction=OUT:
          WIRCmpActRng{1..3}Ptr_Cnt_u32: type=UInt32
          AlgFltStatusPtr_Cnt_b16: type=UInt16
          WIRMaxCompPtr_Pct_f32: type=Float
  89 x sender receiver interface:
    AltFaultActive_Cnt_lgc
      data Cnt_lgc: type=Boolean
    APA_State_enum
      data State_enum: sw-calibration-access=READ-ONLY, type=APA_State_enum
    Authority
      data Uls_f32: sw-calibration-access=READ-ONLY, type=Float
    Authority_Uls_f32
      data Uls_f32: sw-calibration-access=READ-ONLY, type=Float
    BattSwdVltgCorrSts_Cnt_enum
      data Cnt_enum: sw-calibration-access=READ-ONLY, type=BattSwdVltgCorrSts_Cnt_enum
    BoolStatusFlag
      data Cnt_lgc: sw-calibration-access=READ-ONLY, type=Boolean
    BoolStatusFlag_Cnt_lgc
      data Cnt_lgc: sw-calibration-access=READ-ONLY, type=Boolean
    BoolStatusFlagCnt_lgc
      data Cnt_lgc: sw-calibration-access=READ-ONLY, type=Boolean
    Count_Cnt_s08
      data Cnt_s08: sw-calibration-access=READ-ONLY, type=SInt8
    Count_Cnt_s16
      data Cnt_s16: sw-calibration-access=READ-ONLY, type=SInt16
    Count_Cnt_s32
      data Cnt_s32: sw-calibration-access=READ-ONLY, type=SInt32
    Count_Cnt_u08
      data Cnt_u08: sw-calibration-access=READ-ONLY, type=UInt8
    Count_Cnt_u16
      data Cnt_u16: sw-calibration-access=READ-ONLY, type=UInt16
    Count_Cnt_u32
      data Cnt_u32: sw-calibration-access=READ-ONLY, type=UInt32
    Current_Amp_f32
      data Amp_f32: sw-calibration-access=READ-ONLY, type=Float
    DefeatFricLearning
      data Cnt_lgc: sw-calibration-access=READ-ONLY, type=Boolean
    Direction_Cnt_s08
      data Cnt_s08: sw-calibration-access=READ-ONLY, type=SInt8
    Distance_mm_f32
      data mm_f32: sw-calibration-access=READ-ONLY, type=Float
    DrvrModCtrl_enum
      data Cnt_enum: sw-calibration-access=READ-ONLY, type=DrvrModCtrl_enum
    EcuM_CurrentMode: is-service=true
      mode declaration group prototype currentMode: type=EcuM_Mode
    Enable
      data Cnt_lgc: sw-calibration-access=READ-ONLY, type=Boolean
    Enable_Cnt_lgc
      data Cnt_lgc: sw-calibration-access=READ-ONLY, type=Boolean
    EnergyModeState_Cnt_enum
      data Cnt_enum: type=EnergyModeStateType
    EngSpd_Rpm_f32
      data Rpm_f32: sw-calibration-access=READ-ONLY, type=Float
    EOTDisable_Cnt_T_lgc
      data Cnt_lgc: sw-calibration-access=READ-ONLY, type=Boolean
    ESC_State_enum
      data State_enum: sw-calibration-access=READ-ONLY, type=ESC_State_enum
    FETFaultPhase
      data Cnt_enum: sw-calibration-access=READ-ONLY, type=FETPHASETYPE_ENUM
    FETFaultType
      data Cnt_enum: sw-calibration-access=READ-ONLY, type=FETFAULTTYPE_ENUM
    Force_kN_f32
      data kN_f32: sw-calibration-access=READ-ONLY, type=Float
    Frequency
      data Hz_f32: sw-calibration-access=READ-ONLY, type=Float
    Frequency_Hz_f32
      data Hz_f32: sw-calibration-access=READ-ONLY, type=Float
    Haptic_State_enum
      data State_enum: sw-calibration-access=READ-ONLY, type=Haptic_State_enum
    HwAccel_HwDegpSecSqr_f32
      data HwDegpSecSqr_f32: sw-calibration-access=READ-ONLY, type=Float
    HwPos
      data HwDeg_f32: sw-calibration-access=READ-ONLY, type=Float
    HwPos_HwDeg_f32
      data HwDeg_f32: sw-calibration-access=READ-ONLY, type=Float
    HwTrq
      data HwNm_f32: sw-calibration-access=READ-ONLY, type=Float
    HwTrq_HwNm_f32
      data HwNm_f32: sw-calibration-access=READ-ONLY, type=Float
    HwVel
      data HwRadpS_f32: sw-calibration-access=READ-ONLY, type=Float
    HwVel_HwDegpSec_f32
      data HwDegpSec_f32: sw-calibration-access=READ-ONLY, type=Float
    HwVel_HwRadpS_f32
      data HwRadpS_f32: sw-calibration-access=READ-ONLY, type=Float
    IgnCnt_Cnt_u16
      data Cnt_u16: sw-calibration-access=READ-ONLY, type=UInt16
    Inductance_Henry_f32
      data Henry_f32: sw-calibration-access=READ-ONLY, type=Float
    LatAccel_g_f32
      data g_f32: sw-calibration-access=READ-ONLY, type=Float
    LKA_State_enum
      data State_enum: sw-calibration-access=READ-ONLY, type=LKA_State_enum
    LOA_State_enum
      data State_enum: sw-calibration-access=READ-ONLY, type=LOA_State_enum
    ManufModes_Cnt_enum
      data Cnt_enum: sw-calibration-access=READ-ONLY, type=ManufModeType
    MtrPos_Deg_f32
      data Deg_f32: sw-calibration-access=READ-ONLY, type=Float
    MtrPos_Rad_f32
      data Rad_f32: sw-calibration-access=READ-ONLY, type=Float
    MtrPos_Rev_f32
      data Rev_f32: sw-calibration-access=READ-ONLY, type=Float
    MtrPos_Rev_u0p16
      data Rev_u0p16: sw-calibration-access=READ-ONLY, type=UInt16
    MtrQuad_Cnt_u08
      data Cnt_u08: sw-calibration-access=READ-ONLY, type=UInt8
    MtrRampRate_MtrNmpS_f32
      data MtrNmpS_f32: sw-calibration-access=READ-ONLY, type=Float
    MtrTrq
      data MtrNm_f32: sw-calibration-access=READ-ONLY, type=Float
    MtrTrq_MtrNm_f32
      data MtrNm_f32: sw-calibration-access=READ-ONLY, type=Float
    MtrVel
      data MtrRadpS_f32: sw-calibration-access=READ-ONLY, type=Float
    MtrVel_MtrRadpS_f32
      data MtrRadpS_f32: sw-calibration-access=READ-ONLY, type=Float
    MtrVltConstant_VpRadpS_f32
      data VpRadpS_f32: sw-calibration-access=READ-ONLY, type=Float
    PhsAdv_Cnt_s16
      data Cnt_s16: sw-calibration-access=READ-ONLY, type=SInt16
    PI_RawADCSig
      data Volts_f32: sw-calibration-access=READ-ONLY, type=Float
    PkCurr_AmpSq_f32
      data AmpSq_f32: sw-calibration-access=READ-ONLY, type=Float
    Power_Watt_f32
      data Watt_f32: sw-calibration-access=READ-ONLY, type=Float
    RampRate
      data XpmS_f32: sw-calibration-access=READ-ONLY, type=Float
    RampRate_UlspS_f32
      data UlspS_f32: sw-calibration-access=READ-ONLY, type=Float
    RampRate_XpmS_f32
      data XpmS_f32: sw-calibration-access=READ-ONLY, type=Float
    Resistance_Ohm_f32
      data Ohm_f32: sw-calibration-access=READ-ONLY, type=Float
    ScaleFactor_Uls_f32
      data Uls_f32: sw-calibration-access=READ-ONLY, type=Float
    SigQlfr_State_enum
      data State_enum: sw-calibration-access=READ-ONLY, type=SigQlfr_State_enum
    SrlComSvcDft
      data Cnt_b32: sw-calibration-access=READ-ONLY, type=UInt32
    SS_State_enum
      data State_enum: sw-calibration-access=READ-ONLY, type=SS_State_enum
    SysPwrMd_Cnt_enum
      data Cnt_enum: sw-calibration-access=READ-ONLY, type=SysPwrMd
    SystemState
      mode declaration group prototype Mode: type=StaMd_Mode
    Temperature
      data DegC_f32: sw-calibration-access=READ-ONLY, type=Float
    Temperature_DegC_f32
      data DegC_f32: sw-calibration-access=READ-ONLY, type=Float
    Time_USec_u32
      data USec_u32: sw-calibration-access=READ-ONLY, type=UInt32
    TransTrq_TransNm_f32
      data TransNm_f32: type=Float
    TuningSessionActPtr
      data Cnt_u8: sw-calibration-access=READ-ONLY, type=TuningSessionAddrPtrEnum
    UnityScalar
      data Uls_f32: sw-calibration-access=READ-ONLY, type=Float
    UnityScalar_Uls_f32
      data Uls_f32: sw-calibration-access=READ-ONLY, type=Float
    Validity_Cnt_lgc
      data Cnt_lgc: sw-calibration-access=READ-ONLY, type=Boolean
    Vecu_Volt_f32
      data Volt_f32: sw-calibration-access=READ-ONLY, range raw >5..<31, type=Float  # This port prototype is inteded to communicate voltage signals that represent the ecu supplied voltage. This signal has a lower limit, which is non-zero, to allow users of the signal to use it as a denominator in an expression without requiring a divide by 0 check.
    VehAccel_KphpS_f32
      data KphpS_f32: sw-calibration-access=READ-ONLY, type=Float
    VehAccel_MpSecSq_f32
      data MpSecSq_f32: sw-calibration-access=READ-ONLY, type=Float
    VehSpd
      data Kph_f32: sw-calibration-access=READ-ONLY, type=Float
    VehSpd_Kph_f32
      data Kph_f32: sw-calibration-access=READ-ONLY, type=Float
    VltgCtrlTerm_Uls_f32
      data Uls_f32: sw-calibration-access=READ-ONLY, type=Float
    Voltage_Volt_f32
      data Volt_f32: sw-calibration-access=READ-ONLY, range raw >0..<31, type=Float  # This signal is intended to communicate any type voltage signal measured by the ecu. This signal has a lower limit of 0 which reequires users of the signal to provide divide by 0 protection if it is used as a denominator in a calculation. See Vecu port prototype if a port with a lower limit is desired.
    Voltage_Volt_u3p13
      data Volt_u3p13: sw-calibration-access=READ-ONLY, type=UInt16
    Voltage_Volts_f32
      data Volts_f32: sw-calibration-access=READ-ONLY, type=Float
    YawRate_DegpS_f32
      data DegpS_f32: sw-calibration-access=READ-ONLY, type=Float
