AUTOSAR XML (schema 314)
package /DaVinci
  ecu configuration EPS: ecu-extract=EPS, ecu-sw-composition=EcuSwComposition
package /DaVinci/PKG_ECU
  ecu instance EPS: com-processing-period=0.005, diagnostic-address=0, sleep-mode-supported=false, wake-up-over-bus-supported=false
package /ECUComposition
  ecu sw composition EcuSwComposition: ecu-extract=EPS
    6 x service component prototype:
      CDD: service-component=CDD
      ComM: service-component=ComM
      NexteerLibs: service-component=NexteerLibs
      NvM: service-component=NvM
      NvMProxy: service-component=NvMProxy
      WdgM: service-component=WdgM
    service connector prototype NvM_PS_Rte_NvmBlock_AbsHwPos_EOLVehCntrOffset_AbsHwPos_EOLVehCntrOffset: application-port=ECU_Composition.AbsHwPos.EOLVehCntrOffset, service-port=NvM.PS_Rte_NvmBlock_AbsHwPos_EOLVehCntrOffset
    service connector prototype NexteerLibs_SystemTime_Ap_ActivePull_SystemTime: application-port=ECU_Composition.Ap_ActivePull.SystemTime, service-port=NexteerLibs.SystemTime
    service connector prototype NvMProxy_PS_NvMP_NvmBlock_SteerAsstDefeat_Ap_AstLmt_SteeringAsstDefeat: application-port=ECU_Composition.Ap_AstLmt.SteeringAsstDefeat, service-port=NvMProxy.PS_NvMP_NvmBlock_SteerAsstDefeat
    service connector prototype NvM_PS_Rte_NvmBlock_Ap_AvgFricLrn_AvgFricLrnData_Ap_AvgFricLrn_AvgFricLrnData: application-port=ECU_Composition.Ap_AvgFricLrn.AvgFricLrnData, service-port=NvM.PS_Rte_NvmBlock_Ap_AvgFricLrn_AvgFricLrnData
    service connector prototype NexteerLibs_SystemTime_Ap_AvgFricLrn_SystemTime: application-port=ECU_Composition.Ap_AvgFricLrn.SystemTime, service-port=NexteerLibs.SystemTime
    service connector prototype WdgM_SE004_SE10ms_9_CP001_BVDiag_Per1_CP1_Ap_BVDiag_BVDiag_Per1_CP1: application-port=ECU_Composition.Ap_BVDiag.BVDiag_Per1_CP1, service-port=WdgM.SE004_SE10ms_9_CP001_BVDiag_Per1_CP1
    service connector prototype NexteerLibs_SystemTime_Ap_BVDiag_SystemTime: application-port=ECU_Composition.Ap_BVDiag.SystemTime, service-port=NexteerLibs.SystemTime
    service connector prototype WdgM_SE002_SE100ms_8_CP000_DiagMgr8_Per_CP0_Ap_DiagMgr8_DiagMgr8_Per_CP0: application-port=ECU_Composition.Ap_DiagMgr8.DiagMgr8_Per_CP0, service-port=WdgM.SE002_SE100ms_8_CP000_DiagMgr8_Per_CP0
    service connector prototype NvM_PS_Rte_NvmBlock_Ap_LrnEOT_LearnedEOT_Ap_LrnEOT_LearnedEOTData: application-port=ECU_Composition.Ap_LrnEOT.LearnedEOTData, service-port=NvM.PS_Rte_NvmBlock_Ap_LrnEOT_LearnedEOT
    service connector prototype NexteerLibs_SystemTime_Ap_LrnEOT_SystemTime: application-port=ECU_Composition.Ap_LrnEOT.SystemTime, service-port=NexteerLibs.SystemTime
    service connector prototype NexteerLibs_SystemTime_Ap_PwrLmtFuncCr_SystemTime: application-port=ECU_Composition.Ap_PwrLmtFuncCr.SystemTime, service-port=NexteerLibs.SystemTime
    service connector prototype WdgM_SE008_SE2ms_8_CP001_StabilityComp2_Per1_CP1_Ap_StabilityComp2_StabilityComp2_Per1_CP1: application-port=ECU_Composition.Ap_StabilityComp2.StabilityComp2_Per1_CP1, service-port=WdgM.SE008_SE2ms_8_CP001_StabilityComp2_Per1_CP1
    service connector prototype WdgM_SE008_SE2ms_8_CP000_StaMd8_Per1_CP0_Ap_StaMd8_StaMd8_Per1_CP0: application-port=ECU_Composition.Ap_StaMd8.StaMd8_Per1_CP0, service-port=WdgM.SE008_SE2ms_8_CP000_StaMd8_Per1_CP0
    service connector prototype NexteerLibs_SystemTime_Ap_Sweep_SystemTime: application-port=ECU_Composition.Ap_Sweep.SystemTime, service-port=NexteerLibs.SystemTime
    service connector prototype WdgM_SE000_SE100ms_9_CP001_ThrmlDutyCycle_Per1_CP1_Ap_ThrmlDutyCycle_ThrmlDutyCycle_Per1_CP1: application-port=ECU_Composition.Ap_ThrmlDutyCycle.ThrmlDutyCycle_Per1_CP1, service-port=WdgM.SE000_SE100ms_9_CP001_ThrmlDutyCycle_Per1_CP1
    service connector prototype NvMProxy_PS_NvMP_NvmBlock_CogTrqCal_Ap_TrqCanc_EOLCogTrqCanc: application-port=ECU_Composition.Ap_TrqCanc.EOLCogTrqCanc, service-port=NvMProxy.PS_NvMP_NvmBlock_CogTrqCal
    service connector prototype NvMProxy_PS_NvMP_NvmBlock_CogTrqRplComp_Ap_TrqCanc_EOLCogTrqRplComp: application-port=ECU_Composition.Ap_TrqCanc.EOLCogTrqRplComp, service-port=NvMProxy.PS_NvMP_NvmBlock_CogTrqRplComp
    service connector prototype NexteerLibs_SystemTime_Ap_TSMit_SystemTime: application-port=ECU_Composition.Ap_TSMit.SystemTime, service-port=NexteerLibs.SystemTime
    service connector prototype NvMProxy_PS_NvMP_NvmBlock_TSMitDisableEOL_Ap_TSMit_TSMitDisableEOL: application-port=ECU_Composition.Ap_TSMit.TSMitDisableEOL, service-port=NvMProxy.PS_NvMP_NvmBlock_TSMitDisableEOL
    service connector prototype NvMProxy_PS_NvMP_NvmBlock_TSMitGainLrn_Ap_TSMit_TSMitGainLrn: application-port=ECU_Composition.Ap_TSMit.TSMitGainLrn, service-port=NvMProxy.PS_NvMP_NvmBlock_TSMitGainLrn
    service connector prototype WdgM_SE003_SE10ms_10_CP000_TuningSelAuth_Per1_CP0_Ap_TuningSelAuth_TuningSelAuth_Per1_CP0: application-port=ECU_Composition.Ap_TuningSelAuth.TuningSelAuth_Per1_CP0, service-port=WdgM.SE003_SE10ms_10_CP000_TuningSelAuth_Per1_CP0
    service connector prototype NexteerLibs_SystemTime_Ap_WhlImbRej_SystemTime: application-port=ECU_Composition.Ap_WhlImbRej.SystemTime, service-port=NexteerLibs.SystemTime
    service connector prototype NexteerLibs_SystemTime_Ap_WIRInputQual_SystemTime: application-port=ECU_Composition.Ap_WIRInputQual.SystemTime, service-port=NexteerLibs.SystemTime
    service connector prototype WdgM_SE007_SE2ms_9_CP000_BatteryVoltage_Per1_CP0_BatteryVoltage_BatteryVoltage_Per1_CP0: application-port=ECU_Composition.BatteryVoltage.BatteryVoltage_Per1_CP0, service-port=WdgM.SE007_SE2ms_9_CP000_BatteryVoltage_Per1_CP0
    service connector prototype NvM_PS_Rte_NvmBlock_BatteryVoltage_OvervoltageData_BatteryVoltage_OvervoltageData: application-port=ECU_Composition.BatteryVoltage.OvervoltageData, service-port=NvM.PS_Rte_NvmBlock_BatteryVoltage_OvervoltageData
    service connector prototype NexteerLibs_SystemTime_BatteryVoltage_SystemTime: application-port=ECU_Composition.BatteryVoltage.SystemTime, service-port=NexteerLibs.SystemTime
    service connector prototype NexteerLibs_SystemTime_BkCpPc_SystemTime: application-port=ECU_Composition.BkCpPc.SystemTime, service-port=NexteerLibs.SystemTime
    service connector prototype WdgM_SE005_SE4ms_10_CP000_uDiagLossOfExec_Per3_CP0_Cd_uDiag_uDiagLossOfExec_Per3_CP0: application-port=ECU_Composition.Cd_uDiag.uDiagLossOfExec_Per3_CP0, service-port=WdgM.SE005_SE4ms_10_CP000_uDiagLossOfExec_Per3_CP0
    service connector prototype WdgM_SE001_SE100ms_10_CP001_uDiagStaticRegs_Per_CP1_Cd_uDiag_uDiagStaticRegs_Per_CP1: application-port=ECU_Composition.Cd_uDiag.uDiagStaticRegs_Per_CP1, service-port=WdgM.SE001_SE100ms_10_CP001_uDiagStaticRegs_Per_CP1
    service connector prototype CDD_CDDPorts_CDDInterface_CDDPorts: application-port=ECU_Composition.CDDInterface.CDDPorts, service-port=CDD.CDDPorts
    service connector prototype NexteerLibs_SystemTime_CDDInterface_SystemTime: application-port=ECU_Composition.CDDInterface.SystemTime, service-port=NexteerLibs.SystemTime
    service connector prototype NvM_PS_Rte_NvmBlock_CmMtrCurr_CurrTempOffset_CmMtrCurr_EOLCurrTempOffset: application-port=ECU_Composition.CmMtrCurr.EOLCurrTempOffset, service-port=NvM.PS_Rte_NvmBlock_CmMtrCurr_CurrTempOffset
    service connector prototype NvMProxy_PS_NvMP_NvmBlock_ShCurrCal_CmMtrCurr_EOLShCurrCal: application-port=ECU_Composition.CmMtrCurr.EOLShCurrCal, service-port=NvMProxy.PS_NvMP_NvmBlock_ShCurrCal
    service connector prototype NexteerLibs_SystemTime_ComplErr_SystemTime: application-port=ECU_Composition.ComplErr.SystemTime, service-port=NexteerLibs.SystemTime
    service connector prototype NexteerLibs_SystemTime_CtrldDisShtdn_SystemTime: application-port=ECU_Composition.CtrldDisShtdn.SystemTime, service-port=NexteerLibs.SystemTime
    service connector prototype WdgM_SE000_SE100ms_9_CP000_CtrlTemp_Per2_CP0_CtrlTemp_CtrlTemp_Per2_CP0: application-port=ECU_Composition.CtrlTemp.CtrlTemp_Per2_CP0, service-port=WdgM.SE000_SE100ms_9_CP000_CtrlTemp_Per2_CP0
    service connector prototype WdgM_SE001_SE100ms_10_CP000_CurrParamComp_Per2_CP0_CurrParamComp_CurrParamComp_Per2_CP0: application-port=ECU_Composition.CurrParamComp.CurrParamComp_Per2_CP0, service-port=WdgM.SE001_SE100ms_10_CP000_CurrParamComp_Per2_CP0
    service connector prototype NvMProxy_PS_NvMP_NvmBlock_EOLNomMtrParam_CurrParamComp_EOLNomMtrParamBlk: application-port=ECU_Composition.CurrParamComp.EOLNomMtrParamBlk, service-port=NvMProxy.PS_NvMP_NvmBlock_EOLNomMtrParam
    service connector prototype NexteerLibs_SystemTime_DemIf_SystemTime: application-port=ECU_Composition.DemIf.SystemTime, service-port=NexteerLibs.SystemTime
    service connector prototype NvMProxy_PS_NvMP_NvmBlock_DigColPsEOL_DigColPs_EOLDigColPosCals: application-port=ECU_Composition.DigColPs.EOLDigColPosCals, service-port=NvMProxy.PS_NvMP_NvmBlock_DigColPsEOL
    service connector prototype NexteerLibs_SystemTime_DigColPs_SystemTime: application-port=ECU_Composition.DigColPs.SystemTime, service-port=NexteerLibs.SystemTime
    service connector prototype NexteerLibs_SystemTime_FltInjection_SystemTime: application-port=ECU_Composition.FltInjection.SystemTime, service-port=NexteerLibs.SystemTime
    service connector prototype NexteerLibs_SystemTime_IoHwAbstractionUsr_SystemTime: application-port=ECU_Composition.IoHwAbstractionUsr.SystemTime, service-port=NexteerLibs.SystemTime
    service connector prototype NexteerLibs_SystemTime_MtrDrvDiag_SystemTime: application-port=ECU_Composition.MtrDrvDiag.SystemTime, service-port=NexteerLibs.SystemTime
    service connector prototype NvMProxy_PS_NvMP_NvmBlock_Polarity_Polarity_Polarity: application-port=ECU_Composition.Polarity.Polarity, service-port=NvMProxy.PS_NvMP_NvmBlock_Polarity
    service connector prototype NvMProxy_PS_NvMP_NvmBlock_DigTrqTrim_Sa_DigHwTrqSENT_NvM_DigHwTrqSENTTrim_Srv: application-port=ECU_Composition.Sa_DigHwTrqSENT.NvM_DigHwTrqSENTTrim_Srv, service-port=NvMProxy.PS_NvMP_NvmBlock_DigTrqTrim
    service connector prototype WdgM_SE003_SE10ms_10_CP001_ShtdnMech_Per1_CP1_Sa_ShtdnMech_ShtdnMech_Per1_CP1: application-port=ECU_Composition.Sa_ShtdnMech.ShtdnMech_Per1_CP1, service-port=WdgM.SE003_SE10ms_10_CP001_ShtdnMech_Per1_CP1
    service connector prototype NexteerLibs_SystemTime_Sa_TmprlMon2_SystemTime: application-port=ECU_Composition.Sa_TmprlMon2.SystemTime, service-port=NexteerLibs.SystemTime
    service connector prototype WdgM_SE004_SE10ms_9_CP000_SrlComInput_Per2_CP0_SrlComInput_SrlComInput_Per2_CP0: application-port=ECU_Composition.SrlComInput.SrlComInput_Per2_CP0, service-port=WdgM.SE004_SE10ms_9_CP000_SrlComInput_Per2_CP0
    service connector prototype NexteerLibs_SystemTime_SrlComInput_SystemTime: application-port=ECU_Composition.SrlComInput.SystemTime, service-port=NexteerLibs.SystemTime
    service connector prototype ComM_UR_ComMUser_VN_SLHSSharedDiagnostic_Ch0_0_SrlComOutput_ComM_UserRequest_0: application-port=ECU_Composition.SrlComOutput.ComM_UserRequest_0, service-port=ComM.UR_ComMUser_VN_SLHSSharedDiagnostic_Ch0_0
    service connector prototype ComM_UR_ComMUser_VN_AllNodes_Ch0_1_SrlComOutput_ComM_UserRequest_1: application-port=ECU_Composition.SrlComOutput.ComM_UserRequest_1, service-port=ComM.UR_ComMUser_VN_AllNodes_Ch0_1
    service connector prototype ComM_UR_ComMUser_VN_SLHS_VNReq_Ch0_2_SrlComOutput_ComM_UserRequest_2: application-port=ECU_Composition.SrlComOutput.ComM_UserRequest_2, service-port=ComM.UR_ComMUser_VN_SLHS_VNReq_Ch0_2
    service connector prototype ComM_UR_ComMUser_VN_SLHSSharedDiagnostic_Ch1_3_SrlComOutput_ComM_UserRequest_3: application-port=ECU_Composition.SrlComOutput.ComM_UserRequest_3, service-port=ComM.UR_ComMUser_VN_SLHSSharedDiagnostic_Ch1_3
    service connector prototype ComM_UR_ComMUser_VN_AllNodes_Ch1_4_SrlComOutput_ComM_UserRequest_4: application-port=ECU_Composition.SrlComOutput.ComM_UserRequest_4, service-port=ComM.UR_ComMUser_VN_AllNodes_Ch1_4
    service connector prototype ComM_UR_ComMUser_VN_SLHS_VNReq_Ch1_5_SrlComOutput_ComM_UserRequest_5: application-port=ECU_Composition.SrlComOutput.ComM_UserRequest_5, service-port=ComM.UR_ComMUser_VN_SLHS_VNReq_Ch1_5
    service connector prototype NvM_PS_Rte_NvmBlock_SrlComOutput_DTCTrigSts_SrlComOutput_DTCTrigSts: application-port=ECU_Composition.SrlComOutput.DTCTrigSts, service-port=NvM.PS_Rte_NvmBlock_SrlComOutput_DTCTrigSts
    service connector prototype NexteerLibs_SystemTime_SrlComOutput_SystemTime: application-port=ECU_Composition.SrlComOutput.SystemTime, service-port=NexteerLibs.SystemTime
    service connector prototype NvMProxy_PS_NvMP_NvmBlock_CloseCheckData_StaMd_CloseCheckData: application-port=ECU_Composition.StaMd.CloseCheckData, service-port=NvMProxy.PS_NvMP_NvmBlock_CloseCheckData
    service connector prototype WdgM_SE006_SE2ms_10_CP001_StaMd_Per1_CP1_StaMd_StaMd_Per1_CP1: application-port=ECU_Composition.StaMd.StaMd_Per1_CP1, service-port=WdgM.SE006_SE2ms_10_CP001_StaMd_Per1_CP1
    service connector prototype NvMProxy_PS_NvMP_NvmBlock_TypeHRamBuffer_StaMd_TypeHData: application-port=ECU_Composition.StaMd.TypeHData, service-port=NvMProxy.PS_NvMP_NvmBlock_TypeHRamBuffer
    service connector prototype NexteerLibs_SystemTime_StOpCtrl_SystemTime: application-port=ECU_Composition.StOpCtrl.SystemTime, service-port=NexteerLibs.SystemTime
    service connector prototype NexteerLibs_SystemTime_TmprlMon_SystemTime: application-port=ECU_Composition.TmprlMon.SystemTime, service-port=NexteerLibs.SystemTime
    service connector prototype WdgM_SE006_SE2ms_10_CP000_TmprlMon_Per1_CP0_TmprlMon_TmprlMon_Per1_CP0: application-port=ECU_Composition.TmprlMon.TmprlMon_Per1_CP0, service-port=WdgM.SE006_SE2ms_10_CP000_TmprlMon_Per1_CP0
    service connector prototype NvMProxy_PS_NvMP_NvmBlock_TorqueCmdSF_TrqCmdScl_TrqCmdScl: application-port=ECU_Composition.TrqCmdScl.TrqCmdScl, service-port=NvMProxy.PS_NvMP_NvmBlock_TorqueCmdSF
    service connector prototype NexteerLibs_SystemTime_TrqOvlSta_SystemTime: application-port=ECU_Composition.TrqOvlSta.SystemTime, service-port=NexteerLibs.SystemTime
    service connector prototype NvMProxy_PS_NvMP_NvmBlock_MtrPosReset_VehDyn_NVM_VehDynReset_Srv: application-port=ECU_Composition.VehDyn.NVM_VehDynReset_Srv, service-port=NvMProxy.PS_NvMP_NvmBlock_MtrPosReset
    service connector prototype NexteerLibs_SystemTime_VehDyn_SystemTime: application-port=ECU_Composition.VehDyn.SystemTime, service-port=NexteerLibs.SystemTime
    service connector prototype NexteerLibs_SystemTime_VehPwrMd_SystemTime: application-port=ECU_Composition.VehPwrMd.SystemTime, service-port=NexteerLibs.SystemTime
    service connector prototype WdgM_SE007_SE2ms_9_CP001_VehPwrMd_Per1_CP1_VehPwrMd_VehPwrMd_Per1_CP1: application-port=ECU_Composition.VehPwrMd.VehPwrMd_Per1_CP1, service-port=WdgM.SE007_SE2ms_9_CP001_VehPwrMd_Per1_CP1
package /ECUCompositionType
  composition type ECU_Composition
    94 x component:
      AbsHwPos: type=Ap_AbsHwPos
      Ap_ActivePull: type=Ap_ActivePull
      Ap_AssistFirewall: type=Ap_AssistFirewall
      Ap_AstLmt: type=Ap_AstLmt
      Ap_AvgFricLrn: type=Ap_AvgFricLrn
      Ap_BVDiag: type=Ap_BVDiag
      Ap_DampingFirewall: type=Ap_DampingFirewall
      Ap_DiagMgr8: type=Ap_DiagMgr8
      Ap_DiagMgr9: type=Ap_DiagMgr9
      Ap_ePWM2: type=Ap_ePWM2
      Ap_EtDmpFw: type=Ap_EtDmpFw
      Ap_GCCDiag: type=Ap_GCCDiag
      Ap_GenPosTraj: type=Ap_GenPosTraj
      Ap_GMStrtStop: type=Ap_GMStrtStop
      Ap_HOWDetect: type=Ap_HOWDetect
      Ap_HwPwUp: type=Ap_HwPwUp
      Ap_LmtCod: type=Ap_LmtCod
      Ap_LrnEOT: type=Ap_LrnEOT
      Ap_MtrTempEst: type=Ap_MtrTempEst
      Ap_PICurrCntrl: type=Ap_PICurrCntrl
      Ap_PosServo: type=Ap_PosServo
      Ap_PwrLmtFuncCr: type=Ap_PwrLmtFuncCr
      Ap_SASPlausDiag: type=Ap_SASPlausDiag
      Ap_SignlCondn: type=Ap_SignlCondn
      Ap_StabilityComp2: type=Ap_StabilityComp2
      Ap_StaMd8: type=Ap_StaMd8
      Ap_StaMd9: type=Ap_StaMd9
      Ap_Sweep: type=Ap_Sweep
      Ap_Sweep2: type=Ap_Sweep2
      Ap_ThrmlDutyCycle: type=Ap_ThrmlDutyCycle
      Ap_TqRsDg: type=Ap_TqRsDg
      Ap_TrqArblim: type=Ap_TrqArblim
      Ap_TrqCanc: type=Ap_TrqCanc
      Ap_TrqOsc: type=Ap_TrqOsc
      Ap_TSMit: type=Ap_TSMit
      Ap_TuningSelAuth: type=Ap_TuningSelAuth
      Ap_WhlImbRej: type=Ap_WhlImbRej
      Ap_WIRInputQual: type=Ap_WIRInputQual
      Assist: type=Ap_Assist
      BatteryVoltage: type=Ap_BatteryVoltage
      BkCpPc: type=Sa_BkCpPc
      Cd_Nhet1: type=Cd_Nhet1
      Cd_uDiag: type=Cd_uDiag
      CDDInterface: type=Sa_CDDInterface
      CmMtrCurr: type=Sa_CmMtrCurr
      ComplErr: type=Ap_ComplErr
      CtrldDisShtdn: type=Ap_CtrldDisShtdn
      CtrlTemp: type=Sa_CtrlTemp
      CurrCmd: type=Ap_CurrCmd
      CurrParamComp: type=Ap_CurrParamComp
      CustPerSrvcs: type=Ap_CustPerSrvcs
      Damping: type=Ap_Damping
      DemIf: type=Ap_DemIf
      DiagMgr: type=Ap_DiagMgr10
      DigColPs: type=Sa_DigColPs
      DigPhsReasDiag: type=Ap_DigPhsReasDiag
      EOTActuatorMng: type=Ap_EOTActuatorMng
      FltInjection: type=Ap_FltInjection
      FrqDepDmpnInrtCmp: type=Ap_FrqDepDmpnInrtCmp
      HighFreqAssist: type=Ap_HighFreqAssist
      HiLoadStall: type=Ap_HiLoadStall
      HystComp: type=Ap_HystComp
      IoHwAbsDigSig: type=IoHwAbstraction
      IoHwAbstractionUsr: type=IoHwAbstractionUsr
      MtrDrvDiag: type=Sa_MtrDrvDiag
      NtWrap: type=NtWrap
      PeakCurrEst: type=Ap_PeakCurrEst
      Polarity: type=Ap_Polarity
      QuadDet: type=Ap_QuadDet
      Return: type=Ap_Return
      ReturnFirewall: type=Ap_ReturnFirewall
      RteErrata: type=RteErrata10
      RteErrata8: type=RteErrata8
      RteErrata9: type=RteErrata9
      Sa_DigHwTrqSENT: type=Sa_DigHwTrqSENT
      Sa_DigMSB: type=Sa_DigMSB
      Sa_MtrVel: type=Sa_MtrVel
      Sa_MtrVel2: type=Sa_MtrVel2
      Sa_MtrVel3: type=Sa_MtrVel3
      Sa_OvrVoltMon: type=Sa_OvrVoltMon
      Sa_ShtdnMech: type=Sa_ShtdnMech
      Sa_TmprlMon2: type=Sa_TmprlMon2
      SrlComInput: type=Ap_SrlComInput
      SrlComOutput: type=Ap_SrlComOutput
      StabilityComp: type=Ap_StabilityComp
      StaMd: type=Ap_StaMd
      StOpCtrl: type=Ap_StOpCtrl
      TmprlMon: type=Sa_TmprlMon
      TrqCmdScl: type=Ap_TrqCmdScl
      TrqOvlSta: type=Ap_TrqOvlSta
      VehDyn: type=Ap_VehDyn
      VehPwrMd: type=Ap_VehPwrMd
      VehSpdLmt: type=Ap_VehSpdLmt
      Xcp: type=Ap_ApXcp
    connect AbsHwPos.HandwheelAuthority -> Ap_ActivePull.HandwheelAuthority
    connect AbsHwPos.HandwheelAuthority -> Ap_AvgFricLrn.HwPosAuthority
    connect AbsHwPos.HandwheelAuthority -> Ap_EtDmpFw.HandwheelAuthority
    connect AbsHwPos.HandwheelAuthority -> Ap_LrnEOT.HandwheelAuthority
    connect AbsHwPos.HandwheelAuthority -> Ap_TSMit.HandwheelAuthority
    connect AbsHwPos.HandwheelAuthority -> EOTActuatorMng.HandWheelAuth
    connect AbsHwPos.HandwheelAuthority -> Return.HandwheelAuthority
    connect AbsHwPos.HandwheelAuthority -> VehDyn.HwAuth
    connect AbsHwPos.HandwheelAuthority -> VehSpdLmt.HwPosAuth
    connect AbsHwPos.HandwheelPosition -> Ap_ActivePull.HandwheelPosition
    connect AbsHwPos.HandwheelPosition -> Ap_AvgFricLrn.HwAng
    connect AbsHwPos.HandwheelPosition -> Ap_EtDmpFw.HandwheelPosition
    connect AbsHwPos.HandwheelPosition -> Ap_GenPosTraj.HwPosition
    connect AbsHwPos.HandwheelPosition -> Ap_LrnEOT.HandwheelPosition
    connect AbsHwPos.HandwheelPosition -> Ap_PosServo.HandwheelPosition
    connect AbsHwPos.HandwheelPosition -> Ap_TSMit.HandwheelPosition
    connect AbsHwPos.HandwheelPosition -> EOTActuatorMng.HandWheelPos
    connect AbsHwPos.HandwheelPosition -> Return.HandwheelPosition
    connect AbsHwPos.HandwheelPosition -> ReturnFirewall.HandwheelPosition
    connect AbsHwPos.HandwheelPosition -> VehDyn.HandwheelPosition
    connect AbsHwPos.HandwheelPosition -> VehSpdLmt.HwPos
    connect AbsHwPos.RelHwPos -> VehDyn.RelHwPos
    connect AbsHwPos.SrlComHwPos -> SrlComOutput.SrlComHwPos
    connect Ap_ActivePull.ActivePull_SCom -> NtWrap.C_ActivePull_SCom
    connect Ap_ActivePull.PullCompCmd -> Ap_AstLmt.PullCompCmd
    connect Ap_AssistFirewall.AsstFirewallActive -> Ap_DampingFirewall.AsstFirewallActive
    connect Ap_AssistFirewall.AsstFirewallActive -> Ap_StabilityComp2.AsstFWActive
    connect Ap_AssistFirewall.AsstFirewallActive -> StabilityComp.AsstFWActive
    connect Ap_AssistFirewall.CombinedAssist -> Ap_StabilityComp2.CombinedAssist
    connect Ap_AssistFirewall.CombinedAssist -> StabilityComp.CombinedAssist
    connect Ap_AstLmt.AstLmt_Scom -> NtWrap.C_AssistLmtFunc_Scom
    connect Ap_AstLmt.PreLimitForStall -> HiLoadStall.PreLimitForStall
    connect Ap_AstLmt.PreLimitTorque -> Ap_TSMit.PreLimitMtrTrqCmd
    connect Ap_AstLmt.PreLimitTorque -> EOTActuatorMng.PreLimitTorque
    connect Ap_AstLmt.SumLimTrqCmd -> Ap_Sweep2.InputMtrTrq
    connect Ap_AstLmt.TrqLimitMin -> Ap_TqRsDg.TrqLimitMin
    connect Ap_AvgFricLrn.AvgFricLrn_SCom -> NtWrap.C_AvgFricLrn_Scom
    connect Ap_AvgFricLrn.FricOffset -> HystComp.FricOffset
    connect Ap_DampingFirewall.CombinedDamping -> Ap_AstLmt.CombinedDamping
    connect Ap_DiagMgr8.NxtrDiagMgr8 -> Ap_StaMd8.NxtrDiagMgr
    connect Ap_DiagMgr8.NxtrDiagMgr8 -> Sa_MtrVel2.NxtrDiagMgr
    connect Ap_DiagMgr9.DiagMgr_StaCtrl -> Ap_StaMd9.DiagMgr_StaCtrl
    connect Ap_DiagMgr9.NxtrDiagMgr9 -> Ap_AvgFricLrn.NxtrDiagMgr
    connect Ap_DiagMgr9.NxtrDiagMgr9 -> Ap_BVDiag.NxtrDiagMgr
    connect Ap_DiagMgr9.NxtrDiagMgr9 -> Ap_ThrmlDutyCycle.NxtrDiagMgr
    connect Ap_DiagMgr9.NxtrDiagMgr9 -> BatteryVoltage.NxtrDiagMgr
    connect Ap_DiagMgr9.NxtrDiagMgr9 -> CtrlTemp.NxtrDiagMgr
    connect Ap_DiagMgr9.NxtrDiagMgr9 -> CustPerSrvcs.NxtrDiagMgr
    connect Ap_DiagMgr9.NxtrDiagMgr9 -> DemIf.NxtrDiagMgr
    connect Ap_DiagMgr9.NxtrDiagMgr9 -> SrlComInput.NxtrDiagMgr
    connect Ap_DiagMgr9.NxtrDiagMgr9 -> SrlComOutput.NxtrDiagMgr
    connect Ap_DiagMgr9.NxtrDiagMgr9 -> VehPwrMd.NxtrDiagMgr
    connect Ap_EtDmpFw.EOTDampingLtd -> Ap_AstLmt.AssistEOTDamping
    connect Ap_GenPosTraj.GenPosTraj_SCom -> NtWrap.C_GeneratePosTraj_SCom
    connect Ap_GenPosTraj.PosTrajHwAngle -> TrqOvlSta.PosTrajHwAngle
    connect Ap_GMStrtStop.SSScale -> StOpCtrl.StrtStopScaleFctr
    connect Ap_GMStrtStop.SSSlew -> StOpCtrl.StrtStopRateLimit
    connect Ap_HOWDetect.HOWEstimate -> SrlComOutput.HOWEstimate
    connect Ap_HwPwUp.MtrDrvrInitStart -> MtrDrvDiag.MtrDrvrInitStart
    connect Ap_HwPwUp.PwrDiscATestStart -> BkCpPc.PwrDiscATestStart
    connect Ap_HwPwUp.PwrDiscBTestStart -> BkCpPc.PwrDiscBTestStart
    connect Ap_HwPwUp.PwrDiscBTestStart -> Sa_OvrVoltMon.PwrDiscBTestStart
    connect Ap_HwPwUp.TMFTestStart -> TmprlMon.TMFTestStart
    connect Ap_LmtCod.EOTGainLtd -> Ap_AstLmt.AssistEOTGain
    connect Ap_LmtCod.EOTLimitLtd -> Ap_AstLmt.AssistEOTLimit
    connect Ap_LmtCod.OutputRampMultLtd -> Ap_AstLmt.OutputRampMult
    connect Ap_LmtCod.OutputRampMultLtd -> Ap_TqRsDg.OutputRampMult
    connect Ap_LmtCod.StallLimitLtd -> Ap_AstLmt.AssistStallLimit
    connect Ap_LmtCod.ThermalLimitLtd -> Ap_AstLmt.ThermalLimit
    connect Ap_LmtCod.VehSpdLimitLtd -> Ap_AstLmt.AssistVehSpdLimit
    connect Ap_LrnEOT.CCWFound -> EOTActuatorMng.CcwFound
    connect Ap_LrnEOT.CCWPosition -> EOTActuatorMng.CcwEOT
    connect Ap_LrnEOT.CCWPosition -> TrqOvlSta.CCWPosition
    connect Ap_LrnEOT.CCWPosition -> VehDyn.CcwEOT
    connect Ap_LrnEOT.CCWPosition -> VehSpdLmt.CCWPosition
    connect Ap_LrnEOT.CWFound -> EOTActuatorMng.CwFound
    connect Ap_LrnEOT.CWPosition -> EOTActuatorMng.CwEOT
    connect Ap_LrnEOT.CWPosition -> TrqOvlSta.CWPosition
    connect Ap_LrnEOT.CWPosition -> VehDyn.CwEOT
    connect Ap_LrnEOT.CWPosition -> VehSpdLmt.CWPosition
    connect Ap_LrnEOT.LrnEOT_Scom -> NtWrap.C_LrnEOT_SCom
    connect Ap_MtrTempEst.AssistMechTempEst -> Ap_AvgFricLrn.Temperature
    connect Ap_MtrTempEst.AssistMechTempEst -> Damping.AssistMechTempEst
    connect Ap_MtrTempEst.AssistMechTempEst -> HystComp.AssistMechTempEst
    connect Ap_MtrTempEst.AssistMechTempEst -> Return.AssistMechTempEst
    connect Ap_MtrTempEst.CuTempEst -> Ap_ThrmlDutyCycle.CuTempEst
    connect Ap_MtrTempEst.CuTempEst -> CurrParamComp.CuTempEst
    connect Ap_MtrTempEst.MagTempEst -> Ap_ThrmlDutyCycle.MagTempEst
    connect Ap_MtrTempEst.MagTempEst -> CurrParamComp.MagTempEst
    connect Ap_MtrTempEst.SiTempEst -> Ap_ThrmlDutyCycle.SiTempEst
    connect Ap_MtrTempEst.SiTempEst -> CurrParamComp.SiTempEst
    connect Ap_PICurrCntrl.DervLambdaAlphaDiag -> Ap_TqRsDg.DervLambdaAlphaDiag
    connect Ap_PICurrCntrl.DervLambdaBetaDiag -> Ap_TqRsDg.DervLambdaBetaDiag
    connect Ap_PosServo.PosSrvoCmd -> Ap_TrqArblim.PosSrvoCmd
    connect Ap_PosServo.PosSrvoReturnSclFct -> Return.PAReturnSclFct
    connect Ap_PwrLmtFuncCr.FltTrqLmt -> Ap_AstLmt.PowerLimitPerc
    connect Ap_PwrLmtFuncCr.MRFMtrTrqCmd -> Ap_DiagMgr8.MtrTrq
    connect Ap_PwrLmtFuncCr.MRFMtrTrqCmd -> Ap_DiagMgr9.MtrTrq
    connect Ap_PwrLmtFuncCr.MRFMtrTrqCmd -> TrqCmdScl.MRFMtrTrqCmd
    connect Ap_SignlCondn.Vehicle_LonAccel -> Ap_DampingFirewall.VehicleLonAccel
    connect Ap_SignlCondn.Vehicle_LonAccel -> FrqDepDmpnInrtCmp.VehicleLonAccel
    connect Ap_SignlCondn.VehicleSpeed -> Ap_ActivePull.VehicleSpeed
    connect Ap_SignlCondn.VehicleSpeed -> Ap_AssistFirewall.VehicleSpeed
    connect Ap_SignlCondn.VehicleSpeed -> Ap_AstLmt.VehSpd
    connect Ap_SignlCondn.VehicleSpeed -> Ap_AvgFricLrn.VehSpd
    connect Ap_SignlCondn.VehicleSpeed -> Ap_DampingFirewall.VehicleSpeed
    connect Ap_SignlCondn.VehicleSpeed -> Ap_DiagMgr8.VehSpd
    connect Ap_SignlCondn.VehicleSpeed -> Ap_DiagMgr9.VehSpd
    connect Ap_SignlCondn.VehicleSpeed -> Ap_EtDmpFw.Vehicle_Speed
    connect Ap_SignlCondn.VehicleSpeed -> Ap_GCCDiag.VehicleSpeed
    connect Ap_SignlCondn.VehicleSpeed -> Ap_GMStrtStop.VehicleSpeed
    connect Ap_SignlCondn.VehicleSpeed -> Ap_HOWDetect.VehSpd
    connect Ap_SignlCondn.VehicleSpeed -> Ap_LmtCod.VehicleSpeed
    connect Ap_SignlCondn.VehicleSpeed -> Ap_PosServo.VehicleSpeed
    connect Ap_SignlCondn.VehicleSpeed -> Ap_StabilityComp2.VehicleSpeed
    connect Ap_SignlCondn.VehicleSpeed -> Ap_Sweep.VehSpd
    connect Ap_SignlCondn.VehicleSpeed -> Ap_TSMit.VehicleSpeed
    connect Ap_SignlCondn.VehicleSpeed -> Ap_TuningSelAuth.VehicleSpeed
    connect Ap_SignlCondn.VehicleSpeed -> Ap_WhlImbRej.VehSpd
    connect Ap_SignlCondn.VehicleSpeed -> Assist.VehSpd
    connect Ap_SignlCondn.VehicleSpeed -> CmMtrCurr.VehSpd
    connect Ap_SignlCondn.VehicleSpeed -> CurrCmd.VehSpd
    connect Ap_SignlCondn.VehicleSpeed -> Damping.VehicleSpeed
    connect Ap_SignlCondn.VehicleSpeed -> DiagMgr.VehSpd
    connect Ap_SignlCondn.VehicleSpeed -> EOTActuatorMng.VehicleSpeed
    connect Ap_SignlCondn.VehicleSpeed -> FrqDepDmpnInrtCmp.VehicleSpeed
    connect Ap_SignlCondn.VehicleSpeed -> HighFreqAssist.VehicleSpeed
    connect Ap_SignlCondn.VehicleSpeed -> HystComp.VehicleSpeed
    connect Ap_SignlCondn.VehicleSpeed -> Return.VehicleSpeed
    connect Ap_SignlCondn.VehicleSpeed -> ReturnFirewall.VehicleSpeed
    connect Ap_SignlCondn.VehicleSpeed -> StabilityComp.VehicleSpeed
    connect Ap_SignlCondn.VehicleSpeed -> VehDyn.VehicleSpeed
    connect Ap_SignlCondn.VehicleSpeed -> VehPwrMd.VehSpd
    connect Ap_SignlCondn.VehicleSpeed -> VehSpdLmt.VehSpd
    connect Ap_StabilityComp2.SysAssistCmd -> StabilityComp.SysAssistCmd_MtrNm
    connect Ap_StaMd8.SystemState8 -> Ap_DiagMgr8.SystemState
    connect Ap_StaMd8.SystemState8 -> RteErrata8.SystemState
    connect Ap_StaMd9.StaMd_SCom -> NtWrap.C_StaMd_SCom
    connect Ap_StaMd9.SystemState9 -> Ap_ActivePull.SystemState
    connect Ap_StaMd9.SystemState9 -> Ap_AvgFricLrn.SystemState
    connect Ap_StaMd9.SystemState9 -> Ap_DiagMgr9.SystemState
    connect Ap_StaMd9.SystemState9 -> BatteryVoltage.SystemState
    connect Ap_StaMd9.SystemState9 -> CustPerSrvcs.SystemState
    connect Ap_StaMd9.SystemState9 -> RteErrata9.SystemState
    connect Ap_StaMd9.SystemState9 -> SrlComInput.SystemState
    connect Ap_StaMd9.SystemState9 -> SrlComOutput.SystemState
    connect Ap_StaMd9.SystemState9 -> VehPwrMd.SystemState
    connect Ap_Sweep.OutputHwTrq -> Ap_ActivePull.HwTorque
    connect Ap_Sweep.OutputHwTrq -> Ap_AssistFirewall.HwTorque
    connect Ap_Sweep.OutputHwTrq -> Ap_AvgFricLrn.HwTrq
    connect Ap_Sweep.OutputHwTrq -> Ap_DampingFirewall.HwTorque
    connect Ap_Sweep.OutputHwTrq -> Ap_DiagMgr8.HwTrq
    connect Ap_Sweep.OutputHwTrq -> Ap_DiagMgr9.HwTrq
    connect Ap_Sweep.OutputHwTrq -> Ap_GCCDiag.HwTorque
    connect Ap_Sweep.OutputHwTrq -> Ap_GMStrtStop.HwTorque
    connect Ap_Sweep.OutputHwTrq -> Ap_HOWDetect.HwTrq
    connect Ap_Sweep.OutputHwTrq -> Ap_LrnEOT.HwTorque
    connect Ap_Sweep.OutputHwTrq -> Ap_PosServo.HwTorque
    connect Ap_Sweep.OutputHwTrq -> Ap_StabilityComp2.HwTorque
    connect Ap_Sweep.OutputHwTrq -> Ap_TrqArblim.HwTorque
    connect Ap_Sweep.OutputHwTrq -> Ap_TSMit.HwTorque
    connect Ap_Sweep.OutputHwTrq -> Ap_TuningSelAuth.HwTorque
    connect Ap_Sweep.OutputHwTrq -> Ap_WhlImbRej.HwTrq
    connect Ap_Sweep.OutputHwTrq -> Assist.HwTrq
    connect Ap_Sweep.OutputHwTrq -> Damping.HwTorque
    connect Ap_Sweep.OutputHwTrq -> DiagMgr.HwTrq
    connect Ap_Sweep.OutputHwTrq -> EOTActuatorMng.HwTorque
    connect Ap_Sweep.OutputHwTrq -> FrqDepDmpnInrtCmp.HwTorque
    connect Ap_Sweep.OutputHwTrq -> HighFreqAssist.HwTorque
    connect Ap_Sweep.OutputHwTrq -> HystComp.HwTorque
    connect Ap_Sweep.OutputHwTrq -> Return.HwTorque
    connect Ap_Sweep.OutputHwTrq -> SrlComOutput.HwTrq
    connect Ap_Sweep.OutputHwTrq -> StabilityComp.HwTorque
    connect Ap_Sweep.OutputHwTrq -> TrqOvlSta.HwTorque
    connect Ap_Sweep.OutputHwTrq -> VehDyn.HwTorque
    connect Ap_Sweep2.OutputMtrTrq -> Ap_LrnEOT.PostLimitTorque
    connect Ap_Sweep2.OutputMtrTrq -> CtrldDisShtdn.SumLimTrqCmd
    connect Ap_ThrmlDutyCycle.DutyCycleLevel -> Assist.DutyCycleLevel
    connect Ap_ThrmlDutyCycle.ThermalLimit -> Ap_LmtCod.ThermalLimit
    connect Ap_ThrmlDutyCycle.ThermLimitPerc -> Ap_AstLmt.ThermalLimitPerc
    connect Ap_TrqArblim.AssistDDFactor -> Assist.AssistDDFactor
    connect Ap_TrqArblim.AssistDDFactor -> StabilityComp.AssistDDFactor
    connect Ap_TrqArblim.DampingDDFactor -> Damping.DampingDDFactor
    connect Ap_TrqArblim.ESCIsLimited -> TrqOvlSta.ESCIsLimited
    connect Ap_TrqArblim.ESCTorqueDelivered -> SrlComOutput.ESCTorqueDelivered
    connect Ap_TrqArblim.IqTrqOv -> Assist.IpTrqOvr
    connect Ap_TrqArblim.LKATorqueDelivered -> SrlComOutput.LKATrqDelivered
    connect Ap_TrqArblim.OpTrqOv -> Ap_AstLmt.OpTrqOvr
    connect Ap_TrqArblim.ReturnDDFactor -> Return.ReturnDDFactor
    connect Ap_TrqCanc.TrqCanc_Scom -> NtWrap.C_TrqCanc_Scom
    connect Ap_TrqOsc.TrqOscCmd -> Ap_TrqArblim.TrqOscCmd
    connect Ap_TSMit.TSMit_SCom -> NtWrap.C_TSMit_SCom
    connect Ap_TSMit.TSMitCommand -> Ap_AstLmt.TSMitCommand
    connect Ap_TuningSelAuth.ActiveTunPers -> Xcp.ActiveTunPers
    connect Ap_TuningSelAuth.ActiveTunSet -> Xcp.ActiveTunSet
    connect Ap_WhlImbRej.WhlImbRejCmd -> Ap_AstLmt.WheelImbalanceCmd
    connect Ap_WhlImbRej.WIRCmdAmpBlnd -> Ap_DampingFirewall.WIRCmdAmpBlnd
    connect Ap_WhlImbRej.WIRCmdAmpBlnd -> Assist.WIRCmdAmpBlnd
    connect Ap_WhlImbRej.WIRCmdAmpBlnd -> FrqDepDmpnInrtCmp.WIRCmdAmpBlnd
    connect Ap_WhlImbRej.WIRCmdAmpBlnd -> HighFreqAssist.WIRCmdAmpBlnd
    connect Ap_WhlImbRej.WIRCmdAmpBlnd -> HystComp.WIRCmdAmpBlnd
    connect Ap_WIRInputQual.QualWhlFreqL -> Ap_WhlImbRej.QualWhlFreqL
    connect Ap_WIRInputQual.QualWhlFreqR -> Ap_WhlImbRej.QualWhlFreqR
    connect Ap_WIRInputQual.WhlFreqQualified -> Ap_WhlImbRej.WhlFreqQualified
    connect Assist.BaseAssistCmd -> Ap_AssistFirewall.BaseAssistCmd
    connect Assist.BaseAssistCmd -> Ap_DampingFirewall.BaseAssistCmd
    connect Assist.BaseAssistCmd -> FrqDepDmpnInrtCmp.BaseAssistCmd
    connect Assist.BaseAssistCmd -> HystComp.BaseAssistCmd
    connect BatteryVoltage.Vecu -> Ap_PwrLmtFuncCr.Vecu
    connect BatteryVoltage.Vecu -> CDDInterface.Vecu
    connect BatteryVoltage.Vecu -> CmMtrCurr.Vecu
    connect BatteryVoltage.Vecu -> CurrCmd.Vecu
    connect BatteryVoltage.Vecu -> DemIf.Vecu
    connect BkCpPc.CapPcDcStub -> BkCpPc.PhyCapDischarge
    connect BkCpPc.CapPcDcStub -> BkCpPc.PhyCapPrecharge
    connect BkCpPc.PwrDiscATestComplete -> Ap_HwPwUp.PwrDiscATestComplete
    connect BkCpPc.PwrDiscBTestComplete -> Ap_HwPwUp.PwrDiscBTestComplete
    connect Cd_Nhet1.DigHwTrqT1 -> Sa_DigHwTrqSENT.T1
    connect Cd_Nhet1.DigHwTrqT2 -> Sa_DigHwTrqSENT.T2
    connect CDDInterface.ADCMtrCurr1 -> CmMtrCurr.ADCMtrCurr1
    connect CDDInterface.ADCMtrCurr2 -> CmMtrCurr.ADCMtrCurr2
    connect CDDInterface.BallNutTempEstSrlComSvcDft -> Ap_MtrTempEst.AMTempEstDisable
    connect CDDInterface.CorrectedElecMtrPos -> Sa_DigMSB.CorrectedElecMtrPos
    connect CDDInterface.CorrectedElecMtrPosFloat -> Ap_PICurrCntrl.CorrMtrPosElec
    connect CDDInterface.CorrMtrCurrPosition -> CmMtrCurr.CorrMtrCurrPosition
    connect CDDInterface.CumMechMtrPos -> Sa_DigMSB.CumMechMtrPos
    connect CDDInterface.CumMechMtrPos -> VehDyn.MechMtrPos1
    connect CDDInterface.DampingSrlComSvcDft -> Ap_DampingFirewall.Defeat_Damping_Svc
    connect CDDInterface.DampingSrlComSvcDft -> Damping.DefeatDampingSvc
    connect CDDInterface.DftAsstTbl -> Ap_AssistFirewall.Defeat_AsstTbl_Service
    connect CDDInterface.DftAsstTbl -> Assist.DftAsstTbl
    connect CDDInterface.Die1RxError -> Sa_DigMSB.Die1RxError
    connect CDDInterface.Die1RxMtrPos -> Sa_DigMSB.Die1RxMtrPos
    connect CDDInterface.Die1RxRevCtr -> Sa_DigMSB.Die1RxRevCtr
    connect CDDInterface.Die1UnderVoltgFltAccum -> Sa_DigMSB.Die1UnderVoltgFltAccum
    connect CDDInterface.Die2RxError -> Sa_DigMSB.Die2RxError
    connect CDDInterface.Die2RxMtrPos -> Sa_DigMSB.Die2RxMtrPos
    connect CDDInterface.Die2RxRevCtr -> Sa_DigMSB.Die2RxRevCtr
    connect CDDInterface.DisableCEBusNormComm -> DemIf.DisableCEBusNormComm
    connect CDDInterface.DisableHSBusNormComm -> DemIf.DisableHSBusNormComm
    connect CDDInterface.DwnldAsstGain -> Assist.DwnldAsstGain
    connect CDDInterface.EngONSrlComSvcDft -> VehPwrMd.EngONSrlComSvcDft
    connect CDDInterface.EOTImpactSrlComSvcDft -> Ap_EtDmpFw.EOTDisable
    connect CDDInterface.EOTImpactSrlComSvcDft -> EOTActuatorMng.EOTDisable
    connect CDDInterface.EOTThermalSrlComSvcDft -> HiLoadStall.DftStallLimit
    connect CDDInterface.ExpectedOnTimeA -> DigPhsReasDiag.ExpectedOnTimeA
    connect CDDInterface.ExpectedOnTimeB -> DigPhsReasDiag.ExpectedOnTimeB
    connect CDDInterface.ExpectedOnTimeC -> DigPhsReasDiag.ExpectedOnTimeC
    connect CDDInterface.FreqDepDmpSrlComSvcDft -> Ap_DampingFirewall.FreqDepDmpSrlComSvcDft
    connect CDDInterface.FreqDepDmpSrlComSvcDft -> FrqDepDmpnInrtCmp.FreqDepDmpSrlComSvcDft
    connect CDDInterface.FricLrnSrlComSvcDft -> Ap_AvgFricLrn.DefeatFricLearning
    connect CDDInterface.HystCompSrlComSvcDft -> HystComp.DefeatHystService
    connect CDDInterface.IgnCnt -> Ap_DiagMgr8.IgnCnt
    connect CDDInterface.IgnCnt -> Ap_DiagMgr9.IgnCnt
    connect CDDInterface.IgnCnt -> DiagMgr.IgnCnt
    connect CDDInterface.LimitSrlComSvcDft -> Ap_AstLmt.DefeatLimitService
    connect CDDInterface.LRPRPhaseadvanceCaptured -> DigPhsReasDiag.LRPRPhaseadvanceCaptured
    connect CDDInterface.MeasuredOnTimeA -> DigPhsReasDiag.MeasuredOnTimeA
    connect CDDInterface.MeasuredOnTimeB -> DigPhsReasDiag.MeasuredOnTimeB
    connect CDDInterface.MeasuredOnTimeC -> DigPhsReasDiag.MeasuredOnTimeC
    connect CDDInterface.MEC -> AbsHwPos.ManufMode
    connect CDDInterface.MEC -> Ap_AssistFirewall.MEC_Counter
    connect CDDInterface.MEC -> Ap_DampingFirewall.MEC_Counter
    connect CDDInterface.MEC -> Ap_DiagMgr8.MEC
    connect CDDInterface.MEC -> Ap_DiagMgr9.MEC
    connect CDDInterface.MEC -> Ap_EtDmpFw.MEC_Counter
    connect CDDInterface.MEC -> CmMtrCurr.MEC
    connect CDDInterface.MEC -> DiagMgr.MEC
    connect CDDInterface.MEC -> DigColPs.MecState
    connect CDDInterface.MEC -> ReturnFirewall.MEC_Counter
    connect CDDInterface.MEC -> Sa_DigHwTrqSENT.MECCounter
    connect CDDInterface.MechMtrPos1TimeStamp -> Sa_MtrVel2.MechMtrPos1Timestamp
    connect CDDInterface.MechMtrPos2TimeStamp -> Sa_MtrVel.MechMtrPos2Timestamp
    connect CDDInterface.MfgDiagInhibit -> Ap_DiagMgr8.MfgDiagInhibit
    connect CDDInterface.MfgDiagInhibit -> Ap_DiagMgr9.MfgDiagInhibit
    connect CDDInterface.MfgDiagInhibit -> DiagMgr.MfgDiagInhibit
    connect CDDInterface.ModIdxFinal -> DigPhsReasDiag.LRPRModulationIndexCaptured
    connect CDDInterface.MtrCurrDax -> PeakCurrEst.MtrCurrDax
    connect CDDInterface.MtrCurrK1 -> CmMtrCurr.MtrCurrK1
    connect CDDInterface.MtrCurrK2 -> CmMtrCurr.MtrCurrK2
    connect CDDInterface.MtrCurrQax -> PeakCurrEst.MtrCurrQax
    connect CDDInterface.PosTrajEnable -> Ap_GenPosTraj.PosTrajEnable
    connect CDDInterface.PosTrajEnable -> TrqOvlSta.PosTrajEnable
    connect CDDInterface.PullCompLrnSrlComSvcDft -> Ap_ActivePull.DisableLearning
    connect CDDInterface.PullCompSrlComSvcDft -> Ap_ActivePull.DisableOutput
    connect CDDInterface.ReturnSrlComSvcDft -> Return.DefeatReturnSvc
    connect CDDInterface.ReturnSrlComSvcDft -> ReturnFirewall.Defeat_Return_Svc
    connect CDDInterface.RxMsgsSrlComSvcDft -> SrlComInput.RxMsgsSrlComSvcDft
    connect CDDInterface.RxMtrPos1ParityAccum -> Sa_DigMSB.RxMtrPosParityAccum
    connect CDDInterface.SrlComSvcDft -> CmMtrCurr.SrlComSvcDft
    connect CDDInterface.SysCVSwitchADC -> IoHwAbstractionUsr.SysCVSwitchADC
    connect CDDInterface.ThermalDCSrlComSvcDft -> Ap_ThrmlDutyCycle.DefeatDutySvc
    connect CDDInterface.TrqRmpSrlComSvcDft -> StOpCtrl.RampSrlComSvcDft
    connect CDDInterface.UncorrMechMtrPos1 -> Sa_DigMSB.UncorrMechMtrPos1
    connect CDDInterface.WIRMfgEnabled -> Ap_WhlImbRej.WIRMfgEnable
    connect CDDInterface.WIRMfgEnabled -> SrlComInput.WIREnabled
    connect CmMtrCurr.CmMtrCurr_SCom -> NtWrap.C_CmMtrCurr_SCom
    connect CmMtrCurr.ComOffset -> CDDInterface.CommOffset
    connect CmMtrCurr.CurrentGainSvc -> CurrCmd.CurrentGainSvc
    connect CmMtrCurr.MtrCurr1TempOffset -> CDDInterface.MtrCurr1TempOffset
    connect CmMtrCurr.MtrCurr2TempOffset -> CDDInterface.MtrCurr2TempOffset
    connect ComplErr.ComplErr -> AbsHwPos.ComplError
    connect CtrldDisShtdn.CntDisMtrTrqCmdCRF -> Ap_AvgFricLrn.CRFMtrTrq
    connect CtrldDisShtdn.CntDisMtrTrqCmdCRF -> ComplErr.TorqueCmdCRF
    connect CtrldDisShtdn.CntDisMtrTrqCmdCRF -> VehDyn.TorqueCmdCRF
    connect CtrldDisShtdn.CntDisMtrTrqCmdMRF -> Ap_PwrLmtFuncCr.CntDisMtrTrqCmdMRF
    connect CtrldDisShtdn.CntDisMtrTrqCmdMRF -> DiagMgr.MtrTrq
    connect CtrldDisShtdn.CtrldDmpStsCmp -> Ap_ePWM2.CtrldDmpStsCmp
    connect CtrldDisShtdn.CtrldDmpStsCmp -> Ap_StaMd8.ControlledDampStatusComplete
    connect CtrldDisShtdn.CtrldDmpStsCmp -> StaMd.ControlledDampStatusComplete
    connect CtrlTemp.FiltMeasTemp -> Ap_MtrTempEst.CtrlTempFinal
    connect CtrlTemp.FiltMeasTemp -> Ap_ThrmlDutyCycle.FiltMeasTemp
    connect CtrlTemp.FiltMeasTemp -> CmMtrCurr.FiltCntrlTemp
    connect CurrCmd.MtrCurrAngle -> CmMtrCurr.MtrCurrAngle
    connect CurrCmd.MtrCurrDaxRef -> Ap_PICurrCntrl.MtrCurrDaxRef
    connect CurrCmd.MtrCurrDaxRef -> Ap_TrqCanc.MtrCurrDaxRef
    connect CurrCmd.MtrCurrDaxRef -> CurrParamComp.MtrCurrDaxRef
    connect CurrCmd.MtrCurrDaxRef -> PeakCurrEst.MtrCurrDaxRef
    connect CurrCmd.MtrCurrQaxRef -> Ap_TrqCanc.MtrCurrQaxRef
    connect CurrCmd.MtrCurrQaxRef -> CurrParamComp.MtrCurrQaxRef
    connect CurrCmd.MtrCurrQaxRef -> PeakCurrEst.MtrCurrQaxRef
    connect CurrParamComp.EstKe -> Ap_PICurrCntrl.EstKe
    connect CurrParamComp.EstKe -> Ap_PwrLmtFuncCr.EstKe
    connect CurrParamComp.EstKe -> Ap_TrqCanc.EstKe
    connect CurrParamComp.EstKe -> CurrCmd.EstKe
    connect CurrParamComp.EstLd -> Ap_TrqCanc.EstLd
    connect CurrParamComp.EstLd -> CurrCmd.EstLd
    connect CurrParamComp.EstLq -> Ap_TrqCanc.EstLq
    connect CurrParamComp.EstLq -> CurrCmd.EstLq
    connect CurrParamComp.EstR -> Ap_PICurrCntrl.EstR
    connect CurrParamComp.EstR -> CurrCmd.EstR
    connect CurrParamComp.SCom_EOLNomMtrParam -> NtWrap.C_SCom_EOLNomMtrParam
    connect Damping.DampingCmd -> Ap_DampingFirewall.DampingCmd
    connect DemIf.DemIf -> Ap_DiagMgr9.DemIf
    connect DiagMgr.DiagRampRate -> StOpCtrl.DiagRampRate
    connect DiagMgr.DiagRampValue -> StOpCtrl.DiagRampValue
    connect DiagMgr.DiagRmpToZeroActive -> Ap_StaMd8.FTerm
    connect DiagMgr.DiagRmpToZeroActive -> SrlComInput.DiagRmpToZeroActive
    connect DiagMgr.DiagRmpToZeroActive -> SrlComOutput.DiagRmpToZeroActive
    connect DiagMgr.DiagRmpToZeroActive -> StaMd.FTerm
    connect DiagMgr.DiagRmpToZeroActive -> StOpCtrl.DiagStsDiagRmpActive
    connect DiagMgr.DiagStsCtrldDisRmpPres -> Ap_ePWM2.DiagStsCtrldDisRmpPres
    connect DiagMgr.DiagStsCtrldDisRmpPres -> CtrldDisShtdn.DiagStsF2Active
    connect DiagMgr.DiagStsDefTemp -> CtrlTemp.DiagStsTempRdPrf
    connect DiagMgr.DiagStsDefVehSpd -> SrlComInput.DiagStsDefVehSpd
    connect DiagMgr.DiagStsHWASbSystmFltPres -> AbsHwPos.DiagStatusHwPosReducedPerf
    connect DiagMgr.DiagStsHWASbSystmFltPres -> Ap_LrnEOT.DiagStsHwPosDis
    connect DiagMgr.DiagStsHWASbSystmFltPres -> Return.DiagStsHwPosDis
    connect DiagMgr.DiagStsNonRecRmpToZeroFltPres -> Ap_ePWM2.DiagStsNonRecRmpToZeroFltPres
    connect DiagMgr.DiagStsNonRecRmpToZeroFltPres -> SrlComInput.DiagStsNonRecRmpToZeroFltPres
    connect DiagMgr.DiagStsScomHWANotValid -> SrlComOutput.DiagStsHwPosDis
    connect DiagMgr.DiagStsWIRDisable -> Ap_WhlImbRej.DiagStsWIRDisable
    connect DiagMgr.NxtrDiagMgr10 -> AbsHwPos.NxtrDiagMgr
    connect DiagMgr.NxtrDiagMgr10 -> Ap_AssistFirewall.NxtrDiagMgr
    connect DiagMgr.NxtrDiagMgr10 -> Ap_DampingFirewall.NxtrDiagMgr
    connect DiagMgr.NxtrDiagMgr10 -> Ap_GCCDiag.NxtrDiagMgr
    connect DiagMgr.NxtrDiagMgr10 -> Ap_LrnEOT.NxtrDiagMgr
    connect DiagMgr.NxtrDiagMgr10 -> Ap_PwrLmtFuncCr.NxtrDiagMgr
    connect DiagMgr.NxtrDiagMgr10 -> Ap_SASPlausDiag.NxtrDiagMgr
    connect DiagMgr.NxtrDiagMgr10 -> Ap_TqRsDg.NxtrDiagMgr
    connect DiagMgr.NxtrDiagMgr10 -> Ap_WhlImbRej.NxtrDiagMgr
    connect DiagMgr.NxtrDiagMgr10 -> BkCpPc.NxtrDiagMgr
    connect DiagMgr.NxtrDiagMgr10 -> Cd_Nhet1.NxtrDiagMgr
    connect DiagMgr.NxtrDiagMgr10 -> Cd_uDiag.NxtrDiagMgr
    connect DiagMgr.NxtrDiagMgr10 -> CmMtrCurr.NxtrDiagMgr
    connect DiagMgr.NxtrDiagMgr10 -> DigColPs.NxtrDiagMgr
    connect DiagMgr.NxtrDiagMgr10 -> DigPhsReasDiag.NxtrDiagMgr
    connect DiagMgr.NxtrDiagMgr10 -> IoHwAbstractionUsr.NxtrDiagMgr
    connect DiagMgr.NxtrDiagMgr10 -> MtrDrvDiag.NxtrDiagMgr
    connect DiagMgr.NxtrDiagMgr10 -> Polarity.NxtrDiagMgr
    connect DiagMgr.NxtrDiagMgr10 -> ReturnFirewall.NxtrDiagMgr
    connect DiagMgr.NxtrDiagMgr10 -> Sa_DigHwTrqSENT.NxtrDiagMgr
    connect DiagMgr.NxtrDiagMgr10 -> Sa_DigMSB.NxtrDiagMgr
    connect DiagMgr.NxtrDiagMgr10 -> Sa_MtrVel.NxtrDiagMgr
    connect DiagMgr.NxtrDiagMgr10 -> Sa_OvrVoltMon.NxtrDiagMgr
    connect DiagMgr.NxtrDiagMgr10 -> StabilityComp.NxtrDiagMgr
    connect DiagMgr.NxtrDiagMgr10 -> StaMd.NxtrDiagMgr
    connect DiagMgr.NxtrDiagMgr10 -> TmprlMon.NxtrDiagMgr
    connect DiagMgr.NxtrDiagMgr10 -> VehDyn.NxtrDiagMgr
    connect DigColPs.DigColPs_SCom -> NtWrap.C_DigColPs_SCom
    connect DigColPs.I2CHwAbsPos -> AbsHwPos.I2CHwAbsPos
    connect DigColPs.I2CHwAbsPos -> Ap_SASPlausDiag.I2CHwAbsPos
    connect DigColPs.I2CHwAbsPosValid -> AbsHwPos.I2CHwAbsPosValid
    connect DigColPs.I2CHwAbsPosValid -> Ap_SASPlausDiag.I2CHwAbsPosValid
    connect DigColPs.TrimComp -> SrlComOutput.TrimCompEOL
    connect EOTActuatorMng.AssistEOTDamping -> Ap_EtDmpFw.AssistEOTDamping
    connect EOTActuatorMng.AssistEOTGain -> Ap_LmtCod.AssistEOTGain
    connect EOTActuatorMng.AssistEOTLimit -> Ap_LmtCod.AssistEOTLimit
    connect FltInjection.FltInjection_SCom -> Ap_AvgFricLrn.FltInjection_SCom
    connect FltInjection.FltInjection_SCom -> Ap_EtDmpFw.FaultInjection_SCom
    connect FltInjection.FltInjection_SCom -> Ap_GCCDiag.FltInjection_SCom
    connect FltInjection.FltInjection_SCom -> Ap_LmtCod.FltInjection_SCom
    connect FltInjection.FltInjection_SCom -> Ap_SignlCondn.FaultInjection_SCom
    connect FltInjection.FltInjection_SCom -> Ap_TrqArblim.FaultInjection_SCom
    connect FltInjection.FltInjection_SCom -> Assist.FltInjection_SCom
    connect FltInjection.FltInjection_SCom -> BatteryVoltage.FltInjection_SCom
    connect FltInjection.FltInjection_SCom -> Damping.FltInjection_SCom
    connect FltInjection.FltInjection_SCom -> FrqDepDmpnInrtCmp.FltInjection_SCom
    connect FltInjection.FltInjection_SCom -> HystComp.FltInjection_SCom
    connect FltInjection.FltInjection_SCom -> Return.FltInjection_SCom
    connect FltInjection.FltInjection_SCom -> Sa_DigHwTrqSENT.FaultInjection_SCom
    connect FltInjection.FltInjection_SCom -> StabilityComp.FaultInjection_SCom
    connect FltInjection.FltInjection_SCom -> TrqOvlSta.FaultInjection_SCom
    connect FrqDepDmpnInrtCmp.FrqDepDmpnInrtCmp -> Ap_DampingFirewall.InertiaComp
    connect HighFreqAssist.HighFreqAssist -> Ap_AssistFirewall.HighFreqAssist
    connect HiLoadStall.AssistStallLimit -> Ap_LmtCod.AssistStallLimit
    connect HystComp.HysteresisComp -> Ap_AssistFirewall.HysteresisComp
    connect IoHwAbsDigSig.EpsEn -> VehPwrMd.EpsEn
    connect IoHwAbsDigSig.FetDrvCntl -> TmprlMon.FetDrvCntl
    connect IoHwAbsDigSig.FetDrvReset -> MtrDrvDiag.FetDrvReset
    connect IoHwAbsDigSig.FetDrvReset -> Sa_ShtdnMech.FetDrvReset
    connect IoHwAbsDigSig.FetFlt1Data -> MtrDrvDiag.FetFlt1Data
    connect IoHwAbsDigSig.FetFlt2Clk -> MtrDrvDiag.FetFlt2Clk
    connect IoHwAbsDigSig.IoHwAbPortConfig -> MtrDrvDiag.IoHwAbPortConfig
    connect IoHwAbsDigSig.OvrVoltFdbk -> Sa_OvrVoltMon.phyOvrVoltFdbk
    connect IoHwAbsDigSig.PwrSwitchEn -> TmprlMon.PwrSwitchEn
    connect IoHwAbsDigSig.SysFault2 -> Sa_ShtdnMech.SysFault2
    connect IoHwAbsDigSig.SysFault2 -> TmprlMon.SysFault2
    connect IoHwAbsDigSig.SysFault3 -> Sa_ShtdnMech.SysFault3
    connect IoHwAbsDigSig.SysFault3 -> TmprlMon.SysFault3
    connect IoHwAbsDigSig.TODReset -> StaMd.TOD
    connect IoHwAbsDigSig.WdMonitor -> Sa_TmprlMon2.WdMonitor
    connect IoHwAbsDigSig.WdMonitor -> TmprlMon.WdMonitor
    connect IoHwAbsDigSig.WdReset -> TmprlMon.WdReset
    connect IoHwAbstractionUsr.Batt -> Ap_BVDiag.Batt
    connect IoHwAbstractionUsr.Batt -> BatteryVoltage.Batt
    connect IoHwAbstractionUsr.Batt -> BkCpPc.Batt
    connect IoHwAbstractionUsr.BattSwitched -> BatteryVoltage.BattSwitched
    connect IoHwAbstractionUsr.BattSwitched -> BkCpPc.BattSwitched
    connect IoHwAbstractionUsr.SysCVSwitch -> BatteryVoltage.SysCVSwitch
    connect IoHwAbstractionUsr.TemperatureADC -> CtrlTemp.TemperatureADC
    connect MtrDrvDiag.GateDriveResetActive -> DigPhsReasDiag.GateDriveResetActive
    connect MtrDrvDiag.MtrDrvrInitComplete -> Ap_HwPwUp.MtrDrvrInitComplete
    connect PeakCurrEst.EstPkCurr -> Ap_MtrTempEst.EstPkCurr
    connect PeakCurrEst.EstPkCurr -> Ap_ThrmlDutyCycle.MtrPkCurr
    connect PeakCurrEst.FiltEstPkCurr -> Ap_ThrmlDutyCycle.FilteredPkCurr
    connect Polarity.AssistAssyPolarity -> CDDInterface.AssistAssemblyPolarity
    connect Polarity.AssistAssyPolarity -> CtrldDisShtdn.AssistAssyPolarity
    connect Polarity.AssistAssyPolarity -> Polarity.DiagAssistAssyPolarity
    connect Polarity.AssistAssyPolarity -> Sa_DigMSB.AssistAssemblyPolarity
    connect Polarity.AssistAssyPolarity -> Sa_MtrVel.AsstAssemblyPolarity
    connect Polarity.AssistAssyPolarity -> Sa_MtrVel2.AsstAssemblyPolarity
    connect Polarity.HwPosPolarity -> Polarity.DiagHwPosPolarity
    connect Polarity.HwTrqPolarity -> Polarity.DiagHwTrqPolarity
    connect Polarity.MtrElecMechPolarity -> CDDInterface.MtrElecMechPolarity
    connect Polarity.MtrElecMechPolarity -> DigPhsReasDiag.MtrElecMechPolarity
    connect Polarity.MtrElecMechPolarity -> Polarity.DiagMtrElecMechPolarity
    connect Polarity.MtrPosPolarity -> CDDInterface.MtrPosPolarity
    connect Polarity.MtrPosPolarity -> Polarity.DiagMtrPosPolarity
    connect Polarity.MtrPosPolarity -> Sa_DigMSB.MtrPosPolarity
    connect Polarity.MtrVelPolarity -> Polarity.DiagMtrVelPolarity
    connect Polarity.Polarity_SCom -> NtWrap.C_Polarity_SCom
    connect QuadDet.MtrQuad -> CurrCmd.MtrQuad
    connect Return.ReturnCmd -> ReturnFirewall.ReturnCmd
    connect ReturnFirewall.LimitedReturn -> Ap_AstLmt.LimitedReturn
    connect Sa_DigHwTrqSENT.DigHwTrqSENT_SCom -> NtWrap.C_DigHwTrqSENT_SCom
    connect Sa_DigHwTrqSENT.HwTorque -> Ap_Sweep.InputHwTrq
    connect Sa_DigMSB.AlignedCumMechMtrPosCRF -> AbsHwPos.AlignedCumMechMtrPosCRF
    connect Sa_DigMSB.AlignedCumMechMtrPosStatus -> AbsHwPos.TurnsCntrValidity
    connect Sa_DigMSB.CumMechMtrPosCRF -> AbsHwPos.CumMechMtrPosCRF
    connect Sa_DigMSB.CumMechMtrPosMRF -> QuadDet.MRFCumMtrPos
    connect Sa_DigMSB.CumMechMtrPosMRF -> Sa_MtrVel2.CumMechMtrPosMRF
    connect Sa_DigMSB.MechMtrPos2 -> Sa_MtrVel.MechMtrPos2
    connect Sa_MtrVel.HandwheelVel -> Ap_ActivePull.HandwheelVelocity
    connect Sa_MtrVel.HandwheelVel -> Ap_AvgFricLrn.HwVel
    connect Sa_MtrVel.HandwheelVel -> Ap_GMStrtStop.HandwheelVelocity
    connect Sa_MtrVel.HandwheelVel -> Ap_MtrTempEst.HwVel
    connect Sa_MtrVel.HandwheelVel -> Ap_TSMit.HandwheelVelocity
    connect Sa_MtrVel.HandwheelVel -> Return.HandwheelVel
    connect Sa_MtrVel.HandwheelVel -> Sa_MtrVel2.HandwheelVel
    connect Sa_MtrVel.HandwheelVel -> SrlComOutput.HandwheelVel
    connect Sa_MtrVel.HwVelValid -> SrlComOutput.HwVelValid
    connect Sa_MtrVel.MotorVelCRF -> Ap_DampingFirewall.MtrVelCRF
    connect Sa_MtrVel.MotorVelCRF -> Ap_EtDmpFw.CRFMtrVel
    connect Sa_MtrVel.MotorVelCRF -> Ap_LrnEOT.MtrVelCRF
    connect Sa_MtrVel.MotorVelCRF -> Ap_PosServo.MotorVelCRF
    connect Sa_MtrVel.MotorVelCRF -> Ap_ThrmlDutyCycle.MotorVelCRF
    connect Sa_MtrVel.MotorVelCRF -> CtrldDisShtdn.CRFMtrVel
    connect Sa_MtrVel.MotorVelCRF -> Damping.MotorVelCRF
    connect Sa_MtrVel.MotorVelCRF -> EOTActuatorMng.MotorVel
    connect Sa_MtrVel.MotorVelCRF -> FltInjection.MotorVelCRF
    connect Sa_MtrVel.MotorVelCRF -> FrqDepDmpnInrtCmp.CRFMotorVel
    connect Sa_MtrVel.MotorVelCRF -> HiLoadStall.MtrVelCRF
    connect Sa_MtrVel.MotorVelCRF -> VehDyn.MotorVelCRF
    connect Sa_MtrVel.MotorVelMRF -> Ap_PICurrCntrl.MRFMtrVel
    connect Sa_MtrVel.MotorVelMRF -> Ap_PwrLmtFuncCr.MotorVelMRF
    connect Sa_MtrVel.MotorVelMRF -> Ap_TrqCanc.MRFMtrVel
    connect Sa_MtrVel.MotorVelMRF -> CDDInterface.MRFMtrVel
    connect Sa_MtrVel.MotorVelMRF -> CmMtrCurr.MtrVel
    connect Sa_MtrVel.MotorVelMRF -> CurrCmd.MRFMtrVel
    connect Sa_MtrVel.MotorVelMRF -> DigPhsReasDiag.MotorVelMRFUnfiltered
    connect Sa_MtrVel.MotorVelMRF -> Sa_MtrVel2.MotorVelMRF
    connect Sa_MtrVel2.SysCDiagHwVel -> Sa_MtrVel.SysCDiagHwVel
    connect Sa_MtrVel2.SysCDiagMtrVelMRF -> Sa_MtrVel.SysCDiagMtrVelMRF
    connect SrlComInput.APAMfgEnable -> TrqOvlSta.GMOSH_APAMfgEnable
    connect SrlComInput.APANonRecoverableFaults -> TrqOvlSta.APANonRecoverableFaults
    connect SrlComInput.APARecoverableFaults -> TrqOvlSta.APARecoverableFaults
    connect SrlComInput.APARequest -> TrqOvlSta.APARequest
    connect SrlComInput.DesiredTunPers -> Ap_TuningSelAuth.DesiredTunPers
    connect SrlComInput.DesiredTunPers -> Xcp.DesiredTunPers
    connect SrlComInput.EngRunAtvForCTCInhibit -> DemIf.EngRunAtvForCTCInhibit
    connect SrlComInput.ESCCmd -> Ap_TrqArblim.ESCCmd
    connect SrlComInput.ESCFault -> TrqOvlSta.ESCFault
    connect SrlComInput.ESCMfgEnable -> TrqOvlSta.GMOSH_ESCMfgEnable
    connect SrlComInput.ESCRequest -> TrqOvlSta.ESCRequest
    connect SrlComInput.HapticRequest -> TrqOvlSta.HapticRequest
    connect SrlComInput.LKACmd -> Ap_TrqArblim.LKACmd
    connect SrlComInput.LKAFault -> TrqOvlSta.LKAFault
    connect SrlComInput.LKAInhibit -> TrqOvlSta.LKAInhibit
    connect SrlComInput.LKAMfgEnable -> TrqOvlSta.GMOSH_LKAMfgEnable
    connect SrlComInput.LKARequest -> TrqOvlSta.LKARequest
    connect SrlComInput.MaxSecureVehicleSpeed -> Ap_TrqArblim.MaxSecureVehicleSpeed
    connect SrlComInput.MaxSecureVehicleSpeed -> TrqOvlSta.MaxSecureVehicleSpeed
    connect SrlComInput.MinSecureVehicleSpeed -> TrqOvlSta.MinSecureVehicleSpeed
    connect SrlComInput.ShiftLeverIsInReverse -> TrqOvlSta.ShiftLeverIsInReverse
    connect SrlComInput.SPMForCTCInhibit -> DemIf.SPMForCTCInhibit
    connect SrlComInput.SrlComABSActive -> Ap_TSMit.SrlComABSActive
    connect SrlComInput.SrlComAmbTemp -> Ap_MtrTempEst.AmbTemp
    connect SrlComInput.SrlComAmbTemp -> CtrlTemp.AmbTemp
    connect SrlComInput.SrlComEngineSpeed -> Ap_GMStrtStop.EngSpd
    connect SrlComInput.SrlComEngOn -> DemIf.SrlComEngOn
    connect SrlComInput.SrlComEngOn -> SrlComInput.PrevSrlComEngOn
    connect SrlComInput.SrlComEngOn -> VehPwrMd.SrlComEngOn
    connect SrlComInput.SrlComEngTemp -> Ap_MtrTempEst.EngTemp
    connect SrlComInput.SrlComESCActive -> Ap_TSMit.SrlComESCActive
    connect SrlComInput.SrlComLatAccel -> Ap_AvgFricLrn.LatAcc
    connect SrlComInput.SrlComLWhlSpd -> Ap_WIRInputQual.SrlComLWhlSpd
    connect SrlComInput.SrlComLWhlSpdVld -> Ap_WIRInputQual.SrlComLWhlSpdVld
    connect SrlComInput.SrlComRWhlSpd -> Ap_WIRInputQual.SrlComRWhlSpd
    connect SrlComInput.SrlComRWhlSpdVld -> Ap_WIRInputQual.SrlComRWhlSpdVld
    connect SrlComInput.SrlComSPMOn -> VehPwrMd.SrlComSPMOn
    connect SrlComInput.SrlComSysPwrMd -> DemIf.SrlComSysPwrMd
    connect SrlComInput.SrlComSysPwrMd -> SrlComOutput.SrlComSysPwrMd
    connect SrlComInput.SrlComTCSActive -> Ap_TSMit.SrlComTCSActive
    connect SrlComInput.SrlComTransmissionTrq -> Ap_TSMit.SrlComTransmissionTrq
    connect SrlComInput.SrlComTSMitDefeat -> Ap_TSMit.TSMitDefeat
    connect SrlComInput.SrlComVehicleLonAccel -> Ap_SignlCondn.SrlCom_VehicleLonAccel
    connect SrlComInput.SrlComVehSpd -> Ap_SignlCondn.SrlComVehSpeed
    connect SrlComInput.SrlComYawRate -> Ap_ActivePull.SrlComYawRate
    connect SrlComInput.SrlComYawRate -> Ap_TSMit.SrlComYawRate
    connect SrlComInput.StrtStopFaultActive -> Ap_GMStrtStop.SS12VFault
    connect SrlComInput.SWARTrgtAngRequest -> TrqOvlSta.SWARTrgtAngRequest
    connect SrlComInput.VehicleSpeedValid -> Ap_ActivePull.VehicleSpeedValid
    connect SrlComInput.VehicleSpeedValid -> Ap_AvgFricLrn.VehicleSpeedValid
    connect SrlComInput.VehicleSpeedValid -> Ap_Sweep.VehSpdValid
    connect SrlComInput.VehicleSpeedValid -> Ap_WhlImbRej.VehSpdValid
    connect SrlComInput.VehicleSpeedValid -> CmMtrCurr.VhSpdValid
    connect SrlComInput.VehicleSpeedValid -> VehDyn.VehicleSpeedValid
    connect SrlComInput.VehicleSpeedValid -> VehPwrMd.VehSpdValid
    connect SrlComOutput.BusOffCE -> DemIf.BusOffCE
    connect SrlComOutput.BusOffCE -> SrlComInput.BusOffCE
    connect SrlComOutput.BusOffHS -> DemIf.BusOffHS
    connect SrlComOutput.BusOffHS -> SrlComInput.BusOffHS
    connect StabilityComp.AssistCmd -> Ap_AstLmt.AssistCmd
    connect StabilityComp.AssistCmd -> Damping.AssistCmd
    connect StaMd.MilestoneRqst -> Ap_HwPwUp.MilestoneRqst
    connect StaMd.SystemState -> Ap_DampingFirewall.SystemState
    connect StaMd.SystemState -> Ap_ePWM2.SystemState
    connect StaMd.SystemState -> Ap_GMStrtStop.SystemState
    connect StaMd.SystemState -> Ap_HwPwUp.SystemState
    connect StaMd.SystemState -> Ap_PICurrCntrl.SystemState
    connect StaMd.SystemState -> Ap_PwrLmtFuncCr.SystemState
    connect StaMd.SystemState -> Ap_TqRsDg.SystemState
    connect StaMd.SystemState -> Ap_TrqArblim.SystemState
    connect StaMd.SystemState -> Ap_WhlImbRej.SystemState
    connect StaMd.SystemState -> BkCpPc.SystemState
    connect StaMd.SystemState -> CDDInterface.SystemState
    connect StaMd.SystemState -> CmMtrCurr.SystemState
    connect StaMd.SystemState -> CtrldDisShtdn.SystemState
    connect StaMd.SystemState -> DiagMgr.SystemState
    connect StaMd.SystemState -> DigPhsReasDiag.SystemState
    connect StaMd.SystemState -> FrqDepDmpnInrtCmp.SystemState
    connect StaMd.SystemState -> MtrDrvDiag.SystemState
    connect StaMd.SystemState -> PeakCurrEst.SystemState
    connect StaMd.SystemState -> RteErrata.SystemState
    connect StaMd.SystemState -> Sa_OvrVoltMon.SystemState
    connect StaMd.SystemState -> StaMd.CurrentSystemState
    connect StaMd.SystemState -> TmprlMon.SystemState
    connect StaMd.SystemState -> TrqOvlSta.SystemState
    connect StaMd.SystemState -> VehDyn.SystemState
    connect StOpCtrl.OutputRampMult -> Ap_LmtCod.OutputRampMult
    connect StOpCtrl.SysStReqDi -> Ap_ePWM2.RampDwnStatusComplete
    connect StOpCtrl.SysStReqDi -> Ap_StaMd8.RampStatusComplete
    connect StOpCtrl.SysStReqDi -> StaMd.RampStatusComplete
    connect TmprlMon.TMFTestComplete -> Ap_HwPwUp.TMFTestComplete
    connect TmprlMon.TMFTestComplete -> Ap_StaMd8.TMFTestComplete
    connect TmprlMon.TMFTestComplete -> StaMd.TMFTestComplete
    connect TrqCmdScl.MRFMtrTrqCmdScl -> Ap_GCCDiag.MRFMtrTrqCmdScl
    connect TrqCmdScl.MRFMtrTrqCmdScl -> Ap_TrqCanc.MtrTrqCmdMRFScl
    connect TrqCmdScl.MRFMtrTrqCmdScl -> CurrCmd.MRFTrqCmdScl
    connect TrqCmdScl.MRFMtrTrqCmdScl -> QuadDet.MRFMtrTrqCmdScl
    connect TrqCmdScl.TrqCmdScl_SCom -> NtWrap.C_TrqCmdScl_SCom
    connect TrqOvlSta.APADrvrInterventionDetected -> SrlComOutput.APADrvrInterventionDetected
    connect TrqOvlSta.APAState -> Ap_GMStrtStop.APAState
    connect TrqOvlSta.APAState -> SrlComOutput.APAState
    connect TrqOvlSta.ESCState -> Ap_TrqArblim.ESCState
    connect TrqOvlSta.ESCState -> SrlComOutput.ESCState
    connect TrqOvlSta.GMOSHOscillateState -> Ap_TrqArblim.GMOSHOscillate
    connect TrqOvlSta.LKAState -> Ap_TrqArblim.LKAState
    connect TrqOvlSta.LKAState -> SrlComOutput.LKAState
    connect TrqOvlSta.PosServEnable -> Ap_PosServo.PosSrvoEnable
    connect TrqOvlSta.PosServEnable -> Ap_TrqArblim.PosServEnable
    connect TrqOvlSta.PosSrvoHwAngle -> Ap_PosServo.PosSrvoHwAngle
    connect TrqOvlSta.TrqOscAmp -> Ap_TrqOsc.TrqOscAmp
    connect TrqOvlSta.TrqOscEnable -> Ap_TrqOsc.TrqOscEnable
    connect TrqOvlSta.TrqOscFreq -> Ap_TrqOsc.TrqOscFreq
    connect VehDyn.SensorlessAuthority -> AbsHwPos.VdAuthority
    connect VehDyn.SensorlessAuthority -> Ap_SASPlausDiag.VdAuthority
    connect VehDyn.SensorlessHwPos -> AbsHwPos.VdHwPos
    connect VehDyn.SensorlessHwPos -> Ap_SASPlausDiag.VdHwPos
    connect VehDyn.VehDyn_SCom -> NtWrap.C_VehDyn_SCom
    connect VehPwrMd.ATermActive -> Ap_StaMd8.ATerm
    connect VehPwrMd.ATermActive -> StaMd.ATerm
    connect VehPwrMd.CTermActive -> Ap_StaMd8.CTerm
    connect VehPwrMd.CTermActive -> StaMd.CTerm
    connect VehPwrMd.OperRampRate -> StOpCtrl.OperRampRate
    connect VehPwrMd.OperRampValue -> StOpCtrl.OperRampValue
    connect VehSpdLmt.AstVehSpdLimit -> Ap_LmtCod.AssistVehSpdLimit
    connect Xcp.ActiveTunOvrPtrAddr -> Ap_TuningSelAuth.ActiveTunOvrPtrAddr
    connect Xcp.TuningSessionActPtr -> Ap_TuningSelAuth.TuningSessionActPtr
package /VehicleProject
  system EPS: fibex-element=EPS
    mapping EPS_MPPNG
      sw-impl-mappings:
        94 x swc to impl mapping:
          D_0EE57A38_B70B_4E47_98A2_B71351993FB1_IMPL: component-implementation=Ap_AbsHwPos_Implementation, component=ECU_Composition.AbsHwPos
          D_FAF2AEF1_F184_4C05_96B0_62667B1D789A_IMPL: component-implementation=Ap_ActivePull_Implementation, component=ECU_Composition.Ap_ActivePull
          D_EC153092_5B63_471B_B623_D09E3BF2732A_IMPL: component-implementation=Ap_AssistFirewall_Implementation, component=ECU_Composition.Ap_AssistFirewall
          D_A84AE01B_3FA5_4FA9_B350_7BE8808F571C_IMPL: component-implementation=Ap_AstLmt_Implementation, component=ECU_Composition.Ap_AstLmt
          D_D8370144_E72D_43B0_993C_25FFA19ECB1E_IMPL: component-implementation=Ap_AvgFricLrn_Implementation, component=ECU_Composition.Ap_AvgFricLrn
          D_DB78EA41_6A1C_4C46_BFD7_5EC556D69803_IMPL: component-implementation=Ap_BVDiag_Implementation, component=ECU_Composition.Ap_BVDiag
          D_EEB39A63_DB6A_4F5D_A18A_DAF7BFF70FBD_IMPL: component-implementation=Ap_DampingFirewall_Implementation, component=ECU_Composition.Ap_DampingFirewall
          D_810A2614_CAD9_4FBF_85AE_17396AF4C0C2_IMPL: component-implementation=Ap_DiagMgr8_Implementation, component=ECU_Composition.Ap_DiagMgr8
          D_895254DB_CED5_4B20_BCAA_9CD4444E59F8_IMPL: component-implementation=Ap_DiagMgr9_Implementation, component=ECU_Composition.Ap_DiagMgr9
          D_EE162DC2_26D3_434D_8DD6_FA57DFC2AC92_IMPL: component-implementation=Ap_ePWM2_Implementation, component=ECU_Composition.Ap_ePWM2
          D_31E2E4CB_A5BA_4094_85FD_408EB32C8C5B_IMPL: component-implementation=Ap_EtDmpFw_Implementation, component=ECU_Composition.Ap_EtDmpFw
          D_4D9F6293_F0CB_4B86_9C75_B6CB58B8CE67_IMPL: component-implementation=Ap_GCCDiag_Implementation, component=ECU_Composition.Ap_GCCDiag
          D_BCB61F0F_F2DD_455D_AD80_954524E4928E_IMPL: component-implementation=Ap_GenPosTraj_Implementation, component=ECU_Composition.Ap_GenPosTraj
          D_4CFDBFC8_01F5_4890_9829_41C75DD7B2CB_IMPL: component-implementation=Ap_GMStrtStop_Implementation, component=ECU_Composition.Ap_GMStrtStop
          D_E086462D_2FC2_4CF2_849E_618D357B3374_IMPL: component-implementation=Ap_HOWDetect_Implementation, component=ECU_Composition.Ap_HOWDetect
          D_3AF5FC4D_09AE_42A2_B547_C79FA5278B69_IMPL: component-implementation=Ap_HwPwUp_Implementation, component=ECU_Composition.Ap_HwPwUp
          D_F2F72D17_68DC_4E37_98AE_5766E17E8F2E_IMPL: component-implementation=Ap_LmtCod_Implementation, component=ECU_Composition.Ap_LmtCod
          D_54E5F080_B935_49F8_B6C2_12F1682C4622_IMPL: component-implementation=Ap_LrnEOT_Implementation, component=ECU_Composition.Ap_LrnEOT
          D_F28494CE_5303_4429_84DD_D7418B8E1709_IMPL: component-implementation=Ap_MtrTempEst_Implementation, component=ECU_Composition.Ap_MtrTempEst
          D_BA8CA22D_D7AB_412D_BB95_CCDFC767558B_IMPL: component-implementation=Ap_PICurrCntrl_Implementation, component=ECU_Composition.Ap_PICurrCntrl
          D_BFAB3A75_40B1_42C9_8D07_59698F24A236_IMPL: component-implementation=Ap_PosServo_Implementation, component=ECU_Composition.Ap_PosServo
          D_19F0FB94_39A3_4FA9_8132_C75BBDC4062C_IMPL: component-implementation=Ap_PwrLmtFuncCr_Implementation, component=ECU_Composition.Ap_PwrLmtFuncCr
          D_8516E18C_A73A_43F1_AE58_2C75F224D13B_IMPL: component-implementation=Ap_SASPlausDiag_Implementation, component=ECU_Composition.Ap_SASPlausDiag
          D_1F0A7689_827B_4669_BCA2_D799705EA7BF_IMPL: component-implementation=Ap_SignlCondn_Implementation, component=ECU_Composition.Ap_SignlCondn
          D_888F918F_B370_437C_BFCA_EB69291BBCAE_IMPL: component-implementation=Ap_StabilityComp2_Implementation, component=ECU_Composition.Ap_StabilityComp2
          D_C31F3CAF_9F23_434E_844F_CBEF2869C69E_IMPL: component-implementation=Ap_StaMd8_Implementation, component=ECU_Composition.Ap_StaMd8
          D_1F3B42F5_38BE_4BCF_ACA0_C7C2BFA0E626_IMPL: component-implementation=Ap_StaMd9_Implementation, component=ECU_Composition.Ap_StaMd9
          D_54EB0B5D_D339_4FB2_871D_73D2AD0AEA67_IMPL: component-implementation=Ap_Sweep_Implementation, component=ECU_Composition.Ap_Sweep
          D_9064DEA6_1FDF_4DBD_8A01_9910212E0644_IMPL: component-implementation=Ap_Sweep2_Implementation, component=ECU_Composition.Ap_Sweep2
          D_6B8DF8CE_F7B9_42A7_8E5E_A85D568CA9AA_IMPL: component-implementation=Ap_ThrmlDutyCycle_Implementation, component=ECU_Composition.Ap_ThrmlDutyCycle
          D_221DB4FA_AA06_468D_9583_5C4FB757F9D3_IMPL: component-implementation=Ap_TqRsDg_Implementation, component=ECU_Composition.Ap_TqRsDg
          D_86046A6F_E1EC_413B_A6B8_67E7C642C6D8_IMPL: component-implementation=Ap_TrqArblim_Implementation, component=ECU_Composition.Ap_TrqArblim
          D_B9E0F1EE_7A29_4B0A_8232_886A1A450BFC_IMPL: component-implementation=Ap_TrqCanc_Implementation, component=ECU_Composition.Ap_TrqCanc
          D_DFDB9EE7_AC93_4DF3_A46B_9D638BC94943_IMPL: component-implementation=Ap_TrqOsc_Implementation, component=ECU_Composition.Ap_TrqOsc
          D_A11ADAD8_E923_4DEF_B8E1_F562E1A76969_IMPL: component-implementation=Ap_TSMit_Implementation, component=ECU_Composition.Ap_TSMit
          D_9EAF0D45_D267_43EF_8773_5270EC6E042D_IMPL: component-implementation=Ap_TuningSelAuth_Implementation, component=ECU_Composition.Ap_TuningSelAuth
          D_A10A5E13_2E31_4BFE_B0C8_956F6B8694A9_IMPL: component-implementation=Ap_WhlImbRej_Implementation, component=ECU_Composition.Ap_WhlImbRej
          D_421C32B7_E5BB_4A94_A892_ADC0FAF2C059_IMPL: component-implementation=Ap_WIRInputQual_Implementation, component=ECU_Composition.Ap_WIRInputQual
          D_FE6AA2FD_C447_4C0B_BCA9_C1AF652900F9_IMPL: component-implementation=Ap_Assist_Implementation, component=ECU_Composition.Assist
          D_96C025B6_2C30_4A55_9C4A_DD3E2003270C_IMPL: component-implementation=Ap_BatteryVoltage_Implementation, component=ECU_Composition.BatteryVoltage
          D_46492BB9_3B79_4754_BEF3_56FC3216D546_IMPL: component-implementation=Sa_BkCpPc_Implementation, component=ECU_Composition.BkCpPc
          D_F9756B89_E5A1_4FA5_8973_551853B4A909_IMPL: component-implementation=Cd_Nhet1_Implementation, component=ECU_Composition.Cd_Nhet1
          D_B11C7021_E5F1_4623_AE45_B3D88F645FF4_IMPL: component-implementation=Cd_uDiag_Implementation, component=ECU_Composition.Cd_uDiag
          D_C40D80D9_3C4E_4B29_9D01_8E6F94943A03_IMPL: component-implementation=Sa_CDDInterface_Implementation, component=ECU_Composition.CDDInterface
          D_75A86E5C_038A_4484_B345_E0B0A28EBCF8_IMPL: component-implementation=Sa_CmMtrCurr_Implementation, component=ECU_Composition.CmMtrCurr
          D_40F1677C_59F4_4E80_B521_1FACB7A01453_IMPL: component-implementation=Ap_ComplErr_Implementation, component=ECU_Composition.ComplErr
          D_41907AC3_5C93_4920_B42A_65A215EECB4A_IMPL: component-implementation=Ap_CtrldDisShtdn_Implementation, component=ECU_Composition.CtrldDisShtdn
          D_6C8C4E86_C50A_45FF_8B2A_A0C476CB4097_IMPL: component-implementation=Sa_CtrlTemp_Implementation, component=ECU_Composition.CtrlTemp
          D_6037E795_026A_4A95_BAB3_4AFAAC9ACB08_IMPL: component-implementation=Ap_CurrCmd_Implementation, component=ECU_Composition.CurrCmd
          D_483D4BDB_9752_49F5_9195_4BB7B8EC8802_IMPL: component-implementation=Ap_CurrParamComp_Implementation, component=ECU_Composition.CurrParamComp
          D_B85B3753_F94A_4640_A9AF_1CD88DAA843C_IMPL: component-implementation=Ap_CustPerSrvcs_Implementation, component=ECU_Composition.CustPerSrvcs
          D_5D87CEDD_AF8D_4079_A13D_174AB722C70D_IMPL: component-implementation=Ap_Damping_Implementation, component=ECU_Composition.Damping
          D_034BCA69_F311_4BBB_87CA_7CB716C5FE9E_IMPL: component-implementation=Ap_DemIf_Implementation, component=ECU_Composition.DemIf
          D_12FEF264_148D_4DBD_8492_A70E06A15A04_IMPL: component-implementation=Ap_DiagMgr10_Implementation, component=ECU_Composition.DiagMgr
          D_46191D2B_6579_43BD_B4F3_BC0B87D30E40_IMPL: component-implementation=Sa_DigColPs_Implementation, component=ECU_Composition.DigColPs
          D_6C6AE6B2_26D6_447B_AD21_90DD831AB939_IMPL: component-implementation=Ap_DigPhsReasDiag_Implementation, component=ECU_Composition.DigPhsReasDiag
          D_E2CBEFAE_5E28_49E1_9F3F_6CCAF62188D3_IMPL: component-implementation=Ap_EOTActuatorMng_Implementation, component=ECU_Composition.EOTActuatorMng
          D_0EC72D50_F470_4CEC_8678_E2BC8FE1DA60_IMPL: component-implementation=Ap_FltInjection_Implementation, component=ECU_Composition.FltInjection
          D_9319816F_3A57_4051_93DA_7E7ED312D970_IMPL: component-implementation=Ap_FrqDepDmpnInrtCmp_Implementation, component=ECU_Composition.FrqDepDmpnInrtCmp
          D_4E5E42DD_5059_4FC2_99D8_91C51A9D9A24_IMPL: component-implementation=Ap_HighFreqAssist_Implementation, component=ECU_Composition.HighFreqAssist
          D_9A089670_756B_4291_956D_A72D5022843E_IMPL: component-implementation=Ap_HiLoadStall_Implementation, component=ECU_Composition.HiLoadStall
          D_146631C4_58BC_4158_9C1C_EA776F1810A6_IMPL: component-implementation=Ap_HystComp_Implementation, component=ECU_Composition.HystComp
          D_05E8F7D3_7535_42F4_A81D_C95BDEF4F89A_IMPL: component-implementation=IoHwAbstraction_Implementation, component=ECU_Composition.IoHwAbsDigSig
          D_585FCC6E_976F_4698_8368_FDBC5D29E6C8_IMPL: component-implementation=IoHwAbstractionUsr_Implementation, component=ECU_Composition.IoHwAbstractionUsr
          D_5531E499_2016_45E4_AAE2_ECC23728AEF1_IMPL: component-implementation=Sa_MtrDrvDiag_Implementation, component=ECU_Composition.MtrDrvDiag
          D_BB1E4C17_FB1E_4BEC_AAFD_BE7638B2B037_IMPL: component-implementation=NtWrap_Implementation, component=ECU_Composition.NtWrap
          D_60B54218_134A_4429_BA16_3EEAEE19179F_IMPL: component-implementation=Ap_PeakCurrEst_Implementation, component=ECU_Composition.PeakCurrEst
          D_B29414C1_C8E8_4BEF_946A_17C6EBAEBE79_IMPL: component-implementation=Ap_Polarity_Implementation, component=ECU_Composition.Polarity
          D_375A26AD_0499_417D_9C38_EA06C02715A0_IMPL: component-implementation=Ap_QuadDet_Implementation, component=ECU_Composition.QuadDet
          D_7E252D4E_CB8A_422F_A76F_C3801E29C20A_IMPL: component-implementation=Ap_Return_Implementation, component=ECU_Composition.Return
          D_10FEAC6E_186D_4A73_A7AB_7FE239620B89_IMPL: component-implementation=Ap_ReturnFirewall_Implementation, component=ECU_Composition.ReturnFirewall
          D_3878FB8A_527B_4936_B9C9_5455AE7C2C18_IMPL: component-implementation=RteErrata10_Implementation, component=ECU_Composition.RteErrata
          D_72D3D659_6644_4C09_A31F_E261C6B6620F_IMPL: component-implementation=RteErrata8_Implementation, component=ECU_Composition.RteErrata8
          D_2B98A026_CE52_4A17_8B98_B5A554131C9F_IMPL: component-implementation=RteErrata9_Implementation, component=ECU_Composition.RteErrata9
          D_19DCB15C_8F42_4B01_ACAB_426265F55C5B_IMPL: component-implementation=Sa_DigHwTrqSENT_Implementation, component=ECU_Composition.Sa_DigHwTrqSENT
          D_EFD7C241_B18D_400A_A69B_CEC0547FDAFE_IMPL: component-implementation=Sa_DigMSB_Implementation, component=ECU_Composition.Sa_DigMSB
          D_4BC561EF_C009_4928_90EC_F51B4CC0C6FF_IMPL: component-implementation=Sa_MtrVel_Implementation, component=ECU_Composition.Sa_MtrVel
          D_9A5FA6FA_48E3_4C3F_91A5_1EDE1B4B7E15_IMPL: component-implementation=Sa_MtrVel2_Implementation, component=ECU_Composition.Sa_MtrVel2
          D_FDDD82DB_85A4_441E_A423_1E0641B3FFE4_IMPL: component-implementation=Sa_MtrVel3_Implementation, component=ECU_Composition.Sa_MtrVel3
          D_AC362153_0D76_4F64_A963_CE2EE36555D8_IMPL: component-implementation=Sa_OvrVoltMon_Implementation, component=ECU_Composition.Sa_OvrVoltMon
          D_7B36E249_5AE5_46FB_88FD_0F9AA62D1376_IMPL: component-implementation=Sa_ShtdnMech_Implementation, component=ECU_Composition.Sa_ShtdnMech
          D_42C7D340_FACA_4E2F_936F_419D6D8D3E6E_IMPL: component-implementation=Sa_TmprlMon2_Implementation, component=ECU_Composition.Sa_TmprlMon2
          D_7B1C3B14_5C30_47CE_A6C9_6849B3E69C00_IMPL: component-implementation=Ap_SrlComInput_Implementation, component=ECU_Composition.SrlComInput
          D_631F542F_4333_4647_9EF6_6CE8638267D6_IMPL: component-implementation=Ap_SrlComOutput_Implementation, component=ECU_Composition.SrlComOutput
          D_CC1EE666_B9F0_49F8_9F12_62E29C82CEA3_IMPL: component-implementation=Ap_StabilityComp_Implementation, component=ECU_Composition.StabilityComp
          D_549A49E1_42ED_4456_BD97_C282DBFD98C3_IMPL: component-implementation=Ap_StaMd_Implementation, component=ECU_Composition.StaMd
          D_FEC9008F_1DB7_4D0B_936C_2B74F70D1267_IMPL: component-implementation=Ap_StOpCtrl_Implementation, component=ECU_Composition.StOpCtrl
          D_8A995CAB_8AE5_42FA_9311_B500F436DDB9_IMPL: component-implementation=Sa_TmprlMon_Implementation, component=ECU_Composition.TmprlMon
          D_C44DCD06_F7B1_4566_A383_FF0370DC2539_IMPL: component-implementation=Ap_TrqCmdScl_Implementation, component=ECU_Composition.TrqCmdScl
          D_244DEA6C_C43B_4D59_BA81_8FDE9787FB12_IMPL: component-implementation=Ap_TrqOvlSta_Implementation, component=ECU_Composition.TrqOvlSta
          D_D8311560_0D09_4895_9EC6_B70DA7263C37_IMPL: component-implementation=Ap_VehDyn_Implementation, component=ECU_Composition.VehDyn
          D_447DC844_068B_4E6E_95C5_7AB006626D45_IMPL: component-implementation=Ap_VehPwrMd_Implementation, component=ECU_Composition.VehPwrMd
          D_D9F992B4_A79D_49A6_AD48_E09620ACA05B_IMPL: component-implementation=Ap_VehSpdLmt_Implementation, component=ECU_Composition.VehSpdLmt
          D_DC381543_0123_4077_BD68_4904CEEB7C48_IMPL: component-implementation=Ap_ApXcp_Implementation, component=ECU_Composition.Xcp
      sw-mappings:
        94 x swc to ecu mapping, all with ecu-instance=EPS:
          D_0EE57A38_B70B_4E47_98A2_B71351993FB1_: component=ECU_Composition.AbsHwPos
          D_FAF2AEF1_F184_4C05_96B0_62667B1D789A_: component=ECU_Composition.Ap_ActivePull
          D_EC153092_5B63_471B_B623_D09E3BF2732A_: component=ECU_Composition.Ap_AssistFirewall
          D_A84AE01B_3FA5_4FA9_B350_7BE8808F571C_: component=ECU_Composition.Ap_AstLmt
          D_D8370144_E72D_43B0_993C_25FFA19ECB1E_: component=ECU_Composition.Ap_AvgFricLrn
          D_DB78EA41_6A1C_4C46_BFD7_5EC556D69803_: component=ECU_Composition.Ap_BVDiag
          D_EEB39A63_DB6A_4F5D_A18A_DAF7BFF70FBD_: component=ECU_Composition.Ap_DampingFirewall
          D_810A2614_CAD9_4FBF_85AE_17396AF4C0C2_: component=ECU_Composition.Ap_DiagMgr8
          D_895254DB_CED5_4B20_BCAA_9CD4444E59F8_: component=ECU_Composition.Ap_DiagMgr9
          D_EE162DC2_26D3_434D_8DD6_FA57DFC2AC92_: component=ECU_Composition.Ap_ePWM2
          D_31E2E4CB_A5BA_4094_85FD_408EB32C8C5B_: component=ECU_Composition.Ap_EtDmpFw
          D_4D9F6293_F0CB_4B86_9C75_B6CB58B8CE67_: component=ECU_Composition.Ap_GCCDiag
          D_BCB61F0F_F2DD_455D_AD80_954524E4928E_: component=ECU_Composition.Ap_GenPosTraj
          D_4CFDBFC8_01F5_4890_9829_41C75DD7B2CB_: component=ECU_Composition.Ap_GMStrtStop
          D_E086462D_2FC2_4CF2_849E_618D357B3374_: component=ECU_Composition.Ap_HOWDetect
          D_3AF5FC4D_09AE_42A2_B547_C79FA5278B69_: component=ECU_Composition.Ap_HwPwUp
          D_F2F72D17_68DC_4E37_98AE_5766E17E8F2E_: component=ECU_Composition.Ap_LmtCod
          D_54E5F080_B935_49F8_B6C2_12F1682C4622_: component=ECU_Composition.Ap_LrnEOT
          D_F28494CE_5303_4429_84DD_D7418B8E1709_: component=ECU_Composition.Ap_MtrTempEst
          D_BA8CA22D_D7AB_412D_BB95_CCDFC767558B_: component=ECU_Composition.Ap_PICurrCntrl
          D_BFAB3A75_40B1_42C9_8D07_59698F24A236_: component=ECU_Composition.Ap_PosServo
          D_19F0FB94_39A3_4FA9_8132_C75BBDC4062C_: component=ECU_Composition.Ap_PwrLmtFuncCr
          D_8516E18C_A73A_43F1_AE58_2C75F224D13B_: component=ECU_Composition.Ap_SASPlausDiag
          D_1F0A7689_827B_4669_BCA2_D799705EA7BF_: component=ECU_Composition.Ap_SignlCondn
          D_888F918F_B370_437C_BFCA_EB69291BBCAE_: component=ECU_Composition.Ap_StabilityComp2
          D_C31F3CAF_9F23_434E_844F_CBEF2869C69E_: component=ECU_Composition.Ap_StaMd8
          D_1F3B42F5_38BE_4BCF_ACA0_C7C2BFA0E626_: component=ECU_Composition.Ap_StaMd9
          D_54EB0B5D_D339_4FB2_871D_73D2AD0AEA67_: component=ECU_Composition.Ap_Sweep
          D_9064DEA6_1FDF_4DBD_8A01_9910212E0644_: component=ECU_Composition.Ap_Sweep2
          D_6B8DF8CE_F7B9_42A7_8E5E_A85D568CA9AA_: component=ECU_Composition.Ap_ThrmlDutyCycle
          D_221DB4FA_AA06_468D_9583_5C4FB757F9D3_: component=ECU_Composition.Ap_TqRsDg
          D_86046A6F_E1EC_413B_A6B8_67E7C642C6D8_: component=ECU_Composition.Ap_TrqArblim
          D_B9E0F1EE_7A29_4B0A_8232_886A1A450BFC_: component=ECU_Composition.Ap_TrqCanc
          D_DFDB9EE7_AC93_4DF3_A46B_9D638BC94943_: component=ECU_Composition.Ap_TrqOsc
          D_A11ADAD8_E923_4DEF_B8E1_F562E1A76969_: component=ECU_Composition.Ap_TSMit
          D_9EAF0D45_D267_43EF_8773_5270EC6E042D_: component=ECU_Composition.Ap_TuningSelAuth
          D_A10A5E13_2E31_4BFE_B0C8_956F6B8694A9_: component=ECU_Composition.Ap_WhlImbRej
          D_421C32B7_E5BB_4A94_A892_ADC0FAF2C059_: component=ECU_Composition.Ap_WIRInputQual
          D_FE6AA2FD_C447_4C0B_BCA9_C1AF652900F9_: component=ECU_Composition.Assist
          D_96C025B6_2C30_4A55_9C4A_DD3E2003270C_: component=ECU_Composition.BatteryVoltage
          D_46492BB9_3B79_4754_BEF3_56FC3216D546_: component=ECU_Composition.BkCpPc
          D_F9756B89_E5A1_4FA5_8973_551853B4A909_: component=ECU_Composition.Cd_Nhet1
          D_B11C7021_E5F1_4623_AE45_B3D88F645FF4_: component=ECU_Composition.Cd_uDiag
          D_C40D80D9_3C4E_4B29_9D01_8E6F94943A03_: component=ECU_Composition.CDDInterface
          D_75A86E5C_038A_4484_B345_E0B0A28EBCF8_: component=ECU_Composition.CmMtrCurr
          D_40F1677C_59F4_4E80_B521_1FACB7A01453_: component=ECU_Composition.ComplErr
          D_41907AC3_5C93_4920_B42A_65A215EECB4A_: component=ECU_Composition.CtrldDisShtdn
          D_6C8C4E86_C50A_45FF_8B2A_A0C476CB4097_: component=ECU_Composition.CtrlTemp
          D_6037E795_026A_4A95_BAB3_4AFAAC9ACB08_: component=ECU_Composition.CurrCmd
          D_483D4BDB_9752_49F5_9195_4BB7B8EC8802_: component=ECU_Composition.CurrParamComp
          D_B85B3753_F94A_4640_A9AF_1CD88DAA843C_: component=ECU_Composition.CustPerSrvcs
          D_5D87CEDD_AF8D_4079_A13D_174AB722C70D_: component=ECU_Composition.Damping
          D_034BCA69_F311_4BBB_87CA_7CB716C5FE9E_: component=ECU_Composition.DemIf
          D_12FEF264_148D_4DBD_8492_A70E06A15A04_: component=ECU_Composition.DiagMgr
          D_46191D2B_6579_43BD_B4F3_BC0B87D30E40_: component=ECU_Composition.DigColPs
          D_6C6AE6B2_26D6_447B_AD21_90DD831AB939_: component=ECU_Composition.DigPhsReasDiag
          D_E2CBEFAE_5E28_49E1_9F3F_6CCAF62188D3_: component=ECU_Composition.EOTActuatorMng
          D_0EC72D50_F470_4CEC_8678_E2BC8FE1DA60_: component=ECU_Composition.FltInjection
          D_9319816F_3A57_4051_93DA_7E7ED312D970_: component=ECU_Composition.FrqDepDmpnInrtCmp
          D_4E5E42DD_5059_4FC2_99D8_91C51A9D9A24_: component=ECU_Composition.HighFreqAssist
          D_9A089670_756B_4291_956D_A72D5022843E_: component=ECU_Composition.HiLoadStall
          D_146631C4_58BC_4158_9C1C_EA776F1810A6_: component=ECU_Composition.HystComp
          D_05E8F7D3_7535_42F4_A81D_C95BDEF4F89A_: component=ECU_Composition.IoHwAbsDigSig
          D_585FCC6E_976F_4698_8368_FDBC5D29E6C8_: component=ECU_Composition.IoHwAbstractionUsr
          D_5531E499_2016_45E4_AAE2_ECC23728AEF1_: component=ECU_Composition.MtrDrvDiag
          D_BB1E4C17_FB1E_4BEC_AAFD_BE7638B2B037_: component=ECU_Composition.NtWrap
          D_60B54218_134A_4429_BA16_3EEAEE19179F_: component=ECU_Composition.PeakCurrEst
          D_B29414C1_C8E8_4BEF_946A_17C6EBAEBE79_: component=ECU_Composition.Polarity
          D_375A26AD_0499_417D_9C38_EA06C02715A0_: component=ECU_Composition.QuadDet
          D_7E252D4E_CB8A_422F_A76F_C3801E29C20A_: component=ECU_Composition.Return
          D_10FEAC6E_186D_4A73_A7AB_7FE239620B89_: component=ECU_Composition.ReturnFirewall
          D_3878FB8A_527B_4936_B9C9_5455AE7C2C18_: component=ECU_Composition.RteErrata
          D_72D3D659_6644_4C09_A31F_E261C6B6620F_: component=ECU_Composition.RteErrata8
          D_2B98A026_CE52_4A17_8B98_B5A554131C9F_: component=ECU_Composition.RteErrata9
          D_19DCB15C_8F42_4B01_ACAB_426265F55C5B_: component=ECU_Composition.Sa_DigHwTrqSENT
          D_EFD7C241_B18D_400A_A69B_CEC0547FDAFE_: component=ECU_Composition.Sa_DigMSB
          D_4BC561EF_C009_4928_90EC_F51B4CC0C6FF_: component=ECU_Composition.Sa_MtrVel
          D_9A5FA6FA_48E3_4C3F_91A5_1EDE1B4B7E15_: component=ECU_Composition.Sa_MtrVel2
          D_FDDD82DB_85A4_441E_A423_1E0641B3FFE4_: component=ECU_Composition.Sa_MtrVel3
          D_AC362153_0D76_4F64_A963_CE2EE36555D8_: component=ECU_Composition.Sa_OvrVoltMon
          D_7B36E249_5AE5_46FB_88FD_0F9AA62D1376_: component=ECU_Composition.Sa_ShtdnMech
          D_42C7D340_FACA_4E2F_936F_419D6D8D3E6E_: component=ECU_Composition.Sa_TmprlMon2
          D_7B1C3B14_5C30_47CE_A6C9_6849B3E69C00_: component=ECU_Composition.SrlComInput
          D_631F542F_4333_4647_9EF6_6CE8638267D6_: component=ECU_Composition.SrlComOutput
          D_CC1EE666_B9F0_49F8_9F12_62E29C82CEA3_: component=ECU_Composition.StabilityComp
          D_549A49E1_42ED_4456_BD97_C282DBFD98C3_: component=ECU_Composition.StaMd
          D_FEC9008F_1DB7_4D0B_936C_2B74F70D1267_: component=ECU_Composition.StOpCtrl
          D_8A995CAB_8AE5_42FA_9311_B500F436DDB9_: component=ECU_Composition.TmprlMon
          D_C44DCD06_F7B1_4566_A383_FF0370DC2539_: component=ECU_Composition.TrqCmdScl
          D_244DEA6C_C43B_4D59_BA81_8FDE9787FB12_: component=ECU_Composition.TrqOvlSta
          D_D8311560_0D09_4895_9EC6_B70DA7263C37_: component=ECU_Composition.VehDyn
          D_447DC844_068B_4E6E_95C5_7AB006626D45_: component=ECU_Composition.VehPwrMd
          D_D9F992B4_A79D_49A6_AD48_E09620ACA05B_: component=ECU_Composition.VehSpdLmt
          D_DC381543_0123_4077_BD68_4904CEEB7C48_: component=ECU_Composition.Xcp
    software composition ECU_Composition: software-composition=ECU_Composition
