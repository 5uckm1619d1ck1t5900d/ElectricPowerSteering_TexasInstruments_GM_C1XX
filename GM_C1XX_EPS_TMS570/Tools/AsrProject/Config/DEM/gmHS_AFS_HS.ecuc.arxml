AUTOSAR XML (schema 3.0.2)
package /ActiveEcuC
  ecu configuration ActiveEcuC: ecu-extract=System, module=[Can, CanIf, CanTrcv, CanSM, CanTp, Com, PduR, EcuC, ComM, Dcm, EcuM, NvM, Board, GenyBaseEnv, Dem]
  module config NvM: implementation-config-variant=VARIANT-PRE-COMPILE, module-description=NvM_Impl  # Configuration of the NvM (NvRam Manager) module.
    NvmDummyBlock (NvmBlockDescriptor):
      NvmBlockWriteProt = (unset)
      NvmWriteBlockOnce = (unset)
      NvmRomBlockDataAddress = (unset)
      NvmSingleBlockCallback = (unset)
      NvmRamBlockDataAddress = Dem_NvData
      NvmInitBlockCallback = Dem_NvDataInit
      NvmSelectBlockForReadall = true
    NVM_BLOCK_DEM (NvmBlockDescriptor):
      NvmBlockWriteProt = (unset)
      NvmWriteBlockOnce = (unset)
      NvmRomBlockDataAddress = (unset)
      NvmSingleBlockCallback = (unset)
      NvmRamBlockDataAddress = Dem_NvData
      NvmInitBlockCallback = Dem_NvDataInit
      NvmSelectBlockForReadall = true
  module config Can
    CanGeneral: CanIndex=0
    CanConfigSet
      CAN00 (CanController): CanControllerActivation=true, CanControllerId=0
      HWObj_CT_CAN00_0 (CanHardwareObject): CanHandleType=BASIC, CanIdType=STANDARD, CanObjectId=0, CanObjectType=TRANSMIT, CanControllerRef=CanConfigSet/CAN00
      HWObj_CT_CAN00_1 (CanHardwareObject): CanHandleType=BASIC, CanIdType=STANDARD, CanObjectId=1, CanObjectType=RECEIVE, CanControllerRef=CanConfigSet/CAN00
  module config CanIf
    CanIfPublicConfiguration
    CanIfPrivateConfiguration: CanIfSoftwareFilterType=LINEAR
    CanIfInitConfiguration: CanIfConfigSet=initConfiguration, CanIfNumberOfCanRxPduIds=20, CanIfNumberOfCanTXPduIds=7, CanIfNumberOfDynamicCanTXPduIds=0
      CanIfInitHohConfig: CanIfRefConfigSet=CanConfigSet
        CT_CAN00_0 (CanIfHthConfig): CanIfHthType=BASIC_CAN, CanIfCanControllerIdRef=CanIf/CT_CAN00, CanIfHthIdSymRef=HWObj_CT_CAN00_0
        CT_CAN00_1 (CanIfHrhConfig): CanIfHrhType=BASIC_CAN, CanIfCanControllerHrhIdRef=CanIf/CT_CAN00, CanIfHrhIdSymRef=HWObj_CT_CAN00_1
      CT_CAN00 (CanIfInitControllerConfig): CanIfControllerRefConfigSet=CanConfigSet/CAN00
      AFS_Status_HS__CAN00 (CanIfTxPduConfig):
        CanIfCanTxPduIdCanId = 383
        CanIfCanTxPduIdDlc = 2
        CanIfCanTxPduType = STATIC
        CanIfTxPduIdCanIdType = STANDARD_CAN
        CanIfTxUserType = PDUR
        CanIfUserTxConfirmation = PduR_CanIfTxConfirmation
        CanIfCanTxPduHthRef = CT_CAN00_0
        PduIdRef = PduCollection/AFS_Status_HS__CAN00
      3 x CanIfRxPduConfig, all with CanIfRxPduIdCanIdType=STANDARD_CAN, CanIfRxUserType=PDUR, CanIfUserRxIndication=PduR_CanIfRxIndication, CanIfCanRxPduHrhRef=CT_CAN00_1:
        Antilock_Brake_and_TC_Status_HS__CAN00: CanIfCanRxPduCanId=381, CanIfCanRxPduDlc=6, PduIdRef=PduCollection/Antilock_Brake_and_TC_Status_HS__CAN00
        Driven_Wheel_Grnd_Velocity_HS__CAN00: CanIfCanRxPduCanId=840, CanIfCanRxPduDlc=4, PduIdRef=PduCollection/Driven_Wheel_Grnd_Velocity_HS__CAN00
        Driving_Mode_Control_HS__CAN00: CanIfCanRxPduCanId=562, CanIfCanRxPduDlc=7, PduIdRef=PduCollection/Driving_Mode_Control_HS__CAN00
      DTC_Triggered_779__CAN00 (CanIfTxPduConfig):
        CanIfCanTxPduIdCanId = 1913
        CanIfCanTxPduIdDlc = 7
        CanIfCanTxPduType = STATIC
        CanIfTxPduIdCanIdType = STANDARD_CAN
        CanIfTxUserType = PDUR
        CanIfUserTxConfirmation = PduR_CanIfTxConfirmation
        CanIfCanTxPduHthRef = CT_CAN00_0
        PduIdRef = PduCollection/DTC_Triggered_779__CAN00
      10 x CanIfRxPduConfig, all with CanIfRxPduIdCanIdType=STANDARD_CAN, CanIfCanRxPduHrhRef=CT_CAN00_1:
        NonDriven_Wheel_Grnd_Velocity_HS__CAN00: CanIfCanRxPduCanId=842, CanIfCanRxPduDlc=4, CanIfRxUserType=PDUR, CanIfUserRxIndication=PduR_CanIfRxIndication, PduIdRef=PduCollection/NonDriven_Wheel_Grnd_Velocity_HS__CAN00
        PPEI_Chassis_General_Status_1__CAN00: CanIfCanRxPduCanId=489, CanIfCanRxPduDlc=8, CanIfRxUserType=PDUR, CanIfUserRxIndication=PduR_CanIfRxIndication, PduIdRef=PduCollection/PPEI_Chassis_General_Status_1__CAN00
        PPEI_Driven_Whl_Rotational_Stat__CAN00: CanIfCanRxPduCanId=193, CanIfCanRxPduDlc=8, CanIfRxUserType=PDUR, CanIfUserRxIndication=PduR_CanIfRxIndication, PduIdRef=PduCollection/PPEI_Driven_Whl_Rotational_Stat__CAN00
        PPEI_Engine_General_Status_1__CAN00: CanIfCanRxPduCanId=201, CanIfCanRxPduDlc=8, CanIfRxUserType=PDUR, CanIfUserRxIndication=PduR_CanIfRxIndication, PduIdRef=PduCollection/PPEI_Engine_General_Status_1__CAN00
        PPEI_Engine_General_Status_3__CAN00: CanIfCanRxPduCanId=1017, CanIfCanRxPduDlc=8, CanIfRxUserType=PDUR, CanIfUserRxIndication=PduR_CanIfRxIndication, PduIdRef=PduCollection/PPEI_Engine_General_Status_3__CAN00
        PPEI_NonDrivn_Whl_Rotationl_Stat__CAN00: CanIfCanRxPduCanId=197, CanIfCanRxPduDlc=8, CanIfRxUserType=PDUR, CanIfUserRxIndication=PduR_CanIfRxIndication, PduIdRef=PduCollection/PPEI_NonDrivn_Whl_Rotationl_Stat__CAN00
        PPEI_Platform_General_Status__CAN00: CanIfCanRxPduCanId=497, CanIfCanRxPduDlc=8, CanIfRxUserType=PDUR, CanIfUserRxIndication=PduR_CanIfRxIndication, PduIdRef=PduCollection/PPEI_Platform_General_Status__CAN00
        PPEI_Trans_General_Status_2__CAN00: CanIfCanRxPduCanId=501, CanIfCanRxPduDlc=8, CanIfRxUserType=PDUR, CanIfUserRxIndication=PduR_CanIfRxIndication, PduIdRef=PduCollection/PPEI_Trans_General_Status_2__CAN00
        PPEI_VIN_Digits_10_to_17__CAN00: CanIfCanRxPduCanId=1249, CanIfCanRxPduDlc=8, CanIfRxUserType=PDUR, CanIfUserRxIndication=PduR_CanIfRxIndication, PduIdRef=PduCollection/PPEI_VIN_Digits_10_to_17__CAN00
        TsiCcpRx__CAN00: CanIfCanRxPduCanId=1937, CanIfCanRxPduDlc=8, CanIfRxUserType=APPL, PduIdRef=PduCollection/TsiCcpRx__CAN00
      TsiCcpTx__CAN00 (CanIfTxPduConfig):
        CanIfCanTxPduIdCanId = 1936
        CanIfCanTxPduIdDlc = 8
        CanIfCanTxPduType = STATIC
        CanIfTxPduIdCanIdType = STANDARD_CAN
        CanIfTxUserType = APPL
        CanIfCanTxPduHthRef = CT_CAN00_0
        PduIdRef = PduCollection/TsiCcpTx__CAN00
      TsiDrvRxMsg__CAN00 (CanIfRxPduConfig):
        CanIfCanRxPduCanId = 1939
        CanIfCanRxPduDlc = 8
        CanIfRxPduIdCanIdType = STANDARD_CAN
        CanIfRxUserType = APPL
        CanIfCanRxPduHrhRef = CT_CAN00_1
        PduIdRef = PduCollection/TsiDrvRxMsg__CAN00
      TsiDrvTxMsg__CAN00 (CanIfTxPduConfig):
        CanIfCanTxPduIdCanId = 1938
        CanIfCanTxPduIdDlc = 8
        CanIfCanTxPduType = STATIC
        CanIfTxPduIdCanIdType = STANDARD_CAN
        CanIfTxUserType = APPL
        CanIfCanTxPduHthRef = CT_CAN00_0
        PduIdRef = PduCollection/TsiDrvTxMsg__CAN00
      TsiTpRxMsg__CAN00 (CanIfRxPduConfig):
        CanIfCanRxPduCanId = 1941
        CanIfCanRxPduDlc = 8
        CanIfRxPduIdCanIdType = STANDARD_CAN
        CanIfRxUserType = APPL
        CanIfCanRxPduHrhRef = CT_CAN00_1
        PduIdRef = PduCollection/TsiTpRxMsg__CAN00
      TsiTpTxMsg__CAN00 (CanIfTxPduConfig):
        CanIfCanTxPduIdCanId = 1940
        CanIfCanTxPduIdDlc = 8
        CanIfCanTxPduType = STATIC
        CanIfTxPduIdCanIdType = STANDARD_CAN
        CanIfTxUserType = APPL
        CanIfCanTxPduHthRef = CT_CAN00_0
        PduIdRef = PduCollection/TsiTpTxMsg__CAN00
      USDT_Req_to_AFS_HS_Tp__CAN00 (CanIfRxPduConfig):
        CanIfCanRxPduCanId = 597
        CanIfCanRxPduDlc = 8
        CanIfRxPduIdCanIdType = STANDARD_CAN
        CanIfRxUserType = CAN_TP
        CanIfUserRxIndication = CanTp_RxIndication
        CanIfCanRxPduHrhRef = CT_CAN00_1
        PduIdRef = PduCollection/USDT_Req_to_AFS_HS_Tp__CAN00
      USDT_Req_to_All_HS_ECUs_Tp__CAN00 (CanIfRxPduConfig):
        CanIfCanRxPduCanId = 257
        CanIfCanRxPduDlc = 8
        CanIfRxPduIdCanIdType = STANDARD_CAN
        CanIfRxUserType = CAN_TP
        CanIfUserRxIndication = CanTp_RxIndication
        CanIfCanRxPduHrhRef = CT_CAN00_1
        PduIdRef = PduCollection/USDT_Req_to_All_HS_ECUs_Tp__CAN00
      USDT_Resp_From_AFS_HS_Tp__CAN00 (CanIfTxPduConfig):
        CanIfCanTxPduIdCanId = 1621
        CanIfCanTxPduIdDlc = 8
        CanIfCanTxPduType = STATIC
        CanIfTxPduIdCanIdType = STANDARD_CAN
        CanIfTxUserType = CAN_TP
        CanIfUserTxConfirmation = CanTp_TxConfirmation
        CanIfCanTxPduHthRef = CT_CAN00_0
        PduIdRef = PduCollection/USDT_Resp_From_AFS_HS_Tp__CAN00
      UUDT_Resp_From_AFS_HS__CAN00 (CanIfTxPduConfig):
        CanIfCanTxPduIdCanId = 1365
        CanIfCanTxPduIdDlc = 8
        CanIfCanTxPduType = STATIC
        CanIfTxPduIdCanIdType = STANDARD_CAN
        CanIfTxUserType = APPL
        CanIfCanTxPduHthRef = CT_CAN00_0
        PduIdRef = PduCollection/UUDT_Resp_From_AFS_HS__CAN00
      3 x CanIfRxPduConfig, all with CanIfRxPduIdCanIdType=STANDARD_CAN, CanIfRxUserType=PDUR, CanIfUserRxIndication=PduR_CanIfRxIndication, CanIfCanRxPduHrhRef=CT_CAN00_1:
        Vehicle_Odometer_HS__CAN00: CanIfCanRxPduCanId=288, CanIfCanRxPduDlc=5, PduIdRef=PduCollection/Vehicle_Odometer_HS__CAN00
        VIN_Digits_2_to_9_HS__CAN00: CanIfCanRxPduCanId=1300, CanIfCanRxPduDlc=8, PduIdRef=PduCollection/VIN_Digits_2_to_9_HS__CAN00
        Wheel_Pulses_HS__CAN00: CanIfCanRxPduCanId=1280, CanIfCanRxPduDlc=4, PduIdRef=PduCollection/Wheel_Pulses_HS__CAN00
    CanIfDriverConfig: CanIfDriverNameRef=CanGeneral, CanIfInitHohConfigRef=CanIfInitHohConfig
    CT_CAN00 (CanIfControllerConfig): CanIfWakeupSupport=NO_WAKEUP, CanIfControllerIdRef=CanConfigSet/CAN00, CanIfDriverNameRef=CanIfDriverConfig
  module config CanTrcv
    CanTrcvGeneral: CanTrcvIndex=0
    CanTrcvConfigSet
      CAN00 (CanTrcvChannel): CanTrcvChannelId=0, CanTrcvWakeupSourceRef=CHNL
  module config CanSM
    CanStateManagerConfiguration
      CAN00 (CanStateManagerNetworks):
        CanSMNetworkHandle = ComM/CAN00
        CanSMRxPduGroupId = PduGrp_AFS_HS__CAN00_Rx
        CanSMTransceiverId = CanTrcvConfigSet/CAN00
        CanSMTxPduGroupId = PduGrp_AFS_HS__CAN00_Tx
        CT_CAN00 (CanStateManagerControllers): CanSMControllerId=CanConfigSet/CAN00
  module config CanTp
    CanTpGeneral: CanTpSupportMixed11Addressing=false
    CanTpConfigSet:
      CanTpActiveRxNSduRef = USDT_Req_to_All_HS_ECUs__CAN00_0
      CanTpActiveRxNSduRef = USDT_Req_to_All_HS_ECUs__CAN00_1
      CanTpActiveRxNSduRef = USDT_Req_to_AFS_HS__CAN00_AFS_HS_0
      CanTpActiveRxNSduRef = USDT_Req_to_AFS_HS__CAN00_AFS_HS_1
      CanTpActiveTxNSduRef = CanTp/USDT_Resp_From_AFS_HS__CAN00
    USDT_Req_to_All_HS_ECUs__CAN00_0 (CanTpRxNSdu):
      CanTpAddressingFormat = CANTP_STANDARD
      CanTpRxPaddingActivation = CANTP_ON
      CanTpRxTaType = CANTP_FUNCTIONAL
      CanTpRxNSduRef = PduCollection/USDT_Req_to_All_HS_ECUs__CAN00
      USDT_Req_to_All_HS_ECUs_Tp__CAN00_1 (CanTpRxNPdu): CanTpRxNPduId=0, CanTpRxNPduRef=PduCollection/USDT_Req_to_All_HS_ECUs_Tp__CAN00
    USDT_Req_to_All_HS_ECUs__CAN00_1 (CanTpRxNSdu):
      CanTpAddressingFormat = CANTP_STANDARD
      CanTpRxPaddingActivation = CANTP_ON
      CanTpRxTaType = CANTP_FUNCTIONAL
      CanTpRxNSduRef = PduCollection/USDT_Req_to_All_HS_ECUs__CAN00
      USDT_Req_to_All_HS_ECUs_Tp__CAN00 (CanTpRxNPdu): CanTpRxNPduId=1, CanTpRxNPduRef=PduCollection/USDT_Req_to_All_HS_ECUs_Tp__CAN00
    USDT_Resp_From_AFS_HS__CAN00 (CanTpTxNSdu):
      CanTpAddressingMode = CANTP_STANDARD
      CanTpTxNSduId = 0
      CanTpTxPaddingActivation = CANTP_ON
      CanTpTxTaType = CANTP_PHYSICAL
      CanTpTxNSduRef = PduCollection/USDT_Resp_From_AFS_HS__CAN00
      USDT_Resp_From_AFS_HS_Tp__CAN00_0 (CanTpTxNPdu): CanTpTxNPduRef=PduCollection/USDT_Resp_From_AFS_HS_Tp__CAN00
      USDT_Req_to_AFS_HS_Tp__CAN00 (CanTpRxFcNPdu): CanTpRxFcNPduId=0, CanTpRxFcNPduRef=PduCollection/USDT_Req_to_AFS_HS_Tp__CAN00
    USDT_Req_to_AFS_HS__CAN00_AFS_HS_0 (CanTpRxNSdu):
      CanTpAddressingFormat = CANTP_STANDARD
      CanTpRxPaddingActivation = CANTP_ON
      CanTpRxTaType = CANTP_PHYSICAL
      CanTpRxNSduRef = PduCollection/USDT_Req_to_AFS_HS__CAN00
      USDT_Req_to_AFS_HS_Tp__CAN00_2 (CanTpRxNPdu): CanTpRxNPduId=2, CanTpRxNPduRef=PduCollection/USDT_Req_to_AFS_HS_Tp__CAN00
      USDT_Req_to_AFS_HS_Tp__CAN00_1 (CanTpTxFcNPdu): CanTpTxFcNPduRef=PduCollection/USDT_Resp_From_AFS_HS_Tp__CAN00
    USDT_Req_to_AFS_HS__CAN00_AFS_HS_1 (CanTpRxNSdu):
      CanTpAddressingFormat = CANTP_STANDARD
      CanTpRxPaddingActivation = CANTP_ON
      CanTpRxTaType = CANTP_PHYSICAL
      CanTpRxNSduRef = PduCollection/USDT_Req_to_AFS_HS__CAN00
      USDT_Req_to_AFS_HS_Tp__CAN00_3 (CanTpRxNPdu): CanTpRxNPduId=3, CanTpRxNPduRef=PduCollection/USDT_Req_to_AFS_HS_Tp__CAN00
      USDT_Req_to_AFS_HS_Tp__CAN00_1 (CanTpTxFcNPdu): CanTpTxFcNPduRef=PduCollection/USDT_Resp_From_AFS_HS_Tp__CAN00
  module config Com
    ComGeneral: ComConfigurationTimeBase=0.001
    ComConfig
      PduGrp_AFS_HS__CAN00_Rx (ComIPduGroup): ComIPduGroupHandleId=0
      PduGrp_AFS_HS__CAN00_Tx (ComIPduGroup): ComIPduGroupHandleId=1
      17 x ComIPdu:
        Pdu_AFS_Status_HS__CAN00: ComIpduDirection=SEND, ComIPduSize=2, ComIPduGroupRef=PduGrp_AFS_HS__CAN00_Tx, ComIPduSignalRef=Com_AFSIndOn__AFS_Status_HS__CAN00, ComIPduSignalRef=Com_AFSSysFail__AFS_Status_HS__CAN00, ComIPduSignalRef=Com_FrStSysVeTpSpLimIndOn__AFS_Status_HS__CAN00, ComIPduSignalRef=Com_StSysVehTopSpdLimReq__AFS_Status_HS__CAN00, PduIdRef=PduCollection/AFS_Status_HS__CAN00
          ComTxIPdu: ComTxIPduMinimumDelayTimeFactor=0
            ComTxModeFalse
              ComTxModeFalseFalse (ComTxMode): ComTxModeMode=PERIODIC, ComTxModeTimeOffsetFactor=0, ComTxModeTimePeriodFactor=100
            ComTxModeTrue
              ComTxModeTrueTrue (ComTxMode): ComTxModeMode=PERIODIC, ComTxModeTimeOffsetFactor=0, ComTxModeTimePeriodFactor=100
        Pdu_Antilock_Brake_and_TC_Status_HS__CAN00: ComIpduDirection=RECEIVE, ComIPduRxHandleId=0, ComIPduSize=6, ComIPduGroupRef=PduGrp_AFS_HS__CAN00_Rx, ComIPduSignalRef=Com_VehStabEnhmntStat__Antilock_Brake_and_TC_Status_HS__CAN00, PduIdRef=PduCollection/Antilock_Brake_and_TC_Status_HS__CAN00
        Pdu_Driven_Wheel_Grnd_Velocity_HS__CAN00: ComIpduDirection=RECEIVE, ComIPduRxHandleId=1, ComIPduSize=4, ComIPduGroupRef=PduGrp_AFS_HS__CAN00_Rx, ComIPduSignalRef=Com_WhlGrndVlctyLftDrvn__Driven_Wheel_Grnd_Velocity_HS__CAN00, ComIPduSignalRef=Com_WhlGrndVlctyLftDrvnV__Driven_Wheel_Grnd_Velocity_HS__CAN00, ComIPduSignalRef=Com_WhlGrndVlctyRtDrvn__Driven_Wheel_Grnd_Velocity_HS__CAN00, ComIPduSignalRef=Com_WhlGrndVlctyRtDrvnV__Driven_Wheel_Grnd_Velocity_HS__CAN00, PduIdRef=PduCollection/Driven_Wheel_Grnd_Velocity_HS__CAN00
        Pdu_Driving_Mode_Control_HS__CAN00: ComIpduDirection=RECEIVE, ComIPduRxHandleId=2, ComIPduSize=7, ComIPduGroupRef=PduGrp_AFS_HS__CAN00_Rx, ComIPduSignalRef=Com_DrvMdCntrlState__Driving_Mode_Control_HS__CAN00, PduIdRef=PduCollection/Driving_Mode_Control_HS__CAN00
        Pdu_DTC_Triggered_779__CAN00: ComIpduDirection=SEND, ComIPduSize=7, ComIPduGroupRef=PduGrp_AFS_HS__CAN00_Tx, ComIPduSignalGroupRef=Com_Grp_SG_DTCInfo_779__DTC_Triggered_779__CAN00, PduIdRef=PduCollection/DTC_Triggered_779__CAN00
          ComTxIPdu: ComTxIPduMinimumDelayTimeFactor=0
            ComTxModeFalse
              ComTxModeFalseFalse (ComTxMode): ComTxModeMode=PERIODIC, ComTxModeTimeOffsetFactor=0, ComTxModeTimePeriodFactor=1000
            ComTxModeTrue
              ComTxModeTrueTrue (ComTxMode): ComTxModeMode=PERIODIC, ComTxModeTimeOffsetFactor=0, ComTxModeTimePeriodFactor=1000
        Pdu_NonDriven_Wheel_Grnd_Velocity_HS__CAN00: ComIpduDirection=RECEIVE, ComIPduRxHandleId=3, ComIPduSize=4, ComIPduGroupRef=PduGrp_AFS_HS__CAN00_Rx, ComIPduSignalRef=Com_WhlGrndVlctyLftNnDrvn__NonDriven_Wheel_Grnd_Velocity_HS__CAN00, ComIPduSignalRef=Com_WhlGrndVlctyLftNnDrvnV__NonDriven_Wheel_Grnd_Velocity_HS__CAN00, ComIPduSignalRef=Com_WhlGrndVlctyRtNnDrvn__NonDriven_Wheel_Grnd_Velocity_HS__CAN00, ComIPduSignalRef=Com_WhlGrndVlctyRtNnDrvnV__NonDriven_Wheel_Grnd_Velocity_HS__CAN00, PduIdRef=PduCollection/NonDriven_Wheel_Grnd_Velocity_HS__CAN00
        Pdu_PPEI_Chassis_General_Status_1__CAN00: ComIpduDirection=RECEIVE, ComIPduRxHandleId=4, ComIPduSize=8, ComIPduGroupRef=PduGrp_AFS_HS__CAN00_Rx, ComIPduSignalRef=Com_ABSFld__PPEI_Chassis_General_Status_1__CAN00, ComIPduSignalRef=Com_ABSAtv__PPEI_Chassis_General_Status_1__CAN00, ComIPduSignalRef=Com_VhDynCntlSysSt__PPEI_Chassis_General_Status_1__CAN00, PduIdRef=PduCollection/PPEI_Chassis_General_Status_1__CAN00
        Pdu_PPEI_Driven_Whl_Rotational_Stat__CAN00: ComIpduDirection=RECEIVE, ComIPduRxHandleId=5, ComIPduSize=8, ComIPduGroupRef=PduGrp_AFS_HS__CAN00_Rx, ComIPduSignalGroupRef=Com_Grp_SG_WhlRotatStatLftDrvn__PPEI_Driven_Whl_Rotational_Stat__CAN00, ComIPduSignalGroupRef=Com_Grp_SG_WhlRotatStatRtDrvn__PPEI_Driven_Whl_Rotational_Stat__CAN00, PduIdRef=PduCollection/PPEI_Driven_Whl_Rotational_Stat__CAN00
        Pdu_PPEI_Engine_General_Status_1__CAN00: ComIpduDirection=RECEIVE, ComIPduRxHandleId=6, ComIPduSize=8, ComIPduGroupRef=PduGrp_AFS_HS__CAN00_Rx, ComIPduSignalRef=Com_EngRunAtv__PPEI_Engine_General_Status_1__CAN00, ComIPduSignalRef=Com_EngSpd__PPEI_Engine_General_Status_1__CAN00, ComIPduSignalRef=Com_AccActPosV__PPEI_Engine_General_Status_1__CAN00, ComIPduSignalRef=Com_AccActPos__PPEI_Engine_General_Status_1__CAN00, PduIdRef=PduCollection/PPEI_Engine_General_Status_1__CAN00
        Pdu_PPEI_Engine_General_Status_3__CAN00: ComIpduDirection=RECEIVE, ComIPduRxHandleId=7, ComIPduSize=8, ComIPduGroupRef=PduGrp_AFS_HS__CAN00_Rx, ComIPduSignalRef=Com_GenFld__PPEI_Engine_General_Status_3__CAN00, PduIdRef=PduCollection/PPEI_Engine_General_Status_3__CAN00
        Pdu_PPEI_NonDrivn_Whl_Rotationl_Stat__CAN00: ComIpduDirection=RECEIVE, ComIPduRxHandleId=8, ComIPduSize=8, ComIPduGroupRef=PduGrp_AFS_HS__CAN00_Rx, ComIPduSignalGroupRef=Com_Grp_SG_WhlRotStatLftNDrvn__PPEI_NonDrivn_Whl_Rotationl_Stat__CAN00, ComIPduSignalGroupRef=Com_Grp_SG_WhlRotStatRghtNDrvn__PPEI_NonDrivn_Whl_Rotationl_Stat__CAN00, PduIdRef=PduCollection/PPEI_NonDrivn_Whl_Rotationl_Stat__CAN00
        Pdu_PPEI_Platform_General_Status__CAN00: ComIpduDirection=RECEIVE, ComIPduRxHandleId=9, ComIPduSize=8, ComIPduGroupRef=PduGrp_AFS_HS__CAN00_Rx, ComIPduSignalRef=Com_SysPwrMd__PPEI_Platform_General_Status__CAN00, ComIPduSignalRef=Com_SysBkUpPwrMd__PPEI_Platform_General_Status__CAN00, ComIPduSignalRef=Com_SysBkupPwrMdEn__PPEI_Platform_General_Status__CAN00, ComIPduSignalRef=Com_TrStLgMdAtv__PPEI_Platform_General_Status__CAN00, ComIPduSignalRef=Com_SIRDpl__PPEI_Platform_General_Status__CAN00, PduIdRef=PduCollection/PPEI_Platform_General_Status__CAN00
        Pdu_PPEI_Trans_General_Status_2__CAN00: ComIpduDirection=RECEIVE, ComIPduRxHandleId=10, ComIPduSize=8, ComIPduGroupRef=PduGrp_AFS_HS__CAN00_Rx, ComIPduSignalRef=Com_TransEstGear__PPEI_Trans_General_Status_2__CAN00, ComIPduSignalRef=Com_TransEstGearV__PPEI_Trans_General_Status_2__CAN00, ComIPduSignalRef=Com_TrnsEngdState__PPEI_Trans_General_Status_2__CAN00, ComIPduSignalRef=Com_TrnsEngdStateV__PPEI_Trans_General_Status_2__CAN00, PduIdRef=PduCollection/PPEI_Trans_General_Status_2__CAN00
        Pdu_PPEI_VIN_Digits_10_to_17__CAN00: ComIpduDirection=RECEIVE, ComIPduRxHandleId=11, ComIPduSize=8, ComIPduGroupRef=PduGrp_AFS_HS__CAN00_Rx, ComIPduSignalRef=Com_VehIdNmDig10_17__PPEI_VIN_Digits_10_to_17__CAN00, PduIdRef=PduCollection/PPEI_VIN_Digits_10_to_17__CAN00
        Pdu_Vehicle_Odometer_HS__CAN00: ComIpduDirection=RECEIVE, ComIPduRxHandleId=12, ComIPduSize=5, ComIPduGroupRef=PduGrp_AFS_HS__CAN00_Rx, ComIPduSignalRef=Com_VehOdo__Vehicle_Odometer_HS__CAN00, ComIPduSignalRef=Com_VehOdoV__Vehicle_Odometer_HS__CAN00, PduIdRef=PduCollection/Vehicle_Odometer_HS__CAN00
        Pdu_VIN_Digits_2_to_9_HS__CAN00: ComIpduDirection=RECEIVE, ComIPduRxHandleId=13, ComIPduSize=8, ComIPduGroupRef=PduGrp_AFS_HS__CAN00_Rx, ComIPduSignalRef=Com_VehIdNmDig2_9__VIN_Digits_2_to_9_HS__CAN00, PduIdRef=PduCollection/VIN_Digits_2_to_9_HS__CAN00
        Pdu_Wheel_Pulses_HS__CAN00: ComIpduDirection=RECEIVE, ComIPduRxHandleId=14, ComIPduSize=4, ComIPduGroupRef=PduGrp_AFS_HS__CAN00_Rx, ComIPduSignalRef=Com_WhlPlsPerRevDrvn__Wheel_Pulses_HS__CAN00, ComIPduSignalRef=Com_WhlPlsPerRevNonDrvn__Wheel_Pulses_HS__CAN00, PduIdRef=PduCollection/Wheel_Pulses_HS__CAN00
      10 x ComSignal, all with ComSignalEndianess=BIG_ENDIAN, ComSignalInitValue=0, ComTransferProperty=PENDING:
        Com_AFSIndOn__AFS_Status_HS__CAN00: ComBitPosition=0, ComBitSize=1, ComHandleId=0, ComSignalLength=1, ComSignalType=BOOLEAN, SystemTemplateSystemSignalRef=AFSIndOn
        Com_AFSSysFail__AFS_Status_HS__CAN00: ComBitPosition=1, ComBitSize=1, ComHandleId=1, ComSignalLength=1, ComSignalType=BOOLEAN, SystemTemplateSystemSignalRef=AFSSysFail
        Com_FrStSysVeTpSpLimIndOn__AFS_Status_HS__CAN00: ComBitPosition=2, ComBitSize=1, ComHandleId=2, ComSignalLength=1, ComSignalType=BOOLEAN, SystemTemplateSystemSignalRef=FrStSysVeTpSpLimIndOn
        Com_StSysVehTopSpdLimReq__AFS_Status_HS__CAN00: ComBitPosition=15, ComBitSize=8, ComHandleId=3, ComSignalLength=1, ComSignalType=UINT8, SystemTemplateSystemSignalRef=StSysVehTopSpdLimReq
        Com_VehStabEnhmntStat__Antilock_Brake_and_TC_Status_HS__CAN00: ComBitPosition=4, ComBitSize=3, ComHandleId=4, ComSignalLength=1, ComSignalType=UINT8, ComTimeoutFactor=0, SystemTemplateSystemSignalRef=VehStabEnhmntStat
        Com_WhlGrndVlctyLftDrvn__Driven_Wheel_Grnd_Velocity_HS__CAN00: ComBitPosition=5, ComBitSize=14, ComHandleId=5, ComSignalLength=2, ComSignalType=UINT16, ComTimeoutFactor=0, SystemTemplateSystemSignalRef=WhlGrndVlctyLftDrvn
        Com_WhlGrndVlctyLftDrvnV__Driven_Wheel_Grnd_Velocity_HS__CAN00: ComBitPosition=6, ComBitSize=1, ComHandleId=6, ComSignalLength=1, ComSignalType=BOOLEAN, ComTimeoutFactor=0, SystemTemplateSystemSignalRef=WhlGrndVlctyLftDrvnV
        Com_WhlGrndVlctyRtDrvn__Driven_Wheel_Grnd_Velocity_HS__CAN00: ComBitPosition=21, ComBitSize=14, ComHandleId=7, ComSignalLength=2, ComSignalType=UINT16, ComTimeoutFactor=0, SystemTemplateSystemSignalRef=WhlGrndVlctyRtDrvn
        Com_WhlGrndVlctyRtDrvnV__Driven_Wheel_Grnd_Velocity_HS__CAN00: ComBitPosition=22, ComBitSize=1, ComHandleId=8, ComSignalLength=1, ComSignalType=BOOLEAN, ComTimeoutFactor=0, SystemTemplateSystemSignalRef=WhlGrndVlctyRtDrvnV
        Com_DrvMdCntrlState__Driving_Mode_Control_HS__CAN00: ComBitPosition=39, ComBitSize=8, ComHandleId=9, ComSignalLength=1, ComSignalType=UINT8, ComTimeoutFactor=0, SystemTemplateSystemSignalRef=DrvMdCntrlState
      Com_Grp_SG_DTCInfo_779__DTC_Triggered_779__CAN00 (ComSignalGroup): ComBitPosition=0, ComBitSize=56, ComHandleId=10, ComTransferProperty=PENDING, SystemTemplateSignalGroupRef=SG_DTCInfo_779
        20 x ComGroupSignal, all with ComSignalEndianess=BIG_ENDIAN, ComSignalInitValue=0, ComTransferProperty=PENDING:
          Com_DTCI_DTCTriggered_779__DTC_Triggered_779__CAN00: ComBitPosition=0, ComBitSize=1, ComHandleId=11, ComSignalLength=1, ComSignalType=BOOLEAN, SystemTemplateSystemSignalRef=DTCI_DTCTriggered_779
          Com_DTCIUnused7_779__DTC_Triggered_779__CAN00: ComBitPosition=1, ComBitSize=1, ComHandleId=12, ComSignalLength=1, ComSignalType=BOOLEAN, SystemTemplateSystemSignalRef=DTCIUnused7_779
          Com_DTCIUnused6_779__DTC_Triggered_779__CAN00: ComBitPosition=2, ComBitSize=1, ComHandleId=13, ComSignalLength=1, ComSignalType=BOOLEAN, SystemTemplateSystemSignalRef=DTCIUnused6_779
          Com_DTCIUnused5_779__DTC_Triggered_779__CAN00: ComBitPosition=3, ComBitSize=1, ComHandleId=14, ComSignalLength=1, ComSignalType=BOOLEAN, SystemTemplateSystemSignalRef=DTCIUnused5_779
          Com_DTCIUnused4_779__DTC_Triggered_779__CAN00: ComBitPosition=4, ComBitSize=1, ComHandleId=15, ComSignalLength=1, ComSignalType=BOOLEAN, SystemTemplateSystemSignalRef=DTCIUnused4_779
          Com_DTCIUnused3_779__DTC_Triggered_779__CAN00: ComBitPosition=5, ComBitSize=1, ComHandleId=16, ComSignalLength=1, ComSignalType=BOOLEAN, SystemTemplateSystemSignalRef=DTCIUnused3_779
          Com_DTCIUnused2_779__DTC_Triggered_779__CAN00: ComBitPosition=6, ComBitSize=1, ComHandleId=17, ComSignalLength=1, ComSignalType=BOOLEAN, SystemTemplateSystemSignalRef=DTCIUnused2_779
          Com_DTCIUnused1_779__DTC_Triggered_779__CAN00: ComBitPosition=7, ComBitSize=1, ComHandleId=18, ComSignalLength=1, ComSignalType=BOOLEAN, SystemTemplateSystemSignalRef=DTCIUnused1_779
          Com_DTCI_DTCSource_779__DTC_Triggered_779__CAN00: ComBitPosition=15, ComBitSize=8, ComHandleId=19, ComSignalLength=1, ComSignalType=UINT8, SystemTemplateSystemSignalRef=DTCI_DTCSource_779
          Com_DTCI_DTCNumber_779__DTC_Triggered_779__CAN00: ComBitPosition=23, ComBitSize=16, ComHandleId=20, ComSignalLength=2, ComSignalType=UINT16, SystemTemplateSystemSignalRef=DTCI_DTCNumber_779
          Com_DTCI_DTCFailType_779__DTC_Triggered_779__CAN00: ComBitPosition=39, ComBitSize=8, ComHandleId=21, ComSignalLength=1, ComSignalType=UINT8, SystemTemplateSystemSignalRef=DTCI_DTCFailType_779
          Com_DTCI_CodeSupported_779__DTC_Triggered_779__CAN00: ComBitPosition=40, ComBitSize=1, ComHandleId=22, ComSignalLength=1, ComSignalType=BOOLEAN, SystemTemplateSystemSignalRef=DTCI_CodeSupported_779
          Com_DTCI_CurrentStatus_779__DTC_Triggered_779__CAN00: ComBitPosition=41, ComBitSize=1, ComHandleId=23, ComSignalLength=1, ComSignalType=BOOLEAN, SystemTemplateSystemSignalRef=DTCI_CurrentStatus_779
          Com_DTCI_TstNPsdCdClrdSt_779__DTC_Triggered_779__CAN00: ComBitPosition=42, ComBitSize=1, ComHandleId=24, ComSignalLength=1, ComSignalType=BOOLEAN, SystemTemplateSystemSignalRef=DTCI_TstNPsdCdClrdSt_779
          Com_DTCI_TstFldCdClrdStat_779__DTC_Triggered_779__CAN00: ComBitPosition=43, ComBitSize=1, ComHandleId=25, ComSignalLength=1, ComSignalType=BOOLEAN, SystemTemplateSystemSignalRef=DTCI_TstFldCdClrdStat_779
          Com_DTCI_HistStat_779__DTC_Triggered_779__CAN00: ComBitPosition=44, ComBitSize=1, ComHandleId=26, ComSignalLength=1, ComSignalType=BOOLEAN, SystemTemplateSystemSignalRef=DTCI_HistStat_779
          Com_DTCI_TstNPsdPwrUpSt_779__DTC_Triggered_779__CAN00: ComBitPosition=45, ComBitSize=1, ComHandleId=27, ComSignalLength=1, ComSignalType=BOOLEAN, SystemTemplateSystemSignalRef=DTCI_TstNPsdPwrUpSt_779
          Com_DTCI_TstFldPwrUpSt_779__DTC_Triggered_779__CAN00: ComBitPosition=46, ComBitSize=1, ComHandleId=28, ComSignalLength=1, ComSignalType=BOOLEAN, SystemTemplateSystemSignalRef=DTCI_TstFldPwrUpSt_779
          Com_DTCI_WrnIndRqdSt_779__DTC_Triggered_779__CAN00: ComBitPosition=47, ComBitSize=1, ComHandleId=29, ComSignalLength=1, ComSignalType=BOOLEAN, SystemTemplateSystemSignalRef=DTCI_WrnIndRqdSt_779
          Com_DTCI_DTCFaultType_779__DTC_Triggered_779__CAN00: ComBitPosition=55, ComBitSize=8, ComHandleId=30, ComSignalLength=1, ComSignalType=UINT8, SystemTemplateSystemSignalRef=DTCI_DTCFaultType_779
      7 x ComSignal, all with ComSignalEndianess=BIG_ENDIAN, ComSignalInitValue=0, ComTimeoutFactor=0, ComTransferProperty=PENDING:
        Com_WhlGrndVlctyLftNnDrvn__NonDriven_Wheel_Grnd_Velocity_HS__CAN00: ComBitPosition=5, ComBitSize=14, ComHandleId=31, ComSignalLength=2, ComSignalType=UINT16, SystemTemplateSystemSignalRef=WhlGrndVlctyLftNnDrvn
        Com_WhlGrndVlctyLftNnDrvnV__NonDriven_Wheel_Grnd_Velocity_HS__CAN00: ComBitPosition=6, ComBitSize=1, ComHandleId=32, ComSignalLength=1, ComSignalType=BOOLEAN, SystemTemplateSystemSignalRef=WhlGrndVlctyLftNnDrvnV
        Com_WhlGrndVlctyRtNnDrvn__NonDriven_Wheel_Grnd_Velocity_HS__CAN00: ComBitPosition=21, ComBitSize=14, ComHandleId=33, ComSignalLength=2, ComSignalType=UINT16, SystemTemplateSystemSignalRef=WhlGrndVlctyRtNnDrvn
        Com_WhlGrndVlctyRtNnDrvnV__NonDriven_Wheel_Grnd_Velocity_HS__CAN00: ComBitPosition=22, ComBitSize=1, ComHandleId=34, ComSignalLength=1, ComSignalType=BOOLEAN, SystemTemplateSystemSignalRef=WhlGrndVlctyRtNnDrvnV
        Com_ABSFld__PPEI_Chassis_General_Status_1__CAN00: ComBitPosition=29, ComBitSize=1, ComHandleId=35, ComSignalLength=1, ComSignalType=BOOLEAN, SystemTemplateSystemSignalRef=ABSFld
        Com_ABSAtv__PPEI_Chassis_General_Status_1__CAN00: ComBitPosition=30, ComBitSize=1, ComHandleId=36, ComSignalLength=1, ComSignalType=BOOLEAN, SystemTemplateSystemSignalRef=ABSAtv
        Com_VhDynCntlSysSt__PPEI_Chassis_General_Status_1__CAN00: ComBitPosition=39, ComBitSize=3, ComHandleId=37, ComSignalLength=1, ComSignalType=UINT8, SystemTemplateSystemSignalRef=VhDynCntlSysSt
      Com_Grp_SG_WhlRotatStatLftDrvn__PPEI_Driven_Whl_Rotational_Stat__CAN00 (ComSignalGroup): ComBitPosition=0, ComBitSize=32, ComHandleId=38, ComTimeoutFactor=0, ComTransferProperty=PENDING, SystemTemplateSignalGroupRef=SG_WhlRotatStatLftDrvn
        6 x ComGroupSignal, all with ComSignalEndianess=BIG_ENDIAN, ComSignalInitValue=0, ComTransferProperty=PENDING:
          Com_WRSLDWhlDistPlsCntr__PPEI_Driven_Whl_Rotational_Stat__CAN00: ComBitPosition=1, ComBitSize=10, ComHandleId=40, ComSignalLength=2, ComSignalType=UINT16, SystemTemplateSystemSignalRef=WRSLDWhlDistPlsCntr
          Com_WRSLDWhlDistVal__PPEI_Driven_Whl_Rotational_Stat__CAN00: ComBitPosition=2, ComBitSize=1, ComHandleId=41, ComSignalLength=1, ComSignalType=BOOLEAN, SystemTemplateSystemSignalRef=WRSLDWhlDistVal
          Com_WRSLDWhlRotStatRst__PPEI_Driven_Whl_Rotational_Stat__CAN00: ComBitPosition=3, ComBitSize=1, ComHandleId=42, ComSignalLength=1, ComSignalType=BOOLEAN, SystemTemplateSystemSignalRef=WRSLDWhlRotStatRst
          Com_WRSLDSeqNum__PPEI_Driven_Whl_Rotational_Stat__CAN00: ComBitPosition=5, ComBitSize=2, ComHandleId=43, ComSignalLength=1, ComSignalType=UINT8, SystemTemplateSystemSignalRef=WRSLDSeqNum
          Com_WRSLDWhlDisTpRC__PPEI_Driven_Whl_Rotational_Stat__CAN00: ComBitPosition=7, ComBitSize=2, ComHandleId=44, ComSignalLength=1, ComSignalType=UINT8, SystemTemplateSystemSignalRef=WRSLDWhlDisTpRC
          Com_WRSLDWhlDistTmstm__PPEI_Driven_Whl_Rotational_Stat__CAN00: ComBitPosition=23, ComBitSize=16, ComHandleId=45, ComSignalLength=2, ComSignalType=UINT16, SystemTemplateSystemSignalRef=WRSLDWhlDistTmstm
      Com_Grp_SG_WhlRotatStatRtDrvn__PPEI_Driven_Whl_Rotational_Stat__CAN00 (ComSignalGroup): ComBitPosition=32, ComBitSize=32, ComHandleId=39, ComTimeoutFactor=0, ComTransferProperty=PENDING, SystemTemplateSignalGroupRef=SG_WhlRotatStatRtDrvn
        6 x ComGroupSignal, all with ComSignalEndianess=BIG_ENDIAN, ComSignalInitValue=0, ComTransferProperty=PENDING:
          Com_WRSRDWhlDistPlsCntr__PPEI_Driven_Whl_Rotational_Stat__CAN00: ComBitPosition=33, ComBitSize=10, ComHandleId=46, ComSignalLength=2, ComSignalType=UINT16, SystemTemplateSystemSignalRef=WRSRDWhlDistPlsCntr
          Com_WRSRDWhlDistVal__PPEI_Driven_Whl_Rotational_Stat__CAN00: ComBitPosition=34, ComBitSize=1, ComHandleId=47, ComSignalLength=1, ComSignalType=BOOLEAN, SystemTemplateSystemSignalRef=WRSRDWhlDistVal
          Com_WRSRDWhlRotStatRst__PPEI_Driven_Whl_Rotational_Stat__CAN00: ComBitPosition=35, ComBitSize=1, ComHandleId=48, ComSignalLength=1, ComSignalType=BOOLEAN, SystemTemplateSystemSignalRef=WRSRDWhlRotStatRst
          Com_WRSRDSeqNum__PPEI_Driven_Whl_Rotational_Stat__CAN00: ComBitPosition=37, ComBitSize=2, ComHandleId=49, ComSignalLength=1, ComSignalType=UINT8, SystemTemplateSystemSignalRef=WRSRDSeqNum
          Com_WRSRDWhlDisTpRC__PPEI_Driven_Whl_Rotational_Stat__CAN00: ComBitPosition=39, ComBitSize=2, ComHandleId=50, ComSignalLength=1, ComSignalType=UINT8, SystemTemplateSystemSignalRef=WRSRDWhlDisTpRC
          Com_WRSRDWhlDistTmstm__PPEI_Driven_Whl_Rotational_Stat__CAN00: ComBitPosition=55, ComBitSize=16, ComHandleId=51, ComSignalLength=2, ComSignalType=UINT16, SystemTemplateSystemSignalRef=WRSRDWhlDistTmstm
      5 x ComSignal, all with ComSignalEndianess=BIG_ENDIAN, ComSignalInitValue=0, ComTimeoutFactor=0, ComTransferProperty=PENDING:
        Com_EngRunAtv__PPEI_Engine_General_Status_1__CAN00: ComBitPosition=7, ComBitSize=1, ComHandleId=52, ComSignalLength=1, ComSignalType=BOOLEAN, SystemTemplateSystemSignalRef=EngRunAtv
        Com_EngSpd__PPEI_Engine_General_Status_1__CAN00: ComBitPosition=15, ComBitSize=16, ComHandleId=53, ComSignalLength=2, ComSignalType=UINT16, SystemTemplateSystemSignalRef=EngSpd
        Com_AccActPosV__PPEI_Engine_General_Status_1__CAN00: ComBitPosition=31, ComBitSize=1, ComHandleId=54, ComSignalLength=1, ComSignalType=BOOLEAN, SystemTemplateSystemSignalRef=AccActPosV
        Com_AccActPos__PPEI_Engine_General_Status_1__CAN00: ComBitPosition=39, ComBitSize=8, ComHandleId=55, ComSignalLength=1, ComSignalType=UINT8, SystemTemplateSystemSignalRef=AccActPos
        Com_GenFld__PPEI_Engine_General_Status_3__CAN00: ComBitPosition=5, ComBitSize=1, ComHandleId=56, ComSignalLength=1, ComSignalType=BOOLEAN, SystemTemplateSystemSignalRef=GenFld
      Com_Grp_SG_WhlRotStatLftNDrvn__PPEI_NonDrivn_Whl_Rotationl_Stat__CAN00 (ComSignalGroup): ComBitPosition=0, ComBitSize=32, ComHandleId=57, ComTimeoutFactor=0, ComTransferProperty=PENDING, SystemTemplateSignalGroupRef=SG_WhlRotStatLftNDrvn
        6 x ComGroupSignal, all with ComSignalEndianess=BIG_ENDIAN, ComSignalInitValue=0, ComTransferProperty=PENDING:
          Com_WRSLNDWhlDistPCntr__PPEI_NonDrivn_Whl_Rotationl_Stat__CAN00: ComBitPosition=1, ComBitSize=10, ComHandleId=59, ComSignalLength=2, ComSignalType=UINT16, SystemTemplateSystemSignalRef=WRSLNDWhlDistPCntr
          Com_WRSLNDWhlDistVal__PPEI_NonDrivn_Whl_Rotationl_Stat__CAN00: ComBitPosition=2, ComBitSize=1, ComHandleId=60, ComSignalLength=1, ComSignalType=BOOLEAN, SystemTemplateSystemSignalRef=WRSLNDWhlDistVal
          Com_WRSLNDWhlRotStRst__PPEI_NonDrivn_Whl_Rotationl_Stat__CAN00: ComBitPosition=3, ComBitSize=1, ComHandleId=61, ComSignalLength=1, ComSignalType=BOOLEAN, SystemTemplateSystemSignalRef=WRSLNDWhlRotStRst
          Com_WRSLNDSeqNum__PPEI_NonDrivn_Whl_Rotationl_Stat__CAN00: ComBitPosition=5, ComBitSize=2, ComHandleId=62, ComSignalLength=1, ComSignalType=UINT8, SystemTemplateSystemSignalRef=WRSLNDSeqNum
          Com_WRSLNDWhlDisTpRC__PPEI_NonDrivn_Whl_Rotationl_Stat__CAN00: ComBitPosition=7, ComBitSize=2, ComHandleId=63, ComSignalLength=1, ComSignalType=UINT8, SystemTemplateSystemSignalRef=WRSLNDWhlDisTpRC
          Com_WRSLNDWhlDistTstm__PPEI_NonDrivn_Whl_Rotationl_Stat__CAN00: ComBitPosition=23, ComBitSize=16, ComHandleId=64, ComSignalLength=2, ComSignalType=UINT16, SystemTemplateSystemSignalRef=WRSLNDWhlDistTstm
      Com_Grp_SG_WhlRotStatRghtNDrvn__PPEI_NonDrivn_Whl_Rotationl_Stat__CAN00 (ComSignalGroup): ComBitPosition=32, ComBitSize=32, ComHandleId=58, ComTimeoutFactor=0, ComTransferProperty=PENDING, SystemTemplateSignalGroupRef=SG_WhlRotStatRghtNDrvn
        6 x ComGroupSignal, all with ComSignalEndianess=BIG_ENDIAN, ComSignalInitValue=0, ComTransferProperty=PENDING:
          Com_WRSRNDWhlDistPCntr__PPEI_NonDrivn_Whl_Rotationl_Stat__CAN00: ComBitPosition=33, ComBitSize=10, ComHandleId=65, ComSignalLength=2, ComSignalType=UINT16, SystemTemplateSystemSignalRef=WRSRNDWhlDistPCntr
          Com_WRSRNDWhlDistVal__PPEI_NonDrivn_Whl_Rotationl_Stat__CAN00: ComBitPosition=34, ComBitSize=1, ComHandleId=66, ComSignalLength=1, ComSignalType=BOOLEAN, SystemTemplateSystemSignalRef=WRSRNDWhlDistVal
          Com_WRSRNDWhlRotStRst__PPEI_NonDrivn_Whl_Rotationl_Stat__CAN00: ComBitPosition=35, ComBitSize=1, ComHandleId=67, ComSignalLength=1, ComSignalType=BOOLEAN, SystemTemplateSystemSignalRef=WRSRNDWhlRotStRst
          Com_WRSRNDSeqNum__PPEI_NonDrivn_Whl_Rotationl_Stat__CAN00: ComBitPosition=37, ComBitSize=2, ComHandleId=68, ComSignalLength=1, ComSignalType=UINT8, SystemTemplateSystemSignalRef=WRSRNDSeqNum
          Com_WRSRNDWhlDisTpRC__PPEI_NonDrivn_Whl_Rotationl_Stat__CAN00: ComBitPosition=39, ComBitSize=2, ComHandleId=69, ComSignalLength=1, ComSignalType=UINT8, SystemTemplateSystemSignalRef=WRSRNDWhlDisTpRC
          Com_WRSRNDWhlDistTstm__PPEI_NonDrivn_Whl_Rotationl_Stat__CAN00: ComBitPosition=55, ComBitSize=16, ComHandleId=70, ComSignalLength=2, ComSignalType=UINT16, SystemTemplateSystemSignalRef=WRSRNDWhlDistTstm
      15 x ComSignal, all with ComSignalEndianess=BIG_ENDIAN, ComTimeoutFactor=0, ComTransferProperty=PENDING:
        Com_SysPwrMd__PPEI_Platform_General_Status__CAN00: ComBitPosition=1, ComBitSize=2, ComHandleId=71, ComSignalInitValue=0, ComSignalLength=1, ComSignalType=UINT8, SystemTemplateSystemSignalRef=SysPwrMd
        Com_SysBkUpPwrMd__PPEI_Platform_General_Status__CAN00: ComBitPosition=5, ComBitSize=2, ComHandleId=72, ComSignalInitValue=0, ComSignalLength=1, ComSignalType=UINT8, SystemTemplateSystemSignalRef=SysBkUpPwrMd
        Com_SysBkupPwrMdEn__PPEI_Platform_General_Status__CAN00: ComBitPosition=6, ComBitSize=1, ComHandleId=73, ComSignalInitValue=0, ComSignalLength=1, ComSignalType=BOOLEAN, SystemTemplateSystemSignalRef=SysBkupPwrMdEn
        Com_TrStLgMdAtv__PPEI_Platform_General_Status__CAN00: ComBitPosition=34, ComBitSize=1, ComHandleId=74, ComSignalInitValue=0, ComSignalLength=1, ComSignalType=BOOLEAN, SystemTemplateSystemSignalRef=TrStLgMdAtv
        Com_SIRDpl__PPEI_Platform_General_Status__CAN00: ComBitPosition=58, ComBitSize=1, ComHandleId=75, ComSignalInitValue=0, ComSignalLength=1, ComSignalType=BOOLEAN, SystemTemplateSystemSignalRef=SIRDpl
        Com_TransEstGear__PPEI_Trans_General_Status_2__CAN00: ComBitPosition=3, ComBitSize=4, ComHandleId=76, ComSignalInitValue=15, ComSignalLength=1, ComSignalType=UINT8, SystemTemplateSystemSignalRef=TransEstGear
        Com_TransEstGearV__PPEI_Trans_General_Status_2__CAN00: ComBitPosition=4, ComBitSize=1, ComHandleId=77, ComSignalInitValue=0, ComSignalLength=1, ComSignalType=BOOLEAN, SystemTemplateSystemSignalRef=TransEstGearV
        Com_TrnsEngdState__PPEI_Trans_General_Status_2__CAN00: ComBitPosition=49, ComBitSize=2, ComHandleId=78, ComSignalInitValue=0, ComSignalLength=1, ComSignalType=UINT8, SystemTemplateSystemSignalRef=TrnsEngdState
        Com_TrnsEngdStateV__PPEI_Trans_General_Status_2__CAN00: ComBitPosition=50, ComBitSize=1, ComHandleId=79, ComSignalInitValue=0, ComSignalLength=1, ComSignalType=BOOLEAN, SystemTemplateSystemSignalRef=TrnsEngdStateV
        Com_VehIdNmDig10_17__PPEI_VIN_Digits_10_to_17__CAN00: ComBitPosition=7, ComBitSize=64, ComHandleId=80, ComSignalInitValue=0, ComSignalLength=8, ComSignalType=UINT8_N, SystemTemplateSystemSignalRef=VehIdNmDig10_17
        Com_VehOdo__Vehicle_Odometer_HS__CAN00: ComBitPosition=7, ComBitSize=32, ComHandleId=81, ComSignalInitValue=0, ComSignalLength=4, ComSignalType=UINT32, SystemTemplateSystemSignalRef=VehOdo
        Com_VehOdoV__Vehicle_Odometer_HS__CAN00: ComBitPosition=32, ComBitSize=1, ComHandleId=82, ComSignalInitValue=0, ComSignalLength=1, ComSignalType=BOOLEAN, SystemTemplateSystemSignalRef=VehOdoV
        Com_VehIdNmDig2_9__VIN_Digits_2_to_9_HS__CAN00: ComBitPosition=7, ComBitSize=64, ComHandleId=83, ComSignalInitValue=0, ComSignalLength=8, ComSignalType=UINT8_N, SystemTemplateSystemSignalRef=VehIdNmDig2_9
        Com_WhlPlsPerRevDrvn__Wheel_Pulses_HS__CAN00: ComBitPosition=6, ComBitSize=7, ComHandleId=84, ComSignalInitValue=0, ComSignalLength=1, ComSignalType=UINT8, SystemTemplateSystemSignalRef=WhlPlsPerRevDrvn
        Com_WhlPlsPerRevNonDrvn__Wheel_Pulses_HS__CAN00: ComBitPosition=14, ComBitSize=7, ComHandleId=85, ComSignalInitValue=0, ComSignalLength=1, ComSignalType=UINT8, SystemTemplateSystemSignalRef=WhlPlsPerRevNonDrvn
  module config PduR
    PduRGeneral:
      PduRCanIfSupport = true
      PduRCanTpSupport = true
      PduRComSupport = true
      PduRDcmSupport = true
      PduRFrIfSupport = false
      PduRFrTpSupport = false
      PduRIpduMSupport = false
      PduRLinIfSupport = false
      PduRLinTpSupport = false
      PduRMostIfSupport = false
      PduRMostTpSupport = false
      PduRMulticastFromTpSupport = false
      PduRMulticastToIfSupport = false
      PduRMulticastToTpSupport = false
      PduRZeroCostOperation = false
    PduRGlobalConfig
      PduRRoutingTable
        20 x PduRRoutingPath:
          Derived_PduRRoutingPath_505EED81
            AFS_Status_HS__CAN00 (PduRSrcPdu): HandleId=0, SrcPduRef=PduCollection/AFS_Status_HS__CAN00
            PT_AFS_Status_HS (PduRDestPdu): DestPduRef=PduCollection/AFS_Status_HS__CAN00
          Derived_PduRRoutingPath_F634C27E
            Antilock_Brake_and_TC_Status_HS__CAN00 (PduRSrcPdu): HandleId=1, SrcPduRef=PduCollection/Antilock_Brake_and_TC_Status_HS__CAN00
            PT_Antilock_Brake_and_TC_Status_HS (PduRDestPdu): DestPduRef=PduCollection/Antilock_Brake_and_TC_Status_HS__CAN00
          Derived_PduRRoutingPath_04E659BB
            Driven_Wheel_Grnd_Velocity_HS__CAN00 (PduRSrcPdu): HandleId=2, SrcPduRef=PduCollection/Driven_Wheel_Grnd_Velocity_HS__CAN00
            PT_Driven_Wheel_Grnd_Velocity_HS (PduRDestPdu): DestPduRef=PduCollection/Driven_Wheel_Grnd_Velocity_HS__CAN00
          Derived_PduRRoutingPath_616D85DC
            Driving_Mode_Control_HS__CAN00 (PduRSrcPdu): HandleId=3, SrcPduRef=PduCollection/Driving_Mode_Control_HS__CAN00
            PT_Driving_Mode_Control_HS (PduRDestPdu): DestPduRef=PduCollection/Driving_Mode_Control_HS__CAN00
          Derived_PduRRoutingPath_EC03EF23
            DTC_Triggered_779__CAN00 (PduRSrcPdu): HandleId=4, SrcPduRef=PduCollection/DTC_Triggered_779__CAN00
            PT_DTC_Triggered_779 (PduRDestPdu): DestPduRef=PduCollection/DTC_Triggered_779__CAN00
          Derived_PduRRoutingPath_AA836439
            NonDriven_Wheel_Grnd_Velocity_HS__CAN00 (PduRSrcPdu): HandleId=5, SrcPduRef=PduCollection/NonDriven_Wheel_Grnd_Velocity_HS__CAN00
            PT_NonDriven_Wheel_Grnd_Velocity_HS (PduRDestPdu): DestPduRef=PduCollection/NonDriven_Wheel_Grnd_Velocity_HS__CAN00
          Derived_PduRRoutingPath_93415677
            PPEI_Chassis_General_Status_1__CAN00 (PduRSrcPdu): HandleId=6, SrcPduRef=PduCollection/PPEI_Chassis_General_Status_1__CAN00
            PT_PPEI_Chassis_General_Status_1 (PduRDestPdu): DestPduRef=PduCollection/PPEI_Chassis_General_Status_1__CAN00
          Derived_PduRRoutingPath_7A1DB33C
            PPEI_Driven_Whl_Rotational_Stat__CAN00 (PduRSrcPdu): HandleId=7, SrcPduRef=PduCollection/PPEI_Driven_Whl_Rotational_Stat__CAN00
            PT_PPEI_Driven_Whl_Rotational_Stat (PduRDestPdu): DestPduRef=PduCollection/PPEI_Driven_Whl_Rotational_Stat__CAN00
          Derived_PduRRoutingPath_D54B8BDF
            PPEI_Engine_General_Status_1__CAN00 (PduRSrcPdu): HandleId=8, SrcPduRef=PduCollection/PPEI_Engine_General_Status_1__CAN00
            PT_PPEI_Engine_General_Status_1 (PduRDestPdu): DestPduRef=PduCollection/PPEI_Engine_General_Status_1__CAN00
          Derived_PduRRoutingPath_32C1DB29
            PPEI_Engine_General_Status_3__CAN00 (PduRSrcPdu): HandleId=9, SrcPduRef=PduCollection/PPEI_Engine_General_Status_3__CAN00
            PT_PPEI_Engine_General_Status_3 (PduRDestPdu): DestPduRef=PduCollection/PPEI_Engine_General_Status_3__CAN00
          Derived_PduRRoutingPath_B437AC11
            PPEI_NonDrivn_Whl_Rotationl_Stat__CAN00 (PduRSrcPdu): HandleId=10, SrcPduRef=PduCollection/PPEI_NonDrivn_Whl_Rotationl_Stat__CAN00
            PT_PPEI_NonDrivn_Whl_Rotationl_Stat (PduRDestPdu): DestPduRef=PduCollection/PPEI_NonDrivn_Whl_Rotationl_Stat__CAN00
          Derived_PduRRoutingPath_798E2FA2
            PPEI_Platform_General_Status__CAN00 (PduRSrcPdu): HandleId=11, SrcPduRef=PduCollection/PPEI_Platform_General_Status__CAN00
            PT_PPEI_Platform_General_Status (PduRDestPdu): DestPduRef=PduCollection/PPEI_Platform_General_Status__CAN00
          Derived_PduRRoutingPath_8F6929DC
            PPEI_Trans_General_Status_2__CAN00 (PduRSrcPdu): HandleId=12, SrcPduRef=PduCollection/PPEI_Trans_General_Status_2__CAN00
            PT_PPEI_Trans_General_Status_2 (PduRDestPdu): DestPduRef=PduCollection/PPEI_Trans_General_Status_2__CAN00
          Derived_PduRRoutingPath_C9F4AAE3
            PPEI_VIN_Digits_10_to_17__CAN00 (PduRSrcPdu): HandleId=13, SrcPduRef=PduCollection/PPEI_VIN_Digits_10_to_17__CAN00
            PT_PPEI_VIN_Digits_10_to_17 (PduRDestPdu): DestPduRef=PduCollection/PPEI_VIN_Digits_10_to_17__CAN00
          Derived_PduRRoutingPath_6B044500
            USDT_Req_to_AFS_HS__CAN00 (PduRSrcPdu): HandleId=14, SrcPduRef=PduCollection/USDT_Req_to_AFS_HS__CAN00
            PT_USDT_Req_to_AFS_HS (PduRDestPdu): DestPduRef=PduCollection/USDT_Req_to_AFS_HS__CAN00
          Derived_PduRRoutingPath_7C9D29EE
            USDT_Req_to_All_HS_ECUs__CAN00 (PduRSrcPdu): HandleId=15, SrcPduRef=PduCollection/USDT_Req_to_All_HS_ECUs__CAN00
            PT_USDT_Req_to_All_HS_ECUs (PduRDestPdu): DestPduRef=PduCollection/USDT_Req_to_All_HS_ECUs__CAN00
          Derived_PduRRoutingPath_0007C9F5
            USDT_Resp_From_AFS_HS__CAN00 (PduRSrcPdu): HandleId=16, SrcPduRef=PduCollection/USDT_Resp_From_AFS_HS__CAN00
            PT_USDT_Resp_From_AFS_HS (PduRDestPdu): DestPduRef=PduCollection/USDT_Resp_From_AFS_HS__CAN00
          Derived_PduRRoutingPath_907D9A8C
            Vehicle_Odometer_HS__CAN00 (PduRSrcPdu): HandleId=17, SrcPduRef=PduCollection/Vehicle_Odometer_HS__CAN00
            PT_Vehicle_Odometer_HS (PduRDestPdu): DestPduRef=PduCollection/Vehicle_Odometer_HS__CAN00
          Derived_PduRRoutingPath_F5453B95
            VIN_Digits_2_to_9_HS__CAN00 (PduRSrcPdu): HandleId=18, SrcPduRef=PduCollection/VIN_Digits_2_to_9_HS__CAN00
            PT_VIN_Digits_2_to_9_HS (PduRDestPdu): DestPduRef=PduCollection/VIN_Digits_2_to_9_HS__CAN00
          Derived_PduRRoutingPath_15A80007
            Wheel_Pulses_HS__CAN00 (PduRSrcPdu): HandleId=19, SrcPduRef=PduCollection/Wheel_Pulses_HS__CAN00
            PT_Wheel_Pulses_HS (PduRDestPdu): DestPduRef=PduCollection/Wheel_Pulses_HS__CAN00
  module config EcuC
    PduCollection
      30 x Pdu:
        AFS_Status_HS__CAN00: PduLength=16
        Antilock_Brake_and_TC_Status_HS__CAN00: PduLength=48
        Driven_Wheel_Grnd_Velocity_HS__CAN00: PduLength=32
        Driving_Mode_Control_HS__CAN00: PduLength=56
        DTC_Triggered_779__CAN00: PduLength=56
        NonDriven_Wheel_Grnd_Velocity_HS__CAN00: PduLength=32
        PPEI_Chassis_General_Status_1__CAN00: PduLength=64
        PPEI_Driven_Whl_Rotational_Stat__CAN00: PduLength=64
        PPEI_Engine_General_Status_1__CAN00: PduLength=64
        PPEI_Engine_General_Status_3__CAN00: PduLength=64
        PPEI_NonDrivn_Whl_Rotationl_Stat__CAN00: PduLength=64
        PPEI_Platform_General_Status__CAN00: PduLength=64
        PPEI_Trans_General_Status_2__CAN00: PduLength=64
        PPEI_VIN_Digits_10_to_17__CAN00: PduLength=64
        TsiCcpRx__CAN00: PduLength=64
        TsiCcpTx__CAN00: PduLength=64
        TsiDrvRxMsg__CAN00: PduLength=64
        TsiDrvTxMsg__CAN00: PduLength=64
        TsiTpRxMsg__CAN00: PduLength=64
        TsiTpTxMsg__CAN00: PduLength=64
        USDT_Req_to_AFS_HS_Tp__CAN00
        USDT_Req_to_All_HS_ECUs_Tp__CAN00
        USDT_Resp_From_AFS_HS_Tp__CAN00
        UUDT_Resp_From_AFS_HS__CAN00: PduLength=64
        Vehicle_Odometer_HS__CAN00: PduLength=40
        VIN_Digits_2_to_9_HS__CAN00: PduLength=64
        Wheel_Pulses_HS__CAN00: PduLength=32
        USDT_Req_to_AFS_HS__CAN00: PduLength=64
        USDT_Req_to_All_HS_ECUs__CAN00: PduLength=64
        USDT_Resp_From_AFS_HS__CAN00: PduLength=64
  module config ComM
    ComMGeneral
    ComMConfig
      CAN00 (ComMNetworks): ComMNetworkHandle=ComM/CAN00
    ComMUser_CAN00 (ComMUser): ComMUserIdentifier=0
    CAN00 (ComMChannel): ComMBusType=COMM_BUS_TYPE_CAN, ComMChannelId=0
      CAN00 (ComMUserPerChannel): ComMUserChannel=ComMUser_CAN00
  module config Dcm
    DcmDsl
      DcmDslProtocol
        DcmDslProtocolRow: DcmDslProtocolID=1, DcmDslProtocolTransType=Type1
          CAN00_AFS_HS (DcmDslConnection): DcmConnectionProtocolType=UDS
            CAN00 (DcmDslMainConnection)
              4 x DcmDslProtocolRx:
                DcmDslProtocolRx_0: DcmDslProtocolRxAddrType=FUNCTIONAL_TYPE, DcmDslProtocolRxPduRef=PduCollection/USDT_Req_to_All_HS_ECUs__CAN00
                DcmDslProtocolRx_1: DcmDslProtocolRxAddrType=FUNCTIONAL_TYPE, DcmDslProtocolRxPduRef=PduCollection/USDT_Req_to_All_HS_ECUs__CAN00
                DcmDslProtocolRx_2: DcmDslProtocolRxAddrType=PHYSICAL_TYPE, DcmDslProtocolRxPduRef=PduCollection/USDT_Req_to_AFS_HS__CAN00
                DcmDslProtocolRx_3: DcmDslProtocolRxAddrType=PHYSICAL_TYPE, DcmDslProtocolRxPduRef=PduCollection/USDT_Req_to_AFS_HS__CAN00
      DcmDslProtocolTiming
    DcmPageBufferCfg: DcmPagedBufferEnabled=false
    DcmGeneral
    DcmConfigSet: DcmActiveDslProtocolRowRef=DcmDslProtocolRow
  module config EcuM
    EcuMGeneral
    EcuMConfiguration:
      EcuMModuleConfigurationRef = CanConfigSet
      EcuMModuleConfigurationRef = ComConfig
      EcuMModuleConfigurationRef = PduRGlobalConfig
      EcuMModuleConfigurationRef = CanIfInitConfiguration
      EcuMModuleConfigurationRef = CanStateManagerConfiguration
      EcuMModuleConfigurationRef = ComMConfig
      EcuMUserConfig_FirstUser (EcuMUserConfig): EcuMUser=1
      EcuMDefaultShutdownTarget: EcuMDefaultState=EcuMStateSleep, EcuMDefaultSleepModeRef=EcuMSleepMode
      EcuMSleepMode:
        EcuMSleepModeId = 0
        EcuMSleepModeName = InitialEcuCSleepMode
        EcuMSleepModeSuspend = false
        EcuMWakeupSourceMask = ECUM_WKSOURCE_RESET
        EcuMWakeupSourceMask = ECUM_WKSOURCE_INTERNAL_RESET
        EcuMWakeupSourceMask = ECUM_WKSOURCE_EXTERNAL_WDG
        EcuMWakeupSourceMask = ECUM_WKSOURCE_INTERNAL_WDG
        EcuMWakeupSourceMask = ECUM_WKSOURCE_POWER
        EcuMWakeupSourceMask = CHNL
      6 x EcuMWakeupSource, all with EcuMWakeupSourcePolling=false:
        ECUM_WKSOURCE_RESET: EcuMResetReason=-1, EcuMWakeupSourceId=2
        ECUM_WKSOURCE_INTERNAL_RESET: EcuMResetReason=-1, EcuMWakeupSourceId=4
        ECUM_WKSOURCE_EXTERNAL_WDG: EcuMResetReason=-1, EcuMWakeupSourceId=16
        ECUM_WKSOURCE_INTERNAL_WDG: EcuMResetReason=-1, EcuMWakeupSourceId=8
        ECUM_WKSOURCE_POWER: EcuMResetReason=-1, EcuMWakeupSourceId=1
        CHNL: EcuMWakeupSourceId=32, EcuMComMChannelRef=ComM/CAN00
  module config Board: implementation-config-variant=VARIANT-PRE-COMPILE, module-description=Board_Impl
    BoardGeneral:
      BoardOsType = Autosar
      systemVersion = (unset)
      ecuExtractVersion = (unset)
      BoardOscillator = 20
      BoardPinsetting = Pin_337
      BoardDummyFunction = false
      BoardDummyStatement = true
      BoardConditionalGenerating = false
      BoardEnableSnvPrefixes = true
      BoardNhetUnitUsed = NHET1
      BoardAtomicBitAccessInBitfield = false
      BoardAtomicVariableAccess = Atomic16BitAccess
      BoardWidthOfPointer = 4
      BoardAlignmentFillPattern = 0
      BoardMinObjectSize = 1
      BoardGlobalGPageBehaviour = false
      BoardStructAlignment = Auto
      BoardArrayAlignment = Byte
      BoardStructInArrayAlignment = Byte
      BoardSizeOfPduIdType = Two_Byte
      BoardSizeOfPduLengthType = Two_Byte
      BoardSizeOfEnum = One_Byte
      BoardSizeOfIdType = Two_Byte
      BoardUseExtendedAsrVersionCheck = false
      BoardPCAndLTCRCCheck = false
    InterruptFunctionality: BoardIncludeIsrList=Os.h, BoardUseSchm=true, BoardGlobalReEnableCat1=(unset), BoardGlobalReEnableCat2=(unset)
      4 x InterruptFunctionSet:
        SuspendAllInterrupts: BoardGlobalSuspend=SuspendAllInterrupts(), BoardGlobalRestore=ResumeAllInterrupts(), BoardIncludeFile=Os.h
        SuspendOSInterrupts: BoardGlobalSuspend=SuspendOSInterrupts(), BoardGlobalRestore=ResumeOSInterrupts(), BoardIncludeFile=Os.h
        DisableAllInterrupts: BoardGlobalSuspend=DisableAllInterrupts(), BoardGlobalRestore=EnableAllInterrupts(), BoardIncludeFile=Os.h
        NoCriticalSectionHandling: BoardGlobalSuspend=(unset), BoardGlobalRestore=(unset), BoardIncludeFile=(unset)
  module config GenyBaseEnv: module-description=GenyBaseEnv_Impl
    GenyBaseEnvGeneral: GenyBaseEnvUserConfigFile=, ProjectType=2, NumberOfSubProjects=1
  module config Dem: implementation-config-variant=VARIANT-LINK-TIME, module-description=Dem_Impl
    VectorCommonData: BswmdVersion=2.16.02
    DemGeneral:
      DemBswErrorBufferSize = 100
      DemAddErrorBufferSize = 1
      DemDevErrorDetect = false
      DemDtcStatusAvailabilityMask = 255
      DemFFDataIDLength = 2
      DemMaxNumberEventEntryMir = 0
      DemMaxNumberEventEntryPrm = 26
      DemMaxNumberEventEntrySec = 0
      DemNvmAccessRetry = 0
      DemNvmAccessRetryTimeDelay = 0
      DemVersionInfoApi = true
      DemSnapshotsPerDTC = 2
      DemUseRte = false
      DemPostbuildStartAddress = 0
      DemUseDcmCompatiblePorts = false
      DemUserConfigFile = 
      DemPreInitHasConfigParam = false
      DemSoftwareComponentName = Dem
      DemSupportGetEventIdApi = false
      DemVariantModeSelection = SIMPLE_ECU
      DemMaxNumberPrestoredFF = 0
      DemTaskTime = 10
      DemTypeOfDTCSupported = 1
      DemTimeBasedDebouncingDataType = TIME_BASED_DEBOUNCING_16_BIT
      4 x DemOperationCycleTgt:
        DEM_IGNITION: DemOperationCycle=DEM_IGNITION
        DEM_OBD_DCY: DemOperationCycle=DEM_OBD_DCY
        DEM_POWER: DemOperationCycle=DEM_POWER
        DEM_WARMUP: DemOperationCycle=DEM_WARMUP
      NVM_BLOCK_DEM (DemNvramBlockId): DemNvramBlockIdUsageType=DEM_NVRAM_BLOCK_CORE, DemNvramBlockIdRef=NvM/NVM_BLOCK_DEM
      Warning_Indicator (DemIndicator): DemIndicatorID=0
      Steering_Reduced_Assist (DemIndicator): DemIndicatorID=1
      FFTYPE_NEW0 (DemFreezeFrameClass):
        DemFreezeFrameRecordNum = 0
        DemFreezeFrameKind = (unset)
        DemFreezeFrameIdClassRef = DID_4016
        DemFreezeFrameIdClassRef = DID_401B
        DemFreezeFrameIdClassRef = DID_4074
        DemFreezeFrameIdClassRef = DID_40AC
        DemFreezeFrameIdClassRef = DID_40AD
        DemFreezeFrameIdClassRef = DID_40BC
        DemFreezeFrameIdClassRef = DID_40BD
        DemFreezeFrameIdClassRef = DID_41D3
        DemFreezeFrameIdClassRef = DID_41D4
        DemFreezeFrameIdClassRef = PID_41D{5..7}
        DemFreezeFrameIdClassRef = PID_41D9
        DemFreezeFrameIdClassRef = PID_43D0
        DemFreezeFrameIdClassRef = PID_446F
        DemFreezeFrameIdClassRef = PID_8002
        DemFreezeFrameIdClassRef = PID_8078
        DemFreezeFrameIdClassRef = PID_C000
        DemFreezeFrameIdClassRef = PID_C050
      18 x DemFreezeFrameIdClass, all with DemCreatePortInterface=true:
        PID_41D5: DemFreezeFrameIdDataSize=1, DemDataID=16853
          DemGetDataValByDataIdTgt: DemGetDataValByDataIdTgtRef=CBValByDID_41D5
        PID_41D6: DemFreezeFrameIdDataSize=1, DemDataID=16854
          DemGetDataValByDataIdTgt: DemGetDataValByDataIdTgtRef=CBValByDID_41D6
        PID_41D7: DemFreezeFrameIdDataSize=2, DemDataID=16855
          DemGetDataValByDataIdTgt: DemGetDataValByDataIdTgtRef=CBValByDID_41D7
        PID_41D9: DemFreezeFrameIdDataSize=2, DemDataID=16857
          DemGetDataValByDataIdTgt: DemGetDataValByDataIdTgtRef=CBValByDID_41D9
        PID_43D0: DemFreezeFrameIdDataSize=1, DemDataID=17360
          DemGetDataValByDataIdTgt: DemGetDataValByDataIdTgtRef=CBValByDID_43D0
        PID_446F: DemFreezeFrameIdDataSize=2, DemDataID=17519
          DemGetDataValByDataIdTgt: DemGetDataValByDataIdTgtRef=CBValByDID_446F
        PID_8002: DemFreezeFrameIdDataSize=1, DemDataID=32770
          DemGetDataValByDataIdTgt: DemGetDataValByDataIdTgtRef=CBValByDID_8002
        PID_8078: DemFreezeFrameIdDataSize=1, DemDataID=32888
          DemGetDataValByDataIdTgt: DemGetDataValByDataIdTgtRef=CBValByDID_8078
        PID_C000: DemFreezeFrameIdDataSize=4, DemDataID=49152
          DemGetDataValByDataIdTgt: DemGetDataValByDataIdTgtRef=CBValByDID_C000
        DID_4016: DemFreezeFrameIdDataSize=2, DemDataID=16406
          DemGetDataValByDataIdTgt: DemGetDataValByDataIdTgtRef=CBValByDID_4016
        DID_401B: DemFreezeFrameIdDataSize=1, DemDataID=16411
          DemGetDataValByDataIdTgt: DemGetDataValByDataIdTgtRef=CBValByDID_401B
        DID_4074: DemFreezeFrameIdDataSize=2, DemDataID=16500
          DemGetDataValByDataIdTgt: DemGetDataValByDataIdTgtRef=CBValByDID_4074
        DID_40AC: DemFreezeFrameIdDataSize=2, DemDataID=16556
          DemGetDataValByDataIdTgt: DemGetDataValByDataIdTgtRef=CBValByDID_40AC
        DID_40AD: DemFreezeFrameIdDataSize=1, DemDataID=16557
          DemGetDataValByDataIdTgt: DemGetDataValByDataIdTgtRef=CBValByDID_40AD
        DID_40BC: DemFreezeFrameIdDataSize=2, DemDataID=16572
          DemGetDataValByDataIdTgt: DemGetDataValByDataIdTgtRef=CBValByDID_40BC
        DID_40BD: DemFreezeFrameIdDataSize=1, DemDataID=16573
          DemGetDataValByDataIdTgt: DemGetDataValByDataIdTgtRef=CBValByDID_40BD
        DID_41D3: DemFreezeFrameIdDataSize=2, DemDataID=16851
          DemGetDataValByDataIdTgt: DemGetDataValByDataIdTgtRef=CBValByDID_41D3
        DID_41D4: DemFreezeFrameIdDataSize=2, DemDataID=16852
          DemGetDataValByDataIdTgt: DemGetDataValByDataIdTgtRef=CBValByDID_41D4
      18 x DemGetDataValByDataId:
        CBValByDID_4016: DemGetDataValByDataIdListFnc=CBValByDID_4016
        CBValByDID_401B: DemGetDataValByDataIdListFnc=CBValByDID_401B
        CBValByDID_4074: DemGetDataValByDataIdListFnc=CBValByDID_4074
        CBValByDID_40AC: DemGetDataValByDataIdListFnc=CBValByDID_40AC
        CBValByDID_40AD: DemGetDataValByDataIdListFnc=CBValByDID_40AD
        CBValByDID_40BC: DemGetDataValByDataIdListFnc=CBValByDID_40BC
        CBValByDID_40BD: DemGetDataValByDataIdListFnc=CBValByDID_40BD
        CBValByDID_41D{3..7}: DemGetDataValByDataIdListFnc=CBValByDID_41D{3..7}
        CBValByDID_41D9: DemGetDataValByDataIdListFnc=CBValByDID_41D9
        CBValByDID_43D0: DemGetDataValByDataIdListFnc=CBValByDID_43D0
        CBValByDID_446F: DemGetDataValByDataIdListFnc=CBValByDID_446F
        CBValByDID_8002: DemGetDataValByDataIdListFnc=CBValByDID_8002
        CBValByDID_8078: DemGetDataValByDataIdListFnc=CBValByDID_8078
        CBValByDID_C000: DemGetDataValByDataIdListFnc=CBValByDID_C000
      PID_C050 (DemFreezeFrameIdClass): DemFreezeFrameIdDataSize=5, DemCreatePortInterface=true, DemDataID=49232
        DemGetDataValByDataIdTgt: DemGetDataValByDataIdTgtRef=CBValByDID_C050
      CBValByDID_C050 (DemGetDataValByDataId): DemGetDataValByDataIdListFnc=CBValByDID_C050
    DemConfigSet: DemActiveDsdServiceTableRef=
      6 x DemGroupOfDTC:
        DEM_DTC_GROUP_ALL_DTCS: DemGroupDTCs=(unset)
        DEM_DTC_GROUP_BODY_DTCS: DemGroupDTCs=8388608
        DEM_DTC_GROUP_CHASSIS_DTCS: DemGroupDTCs=4194304
        DEM_DTC_GROUP_EMISSION_REL_DTCS: DemGroupDTCs=(unset)
        DEM_DTC_GROUP_NETWORK_COM_DTCS: DemGroupDTCs=12582912
        DEM_DTC_GROUP_POWERTRAIN_DTCS: DemGroupDTCs=1
      15 x DemDTCClass, all with DemDTC=0, DemDTCKind=DEM_DTC_KIND_ALL_DTCS, DemDTCSeverity=DEM_DTC_SEV_NO_SEVERITY, DemDTCFunctionalUnit=0, DemDTCSupportWarningIndicator=false:
        DtcClass{0..14}
      3 x DemEventParameter, all with DemInitMonitorName=(unset), DemEventKind=DEM_EVENT_KIND_SWC, DemImportedEvent=false, DemExtendedDataRef=(unset), DemFreezeFrameClassRef=FFTYPE_NEW0:
        TEMPERATURE_TOO_HIGH: DemEventID=26, DemDTCClassRef=DtcClass29
          DemEventClass:
            DemEventPriority = 0
            DemFFPrestorageSupported = false
            DemHealingAllowed = true
            DemEventDestination = DEM_DTC_ORIGIN_PRIMARY_MEMORY
            DemHealingCycleCounter = 50
            DemHealingCycleRef = DEM_IGNITION
            DemOperationCycleRef = DEM_IGNITION
            DemPredebounceAlgorithmClass
              DemPreDebounceCounterBased: DemJumpUp=true, DemJumpDown=false, DemCountOutStepSize=1, DemCountInStepSize=1, DemPreDebounceName=DEM_PRE_DEBOUNCE_COUNTER_BASED
            DemIndicator0 (DemIndicatorAttribute): DemIndicatorBehaviour=1, DemLinkedIndicator=Steering_Reduced_Assist
        HIGH_VOLTAGE: DemEventID=18, DemDTCClassRef=DtcClass30
          DemEventClass:
            DemEventPriority = 0
            DemFFPrestorageSupported = false
            DemHealingAllowed = true
            DemEventDestination = DEM_DTC_ORIGIN_PRIMARY_MEMORY
            DemHealingCycleCounter = 50
            DemHealingCycleRef = DEM_IGNITION
            DemOperationCycleRef = DEM_IGNITION
            DemPredebounceAlgorithmClass
              DemPreDebounceCounterBased: DemJumpUp=true, DemJumpDown=false, DemCountOutStepSize=1, DemCountInStepSize=1, DemPreDebounceName=DEM_PRE_DEBOUNCE_COUNTER_BASED
            DemIndicator0 (DemIndicatorAttribute): DemIndicatorBehaviour=1, DemLinkedIndicator=Warning_Indicator
        LOW_VOLTAGE: DemEventID=17, DemDTCClassRef=DtcClass31
          DemEventClass:
            DemEventPriority = 0
            DemFFPrestorageSupported = false
            DemHealingAllowed = true
            DemEventDestination = DEM_DTC_ORIGIN_PRIMARY_MEMORY
            DemHealingCycleCounter = 50
            DemHealingCycleRef = DEM_IGNITION
            DemOperationCycleRef = DEM_IGNITION
            DemPredebounceAlgorithmClass
              DemPreDebounceCounterBased: DemJumpUp=true, DemJumpDown=false, DemCountOutStepSize=1, DemCountInStepSize=1, DemPreDebounceName=DEM_PRE_DEBOUNCE_COUNTER_BASED
            DemIndicator0 (DemIndicatorAttribute): DemIndicatorBehaviour=1, DemLinkedIndicator=Warning_Indicator
      DtcClass15 (DemDTCClass): DemDTC=0, DemDTCKind=DEM_DTC_KIND_ALL_DTCS, DemDTCSeverity=DEM_DTC_SEV_NO_SEVERITY, DemDTCFunctionalUnit=0, DemDTCSupportWarningIndicator=false
      DtcClass16 (DemDTCClass): DemDTC=0, DemDTCKind=DEM_DTC_KIND_ALL_DTCS, DemDTCSeverity=DEM_DTC_SEV_NO_SEVERITY, DemDTCFunctionalUnit=0, DemDTCSupportWarningIndicator=false
      EBCM_INVALID_DATA (DemEventParameter):
        DemEventID = 6
        DemInitMonitorName = (unset)
        DemEventKind = DEM_EVENT_KIND_SWC
        DemImportedEvent = false
        DemExtendedDataRef = (unset)
        DemDTCClassRef = DtcClass32
        DemFreezeFrameClassRef = FFTYPE_NEW0
        DemEventClass:
          DemEventPriority = 0
          DemFFPrestorageSupported = false
          DemHealingAllowed = true
          DemEventDestination = DEM_DTC_ORIGIN_PRIMARY_MEMORY
          DemHealingCycleCounter = 50
          DemHealingCycleRef = DEM_IGNITION
          DemOperationCycleRef = DEM_IGNITION
          DemPredebounceAlgorithmClass
            DemPreDebounceCounterBased: DemJumpUp=true, DemJumpDown=false, DemCountOutStepSize=1, DemCountInStepSize=1, DemPreDebounceName=DEM_PRE_DEBOUNCE_COUNTER_BASED
          DemIndicator0 (DemIndicatorAttribute): DemIndicatorBehaviour=1, DemLinkedIndicator=Steering_Reduced_Assist
      12 x DemDTCClass, all with DemDTC=0, DemDTCKind=DEM_DTC_KIND_ALL_DTCS, DemDTCSeverity=DEM_DTC_SEV_NO_SEVERITY, DemDTCFunctionalUnit=0, DemDTCSupportWarningIndicator=false:
        DtcClass{17..28}
      36 x DemEventParameter, all with DemInitMonitorName=(unset), DemImportedEvent=false, DemExtendedDataRef=(unset):
        VOLTAGE_BELOW_THRES: DemEventID=19, DemEventKind=DEM_EVENT_KIND_SWC, DemDTCClassRef=DtcClass33, DemFreezeFrameClassRef=FFTYPE_NEW0
          DemEventClass:
            DemEventPriority = 0
            DemFFPrestorageSupported = false
            DemHealingAllowed = true
            DemEventDestination = DEM_DTC_ORIGIN_PRIMARY_MEMORY
            DemHealingCycleCounter = 50
            DemHealingCycleRef = DEM_IGNITION
            DemOperationCycleRef = DEM_IGNITION
            DemPredebounceAlgorithmClass
              DemPreDebounceCounterBased: DemJumpUp=true, DemJumpDown=false, DemCountOutStepSize=1, DemCountInStepSize=1, DemPreDebounceName=DEM_PRE_DEBOUNCE_COUNTER_BASED
            DemIndicator0 (DemIndicatorAttribute): DemIndicatorBehaviour=1, DemLinkedIndicator=Steering_Reduced_Assist
        ECM_LOST_COMM_ENG_ON: DemEventID=14, DemEventKind=DEM_EVENT_KIND_SWC, DemDTCClassRef=DtcClass34, DemFreezeFrameClassRef=FFTYPE_NEW0
          DemEventClass:
            DemEventPriority = 0
            DemFFPrestorageSupported = false
            DemHealingAllowed = true
            DemEventDestination = DEM_DTC_ORIGIN_PRIMARY_MEMORY
            DemHealingCycleCounter = 50
            DemHealingCycleRef = DEM_IGNITION
            DemOperationCycleRef = DEM_IGNITION
            DemIndicator0 (DemIndicatorAttribute): DemIndicatorBehaviour=1, DemLinkedIndicator=Steering_Reduced_Assist
            DemPredebounceAlgorithmClass
              DemPreDebounceCounterBased: DemJumpUp=true, DemJumpDown=false, DemCountOutStepSize=1, DemCountInStepSize=1, DemPreDebounceName=DEM_PRE_DEBOUNCE_COUNTER_BASED
        EBCM_LOST_COM: DemEventID=12, DemEventKind=DEM_EVENT_KIND_SWC, DemDTCClassRef=DtcClass35, DemFreezeFrameClassRef=FFTYPE_NEW0
          DemEventClass:
            DemEventPriority = 0
            DemFFPrestorageSupported = false
            DemHealingAllowed = true
            DemEventDestination = DEM_DTC_ORIGIN_PRIMARY_MEMORY
            DemHealingCycleCounter = 50
            DemHealingCycleRef = DEM_IGNITION
            DemOperationCycleRef = DEM_IGNITION
            DemPredebounceAlgorithmClass
              DemPreDebounceCounterBased: DemJumpUp=true, DemJumpDown=false, DemCountOutStepSize=1, DemCountInStepSize=1, DemPreDebounceName=DEM_PRE_DEBOUNCE_COUNTER_BASED
            DemIndicator0 (DemIndicatorAttribute): DemIndicatorBehaviour=1, DemLinkedIndicator=Steering_Reduced_Assist
        BCM_LOST_COMM: DemEventID=11, DemEventKind=DEM_EVENT_KIND_SWC, DemDTCClassRef=DtcClass36, DemFreezeFrameClassRef=FFTYPE_NEW0
          DemEventClass:
            DemEventPriority = 0
            DemFFPrestorageSupported = false
            DemHealingAllowed = true
            DemEventDestination = DEM_DTC_ORIGIN_PRIMARY_MEMORY
            DemHealingCycleCounter = 50
            DemHealingCycleRef = DEM_IGNITION
            DemOperationCycleRef = DEM_IGNITION
            DemPredebounceAlgorithmClass
              DemPreDebounceCounterBased: DemJumpUp=true, DemJumpDown=false, DemCountOutStepSize=1, DemCountInStepSize=1, DemPreDebounceName=DEM_PRE_DEBOUNCE_COUNTER_BASED
        BUS_OFF_HS: DemEventID=16, DemEventKind=DEM_EVENT_KIND_SWC, DemDTCClassRef=DtcClass37, DemFreezeFrameClassRef=FFTYPE_NEW0
          DemEventClass:
            DemEventPriority = 0
            DemFFPrestorageSupported = false
            DemHealingAllowed = true
            DemEventDestination = DEM_DTC_ORIGIN_PRIMARY_MEMORY
            DemHealingCycleCounter = 50
            DemHealingCycleRef = DEM_IGNITION
            DemOperationCycleRef = DEM_IGNITION
            DemIndicator0 (DemIndicatorAttribute): DemIndicatorBehaviour=1, DemLinkedIndicator=Warning_Indicator
            DemPredebounceAlgorithmClass
              DemPreDebounceCounterBased: DemJumpUp=true, DemJumpDown=false, DemCountOutStepSize=1, DemCountInStepSize=1, DemPreDebounceName=DEM_PRE_DEBOUNCE_COUNTER_BASED
        BUS_OFF_CE: DemEventID=15, DemEventKind=DEM_EVENT_KIND_SWC, DemDTCClassRef=DtcClass38, DemFreezeFrameClassRef=FFTYPE_NEW0
          DemEventClass:
            DemEventPriority = 0
            DemFFPrestorageSupported = false
            DemHealingAllowed = true
            DemEventDestination = DEM_DTC_ORIGIN_PRIMARY_MEMORY
            DemHealingCycleCounter = 50
            DemHealingCycleRef = DEM_IGNITION
            DemOperationCycleRef = DEM_IGNITION
            DemIndicator0 (DemIndicatorAttribute): DemIndicatorBehaviour=1, DemLinkedIndicator=Warning_Indicator
            DemPredebounceAlgorithmClass
              DemPreDebounceCounterBased: DemJumpUp=true, DemJumpDown=false, DemCountOutStepSize=1, DemCountInStepSize=1, DemPreDebounceName=DEM_PRE_DEBOUNCE_COUNTER_BASED
        TCM_LOST_COMM: DemEventID=13, DemEventKind=DEM_EVENT_KIND_SWC, DemDTCClassRef=DtcClass39, DemFreezeFrameClassRef=FFTYPE_NEW0
          DemEventClass:
            DemEventPriority = 0
            DemFFPrestorageSupported = false
            DemHealingAllowed = true
            DemEventDestination = DEM_DTC_ORIGIN_PRIMARY_MEMORY
            DemHealingCycleCounter = 50
            DemHealingCycleRef = DEM_IGNITION
            DemOperationCycleRef = DEM_IGNITION
            DemPredebounceAlgorithmClass
              DemPreDebounceCounterBased: DemJumpUp=true, DemJumpDown=false, DemCountOutStepSize=1, DemCountInStepSize=1, DemPreDebounceName=DEM_PRE_DEBOUNCE_COUNTER_BASED
        CANTRCV_E_NO_TRCV_CONTROL: DemEventID=27, DemEventKind=DEM_EVENT_KIND_BSW, DemDTCClassRef=DtcClass0
          DemEventClass:
            DemEventPriority = 0
            DemFFPrestorageSupported = false
            DemHealingAllowed = false
            DemHealingCycleCounter = 1
            DemHealingCycleRef = (unset)
            DemOperationCycleRef = DEM_IGNITION
            DemPredebounceAlgorithmClass
              DemPreDebounceCounterBased: DemJumpUp=true, DemJumpDown=false, DemCountOutStepSize=1, DemCountInStepSize=1, DemPreDebounceName=DEM_PRE_DEBOUNCE_COUNTER_BASED
        PDUR_E_PDU_INSTANCE_LOST: DemEventID=28, DemEventKind=DEM_EVENT_KIND_BSW, DemDTCClassRef=DtcClass1
          DemEventClass:
            DemEventPriority = 0
            DemFFPrestorageSupported = false
            DemHealingAllowed = false
            DemHealingCycleCounter = 1
            DemHealingCycleRef = (unset)
            DemOperationCycleRef = DEM_IGNITION
            DemPredebounceAlgorithmClass
              DemPreDebounceCounterBased: DemJumpUp=true, DemJumpDown=false, DemCountOutStepSize=1, DemCountInStepSize=1, DemPreDebounceName=DEM_PRE_DEBOUNCE_COUNTER_BASED
        PDUR_E_INIT_FAILED: DemEventID=29, DemEventKind=DEM_EVENT_KIND_BSW, DemDTCClassRef=DtcClass2
          DemEventClass:
            DemEventPriority = 0
            DemFFPrestorageSupported = false
            DemHealingAllowed = false
            DemHealingCycleCounter = 1
            DemHealingCycleRef = (unset)
            DemOperationCycleRef = DEM_IGNITION
            DemPredebounceAlgorithmClass
              DemPreDebounceCounterBased: DemJumpUp=true, DemJumpDown=false, DemCountOutStepSize=1, DemCountInStepSize=1, DemPreDebounceName=DEM_PRE_DEBOUNCE_COUNTER_BASED
        COMM_E_NET_START_IND_CHANNEL_0: DemEventID=30, DemEventKind=DEM_EVENT_KIND_BSW, DemDTCClassRef=DtcClass3
          DemEventClass:
            DemEventPriority = 0
            DemFFPrestorageSupported = false
            DemHealingAllowed = false
            DemHealingCycleCounter = 1
            DemHealingCycleRef = (unset)
            DemOperationCycleRef = DEM_IGNITION
            DemPredebounceAlgorithmClass
              DemPreDebounceCounterBased: DemJumpUp=true, DemJumpDown=false, DemCountOutStepSize=1, DemCountInStepSize=1, DemPreDebounceName=DEM_PRE_DEBOUNCE_COUNTER_BASED
        CAN_E_TIMEOUT: DemEventID=31, DemEventKind=DEM_EVENT_KIND_BSW, DemDTCClassRef=DtcClass4
          DemEventClass:
            DemEventPriority = 0
            DemFFPrestorageSupported = false
            DemHealingAllowed = false
            DemHealingCycleCounter = 1
            DemHealingCycleRef = (unset)
            DemOperationCycleRef = DEM_IGNITION
            DemPredebounceAlgorithmClass
              DemPreDebounceCounterBased: DemJumpUp=true, DemJumpDown=false, DemCountOutStepSize=1, DemCountInStepSize=1, DemPreDebounceName=DEM_PRE_DEBOUNCE_COUNTER_BASED
        CANIF_E_INVALID_DLC: DemEventID=32, DemEventKind=DEM_EVENT_KIND_BSW, DemDTCClassRef=DtcClass5
          DemEventClass:
            DemEventPriority = 0
            DemFFPrestorageSupported = false
            DemHealingAllowed = false
            DemHealingCycleCounter = 1
            DemHealingCycleRef = (unset)
            DemOperationCycleRef = DEM_IGNITION
            DemPredebounceAlgorithmClass
              DemPreDebounceCounterBased: DemJumpUp=true, DemJumpDown=false, DemCountOutStepSize=1, DemCountInStepSize=1, DemPreDebounceName=DEM_PRE_DEBOUNCE_COUNTER_BASED
        CANSM_E_MODE_CHANGE_NETWORK_0: DemEventID=33, DemEventKind=DEM_EVENT_KIND_BSW, DemDTCClassRef=DtcClass6
          DemEventClass:
            DemEventPriority = 0
            DemFFPrestorageSupported = false
            DemHealingAllowed = false
            DemHealingCycleCounter = 1
            DemHealingCycleRef = (unset)
            DemOperationCycleRef = DEM_IGNITION
            DemPredebounceAlgorithmClass
              DemPreDebounceCounterBased: DemJumpUp=true, DemJumpDown=false, DemCountOutStepSize=1, DemCountInStepSize=1, DemPreDebounceName=DEM_PRE_DEBOUNCE_COUNTER_BASED
        CANSM_E_MODE_CHANGE_NETWORK_1: DemEventID=34, DemEventKind=DEM_EVENT_KIND_BSW, DemDTCClassRef=DtcClass7
          DemEventClass:
            DemEventPriority = 0
            DemFFPrestorageSupported = false
            DemHealingAllowed = false
            DemHealingCycleCounter = 1
            DemHealingCycleRef = (unset)
            DemOperationCycleRef = DEM_IGNITION
            DemPredebounceAlgorithmClass
              DemPreDebounceCounterBased: DemJumpUp=true, DemJumpDown=false, DemCountOutStepSize=1, DemCountInStepSize=1, DemPreDebounceName=DEM_PRE_DEBOUNCE_COUNTER_BASED
        CANSM_E_BUSOFF_NETWORK_0: DemEventID=35, DemEventKind=DEM_EVENT_KIND_BSW, DemDTCClassRef=DtcClass8
          DemEventClass:
            DemEventPriority = 0
            DemFFPrestorageSupported = false
            DemHealingAllowed = false
            DemHealingCycleCounter = 1
            DemHealingCycleRef = (unset)
            DemOperationCycleRef = DEM_IGNITION
            DemPredebounceAlgorithmClass
              DemPreDebounceCounterBased: DemJumpUp=true, DemJumpDown=false, DemCountOutStepSize=1, DemCountInStepSize=1, DemPreDebounceName=DEM_PRE_DEBOUNCE_COUNTER_BASED
        CANSM_E_BUSOFF_NETWORK_1: DemEventID=36, DemEventKind=DEM_EVENT_KIND_BSW, DemDTCClassRef=DtcClass9
          DemEventClass:
            DemEventPriority = 0
            DemFFPrestorageSupported = false
            DemHealingAllowed = false
            DemHealingCycleCounter = 1
            DemHealingCycleRef = (unset)
            DemOperationCycleRef = DEM_IGNITION
            DemPredebounceAlgorithmClass
              DemPreDebounceCounterBased: DemJumpUp=true, DemJumpDown=false, DemCountOutStepSize=1, DemCountInStepSize=1, DemPreDebounceName=DEM_PRE_DEBOUNCE_COUNTER_BASED
        CANSM_E_SETTRANSCEIVERMODE_NETWORK_0: DemEventID=37, DemEventKind=DEM_EVENT_KIND_BSW, DemDTCClassRef=DtcClass10
          DemEventClass:
            DemEventPriority = 0
            DemFFPrestorageSupported = false
            DemHealingAllowed = false
            DemHealingCycleCounter = 1
            DemHealingCycleRef = (unset)
            DemOperationCycleRef = DEM_IGNITION
            DemPredebounceAlgorithmClass
              DemPreDebounceCounterBased: DemJumpUp=true, DemJumpDown=false, DemCountOutStepSize=1, DemCountInStepSize=1, DemPreDebounceName=DEM_PRE_DEBOUNCE_COUNTER_BASED
        CANSM_E_SETTRANSCEIVERMODE_NETWORK_1: DemEventID=38, DemEventKind=DEM_EVENT_KIND_BSW, DemDTCClassRef=DtcClass11
          DemEventClass:
            DemEventPriority = 0
            DemFFPrestorageSupported = false
            DemHealingAllowed = false
            DemHealingCycleCounter = 1
            DemHealingCycleRef = (unset)
            DemOperationCycleRef = DEM_IGNITION
            DemPredebounceAlgorithmClass
              DemPreDebounceCounterBased: DemJumpUp=true, DemJumpDown=false, DemCountOutStepSize=1, DemCountInStepSize=1, DemPreDebounceName=DEM_PRE_DEBOUNCE_COUNTER_BASED
        LINSM_E_CONFIRMATION_TIMEOUT: DemEventID=39, DemEventKind=DEM_EVENT_KIND_BSW, DemDTCClassRef=DtcClass12
          DemEventClass:
            DemEventPriority = 0
            DemFFPrestorageSupported = false
            DemHealingAllowed = false
            DemHealingCycleCounter = 1
            DemHealingCycleRef = (unset)
            DemOperationCycleRef = DEM_IGNITION
            DemPredebounceAlgorithmClass
              DemPreDebounceCounterBased: DemJumpUp=true, DemJumpDown=false, DemCountOutStepSize=1, DemCountInStepSize=1, DemPreDebounceName=DEM_PRE_DEBOUNCE_COUNTER_BASED
        COMM_E_NET_START_IND_CHANNEL_1: DemEventID=40, DemEventKind=DEM_EVENT_KIND_BSW, DemDTCClassRef=DtcClass13
          DemEventClass:
            DemEventPriority = 0
            DemFFPrestorageSupported = false
            DemHealingAllowed = false
            DemHealingCycleCounter = 1
            DemHealingCycleRef = (unset)
            DemOperationCycleRef = DEM_IGNITION
            DemPredebounceAlgorithmClass
              DemPreDebounceCounterBased: DemJumpUp=true, DemJumpDown=false, DemCountOutStepSize=1, DemCountInStepSize=1, DemPreDebounceName=DEM_PRE_DEBOUNCE_COUNTER_BASED
        COMM_E_NET_START_IND_CHANNEL_2: DemEventID=41, DemEventKind=DEM_EVENT_KIND_BSW, DemDTCClassRef=DtcClass14
          DemEventClass:
            DemEventPriority = 0
            DemFFPrestorageSupported = false
            DemHealingAllowed = false
            DemHealingCycleCounter = 1
            DemHealingCycleRef = (unset)
            DemOperationCycleRef = DEM_IGNITION
            DemPredebounceAlgorithmClass
              DemPreDebounceCounterBased: DemJumpUp=true, DemJumpDown=false, DemCountOutStepSize=1, DemCountInStepSize=1, DemPreDebounceName=DEM_PRE_DEBOUNCE_COUNTER_BASED
        ECUM_E_ALL_RUN_REQUESTS_KILLED: DemEventID=42, DemEventKind=DEM_EVENT_KIND_BSW, DemDTCClassRef=DtcClass15
          DemEventClass:
            DemEventPriority = 0
            DemFFPrestorageSupported = false
            DemHealingAllowed = false
            DemHealingCycleCounter = 1
            DemHealingCycleRef = (unset)
            DemOperationCycleRef = DEM_IGNITION
            DemPredebounceAlgorithmClass
              DemPreDebounceCounterBased: DemJumpUp=true, DemJumpDown=false, DemCountOutStepSize=1, DemCountInStepSize=1, DemPreDebounceName=DEM_PRE_DEBOUNCE_COUNTER_BASED
        ECUM_E_RAM_CHECKED_FAILED: DemEventID=43, DemEventKind=DEM_EVENT_KIND_BSW, DemDTCClassRef=DtcClass16
          DemEventClass:
            DemEventPriority = 0
            DemFFPrestorageSupported = false
            DemHealingAllowed = false
            DemHealingCycleCounter = 1
            DemHealingCycleRef = (unset)
            DemOperationCycleRef = DEM_IGNITION
            DemPredebounceAlgorithmClass
              DemPreDebounceCounterBased: DemJumpUp=true, DemJumpDown=false, DemCountOutStepSize=1, DemCountInStepSize=1, DemPreDebounceName=DEM_PRE_DEBOUNCE_COUNTER_BASED
        NVM_E_REQ_FAILED: DemEventID=44, DemEventKind=DEM_EVENT_KIND_BSW, DemDTCClassRef=DtcClass17
          DemEventClass:
            DemEventPriority = 0
            DemFFPrestorageSupported = false
            DemHealingAllowed = false
            DemHealingCycleCounter = 1
            DemHealingCycleRef = (unset)
            DemOperationCycleRef = DEM_IGNITION
            DemPredebounceAlgorithmClass
              DemPreDebounceCounterBased: DemJumpUp=true, DemJumpDown=false, DemCountOutStepSize=1, DemCountInStepSize=1, DemPreDebounceName=DEM_PRE_DEBOUNCE_COUNTER_BASED
        NVM_E_INTEGRITY_FAILED: DemEventID=45, DemEventKind=DEM_EVENT_KIND_BSW, DemDTCClassRef=DtcClass18
          DemEventClass:
            DemEventPriority = 0
            DemFFPrestorageSupported = false
            DemHealingAllowed = false
            DemHealingCycleCounter = 1
            DemHealingCycleRef = (unset)
            DemOperationCycleRef = DEM_IGNITION
            DemPredebounceAlgorithmClass
              DemPreDebounceCounterBased: DemJumpUp=true, DemJumpDown=false, DemCountOutStepSize=1, DemCountInStepSize=1, DemPreDebounceName=DEM_PRE_DEBOUNCE_COUNTER_BASED
        FLS_E_ERASE_FAILED: DemEventID=46, DemEventKind=DEM_EVENT_KIND_BSW, DemDTCClassRef=DtcClass19
          DemEventClass:
            DemEventPriority = 0
            DemFFPrestorageSupported = false
            DemHealingAllowed = false
            DemHealingCycleCounter = 1
            DemHealingCycleRef = (unset)
            DemOperationCycleRef = DEM_IGNITION
            DemPredebounceAlgorithmClass
              DemPreDebounceCounterBased: DemJumpUp=true, DemJumpDown=false, DemCountOutStepSize=1, DemCountInStepSize=1, DemPreDebounceName=DEM_PRE_DEBOUNCE_COUNTER_BASED
        FLS_E_WRITE_FAILED: DemEventID=47, DemEventKind=DEM_EVENT_KIND_BSW, DemDTCClassRef=DtcClass20
          DemEventClass:
            DemEventPriority = 0
            DemFFPrestorageSupported = false
            DemHealingAllowed = false
            DemHealingCycleCounter = 1
            DemHealingCycleRef = (unset)
            DemOperationCycleRef = DEM_IGNITION
            DemPredebounceAlgorithmClass
              DemPreDebounceCounterBased: DemJumpUp=true, DemJumpDown=false, DemCountOutStepSize=1, DemCountInStepSize=1, DemPreDebounceName=DEM_PRE_DEBOUNCE_COUNTER_BASED
        FLS_E_READ_FAILED: DemEventID=48, DemEventKind=DEM_EVENT_KIND_BSW, DemDTCClassRef=DtcClass21
          DemEventClass:
            DemEventPriority = 0
            DemFFPrestorageSupported = false
            DemHealingAllowed = false
            DemHealingCycleCounter = 1
            DemHealingCycleRef = (unset)
            DemOperationCycleRef = DEM_IGNITION
            DemPredebounceAlgorithmClass
              DemPreDebounceCounterBased: DemJumpUp=true, DemJumpDown=false, DemCountOutStepSize=1, DemCountInStepSize=1, DemPreDebounceName=DEM_PRE_DEBOUNCE_COUNTER_BASED
        FLS_E_COMPARE_FAILED: DemEventID=49, DemEventKind=DEM_EVENT_KIND_BSW, DemDTCClassRef=DtcClass22
          DemEventClass:
            DemEventPriority = 0
            DemFFPrestorageSupported = false
            DemHealingAllowed = false
            DemHealingCycleCounter = 1
            DemHealingCycleRef = (unset)
            DemOperationCycleRef = DEM_IGNITION
            DemPredebounceAlgorithmClass
              DemPreDebounceCounterBased: DemJumpUp=true, DemJumpDown=false, DemCountOutStepSize=1, DemCountInStepSize=1, DemPreDebounceName=DEM_PRE_DEBOUNCE_COUNTER_BASED
        FRIF_E_JLE_SYNC: DemEventID=50, DemEventKind=DEM_EVENT_KIND_BSW, DemDTCClassRef=DtcClass23
          DemEventClass:
            DemEventPriority = 0
            DemFFPrestorageSupported = false
            DemHealingAllowed = false
            DemHealingCycleCounter = 1
            DemHealingCycleRef = (unset)
            DemOperationCycleRef = DEM_IGNITION
            DemPredebounceAlgorithmClass
              DemPreDebounceCounterBased: DemJumpUp=true, DemJumpDown=false, DemCountOutStepSize=1, DemCountInStepSize=1, DemPreDebounceName=DEM_PRE_DEBOUNCE_COUNTER_BASED
        FRNM_E_INIT_FAILED: DemEventID=51, DemEventKind=DEM_EVENT_KIND_BSW, DemDTCClassRef=DtcClass24
          DemEventClass:
            DemEventPriority = 0
            DemFFPrestorageSupported = false
            DemHealingAllowed = false
            DemHealingCycleCounter = 1
            DemHealingCycleRef = (unset)
            DemOperationCycleRef = DEM_IGNITION
            DemPredebounceAlgorithmClass
              DemPreDebounceCounterBased: DemJumpUp=true, DemJumpDown=false, DemCountOutStepSize=1, DemCountInStepSize=1, DemPreDebounceName=DEM_PRE_DEBOUNCE_COUNTER_BASED
        FRSM_E_CLUSTER_STARTUP: DemEventID=52, DemEventKind=DEM_EVENT_KIND_BSW, DemDTCClassRef=DtcClass25
          DemEventClass:
            DemEventPriority = 0
            DemFFPrestorageSupported = false
            DemHealingAllowed = false
            DemHealingCycleCounter = 1
            DemHealingCycleRef = (unset)
            DemOperationCycleRef = DEM_IGNITION
            DemPredebounceAlgorithmClass
              DemPreDebounceCounterBased: DemJumpUp=true, DemJumpDown=false, DemCountOutStepSize=1, DemCountInStepSize=1, DemPreDebounceName=DEM_PRE_DEBOUNCE_COUNTER_BASED
        FRTRCV_E_FR_NO_TRCV_CONTROL: DemEventID=53, DemEventKind=DEM_EVENT_KIND_BSW, DemDTCClassRef=DtcClass26
          DemEventClass:
            DemEventPriority = 0
            DemFFPrestorageSupported = false
            DemHealingAllowed = false
            DemHealingCycleCounter = 1
            DemHealingCycleRef = (unset)
            DemOperationCycleRef = DEM_IGNITION
            DemPredebounceAlgorithmClass
              DemPreDebounceCounterBased: DemJumpUp=true, DemJumpDown=false, DemCountOutStepSize=1, DemCountInStepSize=1, DemPreDebounceName=DEM_PRE_DEBOUNCE_COUNTER_BASED
        WDGM_E_SET_MODE: DemEventID=54, DemEventKind=DEM_EVENT_KIND_BSW, DemDTCClassRef=DtcClass27
          DemEventClass:
            DemEventPriority = 0
            DemFFPrestorageSupported = false
            DemHealingAllowed = false
            DemHealingCycleCounter = 1
            DemHealingCycleRef = (unset)
            DemOperationCycleRef = DEM_IGNITION
            DemPredebounceAlgorithmClass
              DemPreDebounceCounterBased: DemJumpUp=true, DemJumpDown=false, DemCountOutStepSize=1, DemCountInStepSize=1, DemPreDebounceName=DEM_PRE_DEBOUNCE_COUNTER_BASED
        WDGM_E_ALIVE_SUPERVISION: DemEventID=55, DemEventKind=DEM_EVENT_KIND_BSW, DemDTCClassRef=DtcClass28
          DemEventClass:
            DemEventPriority = 0
            DemFFPrestorageSupported = false
            DemHealingAllowed = false
            DemHealingCycleCounter = 1
            DemHealingCycleRef = (unset)
            DemOperationCycleRef = DEM_IGNITION
            DemPredebounceAlgorithmClass
              DemPreDebounceCounterBased: DemJumpUp=true, DemJumpDown=false, DemCountOutStepSize=1, DemCountInStepSize=1, DemPreDebounceName=DEM_PRE_DEBOUNCE_COUNTER_BASED
      23 x DemDTCClass, all with DemDTCKind=DEM_DTC_KIND_ALL_DTCS, DemDTCSeverity=DEM_DTC_SEV_NO_SEVERITY, DemDTCFunctionalUnit=0:
        DtcClass29: DemDTC=4290132, DemDTCSupportWarningIndicator=true
        DtcClass30: DemDTC=4718609, DemDTCSupportWarningIndicator=true
        DtcClass31: DemDTC=4718610, DemDTCSupportWarningIndicator=true
        DtcClass32: DemDTC=12850545, DemDTCSupportWarningIndicator=true
        DtcClass33: DemDTC=4718595, DemDTCSupportWarningIndicator=true
        DtcClass34: DemDTC=12648448, DemDTCSupportWarningIndicator=true
        DtcClass35: DemDTC=12656896, DemDTCSupportWarningIndicator=true
        DtcClass36: DemDTC=12664832, DemDTCSupportWarningIndicator=false
        DtcClass37: DemDTC=12612352, DemDTCSupportWarningIndicator=true
        DtcClass38: DemDTC=12613376, DemDTCSupportWarningIndicator=true
        DtcClass39: DemDTC=12648704, DemDTCSupportWarningIndicator=false
        DtcClass40: DemDTC=4539648, DemDTCSupportWarningIndicator=true
        DtcClass41: DemDTC=4549888, DemDTCSupportWarningIndicator=true
        DtcClass42: DemDTC=12845425, DemDTCSupportWarningIndicator=true
        DtcClass43: DemDTC=4481099, DemDTCSupportWarningIndicator=true
        DtcClass44: DemDTC=4481112, DemDTCSupportWarningIndicator=true
        DtcClass45: DemDTC=4550210, DemDTCSupportWarningIndicator=true
        DtcClass46: DemDTC=12671232, DemDTCSupportWarningIndicator=false
        DtcClass47: DemDTC=12741120, DemDTCSupportWarningIndicator=false
        DtcClass48: DemDTC=12868209, DemDTCSupportWarningIndicator=false
        DtcClass49: DemDTC=12938097, DemDTCSupportWarningIndicator=false
        DtcClass50: DemDTC=15008369, DemDTCSupportWarningIndicator=false
        DtcClass51: DemDTC=4481114, DemDTCSupportWarningIndicator=true
      13 x DemEventParameter, all with DemInitMonitorName=(unset), DemEventKind=DEM_EVENT_KIND_SWC, DemImportedEvent=false, DemExtendedDataRef=(unset), DemFreezeFrameClassRef=FFTYPE_NEW0:
        STEER_WHEEL_TRQ_INP_SENSOR: DemEventID=22, DemDTCClassRef=DtcClass40
          DemEventClass:
            DemEventPriority = 0
            DemFFPrestorageSupported = false
            DemHealingAllowed = true
            DemEventDestination = DEM_DTC_ORIGIN_PRIMARY_MEMORY
            DemHealingCycleCounter = 50
            DemHealingCycleRef = DEM_IGNITION
            DemOperationCycleRef = DEM_IGNITION
            DemIndicator0 (DemIndicatorAttribute): DemIndicatorBehaviour=1, DemLinkedIndicator=Warning_Indicator
            DemPredebounceAlgorithmClass
              DemPreDebounceCounterBased: DemJumpUp=true, DemJumpDown=false, DemCountOutStepSize=1, DemCountInStepSize=1, DemPreDebounceName=DEM_PRE_DEBOUNCE_COUNTER_BASED
        ECU_HW_PERFORMANCE: DemEventID=21, DemDTCClassRef=DtcClass41
          DemEventClass:
            DemEventPriority = 0
            DemFFPrestorageSupported = false
            DemHealingAllowed = true
            DemEventDestination = DEM_DTC_ORIGIN_PRIMARY_MEMORY
            DemHealingCycleCounter = 50
            DemHealingCycleRef = DEM_IGNITION
            DemOperationCycleRef = DEM_IGNITION
            DemIndicator0 (DemIndicatorAttribute): DemIndicatorBehaviour=1, DemLinkedIndicator=Warning_Indicator
            DemPredebounceAlgorithmClass
              DemPreDebounceCounterBased: DemJumpUp=true, DemJumpDown=false, DemCountOutStepSize=1, DemCountInStepSize=1, DemPreDebounceName=DEM_PRE_DEBOUNCE_COUNTER_BASED
        ECM_INVALID_DATA_HS: DemEventID=8, DemDTCClassRef=DtcClass42
          DemEventClass:
            DemEventPriority = 0
            DemFFPrestorageSupported = false
            DemHealingAllowed = true
            DemEventDestination = DEM_DTC_ORIGIN_PRIMARY_MEMORY
            DemHealingCycleCounter = 50
            DemHealingCycleRef = DEM_IGNITION
            DemOperationCycleRef = DEM_IGNITION
            DemIndicator0 (DemIndicatorAttribute): DemIndicatorBehaviour=1, DemLinkedIndicator=Steering_Reduced_Assist
            DemPredebounceAlgorithmClass
              DemPreDebounceCounterBased: DemJumpUp=true, DemJumpDown=false, DemCountOutStepSize=1, DemCountInStepSize=1, DemPreDebounceName=DEM_PRE_DEBOUNCE_COUNTER_BASED
        SWA_CAL_NOT_LEARNED: DemEventID=25, DemDTCClassRef=DtcClass43
          DemEventClass:
            DemEventPriority = 0
            DemFFPrestorageSupported = false
            DemHealingAllowed = true
            DemEventDestination = DEM_DTC_ORIGIN_PRIMARY_MEMORY
            DemHealingCycleCounter = 50
            DemHealingCycleRef = DEM_IGNITION
            DemOperationCycleRef = DEM_IGNITION
            DemIndicator0 (DemIndicatorAttribute): DemIndicatorBehaviour=1, DemLinkedIndicator=Steering_Reduced_Assist
            DemPredebounceAlgorithmClass
              DemPreDebounceCounterBased: DemJumpUp=true, DemJumpDown=false, DemCountOutStepSize=1, DemCountInStepSize=1, DemPreDebounceName=DEM_PRE_DEBOUNCE_COUNTER_BASED
        SWA_HW_FAULT: DemEventID=24, DemDTCClassRef=DtcClass44
          DemEventClass:
            DemEventPriority = 0
            DemFFPrestorageSupported = false
            DemHealingAllowed = true
            DemEventDestination = DEM_DTC_ORIGIN_PRIMARY_MEMORY
            DemHealingCycleCounter = 50
            DemHealingCycleRef = DEM_IGNITION
            DemOperationCycleRef = DEM_IGNITION
            DemIndicator0 (DemIndicatorAttribute): DemIndicatorBehaviour=1, DemLinkedIndicator=Steering_Reduced_Assist
            DemPredebounceAlgorithmClass
              DemPreDebounceCounterBased: DemJumpUp=true, DemJumpDown=false, DemCountOutStepSize=1, DemCountInStepSize=1, DemPreDebounceName=DEM_PRE_DEBOUNCE_COUNTER_BASED
        SW_PERF_CAL_NOT_PROG: DemEventID=20, DemDTCClassRef=DtcClass45
          DemEventClass:
            DemEventPriority = 0
            DemFFPrestorageSupported = false
            DemHealingAllowed = true
            DemEventDestination = DEM_DTC_ORIGIN_PRIMARY_MEMORY
            DemHealingCycleCounter = 50
            DemHealingCycleRef = DEM_IGNITION
            DemOperationCycleRef = DEM_IGNITION
            DemIndicator0 (DemIndicatorAttribute): DemIndicatorBehaviour=1, DemLinkedIndicator=Warning_Indicator
            DemPredebounceAlgorithmClass
              DemPreDebounceCounterBased: DemJumpUp=true, DemJumpDown=false, DemCountOutStepSize=1, DemCountInStepSize=1, DemPreDebounceName=DEM_PRE_DEBOUNCE_COUNTER_BASED
        PACM_LOST_COM: DemEventID=10, DemDTCClassRef=DtcClass46
          DemEventClass:
            DemEventPriority = 0
            DemFFPrestorageSupported = false
            DemHealingAllowed = true
            DemEventDestination = DEM_DTC_ORIGIN_PRIMARY_MEMORY
            DemHealingCycleCounter = 50
            DemHealingCycleRef = DEM_IGNITION
            DemOperationCycleRef = DEM_IGNITION
            DemPredebounceAlgorithmClass
              DemPreDebounceCounterBased: DemJumpUp=true, DemJumpDown=false, DemCountOutStepSize=1, DemCountInStepSize=1, DemPreDebounceName=DEM_PRE_DEBOUNCE_COUNTER_BASED
        FCM_LOST_COM: DemEventID=9, DemDTCClassRef=DtcClass47
          DemEventClass:
            DemEventPriority = 0
            DemFFPrestorageSupported = false
            DemHealingAllowed = true
            DemEventDestination = DEM_DTC_ORIGIN_PRIMARY_MEMORY
            DemHealingCycleCounter = 50
            DemHealingCycleRef = DEM_IGNITION
            DemOperationCycleRef = DEM_IGNITION
            DemPredebounceAlgorithmClass
              DemPreDebounceCounterBased: DemJumpUp=true, DemJumpDown=false, DemCountOutStepSize=1, DemCountInStepSize=1, DemPreDebounceName=DEM_PRE_DEBOUNCE_COUNTER_BASED
        PACM_INVALID_DATA: DemEventID=4, DemDTCClassRef=DtcClass48
          DemEventClass:
            DemEventPriority = 0
            DemFFPrestorageSupported = false
            DemHealingAllowed = true
            DemEventDestination = DEM_DTC_ORIGIN_PRIMARY_MEMORY
            DemHealingCycleCounter = 50
            DemHealingCycleRef = DEM_IGNITION
            DemOperationCycleRef = DEM_IGNITION
            DemPredebounceAlgorithmClass
              DemPreDebounceCounterBased: DemJumpUp=true, DemJumpDown=false, DemCountOutStepSize=1, DemCountInStepSize=1, DemPreDebounceName=DEM_PRE_DEBOUNCE_COUNTER_BASED
        FCM_INVALID_DATA: DemEventID=3, DemDTCClassRef=DtcClass49
          DemEventClass:
            DemEventPriority = 0
            DemFFPrestorageSupported = false
            DemHealingAllowed = true
            DemEventDestination = DEM_DTC_ORIGIN_PRIMARY_MEMORY
            DemHealingCycleCounter = 50
            DemHealingCycleRef = DEM_IGNITION
            DemOperationCycleRef = DEM_IGNITION
            DemPredebounceAlgorithmClass
              DemPreDebounceCounterBased: DemJumpUp=true, DemJumpDown=false, DemCountOutStepSize=1, DemCountInStepSize=1, DemPreDebounceName=DEM_PRE_DEBOUNCE_COUNTER_BASED
        EBCM_INVALID_DATA_CE: DemEventID=1, DemDTCClassRef=DtcClass50
          DemEventClass:
            DemEventPriority = 0
            DemFFPrestorageSupported = false
            DemHealingAllowed = true
            DemEventDestination = DEM_DTC_ORIGIN_PRIMARY_MEMORY
            DemHealingCycleCounter = 50
            DemHealingCycleRef = DEM_IGNITION
            DemOperationCycleRef = DEM_IGNITION
            DemPredebounceAlgorithmClass
              DemPreDebounceCounterBased: DemJumpUp=true, DemJumpDown=false, DemCountOutStepSize=1, DemCountInStepSize=1, DemPreDebounceName=DEM_PRE_DEBOUNCE_COUNTER_BASED
        SWA_PLAUSIBILITY: DemEventID=23, DemDTCClassRef=DtcClass51
          DemEventClass:
            DemEventPriority = 0
            DemFFPrestorageSupported = false
            DemHealingAllowed = true
            DemEventDestination = DEM_DTC_ORIGIN_PRIMARY_MEMORY
            DemHealingCycleCounter = 50
            DemHealingCycleRef = DEM_IGNITION
            DemOperationCycleRef = DEM_IGNITION
            DemIndicator0 (DemIndicatorAttribute): DemIndicatorBehaviour=1, DemLinkedIndicator=Steering_Reduced_Assist
            DemPredebounceAlgorithmClass
              DemPreDebounceCounterBased: DemJumpUp=true, DemJumpDown=false, DemCountOutStepSize=1, DemCountInStepSize=1, DemPreDebounceName=DEM_PRE_DEBOUNCE_COUNTER_BASED
        TCM_INVALID_DATA: DemEventID=7, DemDTCClassRef=DtcClass52
          DemEventClass:
            DemEventPriority = 0
            DemFFPrestorageSupported = false
            DemHealingAllowed = true
            DemEventDestination = DEM_DTC_ORIGIN_PRIMARY_MEMORY
            DemHealingCycleCounter = 50
            DemHealingCycleRef = DEM_IGNITION
            DemOperationCycleRef = DEM_IGNITION
            DemPredebounceAlgorithmClass
              DemPreDebounceCounterBased: DemJumpUp=true, DemJumpDown=false, DemCountOutStepSize=1, DemCountInStepSize=1, DemPreDebounceName=DEM_PRE_DEBOUNCE_COUNTER_BASED
      DtcClass52 (DemDTCClass):
        DemDTC = 12845681
        DemDTCKind = DEM_DTC_KIND_ALL_DTCS
        DemDTCSeverity = DEM_DTC_SEV_NO_SEVERITY
        DemDTCFunctionalUnit = 0
        DemDTCSupportWarningIndicator = false
      BCM_INVALID_DATA (DemEventParameter):
        DemEventID = 5
        DemInitMonitorName = (unset)
        DemEventKind = DEM_EVENT_KIND_SWC
        DemImportedEvent = false
        DemExtendedDataRef = (unset)
        DemDTCClassRef = DtcClass53
        DemFreezeFrameClassRef = FFTYPE_NEW0
        DemEventClass:
          DemEventPriority = 0
          DemFFPrestorageSupported = false
          DemHealingAllowed = true
          DemEventDestination = DEM_DTC_ORIGIN_PRIMARY_MEMORY
          DemHealingCycleCounter = 50
          DemHealingCycleRef = DEM_IGNITION
          DemOperationCycleRef = DEM_IGNITION
          DemPredebounceAlgorithmClass
            DemPreDebounceCounterBased: DemJumpUp=true, DemJumpDown=false, DemCountOutStepSize=1, DemCountInStepSize=1, DemPreDebounceName=DEM_PRE_DEBOUNCE_COUNTER_BASED
      DtcClass53 (DemDTCClass):
        DemDTC = 12853873
        DemDTCKind = DEM_DTC_KIND_ALL_DTCS
        DemDTCSeverity = DEM_DTC_SEV_NO_SEVERITY
        DemDTCFunctionalUnit = 0
        DemDTCSupportWarningIndicator = false
      EBCM_LOST_COM_CE (DemEventParameter):
        DemEventID = 2
        DemInitMonitorName = (unset)
        DemEventKind = DEM_EVENT_KIND_SWC
        DemImportedEvent = false
        DemExtendedDataRef = (unset)
        DemDTCClassRef = DtcClass54
        DemFreezeFrameClassRef = FFTYPE_NEW0
        DemEventClass:
          DemEventPriority = 0
          DemFFPrestorageSupported = false
          DemHealingAllowed = true
          DemEventDestination = DEM_DTC_ORIGIN_PRIMARY_MEMORY
          DemHealingCycleCounter = 50
          DemHealingCycleRef = DEM_IGNITION
          DemOperationCycleRef = DEM_IGNITION
          DemPredebounceAlgorithmClass
            DemPreDebounceCounterBased: DemJumpUp=true, DemJumpDown=false, DemCountOutStepSize=1, DemCountInStepSize=1, DemPreDebounceName=DEM_PRE_DEBOUNCE_COUNTER_BASED
      DtcClass54 (DemDTCClass):
        DemDTC = 14168832
        DemDTCKind = DEM_DTC_KIND_ALL_DTCS
        DemDTCSeverity = DEM_DTC_SEV_NO_SEVERITY
        DemDTCFunctionalUnit = 0
        DemDTCSupportWarningIndicator = false
