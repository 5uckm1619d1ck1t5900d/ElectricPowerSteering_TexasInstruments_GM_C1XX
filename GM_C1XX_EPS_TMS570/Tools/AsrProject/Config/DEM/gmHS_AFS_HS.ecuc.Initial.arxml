AUTOSAR XML (schema 3.0.2)
package /InitialEcuC
  ecu configuration InitialEcuC: ecu-extract=System, module=[Can, CanIf, CanTrcv, CanSM, CanTp, Com, PduR, EcuC, ComM]
  module config Can
    CanGeneral: CanIndex=0
    CanConfigSet
      CAN00 (CanController): CanControllerActivation=true
  module config CanIf
    CanIfPublicConfiguration
    CanIfPrivateConfiguration
    CanIfInitConfiguration: CanIfConfigSet=initConfiguration
      CanIfInitHohConfig: CanIfRefConfigSet=CanConfigSet
      CT_CAN00 (CanIfInitControllerConfig)
      AFS_Status_HS__CAN00 (CanIfTxPduConfig):
        CanIfCanTxPduIdCanId = 383
        CanIfCanTxPduIdDlc = 2
        CanIfCanTxPduType = STATIC
        CanIfTxPduIdCanIdType = STANDARD_CAN
        PduIdRef = PduCollection/AFS_Status_HS__CAN00
      3 x CanIfRxPduConfig, all with CanIfRxPduIdCanIdType=STANDARD_CAN:
        Antilock_Brake_and_TC_Status_HS__CAN00: CanIfCanRxPduCanId=381, CanIfCanRxPduDlc=6, PduIdRef=PduCollection/Antilock_Brake_and_TC_Status_HS__CAN00
        Driven_Wheel_Grnd_Velocity_HS__CAN00: CanIfCanRxPduCanId=840, CanIfCanRxPduDlc=4, PduIdRef=PduCollection/Driven_Wheel_Grnd_Velocity_HS__CAN00
        Driving_Mode_Control_HS__CAN00: CanIfCanRxPduCanId=562, CanIfCanRxPduDlc=7, PduIdRef=PduCollection/Driving_Mode_Control_HS__CAN00
      DTC_Triggered_779__CAN00 (CanIfTxPduConfig):
        CanIfCanTxPduIdCanId = 1913
        CanIfCanTxPduIdDlc = 7
        CanIfCanTxPduType = STATIC
        CanIfTxPduIdCanIdType = STANDARD_CAN
        PduIdRef = PduCollection/DTC_Triggered_779__CAN00
      10 x CanIfRxPduConfig, all with CanIfRxPduIdCanIdType=STANDARD_CAN:
        NonDriven_Wheel_Grnd_Velocity_HS__CAN00: CanIfCanRxPduCanId=842, CanIfCanRxPduDlc=4, PduIdRef=PduCollection/NonDriven_Wheel_Grnd_Velocity_HS__CAN00
        PPEI_Chassis_General_Status_1__CAN00: CanIfCanRxPduCanId=489, CanIfCanRxPduDlc=8, PduIdRef=PduCollection/PPEI_Chassis_General_Status_1__CAN00
        PPEI_Driven_Whl_Rotational_Stat__CAN00: CanIfCanRxPduCanId=193, CanIfCanRxPduDlc=8, PduIdRef=PduCollection/PPEI_Driven_Whl_Rotational_Stat__CAN00
        PPEI_Engine_General_Status_1__CAN00: CanIfCanRxPduCanId=201, CanIfCanRxPduDlc=8, PduIdRef=PduCollection/PPEI_Engine_General_Status_1__CAN00
        PPEI_Engine_General_Status_3__CAN00: CanIfCanRxPduCanId=1017, CanIfCanRxPduDlc=8, PduIdRef=PduCollection/PPEI_Engine_General_Status_3__CAN00
        PPEI_NonDrivn_Whl_Rotationl_Stat__CAN00: CanIfCanRxPduCanId=197, CanIfCanRxPduDlc=8, PduIdRef=PduCollection/PPEI_NonDrivn_Whl_Rotationl_Stat__CAN00
        PPEI_Platform_General_Status__CAN00: CanIfCanRxPduCanId=497, CanIfCanRxPduDlc=8, PduIdRef=PduCollection/PPEI_Platform_General_Status__CAN00
        PPEI_Trans_General_Status_2__CAN00: CanIfCanRxPduCanId=501, CanIfCanRxPduDlc=8, PduIdRef=PduCollection/PPEI_Trans_General_Status_2__CAN00
        PPEI_VIN_Digits_10_to_17__CAN00: CanIfCanRxPduCanId=1249, CanIfCanRxPduDlc=8, PduIdRef=PduCollection/PPEI_VIN_Digits_10_to_17__CAN00
        TsiCcpRx__CAN00: CanIfCanRxPduCanId=1937, CanIfCanRxPduDlc=8, PduIdRef=PduCollection/TsiCcpRx__CAN00
      TsiCcpTx__CAN00 (CanIfTxPduConfig):
        CanIfCanTxPduIdCanId = 1936
        CanIfCanTxPduIdDlc = 8
        CanIfCanTxPduType = STATIC
        CanIfTxPduIdCanIdType = STANDARD_CAN
        PduIdRef = PduCollection/TsiCcpTx__CAN00
      TsiDrvRxMsg__CAN00 (CanIfRxPduConfig): CanIfCanRxPduCanId=1939, CanIfCanRxPduDlc=8, CanIfRxPduIdCanIdType=STANDARD_CAN, PduIdRef=PduCollection/TsiDrvRxMsg__CAN00
      TsiDrvTxMsg__CAN00 (CanIfTxPduConfig):
        CanIfCanTxPduIdCanId = 1938
        CanIfCanTxPduIdDlc = 8
        CanIfCanTxPduType = STATIC
        CanIfTxPduIdCanIdType = STANDARD_CAN
        PduIdRef = PduCollection/TsiDrvTxMsg__CAN00
      TsiTpRxMsg__CAN00 (CanIfRxPduConfig): CanIfCanRxPduCanId=1941, CanIfCanRxPduDlc=8, CanIfRxPduIdCanIdType=STANDARD_CAN, PduIdRef=PduCollection/TsiTpRxMsg__CAN00
      TsiTpTxMsg__CAN00 (CanIfTxPduConfig):
        CanIfCanTxPduIdCanId = 1940
        CanIfCanTxPduIdDlc = 8
        CanIfCanTxPduType = STATIC
        CanIfTxPduIdCanIdType = STANDARD_CAN
        PduIdRef = PduCollection/TsiTpTxMsg__CAN00
      USDT_Req_to_AFS_HS_Tp__CAN00 (CanIfRxPduConfig): CanIfCanRxPduCanId=597, CanIfCanRxPduDlc=8, CanIfRxPduIdCanIdType=STANDARD_CAN, PduIdRef=PduCollection/USDT_Req_to_AFS_HS_Tp__CAN00
      USDT_Req_to_All_HS_ECUs_Tp__CAN00 (CanIfRxPduConfig): CanIfCanRxPduCanId=257, CanIfCanRxPduDlc=8, CanIfRxPduIdCanIdType=STANDARD_CAN, PduIdRef=PduCollection/USDT_Req_to_All_HS_ECUs_Tp__CAN00
      USDT_Resp_From_AFS_HS_Tp__CAN00 (CanIfTxPduConfig):
        CanIfCanTxPduIdCanId = 1621
        CanIfCanTxPduIdDlc = 8
        CanIfCanTxPduType = STATIC
        CanIfTxPduIdCanIdType = STANDARD_CAN
        PduIdRef = PduCollection/USDT_Resp_From_AFS_HS_Tp__CAN00
      UUDT_Resp_From_AFS_HS__CAN00 (CanIfTxPduConfig):
        CanIfCanTxPduIdCanId = 1365
        CanIfCanTxPduIdDlc = 8
        CanIfCanTxPduType = STATIC
        CanIfTxPduIdCanIdType = STANDARD_CAN
        PduIdRef = PduCollection/UUDT_Resp_From_AFS_HS__CAN00
      3 x CanIfRxPduConfig, all with CanIfRxPduIdCanIdType=STANDARD_CAN:
        Vehicle_Odometer_HS__CAN00: CanIfCanRxPduCanId=288, CanIfCanRxPduDlc=5, PduIdRef=PduCollection/Vehicle_Odometer_HS__CAN00
        VIN_Digits_2_to_9_HS__CAN00: CanIfCanRxPduCanId=1300, CanIfCanRxPduDlc=8, PduIdRef=PduCollection/VIN_Digits_2_to_9_HS__CAN00
        Wheel_Pulses_HS__CAN00: CanIfCanRxPduCanId=1280, CanIfCanRxPduDlc=4, PduIdRef=PduCollection/Wheel_Pulses_HS__CAN00
    CanIfDriverConfig: CanIfDriverNameRef=CanGeneral, CanIfInitHohConfigRef=CanIfInitHohConfig
    CT_CAN00 (CanIfControllerConfig): CanIfDriverNameRef=CanIfDriverConfig
  module config CanTrcv
    CanTrcvGeneral
    CanTrcvConfigSet
      CAN00 (CanTrcvChannel)
  module config CanSM
    CanStateManagerConfiguration
      CAN00 (CanStateManagerNetworks): CanSMNetworkHandle=ComM/CAN00
        CT_CAN00 (CanStateManagerControllers): CanSMControllerId=CanConfigSet/CAN00
  module config CanTp
    CanTpGeneral: CanTpSupportMixed11Addressing=false
    USDT_Req_to_All_HS_ECUs__CAN00_0 (CanTpRxNSdu):
      CanTpAddressingFormat = CANTP_STANDARD
      CanTpRxPaddingActivation = CANTP_ON
      CanTpRxTaType = CANTP_FUNCTIONAL
      CanTpRxNSduRef = USDT_Req_to_All_HS_ECUs__CAN00
      USDT_Req_to_All_HS_ECUs_Tp__CAN00_1 (CanTpRxNPdu): CanTpRxNPduRef=PduCollection/USDT_Req_to_All_HS_ECUs_Tp__CAN00
    USDT_Req_to_All_HS_ECUs__CAN00_1 (CanTpRxNSdu):
      CanTpAddressingFormat = CANTP_STANDARD
      CanTpRxPaddingActivation = CANTP_ON
      CanTpRxTaType = CANTP_FUNCTIONAL
      CanTpRxNSduRef = USDT_Req_to_All_HS_ECUs__CAN00
      USDT_Req_to_All_HS_ECUs_Tp__CAN00 (CanTpRxNPdu): CanTpRxNPduRef=PduCollection/USDT_Req_to_All_HS_ECUs_Tp__CAN00
    USDT_Resp_From_AFS_HS__CAN00 (CanTpTxNSdu):
      CanTpAddressingMode = CANTP_STANDARD
      CanTpTxPaddingActivation = CANTP_ON
      CanTpTxTaType = CANTP_PHYSICAL
      CanTpTxNSduRef = PduCollection/USDT_Resp_From_AFS_HS__CAN00
      USDT_Resp_From_AFS_HS_Tp__CAN00_0 (CanTpTxNPdu): CanTpTxNPduRef=PduCollection/USDT_Resp_From_AFS_HS_Tp__CAN00
      USDT_Req_to_AFS_HS_Tp__CAN00 (CanTpRxFcNPdu): CanTpRxFcNPduRef=PduCollection/USDT_Req_to_AFS_HS_Tp__CAN00
    USDT_Req_to_AFS_HS__CAN00_AFS_HS_0 (CanTpRxNSdu): CanTpAddressingFormat=CANTP_STANDARD, CanTpRxPaddingActivation=CANTP_ON, CanTpRxTaType=CANTP_PHYSICAL, CanTpRxNSduRef=USDT_Req_to_AFS_HS__CAN00
      USDT_Req_to_AFS_HS_Tp__CAN00_2 (CanTpRxNPdu): CanTpRxNPduRef=PduCollection/USDT_Req_to_AFS_HS_Tp__CAN00
      USDT_Req_to_AFS_HS_Tp__CAN00_1 (CanTpTxFcNPdu): CanTpTxFcNPduRef=PduCollection/USDT_Resp_From_AFS_HS_Tp__CAN00
    USDT_Req_to_AFS_HS__CAN00_AFS_HS_1 (CanTpRxNSdu): CanTpAddressingFormat=CANTP_STANDARD, CanTpRxPaddingActivation=CANTP_ON, CanTpRxTaType=CANTP_PHYSICAL, CanTpRxNSduRef=USDT_Req_to_AFS_HS__CAN00
      USDT_Req_to_AFS_HS_Tp__CAN00_3 (CanTpRxNPdu): CanTpRxNPduRef=PduCollection/USDT_Req_to_AFS_HS_Tp__CAN00
      USDT_Req_to_AFS_HS_Tp__CAN00_1 (CanTpTxFcNPdu): CanTpTxFcNPduRef=PduCollection/USDT_Resp_From_AFS_HS_Tp__CAN00
  module config Com
    ComGeneral: ComConfigurationTimeBase=0.001
    ComConfig
      PduGrp_AFS_HS__CAN00_Rx (ComIPduGroup)
      PduGrp_AFS_HS__CAN00_Tx (ComIPduGroup)
      17 x ComIPdu:
        Pdu_AFS_Status_HS__CAN00: ComIpduDirection=SEND, ComIPduSize=2, ComIPduGroupRef=PduGrp_AFS_HS__CAN00_Tx, ComIPduSignalRef=Com_AFSIndOn__AFS_Status_HS__CAN00, ComIPduSignalRef=Com_AFSSysFail__AFS_Status_HS__CAN00, ComIPduSignalRef=Com_FrStSysVeTpSpLimIndOn__AFS_Status_HS__CAN00, ComIPduSignalRef=Com_StSysVehTopSpdLimReq__AFS_Status_HS__CAN00, PduIdRef=PduCollection/AFS_Status_HS__CAN00
          ComTxIPdu: ComTxIPduMinimumDelayTimeFactor=0
            ComTxModeFalse
              ComTxModeFalseFalse (ComTxMode): ComTxModeMode=PERIODIC, ComTxModeTimeOffsetFactor=0, ComTxModeTimePeriodFactor=100
            ComTxModeTrue
              ComTxModeTrueTrue (ComTxMode): ComTxModeMode=PERIODIC, ComTxModeTimeOffsetFactor=0, ComTxModeTimePeriodFactor=100
        Pdu_Antilock_Brake_and_TC_Status_HS__CAN00: ComIpduDirection=RECEIVE, ComIPduSize=6, ComIPduGroupRef=PduGrp_AFS_HS__CAN00_Rx, ComIPduSignalRef=Com_VehStabEnhmntStat__Antilock_Brake_and_TC_Status_HS__CAN00, PduIdRef=PduCollection/Antilock_Brake_and_TC_Status_HS__CAN00
        Pdu_Driven_Wheel_Grnd_Velocity_HS__CAN00: ComIpduDirection=RECEIVE, ComIPduSize=4, ComIPduGroupRef=PduGrp_AFS_HS__CAN00_Rx, ComIPduSignalRef=Com_WhlGrndVlctyLftDrvn__Driven_Wheel_Grnd_Velocity_HS__CAN00, ComIPduSignalRef=Com_WhlGrndVlctyLftDrvnV__Driven_Wheel_Grnd_Velocity_HS__CAN00, ComIPduSignalRef=Com_WhlGrndVlctyRtDrvn__Driven_Wheel_Grnd_Velocity_HS__CAN00, ComIPduSignalRef=Com_WhlGrndVlctyRtDrvnV__Driven_Wheel_Grnd_Velocity_HS__CAN00, PduIdRef=PduCollection/Driven_Wheel_Grnd_Velocity_HS__CAN00
        Pdu_Driving_Mode_Control_HS__CAN00: ComIpduDirection=RECEIVE, ComIPduSize=7, ComIPduGroupRef=PduGrp_AFS_HS__CAN00_Rx, ComIPduSignalRef=Com_DrvMdCntrlState__Driving_Mode_Control_HS__CAN00, PduIdRef=PduCollection/Driving_Mode_Control_HS__CAN00
        Pdu_DTC_Triggered_779__CAN00: ComIpduDirection=SEND, ComIPduSize=7, ComIPduGroupRef=PduGrp_AFS_HS__CAN00_Tx, ComIPduSignalGroupRef=Com_Grp_SG_DTCInfo_779__DTC_Triggered_779__CAN00, PduIdRef=PduCollection/DTC_Triggered_779__CAN00
          ComTxIPdu: ComTxIPduMinimumDelayTimeFactor=0
            ComTxModeFalse
              ComTxModeFalseFalse (ComTxMode): ComTxModeMode=PERIODIC, ComTxModeTimeOffsetFactor=0, ComTxModeTimePeriodFactor=1000
            ComTxModeTrue
              ComTxModeTrueTrue (ComTxMode): ComTxModeMode=PERIODIC, ComTxModeTimeOffsetFactor=0, ComTxModeTimePeriodFactor=1000
        Pdu_NonDriven_Wheel_Grnd_Velocity_HS__CAN00: ComIpduDirection=RECEIVE, ComIPduSize=4, ComIPduGroupRef=PduGrp_AFS_HS__CAN00_Rx, ComIPduSignalRef=Com_WhlGrndVlctyLftNnDrvn__NonDriven_Wheel_Grnd_Velocity_HS__CAN00, ComIPduSignalRef=Com_WhlGrndVlctyLftNnDrvnV__NonDriven_Wheel_Grnd_Velocity_HS__CAN00, ComIPduSignalRef=Com_WhlGrndVlctyRtNnDrvn__NonDriven_Wheel_Grnd_Velocity_HS__CAN00, ComIPduSignalRef=Com_WhlGrndVlctyRtNnDrvnV__NonDriven_Wheel_Grnd_Velocity_HS__CAN00, PduIdRef=PduCollection/NonDriven_Wheel_Grnd_Velocity_HS__CAN00
        Pdu_PPEI_Chassis_General_Status_1__CAN00: ComIpduDirection=RECEIVE, ComIPduSize=8, ComIPduGroupRef=PduGrp_AFS_HS__CAN00_Rx, ComIPduSignalRef=Com_ABSFld__PPEI_Chassis_General_Status_1__CAN00, ComIPduSignalRef=Com_ABSAtv__PPEI_Chassis_General_Status_1__CAN00, ComIPduSignalRef=Com_VhDynCntlSysSt__PPEI_Chassis_General_Status_1__CAN00, PduIdRef=PduCollection/PPEI_Chassis_General_Status_1__CAN00
        Pdu_PPEI_Driven_Whl_Rotational_Stat__CAN00: ComIpduDirection=RECEIVE, ComIPduSize=8, ComIPduGroupRef=PduGrp_AFS_HS__CAN00_Rx, ComIPduSignalGroupRef=Com_Grp_SG_WhlRotatStatLftDrvn__PPEI_Driven_Whl_Rotational_Stat__CAN00, ComIPduSignalGroupRef=Com_Grp_SG_WhlRotatStatRtDrvn__PPEI_Driven_Whl_Rotational_Stat__CAN00, PduIdRef=PduCollection/PPEI_Driven_Whl_Rotational_Stat__CAN00
        Pdu_PPEI_Engine_General_Status_1__CAN00: ComIpduDirection=RECEIVE, ComIPduSize=8, ComIPduGroupRef=PduGrp_AFS_HS__CAN00_Rx, ComIPduSignalRef=Com_EngRunAtv__PPEI_Engine_General_Status_1__CAN00, ComIPduSignalRef=Com_EngSpd__PPEI_Engine_General_Status_1__CAN00, ComIPduSignalRef=Com_AccActPosV__PPEI_Engine_General_Status_1__CAN00, ComIPduSignalRef=Com_AccActPos__PPEI_Engine_General_Status_1__CAN00, PduIdRef=PduCollection/PPEI_Engine_General_Status_1__CAN00
        Pdu_PPEI_Engine_General_Status_3__CAN00: ComIpduDirection=RECEIVE, ComIPduSize=8, ComIPduGroupRef=PduGrp_AFS_HS__CAN00_Rx, ComIPduSignalRef=Com_GenFld__PPEI_Engine_General_Status_3__CAN00, PduIdRef=PduCollection/PPEI_Engine_General_Status_3__CAN00
        Pdu_PPEI_NonDrivn_Whl_Rotationl_Stat__CAN00: ComIpduDirection=RECEIVE, ComIPduSize=8, ComIPduGroupRef=PduGrp_AFS_HS__CAN00_Rx, ComIPduSignalGroupRef=Com_Grp_SG_WhlRotStatLftNDrvn__PPEI_NonDrivn_Whl_Rotationl_Stat__CAN00, ComIPduSignalGroupRef=Com_Grp_SG_WhlRotStatRghtNDrvn__PPEI_NonDrivn_Whl_Rotationl_Stat__CAN00, PduIdRef=PduCollection/PPEI_NonDrivn_Whl_Rotationl_Stat__CAN00
        Pdu_PPEI_Platform_General_Status__CAN00: ComIpduDirection=RECEIVE, ComIPduSize=8, ComIPduGroupRef=PduGrp_AFS_HS__CAN00_Rx, ComIPduSignalRef=Com_SysPwrMd__PPEI_Platform_General_Status__CAN00, ComIPduSignalRef=Com_SysBkUpPwrMd__PPEI_Platform_General_Status__CAN00, ComIPduSignalRef=Com_SysBkupPwrMdEn__PPEI_Platform_General_Status__CAN00, ComIPduSignalRef=Com_TrStLgMdAtv__PPEI_Platform_General_Status__CAN00, ComIPduSignalRef=Com_SIRDpl__PPEI_Platform_General_Status__CAN00, PduIdRef=PduCollection/PPEI_Platform_General_Status__CAN00
        Pdu_PPEI_Trans_General_Status_2__CAN00: ComIpduDirection=RECEIVE, ComIPduSize=8, ComIPduGroupRef=PduGrp_AFS_HS__CAN00_Rx, ComIPduSignalRef=Com_TransEstGear__PPEI_Trans_General_Status_2__CAN00, ComIPduSignalRef=Com_TransEstGearV__PPEI_Trans_General_Status_2__CAN00, ComIPduSignalRef=Com_TrnsEngdState__PPEI_Trans_General_Status_2__CAN00, ComIPduSignalRef=Com_TrnsEngdStateV__PPEI_Trans_General_Status_2__CAN00, PduIdRef=PduCollection/PPEI_Trans_General_Status_2__CAN00
        Pdu_PPEI_VIN_Digits_10_to_17__CAN00: ComIpduDirection=RECEIVE, ComIPduSize=8, ComIPduGroupRef=PduGrp_AFS_HS__CAN00_Rx, ComIPduSignalRef=Com_VehIdNmDig10_17__PPEI_VIN_Digits_10_to_17__CAN00, PduIdRef=PduCollection/PPEI_VIN_Digits_10_to_17__CAN00
        Pdu_Vehicle_Odometer_HS__CAN00: ComIpduDirection=RECEIVE, ComIPduSize=5, ComIPduGroupRef=PduGrp_AFS_HS__CAN00_Rx, ComIPduSignalRef=Com_VehOdo__Vehicle_Odometer_HS__CAN00, ComIPduSignalRef=Com_VehOdoV__Vehicle_Odometer_HS__CAN00, PduIdRef=PduCollection/Vehicle_Odometer_HS__CAN00
        Pdu_VIN_Digits_2_to_9_HS__CAN00: ComIpduDirection=RECEIVE, ComIPduSize=8, ComIPduGroupRef=PduGrp_AFS_HS__CAN00_Rx, ComIPduSignalRef=Com_VehIdNmDig2_9__VIN_Digits_2_to_9_HS__CAN00, PduIdRef=PduCollection/VIN_Digits_2_to_9_HS__CAN00
        Pdu_Wheel_Pulses_HS__CAN00: ComIpduDirection=RECEIVE, ComIPduSize=4, ComIPduGroupRef=PduGrp_AFS_HS__CAN00_Rx, ComIPduSignalRef=Com_WhlPlsPerRevDrvn__Wheel_Pulses_HS__CAN00, ComIPduSignalRef=Com_WhlPlsPerRevNonDrvn__Wheel_Pulses_HS__CAN00, PduIdRef=PduCollection/Wheel_Pulses_HS__CAN00
      10 x ComSignal, all with ComSignalEndianess=BIG_ENDIAN, ComSignalInitValue=0, ComTransferProperty=PENDING:
        Com_AFSIndOn__AFS_Status_HS__CAN00: ComBitPosition=0, ComBitSize=1, SystemTemplateSystemSignalRef=AFSIndOn
        Com_AFSSysFail__AFS_Status_HS__CAN00: ComBitPosition=1, ComBitSize=1, SystemTemplateSystemSignalRef=AFSSysFail
        Com_FrStSysVeTpSpLimIndOn__AFS_Status_HS__CAN00: ComBitPosition=2, ComBitSize=1, SystemTemplateSystemSignalRef=FrStSysVeTpSpLimIndOn
        Com_StSysVehTopSpdLimReq__AFS_Status_HS__CAN00: ComBitPosition=15, ComBitSize=8, SystemTemplateSystemSignalRef=StSysVehTopSpdLimReq
        Com_VehStabEnhmntStat__Antilock_Brake_and_TC_Status_HS__CAN00: ComBitPosition=4, ComBitSize=3, ComTimeoutFactor=0, SystemTemplateSystemSignalRef=VehStabEnhmntStat
        Com_WhlGrndVlctyLftDrvn__Driven_Wheel_Grnd_Velocity_HS__CAN00: ComBitPosition=5, ComBitSize=14, ComTimeoutFactor=0, SystemTemplateSystemSignalRef=WhlGrndVlctyLftDrvn
        Com_WhlGrndVlctyLftDrvnV__Driven_Wheel_Grnd_Velocity_HS__CAN00: ComBitPosition=6, ComBitSize=1, ComTimeoutFactor=0, SystemTemplateSystemSignalRef=WhlGrndVlctyLftDrvnV
        Com_WhlGrndVlctyRtDrvn__Driven_Wheel_Grnd_Velocity_HS__CAN00: ComBitPosition=21, ComBitSize=14, ComTimeoutFactor=0, SystemTemplateSystemSignalRef=WhlGrndVlctyRtDrvn
        Com_WhlGrndVlctyRtDrvnV__Driven_Wheel_Grnd_Velocity_HS__CAN00: ComBitPosition=22, ComBitSize=1, ComTimeoutFactor=0, SystemTemplateSystemSignalRef=WhlGrndVlctyRtDrvnV
        Com_DrvMdCntrlState__Driving_Mode_Control_HS__CAN00: ComBitPosition=39, ComBitSize=8, ComTimeoutFactor=0, SystemTemplateSystemSignalRef=DrvMdCntrlState
      Com_Grp_SG_DTCInfo_779__DTC_Triggered_779__CAN00 (ComSignalGroup): ComBitPosition=0, ComBitSize=56, ComTransferProperty=PENDING, SystemTemplateSignalGroupRef=SG_DTCInfo_779
        20 x ComGroupSignal, all with ComSignalEndianess=BIG_ENDIAN, ComSignalInitValue=0, ComTransferProperty=PENDING:
          Com_DTCI_DTCTriggered_779__DTC_Triggered_779__CAN00: ComBitPosition=0, ComBitSize=1, SystemTemplateSystemSignalRef=DTCI_DTCTriggered_779
          Com_DTCIUnused7_779__DTC_Triggered_779__CAN00: ComBitPosition=1, ComBitSize=1, SystemTemplateSystemSignalRef=DTCIUnused7_779
          Com_DTCIUnused6_779__DTC_Triggered_779__CAN00: ComBitPosition=2, ComBitSize=1, SystemTemplateSystemSignalRef=DTCIUnused6_779
          Com_DTCIUnused5_779__DTC_Triggered_779__CAN00: ComBitPosition=3, ComBitSize=1, SystemTemplateSystemSignalRef=DTCIUnused5_779
          Com_DTCIUnused4_779__DTC_Triggered_779__CAN00: ComBitPosition=4, ComBitSize=1, SystemTemplateSystemSignalRef=DTCIUnused4_779
          Com_DTCIUnused3_779__DTC_Triggered_779__CAN00: ComBitPosition=5, ComBitSize=1, SystemTemplateSystemSignalRef=DTCIUnused3_779
          Com_DTCIUnused2_779__DTC_Triggered_779__CAN00: ComBitPosition=6, ComBitSize=1, SystemTemplateSystemSignalRef=DTCIUnused2_779
          Com_DTCIUnused1_779__DTC_Triggered_779__CAN00: ComBitPosition=7, ComBitSize=1, SystemTemplateSystemSignalRef=DTCIUnused1_779
          Com_DTCI_DTCSource_779__DTC_Triggered_779__CAN00: ComBitPosition=15, ComBitSize=8, SystemTemplateSystemSignalRef=DTCI_DTCSource_779
          Com_DTCI_DTCNumber_779__DTC_Triggered_779__CAN00: ComBitPosition=23, ComBitSize=16, SystemTemplateSystemSignalRef=DTCI_DTCNumber_779
          Com_DTCI_DTCFailType_779__DTC_Triggered_779__CAN00: ComBitPosition=39, ComBitSize=8, SystemTemplateSystemSignalRef=DTCI_DTCFailType_779
          Com_DTCI_CodeSupported_779__DTC_Triggered_779__CAN00: ComBitPosition=40, ComBitSize=1, SystemTemplateSystemSignalRef=DTCI_CodeSupported_779
          Com_DTCI_CurrentStatus_779__DTC_Triggered_779__CAN00: ComBitPosition=41, ComBitSize=1, SystemTemplateSystemSignalRef=DTCI_CurrentStatus_779
          Com_DTCI_TstNPsdCdClrdSt_779__DTC_Triggered_779__CAN00: ComBitPosition=42, ComBitSize=1, SystemTemplateSystemSignalRef=DTCI_TstNPsdCdClrdSt_779
          Com_DTCI_TstFldCdClrdStat_779__DTC_Triggered_779__CAN00: ComBitPosition=43, ComBitSize=1, SystemTemplateSystemSignalRef=DTCI_TstFldCdClrdStat_779
          Com_DTCI_HistStat_779__DTC_Triggered_779__CAN00: ComBitPosition=44, ComBitSize=1, SystemTemplateSystemSignalRef=DTCI_HistStat_779
          Com_DTCI_TstNPsdPwrUpSt_779__DTC_Triggered_779__CAN00: ComBitPosition=45, ComBitSize=1, SystemTemplateSystemSignalRef=DTCI_TstNPsdPwrUpSt_779
          Com_DTCI_TstFldPwrUpSt_779__DTC_Triggered_779__CAN00: ComBitPosition=46, ComBitSize=1, SystemTemplateSystemSignalRef=DTCI_TstFldPwrUpSt_779
          Com_DTCI_WrnIndRqdSt_779__DTC_Triggered_779__CAN00: ComBitPosition=47, ComBitSize=1, SystemTemplateSystemSignalRef=DTCI_WrnIndRqdSt_779
          Com_DTCI_DTCFaultType_779__DTC_Triggered_779__CAN00: ComBitPosition=55, ComBitSize=8, SystemTemplateSystemSignalRef=DTCI_DTCFaultType_779
      7 x ComSignal, all with ComSignalEndianess=BIG_ENDIAN, ComSignalInitValue=0, ComTimeoutFactor=0, ComTransferProperty=PENDING:
        Com_WhlGrndVlctyLftNnDrvn__NonDriven_Wheel_Grnd_Velocity_HS__CAN00: ComBitPosition=5, ComBitSize=14, SystemTemplateSystemSignalRef=WhlGrndVlctyLftNnDrvn
        Com_WhlGrndVlctyLftNnDrvnV__NonDriven_Wheel_Grnd_Velocity_HS__CAN00: ComBitPosition=6, ComBitSize=1, SystemTemplateSystemSignalRef=WhlGrndVlctyLftNnDrvnV
        Com_WhlGrndVlctyRtNnDrvn__NonDriven_Wheel_Grnd_Velocity_HS__CAN00: ComBitPosition=21, ComBitSize=14, SystemTemplateSystemSignalRef=WhlGrndVlctyRtNnDrvn
        Com_WhlGrndVlctyRtNnDrvnV__NonDriven_Wheel_Grnd_Velocity_HS__CAN00: ComBitPosition=22, ComBitSize=1, SystemTemplateSystemSignalRef=WhlGrndVlctyRtNnDrvnV
        Com_ABSFld__PPEI_Chassis_General_Status_1__CAN00: ComBitPosition=29, ComBitSize=1, SystemTemplateSystemSignalRef=ABSFld
        Com_ABSAtv__PPEI_Chassis_General_Status_1__CAN00: ComBitPosition=30, ComBitSize=1, SystemTemplateSystemSignalRef=ABSAtv
        Com_VhDynCntlSysSt__PPEI_Chassis_General_Status_1__CAN00: ComBitPosition=39, ComBitSize=3, SystemTemplateSystemSignalRef=VhDynCntlSysSt
      Com_Grp_SG_WhlRotatStatLftDrvn__PPEI_Driven_Whl_Rotational_Stat__CAN00 (ComSignalGroup): ComBitPosition=0, ComBitSize=32, ComTimeoutFactor=0, ComTransferProperty=PENDING, SystemTemplateSignalGroupRef=SG_WhlRotatStatLftDrvn
        6 x ComGroupSignal, all with ComSignalEndianess=BIG_ENDIAN, ComSignalInitValue=0, ComTransferProperty=PENDING:
          Com_WRSLDWhlDistPlsCntr__PPEI_Driven_Whl_Rotational_Stat__CAN00: ComBitPosition=1, ComBitSize=10, SystemTemplateSystemSignalRef=WRSLDWhlDistPlsCntr
          Com_WRSLDWhlDistVal__PPEI_Driven_Whl_Rotational_Stat__CAN00: ComBitPosition=2, ComBitSize=1, SystemTemplateSystemSignalRef=WRSLDWhlDistVal
          Com_WRSLDWhlRotStatRst__PPEI_Driven_Whl_Rotational_Stat__CAN00: ComBitPosition=3, ComBitSize=1, SystemTemplateSystemSignalRef=WRSLDWhlRotStatRst
          Com_WRSLDSeqNum__PPEI_Driven_Whl_Rotational_Stat__CAN00: ComBitPosition=5, ComBitSize=2, SystemTemplateSystemSignalRef=WRSLDSeqNum
          Com_WRSLDWhlDisTpRC__PPEI_Driven_Whl_Rotational_Stat__CAN00: ComBitPosition=7, ComBitSize=2, SystemTemplateSystemSignalRef=WRSLDWhlDisTpRC
          Com_WRSLDWhlDistTmstm__PPEI_Driven_Whl_Rotational_Stat__CAN00: ComBitPosition=23, ComBitSize=16, SystemTemplateSystemSignalRef=WRSLDWhlDistTmstm
      Com_Grp_SG_WhlRotatStatRtDrvn__PPEI_Driven_Whl_Rotational_Stat__CAN00 (ComSignalGroup): ComBitPosition=32, ComBitSize=32, ComTimeoutFactor=0, ComTransferProperty=PENDING, SystemTemplateSignalGroupRef=SG_WhlRotatStatRtDrvn
        6 x ComGroupSignal, all with ComSignalEndianess=BIG_ENDIAN, ComSignalInitValue=0, ComTransferProperty=PENDING:
          Com_WRSRDWhlDistPlsCntr__PPEI_Driven_Whl_Rotational_Stat__CAN00: ComBitPosition=33, ComBitSize=10, SystemTemplateSystemSignalRef=WRSRDWhlDistPlsCntr
          Com_WRSRDWhlDistVal__PPEI_Driven_Whl_Rotational_Stat__CAN00: ComBitPosition=34, ComBitSize=1, SystemTemplateSystemSignalRef=WRSRDWhlDistVal
          Com_WRSRDWhlRotStatRst__PPEI_Driven_Whl_Rotational_Stat__CAN00: ComBitPosition=35, ComBitSize=1, SystemTemplateSystemSignalRef=WRSRDWhlRotStatRst
          Com_WRSRDSeqNum__PPEI_Driven_Whl_Rotational_Stat__CAN00: ComBitPosition=37, ComBitSize=2, SystemTemplateSystemSignalRef=WRSRDSeqNum
          Com_WRSRDWhlDisTpRC__PPEI_Driven_Whl_Rotational_Stat__CAN00: ComBitPosition=39, ComBitSize=2, SystemTemplateSystemSignalRef=WRSRDWhlDisTpRC
          Com_WRSRDWhlDistTmstm__PPEI_Driven_Whl_Rotational_Stat__CAN00: ComBitPosition=55, ComBitSize=16, SystemTemplateSystemSignalRef=WRSRDWhlDistTmstm
      5 x ComSignal, all with ComSignalEndianess=BIG_ENDIAN, ComSignalInitValue=0, ComTimeoutFactor=0, ComTransferProperty=PENDING:
        Com_EngRunAtv__PPEI_Engine_General_Status_1__CAN00: ComBitPosition=7, ComBitSize=1, SystemTemplateSystemSignalRef=EngRunAtv
        Com_EngSpd__PPEI_Engine_General_Status_1__CAN00: ComBitPosition=15, ComBitSize=16, SystemTemplateSystemSignalRef=EngSpd
        Com_AccActPosV__PPEI_Engine_General_Status_1__CAN00: ComBitPosition=31, ComBitSize=1, SystemTemplateSystemSignalRef=AccActPosV
        Com_AccActPos__PPEI_Engine_General_Status_1__CAN00: ComBitPosition=39, ComBitSize=8, SystemTemplateSystemSignalRef=AccActPos
        Com_GenFld__PPEI_Engine_General_Status_3__CAN00: ComBitPosition=5, ComBitSize=1, SystemTemplateSystemSignalRef=GenFld
      Com_Grp_SG_WhlRotStatLftNDrvn__PPEI_NonDrivn_Whl_Rotationl_Stat__CAN00 (ComSignalGroup): ComBitPosition=0, ComBitSize=32, ComTimeoutFactor=0, ComTransferProperty=PENDING, SystemTemplateSignalGroupRef=SG_WhlRotStatLftNDrvn
        6 x ComGroupSignal, all with ComSignalEndianess=BIG_ENDIAN, ComSignalInitValue=0, ComTransferProperty=PENDING:
          Com_WRSLNDWhlDistPCntr__PPEI_NonDrivn_Whl_Rotationl_Stat__CAN00: ComBitPosition=1, ComBitSize=10, SystemTemplateSystemSignalRef=WRSLNDWhlDistPCntr
          Com_WRSLNDWhlDistVal__PPEI_NonDrivn_Whl_Rotationl_Stat__CAN00: ComBitPosition=2, ComBitSize=1, SystemTemplateSystemSignalRef=WRSLNDWhlDistVal
          Com_WRSLNDWhlRotStRst__PPEI_NonDrivn_Whl_Rotationl_Stat__CAN00: ComBitPosition=3, ComBitSize=1, SystemTemplateSystemSignalRef=WRSLNDWhlRotStRst
          Com_WRSLNDSeqNum__PPEI_NonDrivn_Whl_Rotationl_Stat__CAN00: ComBitPosition=5, ComBitSize=2, SystemTemplateSystemSignalRef=WRSLNDSeqNum
          Com_WRSLNDWhlDisTpRC__PPEI_NonDrivn_Whl_Rotationl_Stat__CAN00: ComBitPosition=7, ComBitSize=2, SystemTemplateSystemSignalRef=WRSLNDWhlDisTpRC
          Com_WRSLNDWhlDistTstm__PPEI_NonDrivn_Whl_Rotationl_Stat__CAN00: ComBitPosition=23, ComBitSize=16, SystemTemplateSystemSignalRef=WRSLNDWhlDistTstm
      Com_Grp_SG_WhlRotStatRghtNDrvn__PPEI_NonDrivn_Whl_Rotationl_Stat__CAN00 (ComSignalGroup): ComBitPosition=32, ComBitSize=32, ComTimeoutFactor=0, ComTransferProperty=PENDING, SystemTemplateSignalGroupRef=SG_WhlRotStatRghtNDrvn
        6 x ComGroupSignal, all with ComSignalEndianess=BIG_ENDIAN, ComSignalInitValue=0, ComTransferProperty=PENDING:
          Com_WRSRNDWhlDistPCntr__PPEI_NonDrivn_Whl_Rotationl_Stat__CAN00: ComBitPosition=33, ComBitSize=10, SystemTemplateSystemSignalRef=WRSRNDWhlDistPCntr
          Com_WRSRNDWhlDistVal__PPEI_NonDrivn_Whl_Rotationl_Stat__CAN00: ComBitPosition=34, ComBitSize=1, SystemTemplateSystemSignalRef=WRSRNDWhlDistVal
          Com_WRSRNDWhlRotStRst__PPEI_NonDrivn_Whl_Rotationl_Stat__CAN00: ComBitPosition=35, ComBitSize=1, SystemTemplateSystemSignalRef=WRSRNDWhlRotStRst
          Com_WRSRNDSeqNum__PPEI_NonDrivn_Whl_Rotationl_Stat__CAN00: ComBitPosition=37, ComBitSize=2, SystemTemplateSystemSignalRef=WRSRNDSeqNum
          Com_WRSRNDWhlDisTpRC__PPEI_NonDrivn_Whl_Rotationl_Stat__CAN00: ComBitPosition=39, ComBitSize=2, SystemTemplateSystemSignalRef=WRSRNDWhlDisTpRC
          Com_WRSRNDWhlDistTstm__PPEI_NonDrivn_Whl_Rotationl_Stat__CAN00: ComBitPosition=55, ComBitSize=16, SystemTemplateSystemSignalRef=WRSRNDWhlDistTstm
      15 x ComSignal, all with ComSignalEndianess=BIG_ENDIAN, ComTimeoutFactor=0, ComTransferProperty=PENDING:
        Com_SysPwrMd__PPEI_Platform_General_Status__CAN00: ComBitPosition=1, ComBitSize=2, ComSignalInitValue=0, SystemTemplateSystemSignalRef=SysPwrMd
        Com_SysBkUpPwrMd__PPEI_Platform_General_Status__CAN00: ComBitPosition=5, ComBitSize=2, ComSignalInitValue=0, SystemTemplateSystemSignalRef=SysBkUpPwrMd
        Com_SysBkupPwrMdEn__PPEI_Platform_General_Status__CAN00: ComBitPosition=6, ComBitSize=1, ComSignalInitValue=0, SystemTemplateSystemSignalRef=SysBkupPwrMdEn
        Com_TrStLgMdAtv__PPEI_Platform_General_Status__CAN00: ComBitPosition=34, ComBitSize=1, ComSignalInitValue=0, SystemTemplateSystemSignalRef=TrStLgMdAtv
        Com_SIRDpl__PPEI_Platform_General_Status__CAN00: ComBitPosition=58, ComBitSize=1, ComSignalInitValue=0, SystemTemplateSystemSignalRef=SIRDpl
        Com_TransEstGear__PPEI_Trans_General_Status_2__CAN00: ComBitPosition=3, ComBitSize=4, ComSignalInitValue=15, SystemTemplateSystemSignalRef=TransEstGear
        Com_TransEstGearV__PPEI_Trans_General_Status_2__CAN00: ComBitPosition=4, ComBitSize=1, ComSignalInitValue=0, SystemTemplateSystemSignalRef=TransEstGearV
        Com_TrnsEngdState__PPEI_Trans_General_Status_2__CAN00: ComBitPosition=49, ComBitSize=2, ComSignalInitValue=0, SystemTemplateSystemSignalRef=TrnsEngdState
        Com_TrnsEngdStateV__PPEI_Trans_General_Status_2__CAN00: ComBitPosition=50, ComBitSize=1, ComSignalInitValue=0, SystemTemplateSystemSignalRef=TrnsEngdStateV
        Com_VehIdNmDig10_17__PPEI_VIN_Digits_10_to_17__CAN00: ComBitPosition=7, ComBitSize=64, ComSignalInitValue=0, SystemTemplateSystemSignalRef=VehIdNmDig10_17
        Com_VehOdo__Vehicle_Odometer_HS__CAN00: ComBitPosition=7, ComBitSize=32, ComSignalInitValue=0, SystemTemplateSystemSignalRef=VehOdo
        Com_VehOdoV__Vehicle_Odometer_HS__CAN00: ComBitPosition=32, ComBitSize=1, ComSignalInitValue=0, SystemTemplateSystemSignalRef=VehOdoV
        Com_VehIdNmDig2_9__VIN_Digits_2_to_9_HS__CAN00: ComBitPosition=7, ComBitSize=64, ComSignalInitValue=0, SystemTemplateSystemSignalRef=VehIdNmDig2_9
        Com_WhlPlsPerRevDrvn__Wheel_Pulses_HS__CAN00: ComBitPosition=6, ComBitSize=7, ComSignalInitValue=0, SystemTemplateSystemSignalRef=WhlPlsPerRevDrvn
        Com_WhlPlsPerRevNonDrvn__Wheel_Pulses_HS__CAN00: ComBitPosition=14, ComBitSize=7, ComSignalInitValue=0, SystemTemplateSystemSignalRef=WhlPlsPerRevNonDrvn
  module config PduR
    PduRGeneral
    PduRGlobalConfig
      PduRRoutingTable
  module config EcuC
    PduCollection
      30 x Pdu:
        AFS_Status_HS__CAN00: PduLength=16
        Antilock_Brake_and_TC_Status_HS__CAN00: PduLength=48
        Driven_Wheel_Grnd_Velocity_HS__CAN00: PduLength=32
        Driving_Mode_Control_HS__CAN00: PduLength=56
        DTC_Triggered_779__CAN00: PduLength=56
        NonDriven_Wheel_Grnd_Velocity_HS__CAN00: PduLength=32
        PPEI_Chassis_General_Status_1__CAN00: PduLength=64
        PPEI_Driven_Whl_Rotational_Stat__CAN00: PduLength=64
        PPEI_Engine_General_Status_1__CAN00: PduLength=64
        PPEI_Engine_General_Status_3__CAN00: PduLength=64
        PPEI_NonDrivn_Whl_Rotationl_Stat__CAN00: PduLength=64
        PPEI_Platform_General_Status__CAN00: PduLength=64
        PPEI_Trans_General_Status_2__CAN00: PduLength=64
        PPEI_VIN_Digits_10_to_17__CAN00: PduLength=64
        TsiCcpRx__CAN00: PduLength=64
        TsiCcpTx__CAN00: PduLength=64
        TsiDrvRxMsg__CAN00: PduLength=64
        TsiDrvTxMsg__CAN00: PduLength=64
        TsiTpRxMsg__CAN00: PduLength=64
        TsiTpTxMsg__CAN00: PduLength=64
        USDT_Req_to_AFS_HS_Tp__CAN00
        USDT_Req_to_All_HS_ECUs_Tp__CAN00
        USDT_Resp_From_AFS_HS_Tp__CAN00
        UUDT_Resp_From_AFS_HS__CAN00: PduLength=64
        Vehicle_Odometer_HS__CAN00: PduLength=40
        VIN_Digits_2_to_9_HS__CAN00: PduLength=64
        Wheel_Pulses_HS__CAN00: PduLength=32
        USDT_Req_to_AFS_HS__CAN00: PduLength=64
        USDT_Req_to_All_HS_ECUs__CAN00: PduLength=64
        USDT_Resp_From_AFS_HS__CAN00: PduLength=64
  module config ComM
    ComMConfig
      CAN00 (ComMNetworks): ComMNetworkHandle=ComM/CAN00
    CAN00 (ComMChannel): ComMBusType=COMM_BUS_TYPE_CAN, ComMChannelId=0
