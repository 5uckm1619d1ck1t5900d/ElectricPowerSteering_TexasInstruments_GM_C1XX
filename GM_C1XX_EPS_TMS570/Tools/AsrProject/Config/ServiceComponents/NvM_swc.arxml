AUTOSAR XML (schema 3.0.1)
standard types defined: Boolean, UInt8
package /ComponentType
  service component type NvM: category=ServiceComponent  # Software Component description for NvM generated from Ecuc Package: DaVinci_Project
    118 x provide port:
      PS_Rte_NvmBlock_Ap_AvgFricLrn_AvgFricLrnData: provided-interface=NvM_AC3_SRBS_Srv  # PPort_Rte_NvmBlock_Ap_AvgFricLrn_AvgFricLrnData : NvM_AC3_SRBS_Srv | P-Port Prototype of NvM_AC3_SRBS_Srv for NVRAM Block Rte_NvmBlock_Ap_AvgFricLrn_AvgFricLrnData
      PS_Rte_NvmBlock_Ap_LrnEOT_LearnedEOT: provided-interface=NvM_AC3_SRBS_Srv  # PPort_Rte_NvmBlock_Ap_LrnEOT_LearnedEOT : NvM_AC3_SRBS_Srv | P-Port Prototype of NvM_AC3_SRBS_Srv for NVRAM Block Rte_NvmBlock_Ap_LrnEOT_LearnedEOT
      PS_Rte_NvmBlock_Ap_TrqCanc_CogTrqCal: provided-interface=NvM_AC3_SRBS_Srv  # PPort_Rte_NvmBlock_Ap_TrqCanc_CogTrqCal : NvM_AC3_SRBS_Srv | P-Port Prototype of NvM_AC3_SRBS_Srv for NVRAM Block Rte_NvmBlock_Ap_TrqCanc_CogTrqCal
      PS_Rte_NvmBlock_CmMtrCurr_CurrTempOffset: provided-interface=NvM_AC3_SRBS_Srv  # PPort_Rte_NvmBlock_CmMtrCurr_CurrTempOffset : NvM_AC3_SRBS_Srv | P-Port Prototype of NvM_AC3_SRBS_Srv for NVRAM Block Rte_NvmBlock_CmMtrCurr_CurrTempOffset
      PS_Rte_NvmBlock_CmMtrCurr_ShCurrCal: provided-interface=NvM_AC3_SRBS_Srv  # PPort_Rte_NvmBlock_CmMtrCurr_ShCurrCal : NvM_AC3_SRBS_Srv | P-Port Prototype of NvM_AC3_SRBS_Srv for NVRAM Block Rte_NvmBlock_CmMtrCurr_ShCurrCal
      PS_Rte_NvmBlock_CurrParamComp_EOLNomMtrParam: provided-interface=NvM_AC3_SRBS_Srv  # PPort_Rte_NvmBlock_CurrParamComp_EOLNomMtrParam : NvM_AC3_SRBS_Srv | P-Port Prototype of NvM_AC3_SRBS_Srv for NVRAM Block Rte_NvmBlock_CurrParamComp_EOLNomMtrParam
      PS_Rte_NvmBlock_Polarity_Polarity_Cnt_Str: provided-interface=NvM_AC3_SRBS_Srv  # PPort_Rte_NvmBlock_Polarity_Polarity_Cnt_Str : NvM_AC3_SRBS_Srv | P-Port Prototype of NvM_AC3_SRBS_Srv for NVRAM Block Rte_NvmBlock_Polarity_Polarity_Cnt_Str
      PS_Rte_NvmBlock_TrqCmdScl_TorqueCmdSF_Uls_f32: provided-interface=NvM_AC3_SRBS_Srv  # PPort_Rte_NvmBlock_TrqCmdScl_TorqueCmdSF_Uls_f32 : NvM_AC3_SRBS_Srv | P-Port Prototype of NvM_AC3_SRBS_Srv for NVRAM Block Rte_NvmBlock_TrqCmdScl_TorqueCmdSF_Uls_f32
      PS_Rte_NvmBlock_BatteryVoltage_OvervoltageData: provided-interface=NvM_AC3_SRBS_Srv  # PPort_Rte_NvmBlock_BatteryVoltage_OvervoltageData : NvM_AC3_SRBS_Srv | P-Port Prototype of NvM_AC3_SRBS_Srv for NVRAM Block Rte_NvmBlock_BatteryVoltage_OvervoltageData
      PS_NVM_BLOCK_DIAGMGR_NTCSTRG: provided-interface=NvM_AC3_SRBS_Srv  # PPort_NVM_BLOCK_DIAGMGR_NTCSTRG : NvM_AC3_SRBS_Srv | P-Port Prototype of NvM_AC3_SRBS_Srv for NVRAM Block NVM_BLOCK_DIAGMGR_NTCSTRG
      PS_NVM_BLOCK_CMS_EPSDEFEATS: provided-interface=NvM_AC3_SRBS_Srv  # PPort_NVM_BLOCK_CMS_EPSDEFEATS : NvM_AC3_SRBS_Srv | P-Port Prototype of NvM_AC3_SRBS_Srv for NVRAM Block NVM_BLOCK_CMS_EPSDEFEATS
      PS_NVM_BLOCK_SER_VINDATA: provided-interface=NvM_AC3_SRBS_Srv  # PPort_NVM_BLOCK_SER_VINDATA : NvM_AC3_SRBS_Srv | P-Port Prototype of NvM_AC3_SRBS_Srv for NVRAM Block NVM_BLOCK_SER_VINDATA
      PS_NVM_BLOCK_SER_SYSTEMNAME: provided-interface=NvM_AC3_SRBS_Srv  # PPort_NVM_BLOCK_SER_SYSTEMNAME : NvM_AC3_SRBS_Srv | P-Port Prototype of NvM_AC3_SRBS_Srv for NVRAM Block NVM_BLOCK_SER_SYSTEMNAME
      PS_NVM_BLOCK_SER_REPAIRSHOPCODE: provided-interface=NvM_AC3_SRBS_Srv  # PPort_NVM_BLOCK_SER_REPAIRSHOPCODE : NvM_AC3_SRBS_Srv | P-Port Prototype of NvM_AC3_SRBS_Srv for NVRAM Block NVM_BLOCK_SER_REPAIRSHOPCODE
      PS_NVM_BLOCK_SER_PROGDATE: provided-interface=NvM_AC3_SRBS_Srv  # PPort_NVM_BLOCK_SER_PROGDATE : NvM_AC3_SRBS_Srv | P-Port Prototype of NvM_AC3_SRBS_Srv for NVRAM Block NVM_BLOCK_SER_PROGDATE
      PS_NVM_BLOCK_SER_SYSVERSCODEDDI: provided-interface=NvM_AC3_SRBS_Srv  # PPort_NVM_BLOCK_SER_SYSVERSCODEDDI : NvM_AC3_SRBS_Srv | P-Port Prototype of NvM_AC3_SRBS_Srv for NVRAM Block NVM_BLOCK_SER_SYSVERSCODEDDI
      PS_NVM_BLOCK_SER_CUSTMEC: provided-interface=NvM_AC3_SRBS_Srv  # PPort_NVM_BLOCK_SER_CUSTMEC : NvM_AC3_SRBS_Srv | P-Port Prototype of NvM_AC3_SRBS_Srv for NVRAM Block NVM_BLOCK_SER_CUSTMEC
      PS_NVM_BLOCK_SER_MANFTRAC: provided-interface=NvM_AC3_SRBS_Srv  # PPort_NVM_BLOCK_SER_MANFTRAC : NvM_AC3_SRBS_Srv | P-Port Prototype of NvM_AC3_SRBS_Srv for NVRAM Block NVM_BLOCK_SER_MANFTRAC
      PS_NVM_BLOCK_SER_ENDMODELPN: provided-interface=NvM_AC3_SRBS_Srv  # PPort_NVM_BLOCK_SER_ENDMODELPN : NvM_AC3_SRBS_Srv | P-Port Prototype of NvM_AC3_SRBS_Srv for NVRAM Block NVM_BLOCK_SER_ENDMODELPN
      PS_NVM_BLOCK_SER_ENDMODELPNAC: provided-interface=NvM_AC3_SRBS_Srv  # PPort_NVM_BLOCK_SER_ENDMODELPNAC : NvM_AC3_SRBS_Srv | P-Port Prototype of NvM_AC3_SRBS_Srv for NVRAM Block NVM_BLOCK_SER_ENDMODELPNAC
      PS_NVM_BLOCK_SER_SEED_DEPRECATED: provided-interface=NvM_AC3_SRBS_Srv  # PPort_NVM_BLOCK_SER_SEED_DEPRECATED : NvM_AC3_SRBS_Srv | P-Port Prototype of NvM_AC3_SRBS_Srv for NVRAM Block NVM_BLOCK_SER_SEED_DEPRECATED
      PS_NVM_BLOCK_SER_KEY_DEPRECATED: provided-interface=NvM_AC3_SRBS_Srv  # PPort_NVM_BLOCK_SER_KEY_DEPRECATED : NvM_AC3_SRBS_Srv | P-Port Prototype of NvM_AC3_SRBS_Srv for NVRAM Block NVM_BLOCK_SER_KEY_DEPRECATED
      PS_NVM_BLOCK_SER_DATAUNIVNUMSYSID: provided-interface=NvM_AC3_SRBS_Srv  # PPort_NVM_BLOCK_SER_DATAUNIVNUMSYSID : NvM_AC3_SRBS_Srv | P-Port Prototype of NvM_AC3_SRBS_Srv for NVRAM Block NVM_BLOCK_SER_DATAUNIVNUMSYSID
      PS_NVM_BLOCK_CMS_NXTRWIRSELECT: provided-interface=NvM_AC3_SRBS_Srv  # PPort_NVM_BLOCK_CMS_NXTRWIRSELECT : NvM_AC3_SRBS_Srv | P-Port Prototype of NvM_AC3_SRBS_Srv for NVRAM Block NVM_BLOCK_CMS_NXTRWIRSELECT
      PS_NVM_BLOCK_CMS_NXTRMEC: provided-interface=NvM_AC3_SRBS_Srv  # PPort_NVM_BLOCK_CMS_NXTRMEC : NvM_AC3_SRBS_Srv | P-Port Prototype of NvM_AC3_SRBS_Srv for NVRAM Block NVM_BLOCK_CMS_NXTRMEC
      PS_NVM_BLOCK_CMS_ECUSRLNUM: provided-interface=NvM_AC3_SRBS_Srv  # PPort_NVM_BLOCK_CMS_ECUSRLNUM : NvM_AC3_SRBS_Srv | P-Port Prototype of NvM_AC3_SRBS_Srv for NVRAM Block NVM_BLOCK_CMS_ECUSRLNUM
      PS_NVM_BLOCK_CMS_EPSSRLNUM: provided-interface=NvM_AC3_SRBS_Srv  # PPort_NVM_BLOCK_CMS_EPSSRLNUM : NvM_AC3_SRBS_Srv | P-Port Prototype of NvM_AC3_SRBS_Srv for NVRAM Block NVM_BLOCK_CMS_EPSSRLNUM
      PS_NVM_BLOCK_CMS_ECUHWPN: provided-interface=NvM_AC3_SRBS_Srv  # PPort_NVM_BLOCK_CMS_ECUHWPN : NvM_AC3_SRBS_Srv | P-Port Prototype of NvM_AC3_SRBS_Srv for NVRAM Block NVM_BLOCK_CMS_ECUHWPN
      PS_NVM_BLOCK_CMS_NXTRMANUFSCRATCHPAD: provided-interface=NvM_AC3_SRBS_Srv  # PPort_NVM_BLOCK_CMS_NXTRMANUFSCRATCHPAD : NvM_AC3_SRBS_Srv | P-Port Prototype of NvM_AC3_SRBS_Srv for NVRAM Block NVM_BLOCK_CMS_NXTRMANUFSCRATCHPAD
      PS_NVM_BLOCK_CMS_IGNCNTR: provided-interface=NvM_AC3_SRBS_Srv  # PPort_NVM_BLOCK_CMS_IGNCNTR : NvM_AC3_SRBS_Srv | P-Port Prototype of NvM_AC3_SRBS_Srv for NVRAM Block NVM_BLOCK_CMS_IGNCNTR
      PS_NVM_BLOCK_STAMD_TYPEH: provided-interface=NvM_AC3_SRBS_Srv  # PPort_NVM_BLOCK_STAMD_TYPEH : NvM_AC3_SRBS_Srv | P-Port Prototype of NvM_AC3_SRBS_Srv for NVRAM Block NVM_BLOCK_STAMD_TYPEH
      PS_NVM_BLOCK_STAMD_CLOSECHECK: provided-interface=NvM_AC3_SRBS_Srv  # PPort_NVM_BLOCK_STAMD_CLOSECHECK : NvM_AC3_SRBS_Srv | P-Port Prototype of NvM_AC3_SRBS_Srv for NVRAM Block NVM_BLOCK_STAMD_CLOSECHECK
      PS_NVM_BLOCK_DIAGMGR_BLACKBOX: provided-interface=NvM_AC3_SRBS_Srv  # PPort_NVM_BLOCK_DIAGMGR_BLACKBOX : NvM_AC3_SRBS_Srv | P-Port Prototype of NvM_AC3_SRBS_Srv for NVRAM Block NVM_BLOCK_DIAGMGR_BLACKBOX
      PS_Rte_NvmBlock_Sa_DigHwTrqSENT_DigTrqTrim: provided-interface=NvM_AC3_SRBS_Srv  # PPort_Rte_NvmBlock_Sa_DigHwTrqSENT_DigTrqTrim : NvM_AC3_SRBS_Srv | P-Port Prototype of NvM_AC3_SRBS_Srv for NVRAM Block Rte_NvmBlock_Sa_DigHwTrqSENT_DigTrqTrim
      PS_Rte_NvmBlock_Sa_DigMSB_DigMSBEOLData: provided-interface=NvM_AC3_SRBS_Srv  # PPort_Rte_NvmBlock_Sa_DigMSB_DigMSBEOLData : NvM_AC3_SRBS_Srv | P-Port Prototype of NvM_AC3_SRBS_Srv for NVRAM Block Rte_NvmBlock_Sa_DigMSB_DigMSBEOLData
      PS_NVM_BLOCK_SER_BASEMODELPN: provided-interface=NvM_AC3_SRBS_Srv  # PPort_NVM_BLOCK_SER_BASEMODELPN : NvM_AC3_SRBS_Srv | P-Port Prototype of NvM_AC3_SRBS_Srv for NVRAM Block NVM_BLOCK_SER_BASEMODELPN
      PS_NVM_BLOCK_SER_BASEMODELPNAC: provided-interface=NvM_AC3_SRBS_Srv  # PPort_NVM_BLOCK_SER_BASEMODELPNAC : NvM_AC3_SRBS_Srv | P-Port Prototype of NvM_AC3_SRBS_Srv for NVRAM Block NVM_BLOCK_SER_BASEMODELPNAC
      PS_NVM_BLOCK_SER_CALPRGFLAG: provided-interface=NvM_AC3_SRBS_Srv  # PPort_NVM_BLOCK_SER_CALPRGFLAG : NvM_AC3_SRBS_Srv | P-Port Prototype of NvM_AC3_SRBS_Srv for NVRAM Block NVM_BLOCK_SER_CALPRGFLAG
      PS_Rte_NvmBlock_AbsHwPos_EOLVehCntrOffset: provided-interface=NvM_AC3_SRBS_Srv  # PPort_Rte_NvmBlock_AbsHwPos_EOLVehCntrOffset : NvM_AC3_SRBS_Srv | P-Port Prototype of NvM_AC3_SRBS_Srv for NVRAM Block Rte_NvmBlock_AbsHwPos_EOLVehCntrOffset
      PS_Rte_NvmBlock_DigColPs_DigColPsEOL: provided-interface=NvM_AC3_SRBS_Srv  # PPort_Rte_NvmBlock_DigColPs_DigColPsEOL : NvM_AC3_SRBS_Srv | P-Port Prototype of NvM_AC3_SRBS_Srv for NVRAM Block Rte_NvmBlock_DigColPs_DigColPsEOL
      PS_Rte_NvmBlock_Ap_TrqCanc_CogTrqRplComp: provided-interface=NvM_AC3_SRBS_Srv  # PPort_Rte_NvmBlock_Ap_TrqCanc_CogTrqRplComp : NvM_AC3_SRBS_Srv | P-Port Prototype of NvM_AC3_SRBS_Srv for NVRAM Block Rte_NvmBlock_Ap_TrqCanc_CogTrqRplComp
      PS_NVM_BLOCK_SER_PREVREPAIRSHOPCODE: provided-interface=NvM_AC3_SRBS_Srv  # PPort_NVM_BLOCK_SER_PREVREPAIRSHOPCODE : NvM_AC3_SRBS_Srv | P-Port Prototype of NvM_AC3_SRBS_Srv for NVRAM Block NVM_BLOCK_SER_PREVREPAIRSHOPCODE
      PS_Rte_NvmBlock_Ap_AstLmt_SteerAsstDefeat: provided-interface=NvM_AC3_SRBS_Srv  # PPort_Rte_NvmBlock_Ap_AstLmt_SteerAsstDefeat : NvM_AC3_SRBS_Srv | P-Port Prototype of NvM_AC3_SRBS_Srv for NVRAM Block Rte_NvmBlock_Ap_AstLmt_SteerAsstDefeat
      PS_Rte_NvmBlock_Ap_TSMit_TSMitDisableEOL: provided-interface=NvM_AC3_SRBS_Srv  # PPort_Rte_NvmBlock_Ap_TSMit_TSMitDisableEOL : NvM_AC3_SRBS_Srv | P-Port Prototype of NvM_AC3_SRBS_Srv for NVRAM Block Rte_NvmBlock_Ap_TSMit_TSMitDisableEOL
      PS_Rte_NvmBlock_Ap_TSMit_TSMitGainLrn: provided-interface=NvM_AC3_SRBS_Srv  # PPort_Rte_NvmBlock_Ap_TSMit_TSMitGainLrn : NvM_AC3_SRBS_Srv | P-Port Prototype of NvM_AC3_SRBS_Srv for NVRAM Block Rte_NvmBlock_Ap_TSMit_TSMitGainLrn
      PS_NVM_BLOCK_CMS_NXTRMECFLAG: provided-interface=NvM_AC3_SRBS_Srv  # PPort_NVM_BLOCK_CMS_NXTRMECFLAG : NvM_AC3_SRBS_Srv | P-Port Prototype of NvM_AC3_SRBS_Srv for NVRAM Block NVM_BLOCK_CMS_NXTRMECFLAG
      PS_NVM_BLOCK_SER_SEED_SPS: provided-interface=NvM_AC3_SRBS_Srv  # PPort_NVM_BLOCK_SER_SEED_SPS : NvM_AC3_SRBS_Srv | P-Port Prototype of NvM_AC3_SRBS_Srv for NVRAM Block NVM_BLOCK_SER_SEED_SPS
      PS_NVM_BLOCK_SER_KEY_SPS: provided-interface=NvM_AC3_SRBS_Srv  # PPort_NVM_BLOCK_SER_KEY_SPS : NvM_AC3_SRBS_Srv | P-Port Prototype of NvM_AC3_SRBS_Srv for NVRAM Block NVM_BLOCK_SER_KEY_SPS
      PS_NVM_BLOCK_SER_SEED_CPID: provided-interface=NvM_AC3_SRBS_Srv  # PPort_NVM_BLOCK_SER_SEED_CPID : NvM_AC3_SRBS_Srv | P-Port Prototype of NvM_AC3_SRBS_Srv for NVRAM Block NVM_BLOCK_SER_SEED_CPID
      PS_NVM_BLOCK_SER_KEY_CPID: provided-interface=NvM_AC3_SRBS_Srv  # PPort_NVM_BLOCK_SER_KEY_CPID : NvM_AC3_SRBS_Srv | P-Port Prototype of NvM_AC3_SRBS_Srv for NVRAM Block NVM_BLOCK_SER_KEY_CPID
      PS_NVM_BLOCK_SER_SEED_NEXTEER: provided-interface=NvM_AC3_SRBS_Srv  # PPort_NVM_BLOCK_SER_SEED_NEXTEER : NvM_AC3_SRBS_Srv | P-Port Prototype of NvM_AC3_SRBS_Srv for NVRAM Block NVM_BLOCK_SER_SEED_NEXTEER
      PS_NVM_BLOCK_SER_KEY_NEXTEER: provided-interface=NvM_AC3_SRBS_Srv  # PPort_NVM_BLOCK_SER_KEY_NEXTEER : NvM_AC3_SRBS_Srv | P-Port Prototype of NvM_AC3_SRBS_Srv for NVRAM Block NVM_BLOCK_SER_KEY_NEXTEER
      PS_Rte_NvmBlock_VehDyn_MotPosReset: provided-interface=NvM_AC3_SRBS_Srv  # PPort_Rte_NvmBlock_VehDyn_MotPosReset : NvM_AC3_SRBS_Srv | P-Port Prototype of NvM_AC3_SRBS_Srv for NVRAM Block Rte_NvmBlock_VehDyn_MotPosReset
      PS_NVM_BLOCK_SER_ECU_ID: provided-interface=NvM_AC3_SRBS_Srv  # PPort_NVM_BLOCK_SER_ECU_ID : NvM_AC3_SRBS_Srv | P-Port Prototype of NvM_AC3_SRBS_Srv for NVRAM Block NVM_BLOCK_SER_ECU_ID
      PS_NVM_BLOCK_SER_APP_NBID: provided-interface=NvM_AC3_SRBS_Srv  # PPort_NVM_BLOCK_SER_APP_NBID : NvM_AC3_SRBS_Srv | P-Port Prototype of NvM_AC3_SRBS_Srv for NVRAM Block NVM_BLOCK_SER_APP_NBID
      PS_NVM_BLOCK_SER_BCID: provided-interface=NvM_AC3_SRBS_Srv  # PPort_NVM_BLOCK_SER_BCID : NvM_AC3_SRBS_Srv | P-Port Prototype of NvM_AC3_SRBS_Srv for NVRAM Block NVM_BLOCK_SER_BCID
      PS_NVM_BLOCK_SER_SBAT: provided-interface=NvM_AC3_SRBS_Srv  # PPort_NVM_BLOCK_SER_SBAT : NvM_AC3_SRBS_Srv | P-Port Prototype of NvM_AC3_SRBS_Srv for NVRAM Block NVM_BLOCK_SER_SBAT
      PS_Rte_NvmBlock_SrlComOutput_DTCTrigSts: provided-interface=NvM_AC3_SRBS_Srv  # PPort_Rte_NvmBlock_SrlComOutput_DTCTrigSts : NvM_AC3_SRBS_Srv | P-Port Prototype of NvM_AC3_SRBS_Srv for NVRAM Block Rte_NvmBlock_SrlComOutput_DTCTrigSts
      PS_ConfigBlock: provided-interface=NvM_AC3_SRBS_Srv  # PPort_ConfigBlock : NvM_AC3_SRBS_Srv | P-Port Prototype of NvM_AC3_SRBS_Srv for NVRAM Block ConfigBlock
      PAdmin_Rte_NvmBlock_Ap_AvgFricLrn_AvgFricLrnData: provided-interface=NvM_Administration  # PPort_Rte_NvmBlock_Ap_AvgFricLrn_AvgFricLrnData : NvM_Administration | P-Port Prototype of NvM_Administration for NVRAM Block Rte_NvmBlock_Ap_AvgFricLrn_AvgFricLrnData
      PAdmin_Rte_NvmBlock_Ap_LrnEOT_LearnedEOT: provided-interface=NvM_Administration  # PPort_Rte_NvmBlock_Ap_LrnEOT_LearnedEOT : NvM_Administration | P-Port Prototype of NvM_Administration for NVRAM Block Rte_NvmBlock_Ap_LrnEOT_LearnedEOT
      PAdmin_Rte_NvmBlock_Ap_TrqCanc_CogTrqCal: provided-interface=NvM_Administration  # PPort_Rte_NvmBlock_Ap_TrqCanc_CogTrqCal : NvM_Administration | P-Port Prototype of NvM_Administration for NVRAM Block Rte_NvmBlock_Ap_TrqCanc_CogTrqCal
      PAdmin_Rte_NvmBlock_CmMtrCurr_CurrTempOffset: provided-interface=NvM_Administration  # PPort_Rte_NvmBlock_CmMtrCurr_CurrTempOffset : NvM_Administration | P-Port Prototype of NvM_Administration for NVRAM Block Rte_NvmBlock_CmMtrCurr_CurrTempOffset
      PAdmin_Rte_NvmBlock_CmMtrCurr_ShCurrCal: provided-interface=NvM_Administration  # PPort_Rte_NvmBlock_CmMtrCurr_ShCurrCal : NvM_Administration | P-Port Prototype of NvM_Administration for NVRAM Block Rte_NvmBlock_CmMtrCurr_ShCurrCal
      PAdmin_Rte_NvmBlock_CurrParamComp_EOLNomMtrParam: provided-interface=NvM_Administration  # PPort_Rte_NvmBlock_CurrParamComp_EOLNomMtrParam : NvM_Administration | P-Port Prototype of NvM_Administration for NVRAM Block Rte_NvmBlock_CurrParamComp_EOLNomMtrParam
      PAdmin_Rte_NvmBlock_Polarity_Polarity_Cnt_Str: provided-interface=NvM_Administration  # PPort_Rte_NvmBlock_Polarity_Polarity_Cnt_Str : NvM_Administration | P-Port Prototype of NvM_Administration for NVRAM Block Rte_NvmBlock_Polarity_Polarity_Cnt_Str
      PAdmin_Rte_NvmBlock_TrqCmdScl_TorqueCmdSF_Uls_f32: provided-interface=NvM_Administration  # PPort_Rte_NvmBlock_TrqCmdScl_TorqueCmdSF_Uls_f32 : NvM_Administration | P-Port Prototype of NvM_Administration for NVRAM Block Rte_NvmBlock_TrqCmdScl_TorqueCmdSF_Uls_f32
      PAdmin_Rte_NvmBlock_BatteryVoltage_OvervoltageData: provided-interface=NvM_Administration  # PPort_Rte_NvmBlock_BatteryVoltage_OvervoltageData : NvM_Administration | P-Port Prototype of NvM_Administration for NVRAM Block Rte_NvmBlock_BatteryVoltage_OvervoltageData
      PAdmin_NVM_BLOCK_DIAGMGR_NTCSTRG: provided-interface=NvM_Administration  # PPort_NVM_BLOCK_DIAGMGR_NTCSTRG : NvM_Administration | P-Port Prototype of NvM_Administration for NVRAM Block NVM_BLOCK_DIAGMGR_NTCSTRG
      PAdmin_NVM_BLOCK_CMS_EPSDEFEATS: provided-interface=NvM_Administration  # PPort_NVM_BLOCK_CMS_EPSDEFEATS : NvM_Administration | P-Port Prototype of NvM_Administration for NVRAM Block NVM_BLOCK_CMS_EPSDEFEATS
      PAdmin_NVM_BLOCK_SER_VINDATA: provided-interface=NvM_Administration  # PPort_NVM_BLOCK_SER_VINDATA : NvM_Administration | P-Port Prototype of NvM_Administration for NVRAM Block NVM_BLOCK_SER_VINDATA
      PAdmin_NVM_BLOCK_SER_SYSTEMNAME: provided-interface=NvM_Administration  # PPort_NVM_BLOCK_SER_SYSTEMNAME : NvM_Administration | P-Port Prototype of NvM_Administration for NVRAM Block NVM_BLOCK_SER_SYSTEMNAME
      PAdmin_NVM_BLOCK_SER_REPAIRSHOPCODE: provided-interface=NvM_Administration  # PPort_NVM_BLOCK_SER_REPAIRSHOPCODE : NvM_Administration | P-Port Prototype of NvM_Administration for NVRAM Block NVM_BLOCK_SER_REPAIRSHOPCODE
      PAdmin_NVM_BLOCK_SER_PROGDATE: provided-interface=NvM_Administration  # PPort_NVM_BLOCK_SER_PROGDATE : NvM_Administration | P-Port Prototype of NvM_Administration for NVRAM Block NVM_BLOCK_SER_PROGDATE
      PAdmin_NVM_BLOCK_SER_SYSVERSCODEDDI: provided-interface=NvM_Administration  # PPort_NVM_BLOCK_SER_SYSVERSCODEDDI : NvM_Administration | P-Port Prototype of NvM_Administration for NVRAM Block NVM_BLOCK_SER_SYSVERSCODEDDI
      PAdmin_NVM_BLOCK_SER_CUSTMEC: provided-interface=NvM_Administration  # PPort_NVM_BLOCK_SER_CUSTMEC : NvM_Administration | P-Port Prototype of NvM_Administration for NVRAM Block NVM_BLOCK_SER_CUSTMEC
      PAdmin_NVM_BLOCK_SER_MANFTRAC: provided-interface=NvM_Administration  # PPort_NVM_BLOCK_SER_MANFTRAC : NvM_Administration | P-Port Prototype of NvM_Administration for NVRAM Block NVM_BLOCK_SER_MANFTRAC
      PAdmin_NVM_BLOCK_SER_ENDMODELPN: provided-interface=NvM_Administration  # PPort_NVM_BLOCK_SER_ENDMODELPN : NvM_Administration | P-Port Prototype of NvM_Administration for NVRAM Block NVM_BLOCK_SER_ENDMODELPN
      PAdmin_NVM_BLOCK_SER_ENDMODELPNAC: provided-interface=NvM_Administration  # PPort_NVM_BLOCK_SER_ENDMODELPNAC : NvM_Administration | P-Port Prototype of NvM_Administration for NVRAM Block NVM_BLOCK_SER_ENDMODELPNAC
      PAdmin_NVM_BLOCK_SER_SEED_DEPRECATED: provided-interface=NvM_Administration  # PPort_NVM_BLOCK_SER_SEED_DEPRECATED : NvM_Administration | P-Port Prototype of NvM_Administration for NVRAM Block NVM_BLOCK_SER_SEED_DEPRECATED
      PAdmin_NVM_BLOCK_SER_KEY_DEPRECATED: provided-interface=NvM_Administration  # PPort_NVM_BLOCK_SER_KEY_DEPRECATED : NvM_Administration | P-Port Prototype of NvM_Administration for NVRAM Block NVM_BLOCK_SER_KEY_DEPRECATED
      PAdmin_NVM_BLOCK_SER_DATAUNIVNUMSYSID: provided-interface=NvM_Administration  # PPort_NVM_BLOCK_SER_DATAUNIVNUMSYSID : NvM_Administration | P-Port Prototype of NvM_Administration for NVRAM Block NVM_BLOCK_SER_DATAUNIVNUMSYSID
      PAdmin_NVM_BLOCK_CMS_NXTRWIRSELECT: provided-interface=NvM_Administration  # PPort_NVM_BLOCK_CMS_NXTRWIRSELECT : NvM_Administration | P-Port Prototype of NvM_Administration for NVRAM Block NVM_BLOCK_CMS_NXTRWIRSELECT
      PAdmin_NVM_BLOCK_CMS_NXTRMEC: provided-interface=NvM_Administration  # PPort_NVM_BLOCK_CMS_NXTRMEC : NvM_Administration | P-Port Prototype of NvM_Administration for NVRAM Block NVM_BLOCK_CMS_NXTRMEC
      PAdmin_NVM_BLOCK_CMS_ECUSRLNUM: provided-interface=NvM_Administration  # PPort_NVM_BLOCK_CMS_ECUSRLNUM : NvM_Administration | P-Port Prototype of NvM_Administration for NVRAM Block NVM_BLOCK_CMS_ECUSRLNUM
      PAdmin_NVM_BLOCK_CMS_EPSSRLNUM: provided-interface=NvM_Administration  # PPort_NVM_BLOCK_CMS_EPSSRLNUM : NvM_Administration | P-Port Prototype of NvM_Administration for NVRAM Block NVM_BLOCK_CMS_EPSSRLNUM
      PAdmin_NVM_BLOCK_CMS_ECUHWPN: provided-interface=NvM_Administration  # PPort_NVM_BLOCK_CMS_ECUHWPN : NvM_Administration | P-Port Prototype of NvM_Administration for NVRAM Block NVM_BLOCK_CMS_ECUHWPN
      PAdmin_NVM_BLOCK_CMS_NXTRMANUFSCRATCHPAD: provided-interface=NvM_Administration  # PPort_NVM_BLOCK_CMS_NXTRMANUFSCRATCHPAD : NvM_Administration | P-Port Prototype of NvM_Administration for NVRAM Block NVM_BLOCK_CMS_NXTRMANUFSCRATCHPAD
      PAdmin_NVM_BLOCK_CMS_IGNCNTR: provided-interface=NvM_Administration  # PPort_NVM_BLOCK_CMS_IGNCNTR : NvM_Administration | P-Port Prototype of NvM_Administration for NVRAM Block NVM_BLOCK_CMS_IGNCNTR
      PAdmin_NVM_BLOCK_STAMD_TYPEH: provided-interface=NvM_Administration  # PPort_NVM_BLOCK_STAMD_TYPEH : NvM_Administration | P-Port Prototype of NvM_Administration for NVRAM Block NVM_BLOCK_STAMD_TYPEH
      PAdmin_NVM_BLOCK_STAMD_CLOSECHECK: provided-interface=NvM_Administration  # PPort_NVM_BLOCK_STAMD_CLOSECHECK : NvM_Administration | P-Port Prototype of NvM_Administration for NVRAM Block NVM_BLOCK_STAMD_CLOSECHECK
      PAdmin_NVM_BLOCK_DIAGMGR_BLACKBOX: provided-interface=NvM_Administration  # PPort_NVM_BLOCK_DIAGMGR_BLACKBOX : NvM_Administration | P-Port Prototype of NvM_Administration for NVRAM Block NVM_BLOCK_DIAGMGR_BLACKBOX
      PAdmin_Rte_NvmBlock_Sa_DigHwTrqSENT_DigTrqTrim: provided-interface=NvM_Administration  # PPort_Rte_NvmBlock_Sa_DigHwTrqSENT_DigTrqTrim : NvM_Administration | P-Port Prototype of NvM_Administration for NVRAM Block Rte_NvmBlock_Sa_DigHwTrqSENT_DigTrqTrim
      PAdmin_Rte_NvmBlock_Sa_DigMSB_DigMSBEOLData: provided-interface=NvM_Administration  # PPort_Rte_NvmBlock_Sa_DigMSB_DigMSBEOLData : NvM_Administration | P-Port Prototype of NvM_Administration for NVRAM Block Rte_NvmBlock_Sa_DigMSB_DigMSBEOLData
      PAdmin_NVM_BLOCK_SER_BASEMODELPN: provided-interface=NvM_Administration  # PPort_NVM_BLOCK_SER_BASEMODELPN : NvM_Administration | P-Port Prototype of NvM_Administration for NVRAM Block NVM_BLOCK_SER_BASEMODELPN
      PAdmin_NVM_BLOCK_SER_BASEMODELPNAC: provided-interface=NvM_Administration  # PPort_NVM_BLOCK_SER_BASEMODELPNAC : NvM_Administration | P-Port Prototype of NvM_Administration for NVRAM Block NVM_BLOCK_SER_BASEMODELPNAC
      PAdmin_NVM_BLOCK_SER_CALPRGFLAG: provided-interface=NvM_Administration  # PPort_NVM_BLOCK_SER_CALPRGFLAG : NvM_Administration | P-Port Prototype of NvM_Administration for NVRAM Block NVM_BLOCK_SER_CALPRGFLAG
      PAdmin_Rte_NvmBlock_AbsHwPos_EOLVehCntrOffset: provided-interface=NvM_Administration  # PPort_Rte_NvmBlock_AbsHwPos_EOLVehCntrOffset : NvM_Administration | P-Port Prototype of NvM_Administration for NVRAM Block Rte_NvmBlock_AbsHwPos_EOLVehCntrOffset
      PAdmin_Rte_NvmBlock_DigColPs_DigColPsEOL: provided-interface=NvM_Administration  # PPort_Rte_NvmBlock_DigColPs_DigColPsEOL : NvM_Administration | P-Port Prototype of NvM_Administration for NVRAM Block Rte_NvmBlock_DigColPs_DigColPsEOL
      PAdmin_Rte_NvmBlock_Ap_TrqCanc_CogTrqRplComp: provided-interface=NvM_Administration  # PPort_Rte_NvmBlock_Ap_TrqCanc_CogTrqRplComp : NvM_Administration | P-Port Prototype of NvM_Administration for NVRAM Block Rte_NvmBlock_Ap_TrqCanc_CogTrqRplComp
      PAdmin_NVM_BLOCK_SER_PREVREPAIRSHOPCODE: provided-interface=NvM_Administration  # PPort_NVM_BLOCK_SER_PREVREPAIRSHOPCODE : NvM_Administration | P-Port Prototype of NvM_Administration for NVRAM Block NVM_BLOCK_SER_PREVREPAIRSHOPCODE
      PAdmin_Rte_NvmBlock_Ap_AstLmt_SteerAsstDefeat: provided-interface=NvM_Administration  # PPort_Rte_NvmBlock_Ap_AstLmt_SteerAsstDefeat : NvM_Administration | P-Port Prototype of NvM_Administration for NVRAM Block Rte_NvmBlock_Ap_AstLmt_SteerAsstDefeat
      PAdmin_Rte_NvmBlock_Ap_TSMit_TSMitDisableEOL: provided-interface=NvM_Administration  # PPort_Rte_NvmBlock_Ap_TSMit_TSMitDisableEOL : NvM_Administration | P-Port Prototype of NvM_Administration for NVRAM Block Rte_NvmBlock_Ap_TSMit_TSMitDisableEOL
      PAdmin_Rte_NvmBlock_Ap_TSMit_TSMitGainLrn: provided-interface=NvM_Administration  # PPort_Rte_NvmBlock_Ap_TSMit_TSMitGainLrn : NvM_Administration | P-Port Prototype of NvM_Administration for NVRAM Block Rte_NvmBlock_Ap_TSMit_TSMitGainLrn
      PAdmin_NVM_BLOCK_CMS_NXTRMECFLAG: provided-interface=NvM_Administration  # PPort_NVM_BLOCK_CMS_NXTRMECFLAG : NvM_Administration | P-Port Prototype of NvM_Administration for NVRAM Block NVM_BLOCK_CMS_NXTRMECFLAG
      PAdmin_NVM_BLOCK_SER_SEED_SPS: provided-interface=NvM_Administration  # PPort_NVM_BLOCK_SER_SEED_SPS : NvM_Administration | P-Port Prototype of NvM_Administration for NVRAM Block NVM_BLOCK_SER_SEED_SPS
      PAdmin_NVM_BLOCK_SER_KEY_SPS: provided-interface=NvM_Administration  # PPort_NVM_BLOCK_SER_KEY_SPS : NvM_Administration | P-Port Prototype of NvM_Administration for NVRAM Block NVM_BLOCK_SER_KEY_SPS
      PAdmin_NVM_BLOCK_SER_SEED_CPID: provided-interface=NvM_Administration  # PPort_NVM_BLOCK_SER_SEED_CPID : NvM_Administration | P-Port Prototype of NvM_Administration for NVRAM Block NVM_BLOCK_SER_SEED_CPID
      PAdmin_NVM_BLOCK_SER_KEY_CPID: provided-interface=NvM_Administration  # PPort_NVM_BLOCK_SER_KEY_CPID : NvM_Administration | P-Port Prototype of NvM_Administration for NVRAM Block NVM_BLOCK_SER_KEY_CPID
      PAdmin_NVM_BLOCK_SER_SEED_NEXTEER: provided-interface=NvM_Administration  # PPort_NVM_BLOCK_SER_SEED_NEXTEER : NvM_Administration | P-Port Prototype of NvM_Administration for NVRAM Block NVM_BLOCK_SER_SEED_NEXTEER
      PAdmin_NVM_BLOCK_SER_KEY_NEXTEER: provided-interface=NvM_Administration  # PPort_NVM_BLOCK_SER_KEY_NEXTEER : NvM_Administration | P-Port Prototype of NvM_Administration for NVRAM Block NVM_BLOCK_SER_KEY_NEXTEER
      PAdmin_Rte_NvmBlock_VehDyn_MotPosReset: provided-interface=NvM_Administration  # PPort_Rte_NvmBlock_VehDyn_MotPosReset : NvM_Administration | P-Port Prototype of NvM_Administration for NVRAM Block Rte_NvmBlock_VehDyn_MotPosReset
      PAdmin_NVM_BLOCK_SER_ECU_ID: provided-interface=NvM_Administration  # PPort_NVM_BLOCK_SER_ECU_ID : NvM_Administration | P-Port Prototype of NvM_Administration for NVRAM Block NVM_BLOCK_SER_ECU_ID
      PAdmin_NVM_BLOCK_SER_APP_NBID: provided-interface=NvM_Administration  # PPort_NVM_BLOCK_SER_APP_NBID : NvM_Administration | P-Port Prototype of NvM_Administration for NVRAM Block NVM_BLOCK_SER_APP_NBID
      PAdmin_NVM_BLOCK_SER_BCID: provided-interface=NvM_Administration  # PPort_NVM_BLOCK_SER_BCID : NvM_Administration | P-Port Prototype of NvM_Administration for NVRAM Block NVM_BLOCK_SER_BCID
      PAdmin_NVM_BLOCK_SER_SBAT: provided-interface=NvM_Administration  # PPort_NVM_BLOCK_SER_SBAT : NvM_Administration | P-Port Prototype of NvM_Administration for NVRAM Block NVM_BLOCK_SER_SBAT
      PAdmin_Rte_NvmBlock_SrlComOutput_DTCTrigSts: provided-interface=NvM_Administration  # PPort_Rte_NvmBlock_SrlComOutput_DTCTrigSts : NvM_Administration | P-Port Prototype of NvM_Administration for NVRAM Block Rte_NvmBlock_SrlComOutput_DTCTrigSts
      PAdmin_ConfigBlock: provided-interface=NvM_Administration  # PPort_ConfigBlock : NvM_Administration | P-Port Prototype of NvM_Administration for NVRAM Block ConfigBlock
  swc implementation NvM_Impl: behavior=NvM_Behavior
  internal behavior NvM_Behavior: component=NvM
    413 x operation invoked event:
      V_2_GetErrorStatus: start-on-event=GetErrorStatus, operation=PS_Rte_NvmBlock_Ap_AvgFricLrn_AvgFricLrnData.GetErrorStatus
      V_2_SetRamBlockStatus: start-on-event=SetRamBlockStatus, operation=PS_Rte_NvmBlock_Ap_AvgFricLrn_AvgFricLrnData.SetRamBlockStatus
      V_2_ReadBlock: start-on-event=ReadBlock, operation=PS_Rte_NvmBlock_Ap_AvgFricLrn_AvgFricLrnData.ReadBlock
      V_2_WriteBlock: start-on-event=WriteBlock, operation=PS_Rte_NvmBlock_Ap_AvgFricLrn_AvgFricLrnData.WriteBlock
      V_2_InvalidateNvBlock: start-on-event=InvalidateNvBlock, operation=PS_Rte_NvmBlock_Ap_AvgFricLrn_AvgFricLrnData.InvalidateNvBlock
      V_2_EraseBlock: start-on-event=EraseBlock, operation=PS_Rte_NvmBlock_Ap_AvgFricLrn_AvgFricLrnData.EraseBlock
      V_2_SetBlockProtection: start-on-event=SetBlockProtection, operation=PAdmin_Rte_NvmBlock_Ap_AvgFricLrn_AvgFricLrnData.SetBlockProtection
      V_3_GetErrorStatus: start-on-event=GetErrorStatus, operation=PS_Rte_NvmBlock_Ap_LrnEOT_LearnedEOT.GetErrorStatus
      V_3_SetRamBlockStatus: start-on-event=SetRamBlockStatus, operation=PS_Rte_NvmBlock_Ap_LrnEOT_LearnedEOT.SetRamBlockStatus
      V_3_ReadBlock: start-on-event=ReadBlock, operation=PS_Rte_NvmBlock_Ap_LrnEOT_LearnedEOT.ReadBlock
      V_3_WriteBlock: start-on-event=WriteBlock, operation=PS_Rte_NvmBlock_Ap_LrnEOT_LearnedEOT.WriteBlock
      V_3_InvalidateNvBlock: start-on-event=InvalidateNvBlock, operation=PS_Rte_NvmBlock_Ap_LrnEOT_LearnedEOT.InvalidateNvBlock
      V_3_EraseBlock: start-on-event=EraseBlock, operation=PS_Rte_NvmBlock_Ap_LrnEOT_LearnedEOT.EraseBlock
      V_3_SetBlockProtection: start-on-event=SetBlockProtection, operation=PAdmin_Rte_NvmBlock_Ap_LrnEOT_LearnedEOT.SetBlockProtection
      V_4_GetErrorStatus: start-on-event=GetErrorStatus, operation=PS_Rte_NvmBlock_Ap_TrqCanc_CogTrqCal.GetErrorStatus
      V_4_SetRamBlockStatus: start-on-event=SetRamBlockStatus, operation=PS_Rte_NvmBlock_Ap_TrqCanc_CogTrqCal.SetRamBlockStatus
      V_4_ReadBlock: start-on-event=ReadBlock, operation=PS_Rte_NvmBlock_Ap_TrqCanc_CogTrqCal.ReadBlock
      V_4_WriteBlock: start-on-event=WriteBlock, operation=PS_Rte_NvmBlock_Ap_TrqCanc_CogTrqCal.WriteBlock
      V_4_InvalidateNvBlock: start-on-event=InvalidateNvBlock, operation=PS_Rte_NvmBlock_Ap_TrqCanc_CogTrqCal.InvalidateNvBlock
      V_4_EraseBlock: start-on-event=EraseBlock, operation=PS_Rte_NvmBlock_Ap_TrqCanc_CogTrqCal.EraseBlock
      V_4_SetBlockProtection: start-on-event=SetBlockProtection, operation=PAdmin_Rte_NvmBlock_Ap_TrqCanc_CogTrqCal.SetBlockProtection
      V_5_GetErrorStatus: start-on-event=GetErrorStatus, operation=PS_Rte_NvmBlock_CmMtrCurr_CurrTempOffset.GetErrorStatus
      V_5_SetRamBlockStatus: start-on-event=SetRamBlockStatus, operation=PS_Rte_NvmBlock_CmMtrCurr_CurrTempOffset.SetRamBlockStatus
      V_5_ReadBlock: start-on-event=ReadBlock, operation=PS_Rte_NvmBlock_CmMtrCurr_CurrTempOffset.ReadBlock
      V_5_WriteBlock: start-on-event=WriteBlock, operation=PS_Rte_NvmBlock_CmMtrCurr_CurrTempOffset.WriteBlock
      V_5_InvalidateNvBlock: start-on-event=InvalidateNvBlock, operation=PS_Rte_NvmBlock_CmMtrCurr_CurrTempOffset.InvalidateNvBlock
      V_5_EraseBlock: start-on-event=EraseBlock, operation=PS_Rte_NvmBlock_CmMtrCurr_CurrTempOffset.EraseBlock
      V_5_SetBlockProtection: start-on-event=SetBlockProtection, operation=PAdmin_Rte_NvmBlock_CmMtrCurr_CurrTempOffset.SetBlockProtection
      V_6_GetErrorStatus: start-on-event=GetErrorStatus, operation=PS_Rte_NvmBlock_CmMtrCurr_ShCurrCal.GetErrorStatus
      V_6_SetRamBlockStatus: start-on-event=SetRamBlockStatus, operation=PS_Rte_NvmBlock_CmMtrCurr_ShCurrCal.SetRamBlockStatus
      V_6_ReadBlock: start-on-event=ReadBlock, operation=PS_Rte_NvmBlock_CmMtrCurr_ShCurrCal.ReadBlock
      V_6_WriteBlock: start-on-event=WriteBlock, operation=PS_Rte_NvmBlock_CmMtrCurr_ShCurrCal.WriteBlock
      V_6_InvalidateNvBlock: start-on-event=InvalidateNvBlock, operation=PS_Rte_NvmBlock_CmMtrCurr_ShCurrCal.InvalidateNvBlock
      V_6_EraseBlock: start-on-event=EraseBlock, operation=PS_Rte_NvmBlock_CmMtrCurr_ShCurrCal.EraseBlock
      V_6_SetBlockProtection: start-on-event=SetBlockProtection, operation=PAdmin_Rte_NvmBlock_CmMtrCurr_ShCurrCal.SetBlockProtection
      V_7_GetErrorStatus: start-on-event=GetErrorStatus, operation=PS_Rte_NvmBlock_CurrParamComp_EOLNomMtrParam.GetErrorStatus
      V_7_SetRamBlockStatus: start-on-event=SetRamBlockStatus, operation=PS_Rte_NvmBlock_CurrParamComp_EOLNomMtrParam.SetRamBlockStatus
      V_7_ReadBlock: start-on-event=ReadBlock, operation=PS_Rte_NvmBlock_CurrParamComp_EOLNomMtrParam.ReadBlock
      V_7_WriteBlock: start-on-event=WriteBlock, operation=PS_Rte_NvmBlock_CurrParamComp_EOLNomMtrParam.WriteBlock
      V_7_InvalidateNvBlock: start-on-event=InvalidateNvBlock, operation=PS_Rte_NvmBlock_CurrParamComp_EOLNomMtrParam.InvalidateNvBlock
      V_7_EraseBlock: start-on-event=EraseBlock, operation=PS_Rte_NvmBlock_CurrParamComp_EOLNomMtrParam.EraseBlock
      V_7_SetBlockProtection: start-on-event=SetBlockProtection, operation=PAdmin_Rte_NvmBlock_CurrParamComp_EOLNomMtrParam.SetBlockProtection
      V_8_GetErrorStatus: start-on-event=GetErrorStatus, operation=PS_Rte_NvmBlock_Polarity_Polarity_Cnt_Str.GetErrorStatus
      V_8_SetRamBlockStatus: start-on-event=SetRamBlockStatus, operation=PS_Rte_NvmBlock_Polarity_Polarity_Cnt_Str.SetRamBlockStatus
      V_8_ReadBlock: start-on-event=ReadBlock, operation=PS_Rte_NvmBlock_Polarity_Polarity_Cnt_Str.ReadBlock
      V_8_WriteBlock: start-on-event=WriteBlock, operation=PS_Rte_NvmBlock_Polarity_Polarity_Cnt_Str.WriteBlock
      V_8_InvalidateNvBlock: start-on-event=InvalidateNvBlock, operation=PS_Rte_NvmBlock_Polarity_Polarity_Cnt_Str.InvalidateNvBlock
      V_8_EraseBlock: start-on-event=EraseBlock, operation=PS_Rte_NvmBlock_Polarity_Polarity_Cnt_Str.EraseBlock
      V_8_SetBlockProtection: start-on-event=SetBlockProtection, operation=PAdmin_Rte_NvmBlock_Polarity_Polarity_Cnt_Str.SetBlockProtection
      V_9_GetErrorStatus: start-on-event=GetErrorStatus, operation=PS_Rte_NvmBlock_TrqCmdScl_TorqueCmdSF_Uls_f32.GetErrorStatus
      V_9_SetRamBlockStatus: start-on-event=SetRamBlockStatus, operation=PS_Rte_NvmBlock_TrqCmdScl_TorqueCmdSF_Uls_f32.SetRamBlockStatus
      V_9_ReadBlock: start-on-event=ReadBlock, operation=PS_Rte_NvmBlock_TrqCmdScl_TorqueCmdSF_Uls_f32.ReadBlock
      V_9_WriteBlock: start-on-event=WriteBlock, operation=PS_Rte_NvmBlock_TrqCmdScl_TorqueCmdSF_Uls_f32.WriteBlock
      V_9_InvalidateNvBlock: start-on-event=InvalidateNvBlock, operation=PS_Rte_NvmBlock_TrqCmdScl_TorqueCmdSF_Uls_f32.InvalidateNvBlock
      V_9_EraseBlock: start-on-event=EraseBlock, operation=PS_Rte_NvmBlock_TrqCmdScl_TorqueCmdSF_Uls_f32.EraseBlock
      V_9_SetBlockProtection: start-on-event=SetBlockProtection, operation=PAdmin_Rte_NvmBlock_TrqCmdScl_TorqueCmdSF_Uls_f32.SetBlockProtection
      V_10_GetErrorStatus: start-on-event=GetErrorStatus, operation=PS_Rte_NvmBlock_BatteryVoltage_OvervoltageData.GetErrorStatus
      V_10_SetRamBlockStatus: start-on-event=SetRamBlockStatus, operation=PS_Rte_NvmBlock_BatteryVoltage_OvervoltageData.SetRamBlockStatus
      V_10_ReadBlock: start-on-event=ReadBlock, operation=PS_Rte_NvmBlock_BatteryVoltage_OvervoltageData.ReadBlock
      V_10_WriteBlock: start-on-event=WriteBlock, operation=PS_Rte_NvmBlock_BatteryVoltage_OvervoltageData.WriteBlock
      V_10_InvalidateNvBlock: start-on-event=InvalidateNvBlock, operation=PS_Rte_NvmBlock_BatteryVoltage_OvervoltageData.InvalidateNvBlock
      V_10_EraseBlock: start-on-event=EraseBlock, operation=PS_Rte_NvmBlock_BatteryVoltage_OvervoltageData.EraseBlock
      V_10_SetBlockProtection: start-on-event=SetBlockProtection, operation=PAdmin_Rte_NvmBlock_BatteryVoltage_OvervoltageData.SetBlockProtection
      V_12_GetErrorStatus: start-on-event=GetErrorStatus, operation=PS_NVM_BLOCK_DIAGMGR_NTCSTRG.GetErrorStatus
      V_12_SetRamBlockStatus: start-on-event=SetRamBlockStatus, operation=PS_NVM_BLOCK_DIAGMGR_NTCSTRG.SetRamBlockStatus
      V_12_ReadBlock: start-on-event=ReadBlock, operation=PS_NVM_BLOCK_DIAGMGR_NTCSTRG.ReadBlock
      V_12_WriteBlock: start-on-event=WriteBlock, operation=PS_NVM_BLOCK_DIAGMGR_NTCSTRG.WriteBlock
      V_12_InvalidateNvBlock: start-on-event=InvalidateNvBlock, operation=PS_NVM_BLOCK_DIAGMGR_NTCSTRG.InvalidateNvBlock
      V_12_EraseBlock: start-on-event=EraseBlock, operation=PS_NVM_BLOCK_DIAGMGR_NTCSTRG.EraseBlock
      V_12_SetBlockProtection: start-on-event=SetBlockProtection, operation=PAdmin_NVM_BLOCK_DIAGMGR_NTCSTRG.SetBlockProtection
      V_13_GetErrorStatus: start-on-event=GetErrorStatus, operation=PS_NVM_BLOCK_CMS_EPSDEFEATS.GetErrorStatus
      V_13_SetRamBlockStatus: start-on-event=SetRamBlockStatus, operation=PS_NVM_BLOCK_CMS_EPSDEFEATS.SetRamBlockStatus
      V_13_ReadBlock: start-on-event=ReadBlock, operation=PS_NVM_BLOCK_CMS_EPSDEFEATS.ReadBlock
      V_13_WriteBlock: start-on-event=WriteBlock, operation=PS_NVM_BLOCK_CMS_EPSDEFEATS.WriteBlock
      V_13_InvalidateNvBlock: start-on-event=InvalidateNvBlock, operation=PS_NVM_BLOCK_CMS_EPSDEFEATS.InvalidateNvBlock
      V_13_EraseBlock: start-on-event=EraseBlock, operation=PS_NVM_BLOCK_CMS_EPSDEFEATS.EraseBlock
      V_13_SetBlockProtection: start-on-event=SetBlockProtection, operation=PAdmin_NVM_BLOCK_CMS_EPSDEFEATS.SetBlockProtection
      V_14_GetErrorStatus: start-on-event=GetErrorStatus, operation=PS_NVM_BLOCK_SER_VINDATA.GetErrorStatus
      V_14_SetRamBlockStatus: start-on-event=SetRamBlockStatus, operation=PS_NVM_BLOCK_SER_VINDATA.SetRamBlockStatus
      V_14_ReadBlock: start-on-event=ReadBlock, operation=PS_NVM_BLOCK_SER_VINDATA.ReadBlock
      V_14_WriteBlock: start-on-event=WriteBlock, operation=PS_NVM_BLOCK_SER_VINDATA.WriteBlock
      V_14_InvalidateNvBlock: start-on-event=InvalidateNvBlock, operation=PS_NVM_BLOCK_SER_VINDATA.InvalidateNvBlock
      V_14_EraseBlock: start-on-event=EraseBlock, operation=PS_NVM_BLOCK_SER_VINDATA.EraseBlock
      V_14_SetBlockProtection: start-on-event=SetBlockProtection, operation=PAdmin_NVM_BLOCK_SER_VINDATA.SetBlockProtection
      V_15_GetErrorStatus: start-on-event=GetErrorStatus, operation=PS_NVM_BLOCK_SER_SYSTEMNAME.GetErrorStatus
      V_15_SetRamBlockStatus: start-on-event=SetRamBlockStatus, operation=PS_NVM_BLOCK_SER_SYSTEMNAME.SetRamBlockStatus
      V_15_ReadBlock: start-on-event=ReadBlock, operation=PS_NVM_BLOCK_SER_SYSTEMNAME.ReadBlock
      V_15_WriteBlock: start-on-event=WriteBlock, operation=PS_NVM_BLOCK_SER_SYSTEMNAME.WriteBlock
      V_15_InvalidateNvBlock: start-on-event=InvalidateNvBlock, operation=PS_NVM_BLOCK_SER_SYSTEMNAME.InvalidateNvBlock
      V_15_EraseBlock: start-on-event=EraseBlock, operation=PS_NVM_BLOCK_SER_SYSTEMNAME.EraseBlock
      V_15_SetBlockProtection: start-on-event=SetBlockProtection, operation=PAdmin_NVM_BLOCK_SER_SYSTEMNAME.SetBlockProtection
      V_16_GetErrorStatus: start-on-event=GetErrorStatus, operation=PS_NVM_BLOCK_SER_REPAIRSHOPCODE.GetErrorStatus
      V_16_SetRamBlockStatus: start-on-event=SetRamBlockStatus, operation=PS_NVM_BLOCK_SER_REPAIRSHOPCODE.SetRamBlockStatus
      V_16_ReadBlock: start-on-event=ReadBlock, operation=PS_NVM_BLOCK_SER_REPAIRSHOPCODE.ReadBlock
      V_16_WriteBlock: start-on-event=WriteBlock, operation=PS_NVM_BLOCK_SER_REPAIRSHOPCODE.WriteBlock
      V_16_InvalidateNvBlock: start-on-event=InvalidateNvBlock, operation=PS_NVM_BLOCK_SER_REPAIRSHOPCODE.InvalidateNvBlock
      V_16_EraseBlock: start-on-event=EraseBlock, operation=PS_NVM_BLOCK_SER_REPAIRSHOPCODE.EraseBlock
      V_16_SetBlockProtection: start-on-event=SetBlockProtection, operation=PAdmin_NVM_BLOCK_SER_REPAIRSHOPCODE.SetBlockProtection
      V_17_GetErrorStatus: start-on-event=GetErrorStatus, operation=PS_NVM_BLOCK_SER_PROGDATE.GetErrorStatus
      V_17_SetRamBlockStatus: start-on-event=SetRamBlockStatus, operation=PS_NVM_BLOCK_SER_PROGDATE.SetRamBlockStatus
      V_17_ReadBlock: start-on-event=ReadBlock, operation=PS_NVM_BLOCK_SER_PROGDATE.ReadBlock
      V_17_WriteBlock: start-on-event=WriteBlock, operation=PS_NVM_BLOCK_SER_PROGDATE.WriteBlock
      V_17_InvalidateNvBlock: start-on-event=InvalidateNvBlock, operation=PS_NVM_BLOCK_SER_PROGDATE.InvalidateNvBlock
      V_17_EraseBlock: start-on-event=EraseBlock, operation=PS_NVM_BLOCK_SER_PROGDATE.EraseBlock
      V_17_SetBlockProtection: start-on-event=SetBlockProtection, operation=PAdmin_NVM_BLOCK_SER_PROGDATE.SetBlockProtection
      V_18_GetErrorStatus: start-on-event=GetErrorStatus, operation=PS_NVM_BLOCK_SER_SYSVERSCODEDDI.GetErrorStatus
      V_18_SetRamBlockStatus: start-on-event=SetRamBlockStatus, operation=PS_NVM_BLOCK_SER_SYSVERSCODEDDI.SetRamBlockStatus
      V_18_ReadBlock: start-on-event=ReadBlock, operation=PS_NVM_BLOCK_SER_SYSVERSCODEDDI.ReadBlock
      V_18_WriteBlock: start-on-event=WriteBlock, operation=PS_NVM_BLOCK_SER_SYSVERSCODEDDI.WriteBlock
      V_18_InvalidateNvBlock: start-on-event=InvalidateNvBlock, operation=PS_NVM_BLOCK_SER_SYSVERSCODEDDI.InvalidateNvBlock
      V_18_EraseBlock: start-on-event=EraseBlock, operation=PS_NVM_BLOCK_SER_SYSVERSCODEDDI.EraseBlock
      V_18_SetBlockProtection: start-on-event=SetBlockProtection, operation=PAdmin_NVM_BLOCK_SER_SYSVERSCODEDDI.SetBlockProtection
      V_19_GetErrorStatus: start-on-event=GetErrorStatus, operation=PS_NVM_BLOCK_SER_CUSTMEC.GetErrorStatus
      V_19_SetRamBlockStatus: start-on-event=SetRamBlockStatus, operation=PS_NVM_BLOCK_SER_CUSTMEC.SetRamBlockStatus
      V_19_ReadBlock: start-on-event=ReadBlock, operation=PS_NVM_BLOCK_SER_CUSTMEC.ReadBlock
      V_19_WriteBlock: start-on-event=WriteBlock, operation=PS_NVM_BLOCK_SER_CUSTMEC.WriteBlock
      V_19_InvalidateNvBlock: start-on-event=InvalidateNvBlock, operation=PS_NVM_BLOCK_SER_CUSTMEC.InvalidateNvBlock
      V_19_EraseBlock: start-on-event=EraseBlock, operation=PS_NVM_BLOCK_SER_CUSTMEC.EraseBlock
      V_19_SetBlockProtection: start-on-event=SetBlockProtection, operation=PAdmin_NVM_BLOCK_SER_CUSTMEC.SetBlockProtection
      V_20_GetErrorStatus: start-on-event=GetErrorStatus, operation=PS_NVM_BLOCK_SER_MANFTRAC.GetErrorStatus
      V_20_SetRamBlockStatus: start-on-event=SetRamBlockStatus, operation=PS_NVM_BLOCK_SER_MANFTRAC.SetRamBlockStatus
      V_20_ReadBlock: start-on-event=ReadBlock, operation=PS_NVM_BLOCK_SER_MANFTRAC.ReadBlock
      V_20_WriteBlock: start-on-event=WriteBlock, operation=PS_NVM_BLOCK_SER_MANFTRAC.WriteBlock
      V_20_InvalidateNvBlock: start-on-event=InvalidateNvBlock, operation=PS_NVM_BLOCK_SER_MANFTRAC.InvalidateNvBlock
      V_20_EraseBlock: start-on-event=EraseBlock, operation=PS_NVM_BLOCK_SER_MANFTRAC.EraseBlock
      V_20_SetBlockProtection: start-on-event=SetBlockProtection, operation=PAdmin_NVM_BLOCK_SER_MANFTRAC.SetBlockProtection
      V_21_GetErrorStatus: start-on-event=GetErrorStatus, operation=PS_NVM_BLOCK_SER_ENDMODELPN.GetErrorStatus
      V_21_SetRamBlockStatus: start-on-event=SetRamBlockStatus, operation=PS_NVM_BLOCK_SER_ENDMODELPN.SetRamBlockStatus
      V_21_ReadBlock: start-on-event=ReadBlock, operation=PS_NVM_BLOCK_SER_ENDMODELPN.ReadBlock
      V_21_WriteBlock: start-on-event=WriteBlock, operation=PS_NVM_BLOCK_SER_ENDMODELPN.WriteBlock
      V_21_InvalidateNvBlock: start-on-event=InvalidateNvBlock, operation=PS_NVM_BLOCK_SER_ENDMODELPN.InvalidateNvBlock
      V_21_EraseBlock: start-on-event=EraseBlock, operation=PS_NVM_BLOCK_SER_ENDMODELPN.EraseBlock
      V_21_SetBlockProtection: start-on-event=SetBlockProtection, operation=PAdmin_NVM_BLOCK_SER_ENDMODELPN.SetBlockProtection
      V_22_GetErrorStatus: start-on-event=GetErrorStatus, operation=PS_NVM_BLOCK_SER_ENDMODELPNAC.GetErrorStatus
      V_22_SetRamBlockStatus: start-on-event=SetRamBlockStatus, operation=PS_NVM_BLOCK_SER_ENDMODELPNAC.SetRamBlockStatus
      V_22_ReadBlock: start-on-event=ReadBlock, operation=PS_NVM_BLOCK_SER_ENDMODELPNAC.ReadBlock
      V_22_WriteBlock: start-on-event=WriteBlock, operation=PS_NVM_BLOCK_SER_ENDMODELPNAC.WriteBlock
      V_22_InvalidateNvBlock: start-on-event=InvalidateNvBlock, operation=PS_NVM_BLOCK_SER_ENDMODELPNAC.InvalidateNvBlock
      V_22_EraseBlock: start-on-event=EraseBlock, operation=PS_NVM_BLOCK_SER_ENDMODELPNAC.EraseBlock
      V_22_SetBlockProtection: start-on-event=SetBlockProtection, operation=PAdmin_NVM_BLOCK_SER_ENDMODELPNAC.SetBlockProtection
      V_23_GetErrorStatus: start-on-event=GetErrorStatus, operation=PS_NVM_BLOCK_SER_SEED_DEPRECATED.GetErrorStatus
      V_23_SetRamBlockStatus: start-on-event=SetRamBlockStatus, operation=PS_NVM_BLOCK_SER_SEED_DEPRECATED.SetRamBlockStatus
      V_23_ReadBlock: start-on-event=ReadBlock, operation=PS_NVM_BLOCK_SER_SEED_DEPRECATED.ReadBlock
      V_23_WriteBlock: start-on-event=WriteBlock, operation=PS_NVM_BLOCK_SER_SEED_DEPRECATED.WriteBlock
      V_23_InvalidateNvBlock: start-on-event=InvalidateNvBlock, operation=PS_NVM_BLOCK_SER_SEED_DEPRECATED.InvalidateNvBlock
      V_23_EraseBlock: start-on-event=EraseBlock, operation=PS_NVM_BLOCK_SER_SEED_DEPRECATED.EraseBlock
      V_23_SetBlockProtection: start-on-event=SetBlockProtection, operation=PAdmin_NVM_BLOCK_SER_SEED_DEPRECATED.SetBlockProtection
      V_24_GetErrorStatus: start-on-event=GetErrorStatus, operation=PS_NVM_BLOCK_SER_KEY_DEPRECATED.GetErrorStatus
      V_24_SetRamBlockStatus: start-on-event=SetRamBlockStatus, operation=PS_NVM_BLOCK_SER_KEY_DEPRECATED.SetRamBlockStatus
      V_24_ReadBlock: start-on-event=ReadBlock, operation=PS_NVM_BLOCK_SER_KEY_DEPRECATED.ReadBlock
      V_24_WriteBlock: start-on-event=WriteBlock, operation=PS_NVM_BLOCK_SER_KEY_DEPRECATED.WriteBlock
      V_24_InvalidateNvBlock: start-on-event=InvalidateNvBlock, operation=PS_NVM_BLOCK_SER_KEY_DEPRECATED.InvalidateNvBlock
      V_24_EraseBlock: start-on-event=EraseBlock, operation=PS_NVM_BLOCK_SER_KEY_DEPRECATED.EraseBlock
      V_24_SetBlockProtection: start-on-event=SetBlockProtection, operation=PAdmin_NVM_BLOCK_SER_KEY_DEPRECATED.SetBlockProtection
      V_25_GetErrorStatus: start-on-event=GetErrorStatus, operation=PS_NVM_BLOCK_SER_DATAUNIVNUMSYSID.GetErrorStatus
      V_25_SetRamBlockStatus: start-on-event=SetRamBlockStatus, operation=PS_NVM_BLOCK_SER_DATAUNIVNUMSYSID.SetRamBlockStatus
      V_25_ReadBlock: start-on-event=ReadBlock, operation=PS_NVM_BLOCK_SER_DATAUNIVNUMSYSID.ReadBlock
      V_25_WriteBlock: start-on-event=WriteBlock, operation=PS_NVM_BLOCK_SER_DATAUNIVNUMSYSID.WriteBlock
      V_25_InvalidateNvBlock: start-on-event=InvalidateNvBlock, operation=PS_NVM_BLOCK_SER_DATAUNIVNUMSYSID.InvalidateNvBlock
      V_25_EraseBlock: start-on-event=EraseBlock, operation=PS_NVM_BLOCK_SER_DATAUNIVNUMSYSID.EraseBlock
      V_25_SetBlockProtection: start-on-event=SetBlockProtection, operation=PAdmin_NVM_BLOCK_SER_DATAUNIVNUMSYSID.SetBlockProtection
      V_26_GetErrorStatus: start-on-event=GetErrorStatus, operation=PS_NVM_BLOCK_CMS_NXTRWIRSELECT.GetErrorStatus
      V_26_SetRamBlockStatus: start-on-event=SetRamBlockStatus, operation=PS_NVM_BLOCK_CMS_NXTRWIRSELECT.SetRamBlockStatus
      V_26_ReadBlock: start-on-event=ReadBlock, operation=PS_NVM_BLOCK_CMS_NXTRWIRSELECT.ReadBlock
      V_26_WriteBlock: start-on-event=WriteBlock, operation=PS_NVM_BLOCK_CMS_NXTRWIRSELECT.WriteBlock
      V_26_InvalidateNvBlock: start-on-event=InvalidateNvBlock, operation=PS_NVM_BLOCK_CMS_NXTRWIRSELECT.InvalidateNvBlock
      V_26_EraseBlock: start-on-event=EraseBlock, operation=PS_NVM_BLOCK_CMS_NXTRWIRSELECT.EraseBlock
      V_26_SetBlockProtection: start-on-event=SetBlockProtection, operation=PAdmin_NVM_BLOCK_CMS_NXTRWIRSELECT.SetBlockProtection
      V_27_GetErrorStatus: start-on-event=GetErrorStatus, operation=PS_NVM_BLOCK_CMS_NXTRMEC.GetErrorStatus
      V_27_SetRamBlockStatus: start-on-event=SetRamBlockStatus, operation=PS_NVM_BLOCK_CMS_NXTRMEC.SetRamBlockStatus
      V_27_ReadBlock: start-on-event=ReadBlock, operation=PS_NVM_BLOCK_CMS_NXTRMEC.ReadBlock
      V_27_WriteBlock: start-on-event=WriteBlock, operation=PS_NVM_BLOCK_CMS_NXTRMEC.WriteBlock
      V_27_InvalidateNvBlock: start-on-event=InvalidateNvBlock, operation=PS_NVM_BLOCK_CMS_NXTRMEC.InvalidateNvBlock
      V_27_EraseBlock: start-on-event=EraseBlock, operation=PS_NVM_BLOCK_CMS_NXTRMEC.EraseBlock
      V_27_SetBlockProtection: start-on-event=SetBlockProtection, operation=PAdmin_NVM_BLOCK_CMS_NXTRMEC.SetBlockProtection
      V_28_GetErrorStatus: start-on-event=GetErrorStatus, operation=PS_NVM_BLOCK_CMS_ECUSRLNUM.GetErrorStatus
      V_28_SetRamBlockStatus: start-on-event=SetRamBlockStatus, operation=PS_NVM_BLOCK_CMS_ECUSRLNUM.SetRamBlockStatus
      V_28_ReadBlock: start-on-event=ReadBlock, operation=PS_NVM_BLOCK_CMS_ECUSRLNUM.ReadBlock
      V_28_WriteBlock: start-on-event=WriteBlock, operation=PS_NVM_BLOCK_CMS_ECUSRLNUM.WriteBlock
      V_28_InvalidateNvBlock: start-on-event=InvalidateNvBlock, operation=PS_NVM_BLOCK_CMS_ECUSRLNUM.InvalidateNvBlock
      V_28_EraseBlock: start-on-event=EraseBlock, operation=PS_NVM_BLOCK_CMS_ECUSRLNUM.EraseBlock
      V_28_SetBlockProtection: start-on-event=SetBlockProtection, operation=PAdmin_NVM_BLOCK_CMS_ECUSRLNUM.SetBlockProtection
      V_29_GetErrorStatus: start-on-event=GetErrorStatus, operation=PS_NVM_BLOCK_CMS_EPSSRLNUM.GetErrorStatus
      V_29_SetRamBlockStatus: start-on-event=SetRamBlockStatus, operation=PS_NVM_BLOCK_CMS_EPSSRLNUM.SetRamBlockStatus
      V_29_ReadBlock: start-on-event=ReadBlock, operation=PS_NVM_BLOCK_CMS_EPSSRLNUM.ReadBlock
      V_29_WriteBlock: start-on-event=WriteBlock, operation=PS_NVM_BLOCK_CMS_EPSSRLNUM.WriteBlock
      V_29_InvalidateNvBlock: start-on-event=InvalidateNvBlock, operation=PS_NVM_BLOCK_CMS_EPSSRLNUM.InvalidateNvBlock
      V_29_EraseBlock: start-on-event=EraseBlock, operation=PS_NVM_BLOCK_CMS_EPSSRLNUM.EraseBlock
      V_29_SetBlockProtection: start-on-event=SetBlockProtection, operation=PAdmin_NVM_BLOCK_CMS_EPSSRLNUM.SetBlockProtection
      V_30_GetErrorStatus: start-on-event=GetErrorStatus, operation=PS_NVM_BLOCK_CMS_ECUHWPN.GetErrorStatus
      V_30_SetRamBlockStatus: start-on-event=SetRamBlockStatus, operation=PS_NVM_BLOCK_CMS_ECUHWPN.SetRamBlockStatus
      V_30_ReadBlock: start-on-event=ReadBlock, operation=PS_NVM_BLOCK_CMS_ECUHWPN.ReadBlock
      V_30_WriteBlock: start-on-event=WriteBlock, operation=PS_NVM_BLOCK_CMS_ECUHWPN.WriteBlock
      V_30_InvalidateNvBlock: start-on-event=InvalidateNvBlock, operation=PS_NVM_BLOCK_CMS_ECUHWPN.InvalidateNvBlock
      V_30_EraseBlock: start-on-event=EraseBlock, operation=PS_NVM_BLOCK_CMS_ECUHWPN.EraseBlock
      V_30_SetBlockProtection: start-on-event=SetBlockProtection, operation=PAdmin_NVM_BLOCK_CMS_ECUHWPN.SetBlockProtection
      V_31_GetErrorStatus: start-on-event=GetErrorStatus, operation=PS_NVM_BLOCK_CMS_NXTRMANUFSCRATCHPAD.GetErrorStatus
      V_31_SetRamBlockStatus: start-on-event=SetRamBlockStatus, operation=PS_NVM_BLOCK_CMS_NXTRMANUFSCRATCHPAD.SetRamBlockStatus
      V_31_ReadBlock: start-on-event=ReadBlock, operation=PS_NVM_BLOCK_CMS_NXTRMANUFSCRATCHPAD.ReadBlock
      V_31_WriteBlock: start-on-event=WriteBlock, operation=PS_NVM_BLOCK_CMS_NXTRMANUFSCRATCHPAD.WriteBlock
      V_31_InvalidateNvBlock: start-on-event=InvalidateNvBlock, operation=PS_NVM_BLOCK_CMS_NXTRMANUFSCRATCHPAD.InvalidateNvBlock
      V_31_EraseBlock: start-on-event=EraseBlock, operation=PS_NVM_BLOCK_CMS_NXTRMANUFSCRATCHPAD.EraseBlock
      V_31_SetBlockProtection: start-on-event=SetBlockProtection, operation=PAdmin_NVM_BLOCK_CMS_NXTRMANUFSCRATCHPAD.SetBlockProtection
      V_32_GetErrorStatus: start-on-event=GetErrorStatus, operation=PS_NVM_BLOCK_CMS_IGNCNTR.GetErrorStatus
      V_32_SetRamBlockStatus: start-on-event=SetRamBlockStatus, operation=PS_NVM_BLOCK_CMS_IGNCNTR.SetRamBlockStatus
      V_32_ReadBlock: start-on-event=ReadBlock, operation=PS_NVM_BLOCK_CMS_IGNCNTR.ReadBlock
      V_32_WriteBlock: start-on-event=WriteBlock, operation=PS_NVM_BLOCK_CMS_IGNCNTR.WriteBlock
      V_32_InvalidateNvBlock: start-on-event=InvalidateNvBlock, operation=PS_NVM_BLOCK_CMS_IGNCNTR.InvalidateNvBlock
      V_32_EraseBlock: start-on-event=EraseBlock, operation=PS_NVM_BLOCK_CMS_IGNCNTR.EraseBlock
      V_32_SetBlockProtection: start-on-event=SetBlockProtection, operation=PAdmin_NVM_BLOCK_CMS_IGNCNTR.SetBlockProtection
      V_33_GetErrorStatus: start-on-event=GetErrorStatus, operation=PS_NVM_BLOCK_STAMD_TYPEH.GetErrorStatus
      V_33_SetRamBlockStatus: start-on-event=SetRamBlockStatus, operation=PS_NVM_BLOCK_STAMD_TYPEH.SetRamBlockStatus
      V_33_ReadBlock: start-on-event=ReadBlock, operation=PS_NVM_BLOCK_STAMD_TYPEH.ReadBlock
      V_33_WriteBlock: start-on-event=WriteBlock, operation=PS_NVM_BLOCK_STAMD_TYPEH.WriteBlock
      V_33_InvalidateNvBlock: start-on-event=InvalidateNvBlock, operation=PS_NVM_BLOCK_STAMD_TYPEH.InvalidateNvBlock
      V_33_EraseBlock: start-on-event=EraseBlock, operation=PS_NVM_BLOCK_STAMD_TYPEH.EraseBlock
      V_33_SetBlockProtection: start-on-event=SetBlockProtection, operation=PAdmin_NVM_BLOCK_STAMD_TYPEH.SetBlockProtection
      V_34_GetErrorStatus: start-on-event=GetErrorStatus, operation=PS_NVM_BLOCK_STAMD_CLOSECHECK.GetErrorStatus
      V_34_SetRamBlockStatus: start-on-event=SetRamBlockStatus, operation=PS_NVM_BLOCK_STAMD_CLOSECHECK.SetRamBlockStatus
      V_34_ReadBlock: start-on-event=ReadBlock, operation=PS_NVM_BLOCK_STAMD_CLOSECHECK.ReadBlock
      V_34_WriteBlock: start-on-event=WriteBlock, operation=PS_NVM_BLOCK_STAMD_CLOSECHECK.WriteBlock
      V_34_InvalidateNvBlock: start-on-event=InvalidateNvBlock, operation=PS_NVM_BLOCK_STAMD_CLOSECHECK.InvalidateNvBlock
      V_34_EraseBlock: start-on-event=EraseBlock, operation=PS_NVM_BLOCK_STAMD_CLOSECHECK.EraseBlock
      V_34_SetBlockProtection: start-on-event=SetBlockProtection, operation=PAdmin_NVM_BLOCK_STAMD_CLOSECHECK.SetBlockProtection
      V_35_GetErrorStatus: start-on-event=GetErrorStatus, operation=PS_NVM_BLOCK_DIAGMGR_BLACKBOX.GetErrorStatus
      V_35_SetRamBlockStatus: start-on-event=SetRamBlockStatus, operation=PS_NVM_BLOCK_DIAGMGR_BLACKBOX.SetRamBlockStatus
      V_35_ReadBlock: start-on-event=ReadBlock, operation=PS_NVM_BLOCK_DIAGMGR_BLACKBOX.ReadBlock
      V_35_WriteBlock: start-on-event=WriteBlock, operation=PS_NVM_BLOCK_DIAGMGR_BLACKBOX.WriteBlock
      V_35_InvalidateNvBlock: start-on-event=InvalidateNvBlock, operation=PS_NVM_BLOCK_DIAGMGR_BLACKBOX.InvalidateNvBlock
      V_35_EraseBlock: start-on-event=EraseBlock, operation=PS_NVM_BLOCK_DIAGMGR_BLACKBOX.EraseBlock
      V_35_SetBlockProtection: start-on-event=SetBlockProtection, operation=PAdmin_NVM_BLOCK_DIAGMGR_BLACKBOX.SetBlockProtection
      V_36_GetErrorStatus: start-on-event=GetErrorStatus, operation=PS_Rte_NvmBlock_Sa_DigHwTrqSENT_DigTrqTrim.GetErrorStatus
      V_36_SetRamBlockStatus: start-on-event=SetRamBlockStatus, operation=PS_Rte_NvmBlock_Sa_DigHwTrqSENT_DigTrqTrim.SetRamBlockStatus
      V_36_ReadBlock: start-on-event=ReadBlock, operation=PS_Rte_NvmBlock_Sa_DigHwTrqSENT_DigTrqTrim.ReadBlock
      V_36_WriteBlock: start-on-event=WriteBlock, operation=PS_Rte_NvmBlock_Sa_DigHwTrqSENT_DigTrqTrim.WriteBlock
      V_36_InvalidateNvBlock: start-on-event=InvalidateNvBlock, operation=PS_Rte_NvmBlock_Sa_DigHwTrqSENT_DigTrqTrim.InvalidateNvBlock
      V_36_EraseBlock: start-on-event=EraseBlock, operation=PS_Rte_NvmBlock_Sa_DigHwTrqSENT_DigTrqTrim.EraseBlock
      V_36_SetBlockProtection: start-on-event=SetBlockProtection, operation=PAdmin_Rte_NvmBlock_Sa_DigHwTrqSENT_DigTrqTrim.SetBlockProtection
      V_37_GetErrorStatus: start-on-event=GetErrorStatus, operation=PS_Rte_NvmBlock_Sa_DigMSB_DigMSBEOLData.GetErrorStatus
      V_37_SetRamBlockStatus: start-on-event=SetRamBlockStatus, operation=PS_Rte_NvmBlock_Sa_DigMSB_DigMSBEOLData.SetRamBlockStatus
      V_37_ReadBlock: start-on-event=ReadBlock, operation=PS_Rte_NvmBlock_Sa_DigMSB_DigMSBEOLData.ReadBlock
      V_37_WriteBlock: start-on-event=WriteBlock, operation=PS_Rte_NvmBlock_Sa_DigMSB_DigMSBEOLData.WriteBlock
      V_37_InvalidateNvBlock: start-on-event=InvalidateNvBlock, operation=PS_Rte_NvmBlock_Sa_DigMSB_DigMSBEOLData.InvalidateNvBlock
      V_37_EraseBlock: start-on-event=EraseBlock, operation=PS_Rte_NvmBlock_Sa_DigMSB_DigMSBEOLData.EraseBlock
      V_37_SetBlockProtection: start-on-event=SetBlockProtection, operation=PAdmin_Rte_NvmBlock_Sa_DigMSB_DigMSBEOLData.SetBlockProtection
      V_38_GetErrorStatus: start-on-event=GetErrorStatus, operation=PS_NVM_BLOCK_SER_BASEMODELPN.GetErrorStatus
      V_38_SetRamBlockStatus: start-on-event=SetRamBlockStatus, operation=PS_NVM_BLOCK_SER_BASEMODELPN.SetRamBlockStatus
      V_38_ReadBlock: start-on-event=ReadBlock, operation=PS_NVM_BLOCK_SER_BASEMODELPN.ReadBlock
      V_38_WriteBlock: start-on-event=WriteBlock, operation=PS_NVM_BLOCK_SER_BASEMODELPN.WriteBlock
      V_38_InvalidateNvBlock: start-on-event=InvalidateNvBlock, operation=PS_NVM_BLOCK_SER_BASEMODELPN.InvalidateNvBlock
      V_38_EraseBlock: start-on-event=EraseBlock, operation=PS_NVM_BLOCK_SER_BASEMODELPN.EraseBlock
      V_38_SetBlockProtection: start-on-event=SetBlockProtection, operation=PAdmin_NVM_BLOCK_SER_BASEMODELPN.SetBlockProtection
      V_39_GetErrorStatus: start-on-event=GetErrorStatus, operation=PS_NVM_BLOCK_SER_BASEMODELPNAC.GetErrorStatus
      V_39_SetRamBlockStatus: start-on-event=SetRamBlockStatus, operation=PS_NVM_BLOCK_SER_BASEMODELPNAC.SetRamBlockStatus
      V_39_ReadBlock: start-on-event=ReadBlock, operation=PS_NVM_BLOCK_SER_BASEMODELPNAC.ReadBlock
      V_39_WriteBlock: start-on-event=WriteBlock, operation=PS_NVM_BLOCK_SER_BASEMODELPNAC.WriteBlock
      V_39_InvalidateNvBlock: start-on-event=InvalidateNvBlock, operation=PS_NVM_BLOCK_SER_BASEMODELPNAC.InvalidateNvBlock
      V_39_EraseBlock: start-on-event=EraseBlock, operation=PS_NVM_BLOCK_SER_BASEMODELPNAC.EraseBlock
      V_39_SetBlockProtection: start-on-event=SetBlockProtection, operation=PAdmin_NVM_BLOCK_SER_BASEMODELPNAC.SetBlockProtection
      V_40_GetErrorStatus: start-on-event=GetErrorStatus, operation=PS_NVM_BLOCK_SER_CALPRGFLAG.GetErrorStatus
      V_40_SetRamBlockStatus: start-on-event=SetRamBlockStatus, operation=PS_NVM_BLOCK_SER_CALPRGFLAG.SetRamBlockStatus
      V_40_ReadBlock: start-on-event=ReadBlock, operation=PS_NVM_BLOCK_SER_CALPRGFLAG.ReadBlock
      V_40_WriteBlock: start-on-event=WriteBlock, operation=PS_NVM_BLOCK_SER_CALPRGFLAG.WriteBlock
      V_40_InvalidateNvBlock: start-on-event=InvalidateNvBlock, operation=PS_NVM_BLOCK_SER_CALPRGFLAG.InvalidateNvBlock
      V_40_EraseBlock: start-on-event=EraseBlock, operation=PS_NVM_BLOCK_SER_CALPRGFLAG.EraseBlock
      V_40_SetBlockProtection: start-on-event=SetBlockProtection, operation=PAdmin_NVM_BLOCK_SER_CALPRGFLAG.SetBlockProtection
      V_41_GetErrorStatus: start-on-event=GetErrorStatus, operation=PS_Rte_NvmBlock_AbsHwPos_EOLVehCntrOffset.GetErrorStatus
      V_41_SetRamBlockStatus: start-on-event=SetRamBlockStatus, operation=PS_Rte_NvmBlock_AbsHwPos_EOLVehCntrOffset.SetRamBlockStatus
      V_41_ReadBlock: start-on-event=ReadBlock, operation=PS_Rte_NvmBlock_AbsHwPos_EOLVehCntrOffset.ReadBlock
      V_41_WriteBlock: start-on-event=WriteBlock, operation=PS_Rte_NvmBlock_AbsHwPos_EOLVehCntrOffset.WriteBlock
      V_41_InvalidateNvBlock: start-on-event=InvalidateNvBlock, operation=PS_Rte_NvmBlock_AbsHwPos_EOLVehCntrOffset.InvalidateNvBlock
      V_41_EraseBlock: start-on-event=EraseBlock, operation=PS_Rte_NvmBlock_AbsHwPos_EOLVehCntrOffset.EraseBlock
      V_41_SetBlockProtection: start-on-event=SetBlockProtection, operation=PAdmin_Rte_NvmBlock_AbsHwPos_EOLVehCntrOffset.SetBlockProtection
      V_42_GetErrorStatus: start-on-event=GetErrorStatus, operation=PS_Rte_NvmBlock_DigColPs_DigColPsEOL.GetErrorStatus
      V_42_SetRamBlockStatus: start-on-event=SetRamBlockStatus, operation=PS_Rte_NvmBlock_DigColPs_DigColPsEOL.SetRamBlockStatus
      V_42_ReadBlock: start-on-event=ReadBlock, operation=PS_Rte_NvmBlock_DigColPs_DigColPsEOL.ReadBlock
      V_42_WriteBlock: start-on-event=WriteBlock, operation=PS_Rte_NvmBlock_DigColPs_DigColPsEOL.WriteBlock
      V_42_InvalidateNvBlock: start-on-event=InvalidateNvBlock, operation=PS_Rte_NvmBlock_DigColPs_DigColPsEOL.InvalidateNvBlock
      V_42_EraseBlock: start-on-event=EraseBlock, operation=PS_Rte_NvmBlock_DigColPs_DigColPsEOL.EraseBlock
      V_42_SetBlockProtection: start-on-event=SetBlockProtection, operation=PAdmin_Rte_NvmBlock_DigColPs_DigColPsEOL.SetBlockProtection
      V_43_GetErrorStatus: start-on-event=GetErrorStatus, operation=PS_Rte_NvmBlock_Ap_TrqCanc_CogTrqRplComp.GetErrorStatus
      V_43_SetRamBlockStatus: start-on-event=SetRamBlockStatus, operation=PS_Rte_NvmBlock_Ap_TrqCanc_CogTrqRplComp.SetRamBlockStatus
      V_43_ReadBlock: start-on-event=ReadBlock, operation=PS_Rte_NvmBlock_Ap_TrqCanc_CogTrqRplComp.ReadBlock
      V_43_WriteBlock: start-on-event=WriteBlock, operation=PS_Rte_NvmBlock_Ap_TrqCanc_CogTrqRplComp.WriteBlock
      V_43_InvalidateNvBlock: start-on-event=InvalidateNvBlock, operation=PS_Rte_NvmBlock_Ap_TrqCanc_CogTrqRplComp.InvalidateNvBlock
      V_43_EraseBlock: start-on-event=EraseBlock, operation=PS_Rte_NvmBlock_Ap_TrqCanc_CogTrqRplComp.EraseBlock
      V_43_SetBlockProtection: start-on-event=SetBlockProtection, operation=PAdmin_Rte_NvmBlock_Ap_TrqCanc_CogTrqRplComp.SetBlockProtection
      V_44_GetErrorStatus: start-on-event=GetErrorStatus, operation=PS_NVM_BLOCK_SER_PREVREPAIRSHOPCODE.GetErrorStatus
      V_44_SetRamBlockStatus: start-on-event=SetRamBlockStatus, operation=PS_NVM_BLOCK_SER_PREVREPAIRSHOPCODE.SetRamBlockStatus
      V_44_ReadBlock: start-on-event=ReadBlock, operation=PS_NVM_BLOCK_SER_PREVREPAIRSHOPCODE.ReadBlock
      V_44_WriteBlock: start-on-event=WriteBlock, operation=PS_NVM_BLOCK_SER_PREVREPAIRSHOPCODE.WriteBlock
      V_44_InvalidateNvBlock: start-on-event=InvalidateNvBlock, operation=PS_NVM_BLOCK_SER_PREVREPAIRSHOPCODE.InvalidateNvBlock
      V_44_EraseBlock: start-on-event=EraseBlock, operation=PS_NVM_BLOCK_SER_PREVREPAIRSHOPCODE.EraseBlock
      V_44_SetBlockProtection: start-on-event=SetBlockProtection, operation=PAdmin_NVM_BLOCK_SER_PREVREPAIRSHOPCODE.SetBlockProtection
      V_45_GetErrorStatus: start-on-event=GetErrorStatus, operation=PS_Rte_NvmBlock_Ap_AstLmt_SteerAsstDefeat.GetErrorStatus
      V_45_SetRamBlockStatus: start-on-event=SetRamBlockStatus, operation=PS_Rte_NvmBlock_Ap_AstLmt_SteerAsstDefeat.SetRamBlockStatus
      V_45_ReadBlock: start-on-event=ReadBlock, operation=PS_Rte_NvmBlock_Ap_AstLmt_SteerAsstDefeat.ReadBlock
      V_45_WriteBlock: start-on-event=WriteBlock, operation=PS_Rte_NvmBlock_Ap_AstLmt_SteerAsstDefeat.WriteBlock
      V_45_InvalidateNvBlock: start-on-event=InvalidateNvBlock, operation=PS_Rte_NvmBlock_Ap_AstLmt_SteerAsstDefeat.InvalidateNvBlock
      V_45_EraseBlock: start-on-event=EraseBlock, operation=PS_Rte_NvmBlock_Ap_AstLmt_SteerAsstDefeat.EraseBlock
      V_45_SetBlockProtection: start-on-event=SetBlockProtection, operation=PAdmin_Rte_NvmBlock_Ap_AstLmt_SteerAsstDefeat.SetBlockProtection
      V_46_GetErrorStatus: start-on-event=GetErrorStatus, operation=PS_Rte_NvmBlock_Ap_TSMit_TSMitDisableEOL.GetErrorStatus
      V_46_SetRamBlockStatus: start-on-event=SetRamBlockStatus, operation=PS_Rte_NvmBlock_Ap_TSMit_TSMitDisableEOL.SetRamBlockStatus
      V_46_ReadBlock: start-on-event=ReadBlock, operation=PS_Rte_NvmBlock_Ap_TSMit_TSMitDisableEOL.ReadBlock
      V_46_WriteBlock: start-on-event=WriteBlock, operation=PS_Rte_NvmBlock_Ap_TSMit_TSMitDisableEOL.WriteBlock
      V_46_InvalidateNvBlock: start-on-event=InvalidateNvBlock, operation=PS_Rte_NvmBlock_Ap_TSMit_TSMitDisableEOL.InvalidateNvBlock
      V_46_EraseBlock: start-on-event=EraseBlock, operation=PS_Rte_NvmBlock_Ap_TSMit_TSMitDisableEOL.EraseBlock
      V_46_SetBlockProtection: start-on-event=SetBlockProtection, operation=PAdmin_Rte_NvmBlock_Ap_TSMit_TSMitDisableEOL.SetBlockProtection
      V_47_GetErrorStatus: start-on-event=GetErrorStatus, operation=PS_Rte_NvmBlock_Ap_TSMit_TSMitGainLrn.GetErrorStatus
      V_47_SetRamBlockStatus: start-on-event=SetRamBlockStatus, operation=PS_Rte_NvmBlock_Ap_TSMit_TSMitGainLrn.SetRamBlockStatus
      V_47_ReadBlock: start-on-event=ReadBlock, operation=PS_Rte_NvmBlock_Ap_TSMit_TSMitGainLrn.ReadBlock
      V_47_WriteBlock: start-on-event=WriteBlock, operation=PS_Rte_NvmBlock_Ap_TSMit_TSMitGainLrn.WriteBlock
      V_47_InvalidateNvBlock: start-on-event=InvalidateNvBlock, operation=PS_Rte_NvmBlock_Ap_TSMit_TSMitGainLrn.InvalidateNvBlock
      V_47_EraseBlock: start-on-event=EraseBlock, operation=PS_Rte_NvmBlock_Ap_TSMit_TSMitGainLrn.EraseBlock
      V_47_SetBlockProtection: start-on-event=SetBlockProtection, operation=PAdmin_Rte_NvmBlock_Ap_TSMit_TSMitGainLrn.SetBlockProtection
      V_48_GetErrorStatus: start-on-event=GetErrorStatus, operation=PS_NVM_BLOCK_CMS_NXTRMECFLAG.GetErrorStatus
      V_48_SetRamBlockStatus: start-on-event=SetRamBlockStatus, operation=PS_NVM_BLOCK_CMS_NXTRMECFLAG.SetRamBlockStatus
      V_48_ReadBlock: start-on-event=ReadBlock, operation=PS_NVM_BLOCK_CMS_NXTRMECFLAG.ReadBlock
      V_48_WriteBlock: start-on-event=WriteBlock, operation=PS_NVM_BLOCK_CMS_NXTRMECFLAG.WriteBlock
      V_48_InvalidateNvBlock: start-on-event=InvalidateNvBlock, operation=PS_NVM_BLOCK_CMS_NXTRMECFLAG.InvalidateNvBlock
      V_48_EraseBlock: start-on-event=EraseBlock, operation=PS_NVM_BLOCK_CMS_NXTRMECFLAG.EraseBlock
      V_48_SetBlockProtection: start-on-event=SetBlockProtection, operation=PAdmin_NVM_BLOCK_CMS_NXTRMECFLAG.SetBlockProtection
      V_49_GetErrorStatus: start-on-event=GetErrorStatus, operation=PS_NVM_BLOCK_SER_SEED_SPS.GetErrorStatus
      V_49_SetRamBlockStatus: start-on-event=SetRamBlockStatus, operation=PS_NVM_BLOCK_SER_SEED_SPS.SetRamBlockStatus
      V_49_ReadBlock: start-on-event=ReadBlock, operation=PS_NVM_BLOCK_SER_SEED_SPS.ReadBlock
      V_49_WriteBlock: start-on-event=WriteBlock, operation=PS_NVM_BLOCK_SER_SEED_SPS.WriteBlock
      V_49_InvalidateNvBlock: start-on-event=InvalidateNvBlock, operation=PS_NVM_BLOCK_SER_SEED_SPS.InvalidateNvBlock
      V_49_EraseBlock: start-on-event=EraseBlock, operation=PS_NVM_BLOCK_SER_SEED_SPS.EraseBlock
      V_49_SetBlockProtection: start-on-event=SetBlockProtection, operation=PAdmin_NVM_BLOCK_SER_SEED_SPS.SetBlockProtection
      V_50_GetErrorStatus: start-on-event=GetErrorStatus, operation=PS_NVM_BLOCK_SER_KEY_SPS.GetErrorStatus
      V_50_SetRamBlockStatus: start-on-event=SetRamBlockStatus, operation=PS_NVM_BLOCK_SER_KEY_SPS.SetRamBlockStatus
      V_50_ReadBlock: start-on-event=ReadBlock, operation=PS_NVM_BLOCK_SER_KEY_SPS.ReadBlock
      V_50_WriteBlock: start-on-event=WriteBlock, operation=PS_NVM_BLOCK_SER_KEY_SPS.WriteBlock
      V_50_InvalidateNvBlock: start-on-event=InvalidateNvBlock, operation=PS_NVM_BLOCK_SER_KEY_SPS.InvalidateNvBlock
      V_50_EraseBlock: start-on-event=EraseBlock, operation=PS_NVM_BLOCK_SER_KEY_SPS.EraseBlock
      V_50_SetBlockProtection: start-on-event=SetBlockProtection, operation=PAdmin_NVM_BLOCK_SER_KEY_SPS.SetBlockProtection
      V_51_GetErrorStatus: start-on-event=GetErrorStatus, operation=PS_NVM_BLOCK_SER_SEED_CPID.GetErrorStatus
      V_51_SetRamBlockStatus: start-on-event=SetRamBlockStatus, operation=PS_NVM_BLOCK_SER_SEED_CPID.SetRamBlockStatus
      V_51_ReadBlock: start-on-event=ReadBlock, operation=PS_NVM_BLOCK_SER_SEED_CPID.ReadBlock
      V_51_WriteBlock: start-on-event=WriteBlock, operation=PS_NVM_BLOCK_SER_SEED_CPID.WriteBlock
      V_51_InvalidateNvBlock: start-on-event=InvalidateNvBlock, operation=PS_NVM_BLOCK_SER_SEED_CPID.InvalidateNvBlock
      V_51_EraseBlock: start-on-event=EraseBlock, operation=PS_NVM_BLOCK_SER_SEED_CPID.EraseBlock
      V_51_SetBlockProtection: start-on-event=SetBlockProtection, operation=PAdmin_NVM_BLOCK_SER_SEED_CPID.SetBlockProtection
      V_52_GetErrorStatus: start-on-event=GetErrorStatus, operation=PS_NVM_BLOCK_SER_KEY_CPID.GetErrorStatus
      V_52_SetRamBlockStatus: start-on-event=SetRamBlockStatus, operation=PS_NVM_BLOCK_SER_KEY_CPID.SetRamBlockStatus
      V_52_ReadBlock: start-on-event=ReadBlock, operation=PS_NVM_BLOCK_SER_KEY_CPID.ReadBlock
      V_52_WriteBlock: start-on-event=WriteBlock, operation=PS_NVM_BLOCK_SER_KEY_CPID.WriteBlock
      V_52_InvalidateNvBlock: start-on-event=InvalidateNvBlock, operation=PS_NVM_BLOCK_SER_KEY_CPID.InvalidateNvBlock
      V_52_EraseBlock: start-on-event=EraseBlock, operation=PS_NVM_BLOCK_SER_KEY_CPID.EraseBlock
      V_52_SetBlockProtection: start-on-event=SetBlockProtection, operation=PAdmin_NVM_BLOCK_SER_KEY_CPID.SetBlockProtection
      V_53_GetErrorStatus: start-on-event=GetErrorStatus, operation=PS_NVM_BLOCK_SER_SEED_NEXTEER.GetErrorStatus
      V_53_SetRamBlockStatus: start-on-event=SetRamBlockStatus, operation=PS_NVM_BLOCK_SER_SEED_NEXTEER.SetRamBlockStatus
      V_53_ReadBlock: start-on-event=ReadBlock, operation=PS_NVM_BLOCK_SER_SEED_NEXTEER.ReadBlock
      V_53_WriteBlock: start-on-event=WriteBlock, operation=PS_NVM_BLOCK_SER_SEED_NEXTEER.WriteBlock
      V_53_InvalidateNvBlock: start-on-event=InvalidateNvBlock, operation=PS_NVM_BLOCK_SER_SEED_NEXTEER.InvalidateNvBlock
      V_53_EraseBlock: start-on-event=EraseBlock, operation=PS_NVM_BLOCK_SER_SEED_NEXTEER.EraseBlock
      V_53_SetBlockProtection: start-on-event=SetBlockProtection, operation=PAdmin_NVM_BLOCK_SER_SEED_NEXTEER.SetBlockProtection
      V_54_GetErrorStatus: start-on-event=GetErrorStatus, operation=PS_NVM_BLOCK_SER_KEY_NEXTEER.GetErrorStatus
      V_54_SetRamBlockStatus: start-on-event=SetRamBlockStatus, operation=PS_NVM_BLOCK_SER_KEY_NEXTEER.SetRamBlockStatus
      V_54_ReadBlock: start-on-event=ReadBlock, operation=PS_NVM_BLOCK_SER_KEY_NEXTEER.ReadBlock
      V_54_WriteBlock: start-on-event=WriteBlock, operation=PS_NVM_BLOCK_SER_KEY_NEXTEER.WriteBlock
      V_54_InvalidateNvBlock: start-on-event=InvalidateNvBlock, operation=PS_NVM_BLOCK_SER_KEY_NEXTEER.InvalidateNvBlock
      V_54_EraseBlock: start-on-event=EraseBlock, operation=PS_NVM_BLOCK_SER_KEY_NEXTEER.EraseBlock
      V_54_SetBlockProtection: start-on-event=SetBlockProtection, operation=PAdmin_NVM_BLOCK_SER_KEY_NEXTEER.SetBlockProtection
      V_55_GetErrorStatus: start-on-event=GetErrorStatus, operation=PS_Rte_NvmBlock_VehDyn_MotPosReset.GetErrorStatus
      V_55_SetRamBlockStatus: start-on-event=SetRamBlockStatus, operation=PS_Rte_NvmBlock_VehDyn_MotPosReset.SetRamBlockStatus
      V_55_ReadBlock: start-on-event=ReadBlock, operation=PS_Rte_NvmBlock_VehDyn_MotPosReset.ReadBlock
      V_55_WriteBlock: start-on-event=WriteBlock, operation=PS_Rte_NvmBlock_VehDyn_MotPosReset.WriteBlock
      V_55_InvalidateNvBlock: start-on-event=InvalidateNvBlock, operation=PS_Rte_NvmBlock_VehDyn_MotPosReset.InvalidateNvBlock
      V_55_EraseBlock: start-on-event=EraseBlock, operation=PS_Rte_NvmBlock_VehDyn_MotPosReset.EraseBlock
      V_55_SetBlockProtection: start-on-event=SetBlockProtection, operation=PAdmin_Rte_NvmBlock_VehDyn_MotPosReset.SetBlockProtection
      V_56_GetErrorStatus: start-on-event=GetErrorStatus, operation=PS_NVM_BLOCK_SER_ECU_ID.GetErrorStatus
      V_56_SetRamBlockStatus: start-on-event=SetRamBlockStatus, operation=PS_NVM_BLOCK_SER_ECU_ID.SetRamBlockStatus
      V_56_ReadBlock: start-on-event=ReadBlock, operation=PS_NVM_BLOCK_SER_ECU_ID.ReadBlock
      V_56_WriteBlock: start-on-event=WriteBlock, operation=PS_NVM_BLOCK_SER_ECU_ID.WriteBlock
      V_56_InvalidateNvBlock: start-on-event=InvalidateNvBlock, operation=PS_NVM_BLOCK_SER_ECU_ID.InvalidateNvBlock
      V_56_EraseBlock: start-on-event=EraseBlock, operation=PS_NVM_BLOCK_SER_ECU_ID.EraseBlock
      V_56_SetBlockProtection: start-on-event=SetBlockProtection, operation=PAdmin_NVM_BLOCK_SER_ECU_ID.SetBlockProtection
      V_57_GetErrorStatus: start-on-event=GetErrorStatus, operation=PS_NVM_BLOCK_SER_APP_NBID.GetErrorStatus
      V_57_SetRamBlockStatus: start-on-event=SetRamBlockStatus, operation=PS_NVM_BLOCK_SER_APP_NBID.SetRamBlockStatus
      V_57_ReadBlock: start-on-event=ReadBlock, operation=PS_NVM_BLOCK_SER_APP_NBID.ReadBlock
      V_57_WriteBlock: start-on-event=WriteBlock, operation=PS_NVM_BLOCK_SER_APP_NBID.WriteBlock
      V_57_InvalidateNvBlock: start-on-event=InvalidateNvBlock, operation=PS_NVM_BLOCK_SER_APP_NBID.InvalidateNvBlock
      V_57_EraseBlock: start-on-event=EraseBlock, operation=PS_NVM_BLOCK_SER_APP_NBID.EraseBlock
      V_57_SetBlockProtection: start-on-event=SetBlockProtection, operation=PAdmin_NVM_BLOCK_SER_APP_NBID.SetBlockProtection
      V_58_GetErrorStatus: start-on-event=GetErrorStatus, operation=PS_NVM_BLOCK_SER_BCID.GetErrorStatus
      V_58_SetRamBlockStatus: start-on-event=SetRamBlockStatus, operation=PS_NVM_BLOCK_SER_BCID.SetRamBlockStatus
      V_58_ReadBlock: start-on-event=ReadBlock, operation=PS_NVM_BLOCK_SER_BCID.ReadBlock
      V_58_WriteBlock: start-on-event=WriteBlock, operation=PS_NVM_BLOCK_SER_BCID.WriteBlock
      V_58_InvalidateNvBlock: start-on-event=InvalidateNvBlock, operation=PS_NVM_BLOCK_SER_BCID.InvalidateNvBlock
      V_58_EraseBlock: start-on-event=EraseBlock, operation=PS_NVM_BLOCK_SER_BCID.EraseBlock
      V_58_SetBlockProtection: start-on-event=SetBlockProtection, operation=PAdmin_NVM_BLOCK_SER_BCID.SetBlockProtection
      V_59_GetErrorStatus: start-on-event=GetErrorStatus, operation=PS_NVM_BLOCK_SER_SBAT.GetErrorStatus
      V_59_SetRamBlockStatus: start-on-event=SetRamBlockStatus, operation=PS_NVM_BLOCK_SER_SBAT.SetRamBlockStatus
      V_59_ReadBlock: start-on-event=ReadBlock, operation=PS_NVM_BLOCK_SER_SBAT.ReadBlock
      V_59_WriteBlock: start-on-event=WriteBlock, operation=PS_NVM_BLOCK_SER_SBAT.WriteBlock
      V_59_InvalidateNvBlock: start-on-event=InvalidateNvBlock, operation=PS_NVM_BLOCK_SER_SBAT.InvalidateNvBlock
      V_59_EraseBlock: start-on-event=EraseBlock, operation=PS_NVM_BLOCK_SER_SBAT.EraseBlock
      V_59_SetBlockProtection: start-on-event=SetBlockProtection, operation=PAdmin_NVM_BLOCK_SER_SBAT.SetBlockProtection
      V_61_GetErrorStatus: start-on-event=GetErrorStatus, operation=PS_Rte_NvmBlock_SrlComOutput_DTCTrigSts.GetErrorStatus
      V_61_SetRamBlockStatus: start-on-event=SetRamBlockStatus, operation=PS_Rte_NvmBlock_SrlComOutput_DTCTrigSts.SetRamBlockStatus
      V_61_ReadBlock: start-on-event=ReadBlock, operation=PS_Rte_NvmBlock_SrlComOutput_DTCTrigSts.ReadBlock
      V_61_WriteBlock: start-on-event=WriteBlock, operation=PS_Rte_NvmBlock_SrlComOutput_DTCTrigSts.WriteBlock
      V_61_InvalidateNvBlock: start-on-event=InvalidateNvBlock, operation=PS_Rte_NvmBlock_SrlComOutput_DTCTrigSts.InvalidateNvBlock
      V_61_EraseBlock: start-on-event=EraseBlock, operation=PS_Rte_NvmBlock_SrlComOutput_DTCTrigSts.EraseBlock
      V_61_SetBlockProtection: start-on-event=SetBlockProtection, operation=PAdmin_Rte_NvmBlock_SrlComOutput_DTCTrigSts.SetBlockProtection
      V_1_GetErrorStatus: start-on-event=GetErrorStatus, operation=PS_ConfigBlock.GetErrorStatus
      V_1_SetRamBlockStatus: start-on-event=SetRamBlockStatus, operation=PS_ConfigBlock.SetRamBlockStatus
      V_1_ReadBlock: start-on-event=ReadBlock, operation=PS_ConfigBlock.ReadBlock
      V_1_WriteBlock: start-on-event=WriteBlock, operation=PS_ConfigBlock.WriteBlock
      V_1_InvalidateNvBlock: start-on-event=InvalidateNvBlock, operation=PS_ConfigBlock.InvalidateNvBlock
      V_1_EraseBlock: start-on-event=EraseBlock, operation=PS_ConfigBlock.EraseBlock
      V_1_SetBlockProtection: start-on-event=SetBlockProtection, operation=PAdmin_ConfigBlock.SetBlockProtection
    port-api-option port=PS_Rte_NvmBlock_Ap_AvgFricLrn_AvgFricLrnData:
      port-arg-values:
        integer literal NvM_ServiceBlockId_2: type=NvM_BlockIdType, value=2
    port-api-option port=PS_Rte_NvmBlock_Ap_LrnEOT_LearnedEOT:
      port-arg-values:
        integer literal NvM_ServiceBlockId_3: type=NvM_BlockIdType, value=3
    port-api-option port=PS_Rte_NvmBlock_Ap_TrqCanc_CogTrqCal:
      port-arg-values:
        integer literal NvM_ServiceBlockId_4: type=NvM_BlockIdType, value=4
    port-api-option port=PS_Rte_NvmBlock_CmMtrCurr_CurrTempOffset:
      port-arg-values:
        integer literal NvM_ServiceBlockId_5: type=NvM_BlockIdType, value=5
    port-api-option port=PS_Rte_NvmBlock_CmMtrCurr_ShCurrCal:
      port-arg-values:
        integer literal NvM_ServiceBlockId_6: type=NvM_BlockIdType, value=6
    port-api-option port=PS_Rte_NvmBlock_CurrParamComp_EOLNomMtrParam:
      port-arg-values:
        integer literal NvM_ServiceBlockId_7: type=NvM_BlockIdType, value=7
    port-api-option port=PS_Rte_NvmBlock_Polarity_Polarity_Cnt_Str:
      port-arg-values:
        integer literal NvM_ServiceBlockId_8: type=NvM_BlockIdType, value=8
    port-api-option port=PS_Rte_NvmBlock_TrqCmdScl_TorqueCmdSF_Uls_f32:
      port-arg-values:
        integer literal NvM_ServiceBlockId_9: type=NvM_BlockIdType, value=9
    port-api-option port=PS_Rte_NvmBlock_BatteryVoltage_OvervoltageData:
      port-arg-values:
        integer literal NvM_ServiceBlockId_10: type=NvM_BlockIdType, value=10
    port-api-option port=PS_NVM_BLOCK_DIAGMGR_NTCSTRG:
      port-arg-values:
        integer literal NvM_ServiceBlockId_12: type=NvM_BlockIdType, value=12
    port-api-option port=PS_NVM_BLOCK_CMS_EPSDEFEATS:
      port-arg-values:
        integer literal NvM_ServiceBlockId_13: type=NvM_BlockIdType, value=13
    port-api-option port=PS_NVM_BLOCK_SER_VINDATA:
      port-arg-values:
        integer literal NvM_ServiceBlockId_14: type=NvM_BlockIdType, value=14
    port-api-option port=PS_NVM_BLOCK_SER_SYSTEMNAME:
      port-arg-values:
        integer literal NvM_ServiceBlockId_15: type=NvM_BlockIdType, value=15
    port-api-option port=PS_NVM_BLOCK_SER_REPAIRSHOPCODE:
      port-arg-values:
        integer literal NvM_ServiceBlockId_16: type=NvM_BlockIdType, value=16
    port-api-option port=PS_NVM_BLOCK_SER_PROGDATE:
      port-arg-values:
        integer literal NvM_ServiceBlockId_17: type=NvM_BlockIdType, value=17
    port-api-option port=PS_NVM_BLOCK_SER_SYSVERSCODEDDI:
      port-arg-values:
        integer literal NvM_ServiceBlockId_18: type=NvM_BlockIdType, value=18
    port-api-option port=PS_NVM_BLOCK_SER_CUSTMEC:
      port-arg-values:
        integer literal NvM_ServiceBlockId_19: type=NvM_BlockIdType, value=19
    port-api-option port=PS_NVM_BLOCK_SER_MANFTRAC:
      port-arg-values:
        integer literal NvM_ServiceBlockId_20: type=NvM_BlockIdType, value=20
    port-api-option port=PS_NVM_BLOCK_SER_ENDMODELPN:
      port-arg-values:
        integer literal NvM_ServiceBlockId_21: type=NvM_BlockIdType, value=21
    port-api-option port=PS_NVM_BLOCK_SER_ENDMODELPNAC:
      port-arg-values:
        integer literal NvM_ServiceBlockId_22: type=NvM_BlockIdType, value=22
    port-api-option port=PS_NVM_BLOCK_SER_SEED_DEPRECATED:
      port-arg-values:
        integer literal NvM_ServiceBlockId_23: type=NvM_BlockIdType, value=23
    port-api-option port=PS_NVM_BLOCK_SER_KEY_DEPRECATED:
      port-arg-values:
        integer literal NvM_ServiceBlockId_24: type=NvM_BlockIdType, value=24
    port-api-option port=PS_NVM_BLOCK_SER_DATAUNIVNUMSYSID:
      port-arg-values:
        integer literal NvM_ServiceBlockId_25: type=NvM_BlockIdType, value=25
    port-api-option port=PS_NVM_BLOCK_CMS_NXTRWIRSELECT:
      port-arg-values:
        integer literal NvM_ServiceBlockId_26: type=NvM_BlockIdType, value=26
    port-api-option port=PS_NVM_BLOCK_CMS_NXTRMEC:
      port-arg-values:
        integer literal NvM_ServiceBlockId_27: type=NvM_BlockIdType, value=27
    port-api-option port=PS_NVM_BLOCK_CMS_ECUSRLNUM:
      port-arg-values:
        integer literal NvM_ServiceBlockId_28: type=NvM_BlockIdType, value=28
    port-api-option port=PS_NVM_BLOCK_CMS_EPSSRLNUM:
      port-arg-values:
        integer literal NvM_ServiceBlockId_29: type=NvM_BlockIdType, value=29
    port-api-option port=PS_NVM_BLOCK_CMS_ECUHWPN:
      port-arg-values:
        integer literal NvM_ServiceBlockId_30: type=NvM_BlockIdType, value=30
    port-api-option port=PS_NVM_BLOCK_CMS_NXTRMANUFSCRATCHPAD:
      port-arg-values:
        integer literal NvM_ServiceBlockId_31: type=NvM_BlockIdType, value=31
    port-api-option port=PS_NVM_BLOCK_CMS_IGNCNTR:
      port-arg-values:
        integer literal NvM_ServiceBlockId_32: type=NvM_BlockIdType, value=32
    port-api-option port=PS_NVM_BLOCK_STAMD_TYPEH:
      port-arg-values:
        integer literal NvM_ServiceBlockId_33: type=NvM_BlockIdType, value=33
    port-api-option port=PS_NVM_BLOCK_STAMD_CLOSECHECK:
      port-arg-values:
        integer literal NvM_ServiceBlockId_34: type=NvM_BlockIdType, value=34
    port-api-option port=PS_NVM_BLOCK_DIAGMGR_BLACKBOX:
      port-arg-values:
        integer literal NvM_ServiceBlockId_35: type=NvM_BlockIdType, value=35
    port-api-option port=PS_Rte_NvmBlock_Sa_DigHwTrqSENT_DigTrqTrim:
      port-arg-values:
        integer literal NvM_ServiceBlockId_36: type=NvM_BlockIdType, value=36
    port-api-option port=PS_Rte_NvmBlock_Sa_DigMSB_DigMSBEOLData:
      port-arg-values:
        integer literal NvM_ServiceBlockId_37: type=NvM_BlockIdType, value=37
    port-api-option port=PS_NVM_BLOCK_SER_BASEMODELPN:
      port-arg-values:
        integer literal NvM_ServiceBlockId_38: type=NvM_BlockIdType, value=38
    port-api-option port=PS_NVM_BLOCK_SER_BASEMODELPNAC:
      port-arg-values:
        integer literal NvM_ServiceBlockId_39: type=NvM_BlockIdType, value=39
    port-api-option port=PS_NVM_BLOCK_SER_CALPRGFLAG:
      port-arg-values:
        integer literal NvM_ServiceBlockId_40: type=NvM_BlockIdType, value=40
    port-api-option port=PS_Rte_NvmBlock_AbsHwPos_EOLVehCntrOffset:
      port-arg-values:
        integer literal NvM_ServiceBlockId_41: type=NvM_BlockIdType, value=41
    port-api-option port=PS_Rte_NvmBlock_DigColPs_DigColPsEOL:
      port-arg-values:
        integer literal NvM_ServiceBlockId_42: type=NvM_BlockIdType, value=42
    port-api-option port=PS_Rte_NvmBlock_Ap_TrqCanc_CogTrqRplComp:
      port-arg-values:
        integer literal NvM_ServiceBlockId_43: type=NvM_BlockIdType, value=43
    port-api-option port=PS_NVM_BLOCK_SER_PREVREPAIRSHOPCODE:
      port-arg-values:
        integer literal NvM_ServiceBlockId_44: type=NvM_BlockIdType, value=44
    port-api-option port=PS_Rte_NvmBlock_Ap_AstLmt_SteerAsstDefeat:
      port-arg-values:
        integer literal NvM_ServiceBlockId_45: type=NvM_BlockIdType, value=45
    port-api-option port=PS_Rte_NvmBlock_Ap_TSMit_TSMitDisableEOL:
      port-arg-values:
        integer literal NvM_ServiceBlockId_46: type=NvM_BlockIdType, value=46
    port-api-option port=PS_Rte_NvmBlock_Ap_TSMit_TSMitGainLrn:
      port-arg-values:
        integer literal NvM_ServiceBlockId_47: type=NvM_BlockIdType, value=47
    port-api-option port=PS_NVM_BLOCK_CMS_NXTRMECFLAG:
      port-arg-values:
        integer literal NvM_ServiceBlockId_48: type=NvM_BlockIdType, value=48
    port-api-option port=PS_NVM_BLOCK_SER_SEED_SPS:
      port-arg-values:
        integer literal NvM_ServiceBlockId_49: type=NvM_BlockIdType, value=49
    port-api-option port=PS_NVM_BLOCK_SER_KEY_SPS:
      port-arg-values:
        integer literal NvM_ServiceBlockId_50: type=NvM_BlockIdType, value=50
    port-api-option port=PS_NVM_BLOCK_SER_SEED_CPID:
      port-arg-values:
        integer literal NvM_ServiceBlockId_51: type=NvM_BlockIdType, value=51
    port-api-option port=PS_NVM_BLOCK_SER_KEY_CPID:
      port-arg-values:
        integer literal NvM_ServiceBlockId_52: type=NvM_BlockIdType, value=52
    port-api-option port=PS_NVM_BLOCK_SER_SEED_NEXTEER:
      port-arg-values:
        integer literal NvM_ServiceBlockId_53: type=NvM_BlockIdType, value=53
    port-api-option port=PS_NVM_BLOCK_SER_KEY_NEXTEER:
      port-arg-values:
        integer literal NvM_ServiceBlockId_54: type=NvM_BlockIdType, value=54
    port-api-option port=PS_Rte_NvmBlock_VehDyn_MotPosReset:
      port-arg-values:
        integer literal NvM_ServiceBlockId_55: type=NvM_BlockIdType, value=55
    port-api-option port=PS_NVM_BLOCK_SER_ECU_ID:
      port-arg-values:
        integer literal NvM_ServiceBlockId_56: type=NvM_BlockIdType, value=56
    port-api-option port=PS_NVM_BLOCK_SER_APP_NBID:
      port-arg-values:
        integer literal NvM_ServiceBlockId_57: type=NvM_BlockIdType, value=57
    port-api-option port=PS_NVM_BLOCK_SER_BCID:
      port-arg-values:
        integer literal NvM_ServiceBlockId_58: type=NvM_BlockIdType, value=58
    port-api-option port=PS_NVM_BLOCK_SER_SBAT:
      port-arg-values:
        integer literal NvM_ServiceBlockId_59: type=NvM_BlockIdType, value=59
    port-api-option port=PS_Rte_NvmBlock_SrlComOutput_DTCTrigSts:
      port-arg-values:
        integer literal NvM_ServiceBlockId_61: type=NvM_BlockIdType, value=61
    port-api-option port=PS_ConfigBlock:
      port-arg-values:
        integer literal NvM_ServiceBlockId_1: type=NvM_BlockIdType, value=1
    port-api-option port=PAdmin_Rte_NvmBlock_Ap_AvgFricLrn_AvgFricLrnData:
      port-arg-values:
        integer literal NvM_AdminBlockId_2: type=NvM_BlockIdType, value=2
    port-api-option port=PAdmin_Rte_NvmBlock_Ap_LrnEOT_LearnedEOT:
      port-arg-values:
        integer literal NvM_AdminBlockId_3: type=NvM_BlockIdType, value=3
    port-api-option port=PAdmin_Rte_NvmBlock_Ap_TrqCanc_CogTrqCal:
      port-arg-values:
        integer literal NvM_AdminBlockId_4: type=NvM_BlockIdType, value=4
    port-api-option port=PAdmin_Rte_NvmBlock_CmMtrCurr_CurrTempOffset:
      port-arg-values:
        integer literal NvM_AdminBlockId_5: type=NvM_BlockIdType, value=5
    port-api-option port=PAdmin_Rte_NvmBlock_CmMtrCurr_ShCurrCal:
      port-arg-values:
        integer literal NvM_AdminBlockId_6: type=NvM_BlockIdType, value=6
    port-api-option port=PAdmin_Rte_NvmBlock_CurrParamComp_EOLNomMtrParam:
      port-arg-values:
        integer literal NvM_AdminBlockId_7: type=NvM_BlockIdType, value=7
    port-api-option port=PAdmin_Rte_NvmBlock_Polarity_Polarity_Cnt_Str:
      port-arg-values:
        integer literal NvM_AdminBlockId_8: type=NvM_BlockIdType, value=8
    port-api-option port=PAdmin_Rte_NvmBlock_TrqCmdScl_TorqueCmdSF_Uls_f32:
      port-arg-values:
        integer literal NvM_AdminBlockId_9: type=NvM_BlockIdType, value=9
    port-api-option port=PAdmin_Rte_NvmBlock_BatteryVoltage_OvervoltageData:
      port-arg-values:
        integer literal NvM_AdminBlockId_10: type=NvM_BlockIdType, value=10
    port-api-option port=PAdmin_NVM_BLOCK_DIAGMGR_NTCSTRG:
      port-arg-values:
        integer literal NvM_AdminBlockId_12: type=NvM_BlockIdType, value=12
    port-api-option port=PAdmin_NVM_BLOCK_CMS_EPSDEFEATS:
      port-arg-values:
        integer literal NvM_AdminBlockId_13: type=NvM_BlockIdType, value=13
    port-api-option port=PAdmin_NVM_BLOCK_SER_VINDATA:
      port-arg-values:
        integer literal NvM_AdminBlockId_14: type=NvM_BlockIdType, value=14
    port-api-option port=PAdmin_NVM_BLOCK_SER_SYSTEMNAME:
      port-arg-values:
        integer literal NvM_AdminBlockId_15: type=NvM_BlockIdType, value=15
    port-api-option port=PAdmin_NVM_BLOCK_SER_REPAIRSHOPCODE:
      port-arg-values:
        integer literal NvM_AdminBlockId_16: type=NvM_BlockIdType, value=16
    port-api-option port=PAdmin_NVM_BLOCK_SER_PROGDATE:
      port-arg-values:
        integer literal NvM_AdminBlockId_17: type=NvM_BlockIdType, value=17
    port-api-option port=PAdmin_NVM_BLOCK_SER_SYSVERSCODEDDI:
      port-arg-values:
        integer literal NvM_AdminBlockId_18: type=NvM_BlockIdType, value=18
    port-api-option port=PAdmin_NVM_BLOCK_SER_CUSTMEC:
      port-arg-values:
        integer literal NvM_AdminBlockId_19: type=NvM_BlockIdType, value=19
    port-api-option port=PAdmin_NVM_BLOCK_SER_MANFTRAC:
      port-arg-values:
        integer literal NvM_AdminBlockId_20: type=NvM_BlockIdType, value=20
    port-api-option port=PAdmin_NVM_BLOCK_SER_ENDMODELPN:
      port-arg-values:
        integer literal NvM_AdminBlockId_21: type=NvM_BlockIdType, value=21
    port-api-option port=PAdmin_NVM_BLOCK_SER_ENDMODELPNAC:
      port-arg-values:
        integer literal NvM_AdminBlockId_22: type=NvM_BlockIdType, value=22
    port-api-option port=PAdmin_NVM_BLOCK_SER_SEED_DEPRECATED:
      port-arg-values:
        integer literal NvM_AdminBlockId_23: type=NvM_BlockIdType, value=23
    port-api-option port=PAdmin_NVM_BLOCK_SER_KEY_DEPRECATED:
      port-arg-values:
        integer literal NvM_AdminBlockId_24: type=NvM_BlockIdType, value=24
    port-api-option port=PAdmin_NVM_BLOCK_SER_DATAUNIVNUMSYSID:
      port-arg-values:
        integer literal NvM_AdminBlockId_25: type=NvM_BlockIdType, value=25
    port-api-option port=PAdmin_NVM_BLOCK_CMS_NXTRWIRSELECT:
      port-arg-values:
        integer literal NvM_AdminBlockId_26: type=NvM_BlockIdType, value=26
    port-api-option port=PAdmin_NVM_BLOCK_CMS_NXTRMEC:
      port-arg-values:
        integer literal NvM_AdminBlockId_27: type=NvM_BlockIdType, value=27
    port-api-option port=PAdmin_NVM_BLOCK_CMS_ECUSRLNUM:
      port-arg-values:
        integer literal NvM_AdminBlockId_28: type=NvM_BlockIdType, value=28
    port-api-option port=PAdmin_NVM_BLOCK_CMS_EPSSRLNUM:
      port-arg-values:
        integer literal NvM_AdminBlockId_29: type=NvM_BlockIdType, value=29
    port-api-option port=PAdmin_NVM_BLOCK_CMS_ECUHWPN:
      port-arg-values:
        integer literal NvM_AdminBlockId_30: type=NvM_BlockIdType, value=30
    port-api-option port=PAdmin_NVM_BLOCK_CMS_NXTRMANUFSCRATCHPAD:
      port-arg-values:
        integer literal NvM_AdminBlockId_31: type=NvM_BlockIdType, value=31
    port-api-option port=PAdmin_NVM_BLOCK_CMS_IGNCNTR:
      port-arg-values:
        integer literal NvM_AdminBlockId_32: type=NvM_BlockIdType, value=32
    port-api-option port=PAdmin_NVM_BLOCK_STAMD_TYPEH:
      port-arg-values:
        integer literal NvM_AdminBlockId_33: type=NvM_BlockIdType, value=33
    port-api-option port=PAdmin_NVM_BLOCK_STAMD_CLOSECHECK:
      port-arg-values:
        integer literal NvM_AdminBlockId_34: type=NvM_BlockIdType, value=34
    port-api-option port=PAdmin_NVM_BLOCK_DIAGMGR_BLACKBOX:
      port-arg-values:
        integer literal NvM_AdminBlockId_35: type=NvM_BlockIdType, value=35
    port-api-option port=PAdmin_Rte_NvmBlock_Sa_DigHwTrqSENT_DigTrqTrim:
      port-arg-values:
        integer literal NvM_AdminBlockId_36: type=NvM_BlockIdType, value=36
    port-api-option port=PAdmin_Rte_NvmBlock_Sa_DigMSB_DigMSBEOLData:
      port-arg-values:
        integer literal NvM_AdminBlockId_37: type=NvM_BlockIdType, value=37
    port-api-option port=PAdmin_NVM_BLOCK_SER_BASEMODELPN:
      port-arg-values:
        integer literal NvM_AdminBlockId_38: type=NvM_BlockIdType, value=38
    port-api-option port=PAdmin_NVM_BLOCK_SER_BASEMODELPNAC:
      port-arg-values:
        integer literal NvM_AdminBlockId_39: type=NvM_BlockIdType, value=39
    port-api-option port=PAdmin_NVM_BLOCK_SER_CALPRGFLAG:
      port-arg-values:
        integer literal NvM_AdminBlockId_40: type=NvM_BlockIdType, value=40
    port-api-option port=PAdmin_Rte_NvmBlock_AbsHwPos_EOLVehCntrOffset:
      port-arg-values:
        integer literal NvM_AdminBlockId_41: type=NvM_BlockIdType, value=41
    port-api-option port=PAdmin_Rte_NvmBlock_DigColPs_DigColPsEOL:
      port-arg-values:
        integer literal NvM_AdminBlockId_42: type=NvM_BlockIdType, value=42
    port-api-option port=PAdmin_Rte_NvmBlock_Ap_TrqCanc_CogTrqRplComp:
      port-arg-values:
        integer literal NvM_AdminBlockId_43: type=NvM_BlockIdType, value=43
    port-api-option port=PAdmin_NVM_BLOCK_SER_PREVREPAIRSHOPCODE:
      port-arg-values:
        integer literal NvM_AdminBlockId_44: type=NvM_BlockIdType, value=44
    port-api-option port=PAdmin_Rte_NvmBlock_Ap_AstLmt_SteerAsstDefeat:
      port-arg-values:
        integer literal NvM_AdminBlockId_45: type=NvM_BlockIdType, value=45
    port-api-option port=PAdmin_Rte_NvmBlock_Ap_TSMit_TSMitDisableEOL:
      port-arg-values:
        integer literal NvM_AdminBlockId_46: type=NvM_BlockIdType, value=46
    port-api-option port=PAdmin_Rte_NvmBlock_Ap_TSMit_TSMitGainLrn:
      port-arg-values:
        integer literal NvM_AdminBlockId_47: type=NvM_BlockIdType, value=47
    port-api-option port=PAdmin_NVM_BLOCK_CMS_NXTRMECFLAG:
      port-arg-values:
        integer literal NvM_AdminBlockId_48: type=NvM_BlockIdType, value=48
    port-api-option port=PAdmin_NVM_BLOCK_SER_SEED_SPS:
      port-arg-values:
        integer literal NvM_AdminBlockId_49: type=NvM_BlockIdType, value=49
    port-api-option port=PAdmin_NVM_BLOCK_SER_KEY_SPS:
      port-arg-values:
        integer literal NvM_AdminBlockId_50: type=NvM_BlockIdType, value=50
    port-api-option port=PAdmin_NVM_BLOCK_SER_SEED_CPID:
      port-arg-values:
        integer literal NvM_AdminBlockId_51: type=NvM_BlockIdType, value=51
    port-api-option port=PAdmin_NVM_BLOCK_SER_KEY_CPID:
      port-arg-values:
        integer literal NvM_AdminBlockId_52: type=NvM_BlockIdType, value=52
    port-api-option port=PAdmin_NVM_BLOCK_SER_SEED_NEXTEER:
      port-arg-values:
        integer literal NvM_AdminBlockId_53: type=NvM_BlockIdType, value=53
    port-api-option port=PAdmin_NVM_BLOCK_SER_KEY_NEXTEER:
      port-arg-values:
        integer literal NvM_AdminBlockId_54: type=NvM_BlockIdType, value=54
    port-api-option port=PAdmin_Rte_NvmBlock_VehDyn_MotPosReset:
      port-arg-values:
        integer literal NvM_AdminBlockId_55: type=NvM_BlockIdType, value=55
    port-api-option port=PAdmin_NVM_BLOCK_SER_ECU_ID:
      port-arg-values:
        integer literal NvM_AdminBlockId_56: type=NvM_BlockIdType, value=56
    port-api-option port=PAdmin_NVM_BLOCK_SER_APP_NBID:
      port-arg-values:
        integer literal NvM_AdminBlockId_57: type=NvM_BlockIdType, value=57
    port-api-option port=PAdmin_NVM_BLOCK_SER_BCID:
      port-arg-values:
        integer literal NvM_AdminBlockId_58: type=NvM_BlockIdType, value=58
    port-api-option port=PAdmin_NVM_BLOCK_SER_SBAT:
      port-arg-values:
        integer literal NvM_AdminBlockId_59: type=NvM_BlockIdType, value=59
    port-api-option port=PAdmin_Rte_NvmBlock_SrlComOutput_DTCTrigSts:
      port-arg-values:
        integer literal NvM_AdminBlockId_61: type=NvM_BlockIdType, value=61
    port-api-option port=PAdmin_ConfigBlock:
      port-arg-values:
        integer literal NvM_AdminBlockId_1: type=NvM_BlockIdType, value=1
    7 x runnable, all with can-be-invoked-concurrently=true:
      GetErrorStatus: symbol=NvM_GetErrorStatus
      SetRamBlockStatus: symbol=NvM_SetRamBlockStatus
      ReadBlock: symbol=NvM_ReadBlock
      WriteBlock: symbol=NvM_WriteBlock
      InvalidateNvBlock: symbol=NvM_InvalidateNvBlock
      EraseBlock: symbol=NvM_EraseNvBlock
      SetBlockProtection: symbol=NvM_SetBlockProtection
package /PortInterface
  client server interface NvM_Administration: is-service=true
    operation SetBlockProtection
      arg ProtectionEnabled: type=Boolean, direction=IN
  client server interface NvM_AC3_SRBS_Srv: is-service=true  # NvmService_NvmApiConfigClass3 | Port Interface for NVRAM Blocks of Management Types "NATIVE" or "REDUNDANT" without default values.
    6 x operation:
      GetErrorStatus
        arg ErrorStatus: type=NvM_RequestResultType, direction=OUT
      SetRamBlockStatus
        arg RamBlockStatus: type=Boolean, direction=IN
      ReadBlock: possible-error=E_NOT_OK
        arg DstPtr: type=NvM_DestPtr, direction=OUT
      WriteBlock: possible-error=E_NOT_OK
        arg DstPtr: type=NvM_DestPtr, direction=IN
      EraseBlock: possible-error=E_NOT_OK
      InvalidateNvBlock: possible-error=E_NOT_OK
    error E_NOT_OK: error-code=1
package /DataTypes
  integer type NvM_BlockIdType: lower-limit=1, upper-limit=32767  # It is the type to be used in the "Port Defined Arguments". According to the NVM API it must result in an uint16 data type; thus the upper limit does not correspond to the number of configured blocks. Therefore the this type is common to all NVM SWC Descriptions. The upper limit is the theoretical maximum number of NVRAM blocks, if NVM_DATASET_SELECTION_BITS equals to 1. (It cannot be 0 since block Id 1 is fixed to be a REDUNDANT NVRAM Block - it consists of two NV blocks)
  integer type NvM_RequestResultType: compu {0=NVM_REQ_OK, 1=NVM_REQ_NOT_OK, 2=NVM_REQ_PENDING, 3=NVM_REQ_INTEGRITY_FAILED, 4=NVM_REQ_BLOCK_SKIPPED, 5=NVM_REQ_NV_INVALIDATED}, lower-limit=0, upper-limit=5
  array type NvM_DestPtr  # DataPtr Type to be used by WriteBlock, ReadBlock and RestoreBlockDefaults operations. This type is used for all NVRAM blocks
    element NvM_DestPtr_BaseType: type=UInt8, max-number-of-elements=65535
