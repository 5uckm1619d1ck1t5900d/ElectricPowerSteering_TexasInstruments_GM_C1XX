[part 1 of 2: package /DaVinci_Project]
AUTOSAR XML (schema 302)
package /DaVinci_Project
  ecu configuration EPS: ecu-extract=EPS, module=[NvM, Crc, EcuM, IoHwAb, MemIf, Rte, Board, Fee, FlsTst, StaMd, TmprlMon, Assist, Damping, Return, HwPwUp, MtrDrvDiag, AssistFirewall, CtrldDisShtdn, DampingFirewall, DiagMgr, LmtCod, uDiag, TqRsDg, StabilityComp, EOTActuatorMng, HystComp, LrnEOT, Polarity, BatteryVoltage, AstLmt, ThrmlDutyCycle, MtrTempEst, AvgFricLrn, CmMtrCurr, CurrCmd, CurrParamComp, PeakCurrEst, QuadDet, TrqCmdScl, TuningSelAuth, VehPwrMd, PwrLmtFuncCr, BVDiag, Os, Dio, Gpt, Mcu, Port, Wdg_internal_TMS570LS3x, WdgIf, WdgM, CtrlTemp, VehSpdLmt, ActivePull, StOpCtrl, OvrVoltMon, ShtdnMech, HiLoadStall, WhlImbRej, WIRInputQual, FrqDepDmpnInrtCmp, TrqCanc, PICurrCntrl, StabilityComp2, TmprlMon2, DigPhsReasDiag, HighFreqAssist, SignlCondn, NvMProxy, ApXcp, CustPerSrvcs, NvMMgr, BkCpPc, EtDmpFw, ReturnFirewall, DigHwTrqSENT, DigMSB, DigMSBSigCorr, MtrVel, MtrVel2, SpiNxt, AbsHwPos, VehDyn, ComplErr, DigColPs, Sweep, Sweep2, TrqArblim, TrqOvlSta, HOWDetect, PosServo, TrqOsc, StrtStop, TSMit, GenPosTraj]
  module config Board: implementation-config-variant=VARIANT-PRE-COMPILE, module-description=Board_Impl
    BoardGeneral:
      BoardOscillator = 20
      BoardPinsetting = Pin_144
      BoardAtomicBitAccessInBitfield = false
      BoardAtomicVariableAccess = Atomic32BitAccess
      BoardWidthOfPointer = 4
      BoardStructAlignment = Auto
      BoardArrayAlignment = Byte
      BoardStructInArrayAlignment = Byte
      BoardAlignmentFillPattern = 0
      BoardSizeOfPduIdType = Two_Byte
      BoardSizeOfPduLengthType = Two_Byte
      BoardSizeOfEnum = One_Byte
      BoardSizeOfIdType = Two_Byte
      BoardMinObjectSize = 1
      BoardUseExtendedAsrVersionCheck = false
      BoardPCAndLTCRCCheck = false
      systemVersion = (unset)
      ecuExtractVersion = (unset)
      BoardOsType = Autosar
      BoardDummyFunction = false
      BoardDummyStatement = true
      BoardConditionalGenerating = false
      BoardEnableSnvPrefixes = false
      BoardNhetUnitUsed = NHET1
    InterruptFunctionality: BoardIncludeIsrList=Os.h, BoardUseSchm=true, BoardGlobalReEnableCat1=(unset), BoardGlobalReEnableCat2=(unset)
      4 x InterruptFunctionSet:
        SuspendAllInterrupts: BoardGlobalSuspend=SuspendAllInterrupts(), BoardGlobalRestore=ResumeAllInterrupts(), BoardIncludeFile=Os.h
        SuspendOSInterrupts: BoardGlobalSuspend=SuspendOSInterrupts(), BoardGlobalRestore=ResumeOSInterrupts(), BoardIncludeFile=Os.h
        DisableAllInterrupts: BoardGlobalSuspend=DisableAllInterrupts(), BoardGlobalRestore=EnableAllInterrupts(), BoardIncludeFile=Os.h
        NoCriticalSectionHandling: BoardGlobalSuspend=(unset), BoardGlobalRestore=(unset), BoardIncludeFile=(unset)
  module config Crc: implementation-config-variant=VARIANT-PRE-COMPILE, module-description=Bswmd_Crc
    CrcPublishedInformation: CrcInitialValue8=0, CrcInitialValue16=65535, CrcInitialValue32=4294967295
    CrcGeneral: Crc8Mode=CRC_8_RUNTIME, Crc16Mode=CRC_16_RUNTIME, Crc32Mode=CRC_32_RUNTIME, CrcVersionInfoApi=true
  module config EcuM: implementation-config-variant=VARIANT-POST-BUILD, module-description=EcuM_Impl
    EcuMConfiguration:
      EcuMConfigConsistencyHash = 0
      EcuMNvramReadallTimeout = 0
      EcuMNvramWriteallTimeout = 0
      EcuMRunMinimumDuration = 0.1
      EcuMSleepActivityPeriod = 0
      EcuMComStackTypesIncludeFile = ComStack_Types.h
      EcuMDefaultAppMode = OSDEFAULTAPPMODE
      EcuMModuleConfigurationRef = McuModuleConfiguration
      EcuMModuleConfigurationRef = Gpt_Runtime
      EcuMModuleConfigurationRef = Port_Runtime
      EcuMModuleConfigurationRef = WdgM_Runtime
      EcuMNormalMcuModeRef = (unset)
      EcuMDefaultShutdownTarget: EcuMDefaultState=EcuMStateOff, EcuMDefaultSleepModeRef=(unset)
      EcuMDriverInitListZero
      EcuMDriverInitListOne
        EcuMDriverInitItem: EcuMModuleID=Code, EcuMModuleService=(unset), EcuMAdditionalInitCode=EcuStartup_Init1();
      EcuMDriverInitListTwo
        EcuMDriverInitItem: EcuMModuleID=Code, EcuMModuleService=(unset), EcuMAdditionalInitCode=EcuStartup_Init2();
      EcuMDriverInitListThree
        EcuMDriverInitItem: EcuMModuleID=Code, EcuMModuleService=(unset), EcuMAdditionalInitCode=/* Inserted to fix build error */
      EcuMDriverRestartList
        EcuMDriverInitItem: EcuMModuleID=Code, EcuMModuleService=(unset), EcuMAdditionalInitCode=/* Inserted to fix build error */
      InitialEcuMSleepModeEcuMSleepMode (EcuMSleepMode):
        EcuMSleepModeSuspend = false
        EcuMSleepModeId = 0
        EcuMSleepModeName = EcuMSleepMode
        EcuMMcuMode = (unset)
        EcuMWakeupSourceMask = ECUM_WKSOURCE_RESET
        EcuMWakeupSourceMask = ECUM_WKSOURCE_POWER
        EcuMWakeupSourceMask = ECUM_WKSOURCE_INTERNAL_RESET
        EcuMWakeupSourceMask = ECUM_WKSOURCE_INTERNAL_WDG
        EcuMWakeupSourceMask = ECUM_WKSOURCE_EXTERNAL_WDG
        EcuMSleepModeMcuModeRef = McuModeConf
        EcuMSleepModeWdgMModeRef = WdgMMode
      EcuMTTII: EcuMDivisor=1, EcuMSleepModeRef=(unset), EcuMSuccessorRef=(unset)
      EcuMUsrCfg_EPS (EcuMUserConfig): EcuMUser=1
      9 x EcuMWakeupSource, all with EcuMValidationTimeout=0, EcuMWakeupSourcePolling=false:
        ECUM_WKSOURCE_POWER: EcuMResetReason=6, EcuMWakeupSourceId=1
        ECUM_WKSOURCE_RESET: EcuMResetReason=-1, EcuMWakeupSourceId=2
        ECUM_WKSOURCE_INTERNAL_RESET: EcuMResetReason=3, EcuMWakeupSourceId=4
        ECUM_WKSOURCE_INTERNAL_WDG: EcuMResetReason=4, EcuMWakeupSourceId=8
        ECUM_WKSOURCE_EXTERNAL_WDG: EcuMResetReason=-1, EcuMWakeupSourceId=16
        ECUM_WKSOURCE_SOFTWARE_RESET: EcuMResetReason=2, EcuMWakeupSourceId=32
        ECUM_WKSOURCE_OSCI_OR_PLLSLIP_RESET: EcuMResetReason=5, EcuMWakeupSourceId=64
        ECUM_WKSOURCE_EXTERNAL_RESET: EcuMResetReason=1, EcuMWakeupSourceId=128
        ECUM_WKSOURCE_RESET_UNDEFINED: EcuMResetReason=7, EcuMWakeupSourceId=256
      EcuMWdgM:
        EcuMWdgMPostRunModeRef = WdgMMode
        EcuMWdgMRunModeRef = WdgMMode
        EcuMWdgMShutdownModeRef = WdgMMode
        EcuMWdgMStartupModeRef = (unset)
        EcuMWdgMWakeupModeRef = WdgMMode
        EcuMSupervisedEntityRef = (unset)
    EcuMGeneral:
      EcuMMainFunctionPeriod = 0.01
      EcuMIncludeDem = false
      EcuMIncludeDet = true
      EcuMIncludeNvramMgr = true
      EcuMIncludeWdgM = false
      EcuMIncludeComM = false
      EcuMIncludeRte = true
      EcuMIncludeSchM = true
      EcuMTTIIEnabled = false
      EcuMVersionInfoApi = false
      EcuMDevErrorDetect = true
      EcuMCheckParameter = true
      EcuMCheckPointerParameter = true
      EcuMCheckConfigType = true
      EcuMCheckUnInit = true
      EcuMCheckStateParameter = true
      EcuMCheckWkSourceParameter = true
      EcuMCheckBootTargetParameter = true
      EcuMCheckSleepModeParameter = true
      EcuMCheckUserParameter = true
      EcuMEnableProdErrorReporting = false
      EcuMDetErrorhookFunction = Det_ReportError
      EcuMDemSetError = Dem_ReportErrorStatus
      EcuMMcuIncludeFile = Mcu.h
      EcuMWdgMIncludeFile = WdgM.h
      EcuMComMIncludeFile = ComM.h
      EcuMSchMIncludeFile = SchM.h
      EcuMComMCallbackFile = ComM_EcuM.h
      EcuMRteIncludeFile = Rte_Main.h
      EcuMNvmIncludeFile = Nvm.h
      EcuMDetIncludeFile = Det.h
      EcuMDemIncludeFile = Dem.h
      EcuMOsIncludeFile = Os.h
      EcuMProdErrorDetectIncludeFile = Dem.h
      EcuMDevErrorDetectIncludeFile = Det.h
      EcuMAdditionalIncludes = EcuStartup.h
      EcuMAdditionalIncludes = Os.h
      EcuMNvmTypesFile = Nvm.h
      EcuMNvmCancelWriteAllTimeout = 60
      EcuMTTIISleepModeRef = (unset)
      EcuMIrqHandling = SuspendAllInterrupts
      EcuMTTIIWakeupSourceRef = (unset)
      EcuMApiSwitches: EcuMKillAllRUNRequestApi=true, EcuMGetValidatedWakeupEventsApi=true, EcuMGetExpiredWakeupEventsApi=true, EcuMGetStatusOfWakeupSourceApi=true
      EcuMCalloutSwitches:
        EcuMOnRTEStartupCallout = true
        EcuMOnEnterRunCallout = true
        EcuMOnExitRunCallout = true
        EcuMOnExitPostRunCallout = true
        EcuMOnPrepShutdownCallout = true
        EcuMOnGoSleepCallout = true
        EcuMOnGoOffOneCallout = true
        EcuMOnGoOffTwoCallout = true
        EcuMOnWakeupReactionCallout = true
        EcuMGeneratorCompatibilityError = false
      EcuMServicePortConfig:
        EcuMGenStateRequestPort = true
        EcuMGenBootTargetPort = false
        EcuMGenApplicationModePort = false
        EcuMGenShutdownTargetPort = false
        EcuMGenModeSwitchPort = false
        EcuMModeSwitchCbkName = (unset)
        EcuMModeSwitchRteAck = true
        EcuMServiceComponentName = EcuM
    VectorCommonData: BswmdVersion=4.08.00
  module config Fee: implementation-config-variant=VARIANT-PRE-COMPILE, module-description=BSWMD
    FeePublishedInformation:
      FeeBlockOverhead = 24
      FeeMaximumBlockingTime = 600.0
      FeePageOverhead = 0
      FeeVirtualSectorOverhead = 16
      FeeIncludeFile = Fee.h
      FeeSetModeApi = Fee_SetMode
      FeeReadApi = Fee_Read
      FeeWriteApi = Fee_Write
      FeeCancelApi = Fee_Cancel
      FeeGetStatusApi = Fee_GetStatus
      FeeGetJobResultApi = Fee_GetJobResult
      FeeEraseImmediateBlockApi = Fee_EraseImmediateBlock
      FeeInvalidateBlockApi = Fee_InvalidateBlock
    FeeGeneral:
      FeeDevErrorDetect = false
      FeeDeviceIndex = 0
      FeeNvmJobEndNotification = NvM_JobEndNotification
      FeeNvmJobErrorNotification = NvM_JobErrorNotification
      FeePollingMode = true
      FeeVersionInfoApi = false
      FeeEnableErrorCorrection = false
      FeeVirtualPageSize = 8
      FeeFrequency = 160.0
      FeeCRCEnable = false
      FeeWriteCounterSave = false
      FeeNumberOfVirtualSectors = (unset)
      FeeNumberOfVirtualSectorsEEP1 = 2
      FeeNumberOfUnconfiguredBlocksToCopy = 10
      FeeNumberOfEightByteWrites = 128
      FeeCheckBank7Access = false
      FeeGenerateDeviceandvirtualsectorstruc = false
      FeeVirtualsectorSize = VS_16
      FeePhysicalsectorSize = PS_16
    4 x FeeSectorConfiguration, all with FeeSectorBank=7:
      FeeSectorConfiguration: FeeSectorNumber=1, FeeSectorStart=0, FeeSectorEnd=0, FeeSectorName=FeeSectorConfiguration_0
      FeeSectorConfiguration1: FeeSectorNumber=2, FeeSectorStart=1, FeeSectorEnd=1, FeeSectorName=FeeSectorConfiguration_1
      FeeSectorConfiguration2: FeeSectorNumber=3, FeeSectorStart=2, FeeSectorEnd=2, FeeSectorName=FeeSectorConfiguration_2
      FeeSectorConfiguration3: FeeSectorNumber=4, FeeSectorStart=3, FeeSectorEnd=3, FeeSectorName=FeeSectorConfiguration_3
    64 x FeeBlockConfiguration, all with FeeImmediateData=false, FeeNumberOfWriteCycles=1, FeeDeviceIndex=0:
      FeeBlockConfiguration3: FeeDataset=2, FeeBlockNumber=2, FeeBlockSize=4, FeeBlockName=FEE_BLOCK_CONFIG, FeeBlockConfiguration=1, FeeEEPNumber=0
        Fee
          FeeBlockConfiguration: FeeNvmBlockName=ConfigBlock
      FeeBlockConfiguration21: FeeDataset=1, FeeBlockNumber=4, FeeBlockSize=1, FeeBlockName=FEE_BLOCK_SER_CUSTMEC, FeeBlockConfiguration=2, FeeEEPNumber=0
        Fee
          FeeBlockConfiguration: FeeNvmBlockName=NVM_BLOCK_SER_CUSTMEC
      FeeBlockConfiguration23: FeeDataset=1, FeeBlockNumber=6, FeeBlockSize=16, FeeBlockName=FEE_BLOCK_SER_MANFTRAC, FeeBlockConfiguration=3, FeeEEPNumber=0
        Fee
          FeeBlockConfiguration: FeeNvmBlockName=NVM_BLOCK_SER_MANFTRAC
      FeeBlockConfiguration24: FeeDataset=1, FeeBlockNumber=8, FeeBlockSize=4, FeeBlockName=FEE_BLOCK_SER_ENDMODELPN, FeeBlockConfiguration=4, FeeEEPNumber=0
        Fee
          FeeBlockConfiguration: FeeNvmBlockName=NVM_BLOCK_SER_ENDMODELPN
      FeeBlockConfiguration25: FeeDataset=1, FeeBlockNumber=10, FeeBlockSize=2, FeeBlockName=FEE_BLOCK_SER_ENDMODELPNAC, FeeBlockConfiguration=5, FeeEEPNumber=0
        Fee
          FeeBlockConfiguration: FeeNvmBlockName=NVM_BLOCK_SER_ENDMODELPNAC
      FeeBlockConfiguration28: FeeDataset=1, FeeBlockNumber=12, FeeBlockSize=2, FeeBlockName=FEE_BLOCK_SER_SEED_DEPRECATED, FeeBlockConfiguration=6, FeeEEPNumber=0
        Fee
          FeeBlockConfiguration: FeeNvmBlockName=NVM_BLOCK_SER_SEED_DEPRECATED
      FeeBlockConfiguration29: FeeDataset=1, FeeBlockNumber=14, FeeBlockSize=2, FeeBlockName=FEE_BLOCK_SER_KEY_DEPRECATED, FeeBlockConfiguration=7, FeeEEPNumber=0
        Fee
          FeeBlockConfiguration: FeeNvmBlockName=NVM_BLOCK_SER_KEY_DEPRECATED
      FeeBlockConfiguration26: FeeDataset=1, FeeBlockNumber=16, FeeBlockSize=4, FeeBlockName=FEE_BLOCK_SER_BASEMODELPN, FeeBlockConfiguration=8, FeeEEPNumber=0
        Fee
          FeeBlockConfiguration: FeeNvmBlockName=NVM_BLOCK_SER_BASEMODELPN
      FeeBlockConfiguration27: FeeDataset=1, FeeBlockNumber=18, FeeBlockSize=2, FeeBlockName=FEE_BLOCK_SER_BASEMODELPNAC, FeeBlockConfiguration=9, FeeEEPNumber=0
        Fee
          FeeBlockConfiguration: FeeNvmBlockName=NVM_BLOCK_SER_BASEMODELPNAC
      FeeBlockConfiguration6: FeeDataset=1, FeeBlockNumber=20, FeeBlockSize=1024, FeeBlockName=FEE_BLOCK_COGTRQCAL, FeeBlockConfiguration=10, FeeEEPNumber=0
        Fee
          FeeBlockConfiguration: FeeNvmBlockName=Rte_NvmBlock_Ap_TrqCanc_CogTrqCal
      FeeBlockConfiguration7: FeeDataset=1, FeeBlockNumber=22, FeeBlockSize=96, FeeBlockName=FEE_BLOCK_CURRTEMPOFFSET, FeeBlockConfiguration=11, FeeEEPNumber=0
        Fee
          FeeBlockConfiguration: FeeNvmBlockName=Rte_NvmBlock_CmMtrCurr_CurrTempOffset
      FeeBlockConfiguration8: FeeDataset=1, FeeBlockNumber=24, FeeBlockSize=28, FeeBlockName=FEE_BLOCK_SHCURRCAL, FeeBlockConfiguration=12, FeeEEPNumber=0
        Fee
          FeeBlockConfiguration: FeeNvmBlockName=Rte_NvmBlock_CmMtrCurr_ShCurrCal
      FeeBlockConfiguration9: FeeDataset=1, FeeBlockNumber=26, FeeBlockSize=8, FeeBlockName=FEE_BLOCK_EOLNOMMTRPARAM, FeeBlockConfiguration=13, FeeEEPNumber=0
        Fee
          FeeBlockConfiguration: FeeNvmBlockName=Rte_NvmBlock_CurrParamComp_EOLNomMtrParam
      FeeBlockConfiguration10: FeeDataset=1, FeeBlockNumber=28, FeeBlockSize=2, FeeBlockName=FEE_BLOCK_POLARITY, FeeBlockConfiguration=14, FeeEEPNumber=0
        Fee
          FeeBlockConfiguration: FeeNvmBlockName=Rte_NvmBlock_Polarity_Polarity_Cnt_Str
      FeeBlockConfiguration11: FeeDataset=1, FeeBlockNumber=30, FeeBlockSize=4, FeeBlockName=FEE_BLOCK_TORQUECMDSF, FeeBlockConfiguration=15, FeeEEPNumber=0
        Fee
          FeeBlockConfiguration: FeeNvmBlockName=Rte_NvmBlock_TrqCmdScl_TorqueCmdSF_Uls_f32
      FeeBlockConfiguration16: FeeDataset=1, FeeBlockNumber=32, FeeBlockSize=17, FeeBlockName=FEE_BLOCK_SER_VINDATA, FeeBlockConfiguration=16, FeeEEPNumber=0
        Fee
          FeeBlockConfiguration: FeeNvmBlockName=NVM_BLOCK_SER_VINDATA
      FeeBlockConfiguration17: FeeDataset=1, FeeBlockNumber=34, FeeBlockSize=20, FeeBlockName=FEE_BLOCK_SER_SYSTEMNAME, FeeBlockConfiguration=17, FeeEEPNumber=0
        Fee
          FeeBlockConfiguration: FeeNvmBlockName=NVM_BLOCK_SER_SYSTEMNAME
      FeeBlockConfiguration18: FeeDataset=1, FeeBlockNumber=36, FeeBlockSize=10, FeeBlockName=FEE_BLOCK_SER_REPAIRSHOPCODE, FeeBlockConfiguration=18, FeeEEPNumber=0
        Fee
          FeeBlockConfiguration: FeeNvmBlockName=NVM_BLOCK_SER_REPAIRSHOPCODE
      FeeBlockConfiguration20: FeeDataset=1, FeeBlockNumber=38, FeeBlockSize=2, FeeBlockName=FEE_BLOCK_SER_SYSVERSCODEDDI, FeeBlockConfiguration=19, FeeEEPNumber=0
        Fee
          FeeBlockConfiguration: FeeNvmBlockName=NVM_BLOCK_SER_SYSVERSCODEDDI
      FeeBlockConfiguration19: FeeDataset=1, FeeBlockNumber=40, FeeBlockSize=4, FeeBlockName=FEE_BLOCK_SER_PROGDATE, FeeBlockConfiguration=20, FeeEEPNumber=0
        Fee
          FeeBlockConfiguration: FeeNvmBlockName=NVM_BLOCK_SER_PROGDATE
      FeeBlockConfiguration31: FeeDataset=1, FeeBlockNumber=42, FeeBlockSize=9, FeeBlockName=FEE_BLOCK_SER_DATAUNIVNUMSYSID, FeeBlockConfiguration=21, FeeEEPNumber=0
        Fee
          FeeBlockConfiguration: FeeNvmBlockName=NVM_BLOCK_SER_DATAUNIVNUMSYSID
      FeeBlockConfiguration33: FeeDataset=1, FeeBlockNumber=44, FeeBlockSize=2, FeeBlockName=FEE_BLOCK_NXTRWIRSELECT, FeeBlockConfiguration=22, FeeEEPNumber=0
        Fee
          FeeBlockConfiguration: FeeNvmBlockName=NVM_BLOCK_CMS_NXTRWIRSELECT
      FeeBlockConfiguration34: FeeDataset=1, FeeBlockNumber=46, FeeBlockSize=1, FeeBlockName=FEE_BLOCK_CMS_NXTRMEC, FeeBlockConfiguration=23, FeeEEPNumber=0
        Fee
          FeeBlockConfiguration: FeeNvmBlockName=NVM_BLOCK_CMS_NXTRMEC
      FeeBlockConfiguration35: FeeDataset=1, FeeBlockNumber=48, FeeBlockSize=4, FeeBlockName=FEE_BLOCK_CMS_ECUSRLNUM, FeeBlockConfiguration=24, FeeEEPNumber=0
        Fee
          FeeBlockConfiguration: FeeNvmBlockName=NVM_BLOCK_CMS_ECUSRLNUM
      FeeBlockConfiguration36: FeeDataset=1, FeeBlockNumber=50, FeeBlockSize=4, FeeBlockName=FEE_BLOCK_CMS_EPSSRLNUM, FeeBlockConfiguration=25, FeeEEPNumber=0
        Fee
          FeeBlockConfiguration: FeeNvmBlockName=NVM_BLOCK_CMS_EPSSRLNUM
      FeeBlockConfiguration37: FeeDataset=1, FeeBlockNumber=52, FeeBlockSize=12, FeeBlockName=FEE_BLOCK_CMS_ECUHWPN, FeeBlockConfiguration=26, FeeEEPNumber=0
        Fee
          FeeBlockConfiguration: FeeNvmBlockName=NVM_BLOCK_CMS_ECUHWPN
      FeeBlockConfiguration38: FeeDataset=1, FeeBlockNumber=54, FeeBlockSize=64, FeeBlockName=FEE_BLOCK_CMS_NXTRMANUFSCRATCHPAD, FeeBlockConfiguration=27, FeeEEPNumber=0
        Fee
          FeeBlockConfiguration: FeeNvmBlockName=NVM_BLOCK_CMS_NXTRMANUFSCRATCHPAD
      FeeBlockConfiguration14: FeeDataset=1, FeeBlockNumber=56, FeeBlockSize=4, FeeBlockName=FEE_BLOCK_EPS_DEFEATS, FeeBlockConfiguration=28, FeeEEPNumber=0
        Fee
          FeeBlockConfiguration: FeeNvmBlockName=NVM_BLOCK_CMS_EPSDEFEATS
      FeeBlockConfiguration15: FeeDataset=1, FeeBlockNumber=58, FeeBlockSize=5, FeeBlockName=FEE_BLOCK_DIGTRQTRIM_DEPRECATED, FeeBlockConfiguration=29, FeeEEPNumber=0
        Fee
          FeeBlockConfiguration: FeeNvmBlockName=(unset)
      FeeBlockConfiguration4: FeeDataset=1, FeeBlockNumber=60, FeeBlockSize=203, FeeBlockName=FEE_BLOCK_AVGFRICLRN, FeeBlockConfiguration=30, FeeEEPNumber=1
        Fee
          FeeBlockConfiguration: FeeNvmBlockName=Rte_NvmBlock_Ap_AvgFricLrn_AvgFricLrnData
      FeeBlockConfiguration5: FeeDataset=1, FeeBlockNumber=62, FeeBlockSize=10, FeeBlockName=FEE_BLOCK_LEARNEDEOT, FeeBlockConfiguration=31, FeeEEPNumber=1
        Fee
          FeeBlockConfiguration: FeeNvmBlockName=Rte_NvmBlock_Ap_LrnEOT_LearnedEOT
      FeeBlockConfiguration12: FeeDataset=1, FeeBlockNumber=64, FeeBlockSize=449, FeeBlockName=FEE_BLOCK_DEM_DEPRECATED, FeeBlockConfiguration=32, FeeEEPNumber=1
        Fee
          FeeBlockConfiguration: FeeNvmBlockName=NvM_NVM_BLOCK_DEM_DEPRECATED
      FeeBlockConfiguration13: FeeDataset=1, FeeBlockNumber=66, FeeBlockSize=75, FeeBlockName=FEE_BLOCK_NTCSTRG_DEPRECATED, FeeBlockConfiguration=33, FeeEEPNumber=1
        Fee
          FeeBlockConfiguration: FeeNvmBlockName=(unset)
      FeeBlockConfiguration43: FeeDataset=1, FeeBlockNumber=68, FeeBlockSize=8, FeeBlockName=FEE_BLOCK_OVERVOLTAGEDATA, FeeBlockConfiguration=34, FeeEEPNumber=1
        Fee
          FeeBlockConfiguration: FeeNvmBlockName=Rte_NvmBlock_BatteryVoltage_OvervoltageData
      FeeBlockConfiguration39: FeeDataset=1, FeeBlockNumber=70, FeeBlockSize=2, FeeBlockName=FEE_BLOCK_CMS_IGNCNTR, FeeBlockConfiguration=35, FeeEEPNumber=1
        Fee
          FeeBlockConfiguration: FeeNvmBlockName=NVM_BLOCK_CMS_IGNCNTR
      FeeBlockConfiguration40: FeeDataset=1, FeeBlockNumber=72, FeeBlockSize=100, FeeBlockName=FEE_BLOCK_TYPEH, FeeBlockConfiguration=36, FeeEEPNumber=1
        Fee
          FeeBlockConfiguration: FeeNvmBlockName=NVM_BLOCK_STAMD_TYPEH
      FeeBlockConfiguration41: FeeDataset=1, FeeBlockNumber=74, FeeBlockSize=4, FeeBlockName=FEE_BLOCK_CLOSECHECK, FeeBlockConfiguration=37, FeeEEPNumber=1
        Fee
          FeeBlockConfiguration: FeeNvmBlockName=NVM_BLOCK_STAMD_CLOSECHECK
      FeeBlockConfiguration42: FeeDataset=1, FeeBlockNumber=76, FeeBlockSize=192, FeeBlockName=FEE_BLOCK_BLACKBOX, FeeBlockConfiguration=38, FeeEEPNumber=1
        Fee
          FeeBlockConfiguration: FeeNvmBlockName=NVM_BLOCK_DIAGMGR_BLACKBOX
      FeeBlockConfiguration22: FeeDataset=1, FeeBlockNumber=78, FeeBlockSize=4102, FeeBlockName=FEE_BLOCK_DIGMSBEOLDATA, FeeBlockConfiguration=39, FeeEEPNumber=0
        Fee
          FeeBlockConfiguration: FeeNvmBlockName=Rte_NvmBlock_Sa_DigMSB_DigMSBEOLData
      FeeBlockConfiguration30: FeeDataset=1, FeeBlockNumber=80, FeeBlockSize=6, FeeBlockName=FEE_BLOCK_EOLHWPOSTRIM, FeeBlockConfiguration=40, FeeEEPNumber=0
        Fee
          FeeBlockConfiguration: FeeNvmBlockName=Rte_NvmBlock_AbsHwPos_EOLVehCntrOffset
      FeeBlockConfiguration32: FeeDataset=1, FeeBlockNumber=82, FeeBlockSize=20, FeeBlockName=FEE_BLOCK_DIGCOLPSEOL, FeeBlockConfiguration=41, FeeEEPNumber=0
        Fee
          FeeBlockConfiguration: FeeNvmBlockName=Rte_NvmBlock_DigColPs_DigColPsEOL
      FeeBlockConfiguration44: FeeDataset=1, FeeBlockNumber=84, FeeBlockSize=60, FeeBlockName=FEE_BLOCK_NTCSTRG, FeeBlockConfiguration=42, FeeEEPNumber=1
        Fee
          FeeBlockConfiguration: FeeNvmBlockName=NVM_BLOCK_DIAGMGR_NTCSTRG
      FeeBlockConfiguration45: FeeDataset=1, FeeBlockNumber=86, FeeBlockSize=18, FeeBlockName=FEE_BLOCK_COGTRQRPLCOMP, FeeBlockConfiguration=43, FeeEEPNumber=0
        Fee
          FeeBlockConfiguration: FeeNvmBlockName=Rte_NvmBlock_Ap_TrqCanc_CogTrqRplComp
      FeeBlockConfiguration46: FeeDataset=1, FeeBlockNumber=88, FeeBlockSize=10, FeeBlockName=FEE_BLOCK_SER_PREVREPAIRSHOPCODE, FeeBlockConfiguration=44, FeeEEPNumber=0
        Fee
          FeeBlockConfiguration: FeeNvmBlockName=NVM_BLOCK_SER_PREVREPAIRSHOPCODE
      FeeBlockConfiguration47: FeeDataset=1, FeeBlockNumber=90, FeeBlockSize=1, FeeBlockName=FEE_BLOCK_STEERASSTDEFEAT, FeeBlockConfiguration=45, FeeEEPNumber=0
        Fee
          FeeBlockConfiguration: FeeNvmBlockName=Rte_NvmBlock_Ap_AstLmt_SteerAsstDefeat
      FeeBlockConfiguration48: FeeDataset=1, FeeBlockNumber=92, FeeBlockSize=1, FeeBlockName=FEE_BLOCK_TRQOVLSTAMFGENABLE_DEPRECATED, FeeBlockConfiguration=46, FeeEEPNumber=0
        Fee
          FeeBlockConfiguration: FeeNvmBlockName=(unset)
      FeeBlockConfiguration49: FeeDataset=1, FeeBlockNumber=94, FeeBlockSize=10, FeeBlockName=FEE_BLOCK_DIGTRQTRIM, FeeBlockConfiguration=47, FeeEEPNumber=0
        Fee
          FeeBlockConfiguration: FeeNvmBlockName=Rte_NvmBlock_Sa_DigHwTrqSENT_DigTrqTrim
      FeeBlockConfiguration50: FeeDataset=1, FeeBlockNumber=96, FeeBlockSize=2, FeeBlockName=FEE_BLOCK_TSMITDISABLEEOL, FeeBlockConfiguration=48, FeeEEPNumber=0
        Fee
          FeeBlockConfiguration: FeeNvmBlockName=Rte_NvmBlock_Ap_TSMit_TSMitDisableEOL
      FeeBlockConfiguration51: FeeDataset=1, FeeBlockNumber=98, FeeBlockSize=8, FeeBlockName=FEE_BLOCK_TSMITGAINLRN, FeeBlockConfiguration=49, FeeEEPNumber=1
        Fee
          FeeBlockConfiguration: FeeNvmBlockName=Rte_NvmBlock_Ap_TSMit_TSMitGainLrn
      FeeBlockConfiguration52: FeeDataset=1, FeeBlockNumber=100, FeeBlockSize=1, FeeBlockName=FEE_BLOCK_SER_CALPRGFLAG, FeeBlockConfiguration=50, FeeEEPNumber=0
        Fee
          FeeBlockConfiguration: FeeNvmBlockName=NVM_BLOCK_SER_CALPRGFLAG
      FeeBlockConfiguration53: FeeDataset=1, FeeBlockNumber=102, FeeBlockSize=6, FeeBlockName=FEE_BLOCK_SER_SEED_SPS, FeeBlockConfiguration=51, FeeEEPNumber=0
        Fee
          FeeBlockConfiguration: FeeNvmBlockName=NVM_BLOCK_SER_SEED_SPS
      FeeBlockConfiguration57: FeeDataset=1, FeeBlockNumber=104, FeeBlockSize=6, FeeBlockName=FEE_BLOCK_SER_KEY_SPS, FeeBlockConfiguration=52, FeeEEPNumber=0
        Fee
          FeeBlockConfiguration: FeeNvmBlockName=NVM_BLOCK_SER_KEY_SPS
      FeeBlockConfiguration54: FeeDataset=1, FeeBlockNumber=106, FeeBlockSize=6, FeeBlockName=FEE_BLOCK_SER_SEED_CPID, FeeBlockConfiguration=53, FeeEEPNumber=0
        Fee
          FeeBlockConfiguration: FeeNvmBlockName=NVM_BLOCK_SER_SEED_CPID
      FeeBlockConfiguration58: FeeDataset=1, FeeBlockNumber=108, FeeBlockSize=6, FeeBlockName=FEE_BLOCK_SER_KEY_CPID, FeeBlockConfiguration=54, FeeEEPNumber=0
        Fee
          FeeBlockConfiguration: FeeNvmBlockName=NVM_BLOCK_SER_KEY_CPID
      FeeBlockConfiguration55: FeeDataset=1, FeeBlockNumber=110, FeeBlockSize=6, FeeBlockName=FEE_BLOCK_SER_SEED_NEXTEER, FeeBlockConfiguration=55, FeeEEPNumber=0
        Fee
          FeeBlockConfiguration: FeeNvmBlockName=NVM_BLOCK_SER_SEED_NEXTEER
      FeeBlockConfiguration56: FeeDataset=1, FeeBlockNumber=112, FeeBlockSize=6, FeeBlockName=FEE_BLOCK_SER_KEY_NEXTEER, FeeBlockConfiguration=56, FeeEEPNumber=0
        Fee
          FeeBlockConfiguration: FeeNvmBlockName=NVM_BLOCK_SER_KEY_NEXTEER
      FeeBlockConfiguration59: FeeDataset=1, FeeBlockNumber=114, FeeBlockSize=1, FeeBlockName=FEE_BLOCK_SER_NXTRMECFLAG, FeeBlockConfiguration=57, FeeEEPNumber=0
        Fee
          FeeBlockConfiguration: FeeNvmBlockName=NVM_BLOCK_CMS_NXTRMECFLAG
      FeeBlockConfiguration60: FeeDataset=1, FeeBlockNumber=116, FeeBlockSize=5, FeeBlockName=FEE_BLOCK_VEHDYNMOTPOSRESET, FeeBlockConfiguration=58, FeeEEPNumber=1
        Fee
          FeeBlockConfiguration: FeeNvmBlockName=Rte_NvmBlock_VehDyn_MotPosReset
      FeeBlockConfiguration61: FeeDataset=1, FeeBlockNumber=118, FeeBlockSize=16, FeeBlockName=FEE_BLOCK_SER_ECUID, FeeBlockConfiguration=59, FeeEEPNumber=0
        Fee
          FeeBlockConfiguration: FeeNvmBlockName=NVM_BLOCK_SER_ECU_ID
      FeeBlockConfiguration62: FeeDataset=1, FeeBlockNumber=120, FeeBlockSize=2, FeeBlockName=FEE_BLOCK_SER_APPNBID, FeeBlockConfiguration=60, FeeEEPNumber=0
        Fee
          FeeBlockConfiguration: FeeNvmBlockName=NVM_BLOCK_SER_APP_NBID
      FeeBlockConfiguration63: FeeDataset=1, FeeBlockNumber=122, FeeBlockSize=2, FeeBlockName=FEE_BLOCK_SER_BCID, FeeBlockConfiguration=61, FeeEEPNumber=0
        Fee
          FeeBlockConfiguration: FeeNvmBlockName=NVM_BLOCK_SER_BCID
      FeeBlockConfiguration64: FeeDataset=1, FeeBlockNumber=124, FeeBlockSize=822, FeeBlockName=FEE_BLOCK_SER_SBAT, FeeBlockConfiguration=62, FeeEEPNumber=0
        Fee
          FeeBlockConfiguration: FeeNvmBlockName=NVM_BLOCK_SER_SBAT
      FeeBlockConfiguration65: FeeDataset=1, FeeBlockNumber=126, FeeBlockSize=1300, FeeBlockName=FEE_BLOCK_DEM, FeeBlockConfiguration=63, FeeEEPNumber=0
        Fee
          FeeBlockConfiguration: FeeNvmBlockName=NvM_NVM_BLOCK_DEM
      FeeBlockConfiguration66: FeeDataset=1, FeeBlockNumber=128, FeeBlockSize=40, FeeBlockName=FEE_BLOCK_SER_DTCTRIGSTS, FeeBlockConfiguration=64, FeeEEPNumber=0
        Fee
          FeeBlockConfiguration: FeeNvmBlockName=Rte_NvmBlock_SrlComOutput_DTCTrigSts
    FeeTypes: FeeFlashErrCorrHandlingType=Fee_None
    FeeFlashConfiguration: FeeDeviceName=TMS570LS11xx
  module config FlsTst: implementation-config-variant=VARIANT-PRE-COMPILE
    Runtime (FlsTstConfigSet): FlsTstBlockNumberBgnd=4, FlsTstBlockNumberFgnd=0, FlsTstTestCompletedNotification=Appl_FlsTstCompletedNotif
      FlsTstBlockBgndConfigSet
        4 x FlsTstBlock, all with FlsTstBlockBaseAddress=(unset), FlsTstBlockIndex=(unset), FlsTstNumberOfTestedCells=(unset), FlsTstSignatureAddress=(unset), FlsTstTestAlgorithm=FLSTST_64BIT_CRC:
          Cal: FlsTstBlockBaseSymbol=_CCT_Range_10_Start, FlsTstBlockSize=180160, FlsTstSignatureSymbol=_CCT_Range_10_Address
          App: FlsTstBlockBaseSymbol=_CCT_Range_01_Start, FlsTstBlockSize=524144, FlsTstSignatureSymbol=_CCT_Range_01_Address
          Boot: FlsTstBlockBaseSymbol=_CRC_Boot_Start, FlsTstBlockSize=65535, FlsTstSignatureSymbol=_CRC_Boot_Address
          Cal2: FlsTstBlockBaseSymbol=_CCT_Range_11_Start, FlsTstBlockSize=16320, FlsTstSignatureSymbol=_CCT_Range_11_Address
    FlsTstConfigurationOfOptApiServices:
      FlsTstGetCurrentStateApi = false
      FlsTstGetErrorDetailsApi = false
      FlsTstGetTestResultBgndApi = false
      FlsTstGetTestResultFgndApi = false
      FlsTstGetTestSignatureBgndApi = false
      FlsTstGetTestSignatureFgndApi = false
      FlsTstStartFgndApi = false
      FlsTstSuspendResumeApi = true
      FlsTstTestEccApi = false
      FlsTstVersionInfoApi = false
    FlsTstDemEventParameterRefs:
      FLSTST_E_FLSTST_FAILURE = NTC_Num_FlashCRCMemFault
      FLSTST_E_FLSTST_INFO = 1
      FLSTST_E_SELFTEST_FAILURE = NTC_Num_CPU_CoreInitFlt
      FLSTST_E_SELFTEST_INFO = 8
      FLSTST_E_MPU_FAILURE = NTC_Num_PerDiag_DMAFlt
      FLSTST_E_MPU_INFO = 128
      FLSTST_E_UNEXPECTEDIRQ_FAILURE = NTC_Num_FlashCRCMemFault
      FLSTST_E_UNEXPECTEDIRQ_INFO = 1
      FlsTstDemInclude = Ap_DiagMgr.h
      FailureAPI = NxtrDiagMgr10_ReportNTCStatus
    FlsTstGeneral:
      FlsTstDevErrorDetect = false
      FlsTstNumberOfTestedCellsAtomic = 1
      FlsTstTestCompletedNotificationSupported = true
      FlsTstTestIntervalIdEndValue = 4294967295
      FlsTstTestResultSignature = false
    CommonPublishedInformation: ArMajorVersion=1, ArMinorVersion=2, ArPatchVersion=0, SwMajorVersion=1, SwMinorVersion=0, SwPatchVersion=0, ModuleId=104, VendorId=0
  module config IoHwAb: definition=IoHwAbstraction, implementation-config-variant=VARIANT-PRE-COMPILE, module-description=IoHwAbstraction_Impl
    IoHwAbCalSignals
      11 x IoHwAbDiscrete, all with IoHwAbCreateOpDiag=false, IoHwAbDcmAccess=false, IoHwAbCalSourceType=DioChannel, IoHwAbRequirementId=(unset):
        EpsEn: IoHwAbCreateOpSet=false, IoHwAbCreateOpGet=true, IoHwAbDcmDefaultValue=0, IoHwAbDioEntity=ADC1_Ch0
        PwrSwitchEn: IoHwAbCreateOpSet=false, IoHwAbCreateOpGet=true, IoHwAbDioEntity=NHet_Ch8
        FetDrvCntl: IoHwAbCreateOpSet=false, IoHwAbCreateOpGet=true, IoHwAbDioEntity=NHet_Ch4
        FetFlt2Clk: IoHwAbCreateOpSet=true, IoHwAbCreateOpGet=true, IoHwAbDioEntity=NHet_Ch26
        FetFlt1Data: IoHwAbCreateOpSet=false, IoHwAbCreateOpGet=true, IoHwAbDioEntity=NHet_Ch24
        SysFault2: IoHwAbCreateOpSet=true, IoHwAbCreateOpGet=true, IoHwAbDioEntity=NHet_Ch15
        WdMonitor: IoHwAbCreateOpSet=true, IoHwAbCreateOpGet=false, IoHwAbDioEntity=Can3Rx
        FetDrvReset: IoHwAbCreateOpSet=true, IoHwAbCreateOpGet=true, IoHwAbDioEntity=SPI3_NCS1
        WdReset: IoHwAbCreateOpSet=true, IoHwAbCreateOpGet=false, IoHwAbDioEntity=Can3Tx
        TODReset: IoHwAbCreateOpSet=true, IoHwAbCreateOpGet=false, IoHwAbDcmDefaultValue=0, IoHwAbDioEntity=NHet_Ch20
        OvrVoltFdbk: IoHwAbCreateOpSet=false, IoHwAbCreateOpGet=true, IoHwAbDioEntity=NHet_Ch22
    IoHwAbUserDefSignals
      IoHwAbPortConfig (IoHwAbUserDefPort)
        SetFetFlt2ToOutput (IoHwAbUserDefinedOp):
          IoHwAbAccess = Output
          IoHwAbDataType = IoHwAbBoolType
          IoHwAbUnit = None
          IoHwAbRangeMin = (unset)
          IoHwAbRangeMax = (unset)
          IoHwAbResolution = (unset)
          IoHwAbDcmAccess = false
          IoHwAbRequirementId = (unset)
          IoHwAbDcmDefaultValue = 0
      SysFault3 (IoHwAbUserDefPort)
        OP_GET (IoHwAbUserDefinedOp):
          IoHwAbAccess = Input
          IoHwAbDataType = IoHwAbBoolType
          IoHwAbUnit = None
          IoHwAbRangeMin = 0
          IoHwAbRangeMax = (unset)
          IoHwAbResolution = (unset)
          IoHwAbDcmAccess = false
          IoHwAbRequirementId = (unset)
        OP_SET (IoHwAbUserDefinedOp):
          IoHwAbAccess = Output
          IoHwAbDataType = IoHwAbBoolType
          IoHwAbUnit = None
          IoHwAbRangeMin = 0
          IoHwAbRangeMax = (unset)
          IoHwAbResolution = (unset)
          IoHwAbDcmAccess = false
          IoHwAbRequirementId = (unset)
    IoHwAbHandlers
    IoHwAbGeneral:
      IoHwAbDevErrorDetect = true
      IoHwAbDevErrorReport = true
      IoHwAbVersionInfoApi = true
      IoHwAbUseInitFunction = false
      IoHwAbUseRte = false
      IoHwAbUseServicePorts = false
      IoHwAbServiceComponentName = IoHwAbstraction
      IoHwAbErrorhook = Det_ReportError
      IoHwAbCfgIncludeDet = Det.h
      IoHwAbCfgIncludeList = Dio.h
      IoHwAbIrqHandling = SuspendAllInterrupts
      IoHwAbErrorChecks: IoHwAbCfgChkParamPointer=true
      IoHwAbDataTypeSizes:
        IoHwAbDiscreteGroupSize = IOHWAB_UINT8
        IoHwAbCurrentType = IOHWAB_UINT16
        IoHwAbVoltageType = IOHWAB_UINT16
        IoHwAbResistanceType = IOHWAB_UINT16
        IoHwAbSignalDiagnosisType = IOHWAB_UINT16
        IoHwAbPwxPeriodType = IOHWAB_UINT16
        IoHwAbPwxDutyCycleType = IOHWAB_UINT16
    VectorCommonData: BswmdVersion=1.04.06
  module config MemIf: implementation-config-variant=VARIANT-PRE-COMPILE, module-description=MemIf_Impl
    MemIfGeneral: MemIfDevErrorDetect=true, MemIfVersionInfoApi=true
    MemIfAdditional:
      MemIfCfgChkParamDevIndex = true
      MemIfCfgChkParamVInfo = true
      MemIfDebugReporting = true
      MemIfCfgIncludeDet = Det.h
      MemIfErrorhook = Det_ReportError
      MemIfCfgUseFctApi = true
  module config NvM: implementation-config-variant=VARIANT-LINK-TIME, module-description=NvM_Impl
    60 x NvmBlockDescriptor, all with NvmDeviceName=Fee, NvmBlockManagementType=NVM_BLOCK_NATIVE, NvmBlockUseCrc=false, NvmBlockCRCType=NVM_CRC16, NvmBlockUsedCrcType=NVM_NOCRC, NvmCalcRamBlockCrc=false, NvmBlockJobPriority=127, NvmNvBlockNum=1, NvmWriteBlockOnce=false, NvmBlockWriteProt=false, NvmResistantToChangedSw=true, NvmRomBlockDataAddress=(unset), NvmUseJobendCallback=false, NvmSingleBlockCallback=NULL_PTR, NvmRequirementId=(unset):
      Rte_NvmBlock_Ap_AvgFricLrn_AvgFricLrnData: NvmNvramBlockIdentifier=2, NvmNvBlockLength=203, NvmUseServicePorts=true, NvmSelectBlockForReadall=true, NvmRamBlockDataAddress=Rte_Ap_AvgFricLrn_AvgFricLrnData, NvmUseInitCallback=false, NvmInitBlockCallback=NULL_PTR, NvmJobendCbkAtReadAll=false
        NvmTargetBlockReference
          NvmFeeRef: NvmNameOfFeeBlock=FeeBlockConfiguration4
      Rte_NvmBlock_Ap_LrnEOT_LearnedEOT: NvmNvramBlockIdentifier=3, NvmNvBlockLength=10, NvmUseServicePorts=true, NvmSelectBlockForReadall=true, NvmRamBlockDataAddress=Rte_Ap_LrnEOT_LearnedEOT, NvmUseInitCallback=false, NvmInitBlockCallback=NULL_PTR, NvmJobendCbkAtReadAll=false
        NvmTargetBlockReference
          NvmFeeRef: NvmNameOfFeeBlock=FeeBlockConfiguration5
      Rte_NvmBlock_Ap_TrqCanc_CogTrqCal: NvmNvramBlockIdentifier=4, NvmNvBlockLength=1024, NvmUseServicePorts=true, NvmSelectBlockForReadall=true, NvmRamBlockDataAddress=Rte_Ap_TrqCanc_CogTrqCal, NvmUseInitCallback=false, NvmInitBlockCallback=NULL_PTR, NvmJobendCbkAtReadAll=false
        NvmTargetBlockReference
          NvmFeeRef: NvmNameOfFeeBlock=FeeBlockConfiguration6
      Rte_NvmBlock_CmMtrCurr_CurrTempOffset: NvmNvramBlockIdentifier=5, NvmNvBlockLength=96, NvmUseServicePorts=true, NvmSelectBlockForReadall=true, NvmRamBlockDataAddress=Rte_CmMtrCurr_CurrTempOffset, NvmUseInitCallback=false, NvmInitBlockCallback=NULL_PTR, NvmJobendCbkAtReadAll=false
        NvmTargetBlockReference
          NvmFeeRef: NvmNameOfFeeBlock=FeeBlockConfiguration7
      Rte_NvmBlock_CmMtrCurr_ShCurrCal: NvmNvramBlockIdentifier=6, NvmNvBlockLength=28, NvmUseServicePorts=true, NvmSelectBlockForReadall=true, NvmRamBlockDataAddress=Rte_CmMtrCurr_ShCurrCal, NvmUseInitCallback=false, NvmInitBlockCallback=NULL_PTR, NvmJobendCbkAtReadAll=false
        NvmTargetBlockReference
          NvmFeeRef: NvmNameOfFeeBlock=FeeBlockConfiguration8
      Rte_NvmBlock_CurrParamComp_EOLNomMtrParam: NvmNvramBlockIdentifier=7, NvmNvBlockLength=8, NvmUseServicePorts=true, NvmSelectBlockForReadall=true, NvmRamBlockDataAddress=Rte_CurrParamComp_EOLNomMtrParam, NvmUseInitCallback=false, NvmInitBlockCallback=NULL_PTR, NvmJobendCbkAtReadAll=false
        NvmTargetBlockReference
          NvmFeeRef: NvmNameOfFeeBlock=FeeBlockConfiguration9
      Rte_NvmBlock_Polarity_Polarity_Cnt_Str: NvmNvramBlockIdentifier=8, NvmNvBlockLength=2, NvmUseServicePorts=true, NvmSelectBlockForReadall=true, NvmRamBlockDataAddress=NvMP_Rte_Polarity_Polarity_Cnt_Str, NvmUseInitCallback=false, NvmInitBlockCallback=NULL_PTR, NvmJobendCbkAtReadAll=false
        NvmTargetBlockReference
          NvmFeeRef: NvmNameOfFeeBlock=FeeBlockConfiguration10
      Rte_NvmBlock_TrqCmdScl_TorqueCmdSF_Uls_f32: NvmNvramBlockIdentifier=9, NvmNvBlockLength=4, NvmUseServicePorts=true, NvmSelectBlockForReadall=true, NvmRamBlockDataAddress=Rte_TrqCmdScl_TorqueCmdSF_Uls_f32, NvmUseInitCallback=false, NvmInitBlockCallback=NULL_PTR, NvmJobendCbkAtReadAll=false
        NvmTargetBlockReference
          NvmFeeRef: NvmNameOfFeeBlock=FeeBlockConfiguration11
      Rte_NvmBlock_BatteryVoltage_OvervoltageData: NvmNvramBlockIdentifier=10, NvmNvBlockLength=6, NvmUseServicePorts=true, NvmSelectBlockForReadall=true, NvmRamBlockDataAddress=Rte_BatteryVoltage_OvervoltageData, NvmUseInitCallback=false, NvmInitBlockCallback=NULL_PTR, NvmJobendCbkAtReadAll=false
        NvmTargetBlockReference
          NvmFeeRef: NvmNameOfFeeBlock=FeeBlockConfiguration43
      NvM_NVM_BLOCK_DEM_DEPRECATED: NvmNvramBlockIdentifier=11, NvmNvBlockLength=449, NvmUseServicePorts=false, NvmSelectBlockForReadall=false, NvmRamBlockDataAddress=(unset), NvmUseInitCallback=false, NvmInitBlockCallback=Dem_NvDataInit, NvmJobendCbkAtReadAll=true
        NvmTargetBlockReference
          NvmFeeRef: NvmNameOfFeeBlock=FeeBlockConfiguration12
      NVM_BLOCK_DIAGMGR_NTCSTRG: NvmNvramBlockIdentifier=12, NvmNvBlockLength=60, NvmUseServicePorts=true, NvmSelectBlockForReadall=true, NvmRamBlockDataAddress=NTCStrgArray_Cnt_str, NvmUseInitCallback=false, NvmInitBlockCallback=NULL_PTR, NvmJobendCbkAtReadAll=false
        NvmTargetBlockReference
          NvmFeeRef: NvmNameOfFeeBlock=FeeBlockConfiguration44
      NVM_BLOCK_CMS_EPSDEFEATS: NvmNvramBlockIdentifier=13, NvmNvBlockLength=4, NvmUseServicePorts=true, NvmSelectBlockForReadall=true, NvmRamBlockDataAddress=CDD_EOLSrlComSvcDft_Cnt_G_b32, NvmUseInitCallback=false, NvmInitBlockCallback=NULL_PTR, NvmJobendCbkAtReadAll=false
        NvmTargetBlockReference
          NvmFeeRef: NvmNameOfFeeBlock=FeeBlockConfiguration14
      NVM_BLOCK_SER_VINDATA: NvmNvramBlockIdentifier=14, NvmNvBlockLength=17, NvmUseServicePorts=true, NvmSelectBlockForReadall=true, NvmRamBlockDataAddress=Nvm_VIN_Cnt_u8, NvmUseInitCallback=false, NvmInitBlockCallback=NULL_PTR, NvmJobendCbkAtReadAll=false
        NvmTargetBlockReference
          NvmFeeRef: NvmNameOfFeeBlock=FeeBlockConfiguration16
      NVM_BLOCK_SER_SYSTEMNAME: NvmNvramBlockIdentifier=15, NvmNvBlockLength=20, NvmUseServicePorts=true, NvmSelectBlockForReadall=true, NvmRamBlockDataAddress=Nvm_SystemName_Cnt_u8, NvmUseInitCallback=false, NvmInitBlockCallback=NULL_PTR, NvmJobendCbkAtReadAll=false
        NvmTargetBlockReference
          NvmFeeRef: NvmNameOfFeeBlock=FeeBlockConfiguration17
      NVM_BLOCK_SER_REPAIRSHOPCODE: NvmNvramBlockIdentifier=16, NvmNvBlockLength=10, NvmUseServicePorts=true, NvmSelectBlockForReadall=true, NvmRamBlockDataAddress=Nvm_RepairShopCode_Cnt_u8, NvmUseInitCallback=false, NvmInitBlockCallback=NULL_PTR, NvmJobendCbkAtReadAll=false
        NvmTargetBlockReference
          NvmFeeRef: NvmNameOfFeeBlock=FeeBlockConfiguration18
      NVM_BLOCK_SER_PROGDATE: NvmNvramBlockIdentifier=17, NvmNvBlockLength=4, NvmUseServicePorts=true, NvmSelectBlockForReadall=true, NvmRamBlockDataAddress=Nvm_ProgDate_Cnt_u8, NvmUseInitCallback=false, NvmInitBlockCallback=NULL_PTR, NvmJobendCbkAtReadAll=false
        NvmTargetBlockReference
          NvmFeeRef: NvmNameOfFeeBlock=FeeBlockConfiguration19
      NVM_BLOCK_SER_SYSVERSCODEDDI: NvmNvramBlockIdentifier=18, NvmNvBlockLength=2, NvmUseServicePorts=true, NvmSelectBlockForReadall=true, NvmRamBlockDataAddress=Nvm_SystemVerCodeDDI_Cnt_u8, NvmUseInitCallback=false, NvmInitBlockCallback=NULL_PTR, NvmJobendCbkAtReadAll=false
        NvmTargetBlockReference
          NvmFeeRef: NvmNameOfFeeBlock=FeeBlockConfiguration20
      NVM_BLOCK_SER_CUSTMEC: NvmNvramBlockIdentifier=19, NvmNvBlockLength=1, NvmUseServicePorts=true, NvmSelectBlockForReadall=true, NvmRamBlockDataAddress=Nvm_CMEC_Cnt_u8, NvmUseInitCallback=false, NvmInitBlockCallback=NULL_PTR, NvmJobendCbkAtReadAll=false
        NvmTargetBlockReference
          NvmFeeRef: NvmNameOfFeeBlock=FeeBlockConfiguration21
      NVM_BLOCK_SER_MANFTRAC: NvmNvramBlockIdentifier=20, NvmNvBlockLength=16, NvmUseServicePorts=true, NvmSelectBlockForReadall=true, NvmRamBlockDataAddress=Nvm_ManfTraceability_Cnt_u8, NvmUseInitCallback=false, NvmInitBlockCallback=NULL_PTR, NvmJobendCbkAtReadAll=false
        NvmTargetBlockReference
          NvmFeeRef: NvmNameOfFeeBlock=FeeBlockConfiguration23
      NVM_BLOCK_SER_ENDMODELPN: NvmNvramBlockIdentifier=21, NvmNvBlockLength=4, NvmUseServicePorts=true, NvmSelectBlockForReadall=true, NvmRamBlockDataAddress=Nvm_EndModelPN_Cnt_u8, NvmUseInitCallback=false, NvmInitBlockCallback=NULL_PTR, NvmJobendCbkAtReadAll=false
        NvmTargetBlockReference
          NvmFeeRef: NvmNameOfFeeBlock=FeeBlockConfiguration24
      NVM_BLOCK_SER_ENDMODELPNAC: NvmNvramBlockIdentifier=22, NvmNvBlockLength=2, NvmUseServicePorts=true, NvmSelectBlockForReadall=true, NvmRamBlockDataAddress=Nvm_EndModelPNAC_Cnt_u8, NvmUseInitCallback=false, NvmInitBlockCallback=NULL_PTR, NvmJobendCbkAtReadAll=false
        NvmTargetBlockReference
          NvmFeeRef: NvmNameOfFeeBlock=FeeBlockConfiguration25
      NVM_BLOCK_SER_SEED_DEPRECATED: NvmNvramBlockIdentifier=23, NvmNvBlockLength=2, NvmUseServicePorts=true, NvmSelectBlockForReadall=false, NvmRamBlockDataAddress=(unset), NvmUseInitCallback=false, NvmInitBlockCallback=NULL_PTR, NvmJobendCbkAtReadAll=false
        NvmTargetBlockReference
          NvmFeeRef: NvmNameOfFeeBlock=FeeBlockConfiguration28
      NVM_BLOCK_SER_KEY_DEPRECATED: NvmNvramBlockIdentifier=24, NvmNvBlockLength=2, NvmUseServicePorts=true, NvmSelectBlockForReadall=false, NvmRamBlockDataAddress=(unset), NvmUseInitCallback=false, NvmInitBlockCallback=NULL_PTR, NvmJobendCbkAtReadAll=false
        NvmTargetBlockReference
          NvmFeeRef: NvmNameOfFeeBlock=FeeBlockConfiguration29
      NVM_BLOCK_SER_DATAUNIVNUMSYSID: NvmNvramBlockIdentifier=25, NvmNvBlockLength=9, NvmUseServicePorts=true, NvmSelectBlockForReadall=true, NvmRamBlockDataAddress=Nvm_DataUnivNumSysID_Cnt_u8, NvmUseInitCallback=false, NvmInitBlockCallback=NULL_PTR, NvmJobendCbkAtReadAll=false
        NvmTargetBlockReference
          NvmFeeRef: NvmNameOfFeeBlock=FeeBlockConfiguration31
      NVM_BLOCK_CMS_NXTRWIRSELECT: NvmNvramBlockIdentifier=26, NvmNvBlockLength=2, NvmUseServicePorts=true, NvmSelectBlockForReadall=true, NvmRamBlockDataAddress=CDD_EOLNxtrWIRSelect_Cnt_G_u16, NvmUseInitCallback=false, NvmInitBlockCallback=NULL_PTR, NvmJobendCbkAtReadAll=false
        NvmTargetBlockReference
          NvmFeeRef: NvmNameOfFeeBlock=FeeBlockConfiguration33
      NVM_BLOCK_CMS_NXTRMEC: NvmNvramBlockIdentifier=27, NvmNvBlockLength=1, NvmUseServicePorts=true, NvmSelectBlockForReadall=true, NvmRamBlockDataAddress=Nvm_NMEC_Cnt_u8, NvmUseInitCallback=false, NvmInitBlockCallback=NULL_PTR, NvmJobendCbkAtReadAll=false
        NvmTargetBlockReference
          NvmFeeRef: NvmNameOfFeeBlock=FeeBlockConfiguration34
      NVM_BLOCK_CMS_ECUSRLNUM: NvmNvramBlockIdentifier=28, NvmNvBlockLength=4, NvmUseServicePorts=true, NvmSelectBlockForReadall=true, NvmRamBlockDataAddress=Nvm_EcuSrlNum_Cnt_u8, NvmUseInitCallback=false, NvmInitBlockCallback=NULL_PTR, NvmJobendCbkAtReadAll=false
        NvmTargetBlockReference
          NvmFeeRef: NvmNameOfFeeBlock=FeeBlockConfiguration35
      NVM_BLOCK_CMS_EPSSRLNUM: NvmNvramBlockIdentifier=29, NvmNvBlockLength=4, NvmUseServicePorts=true, NvmSelectBlockForReadall=true, NvmRamBlockDataAddress=Nvm_EpsSrlNum_Cnt_u8, NvmUseInitCallback=false, NvmInitBlockCallback=NULL_PTR, NvmJobendCbkAtReadAll=false
        NvmTargetBlockReference
          NvmFeeRef: NvmNameOfFeeBlock=FeeBlockConfiguration36
      NVM_BLOCK_CMS_ECUHWPN: NvmNvramBlockIdentifier=30, NvmNvBlockLength=12, NvmUseServicePorts=true, NvmSelectBlockForReadall=true, NvmRamBlockDataAddress=Nvm_EcuHwPn_Cnt_u8, NvmUseInitCallback=false, NvmInitBlockCallback=NULL_PTR, NvmJobendCbkAtReadAll=false
        NvmTargetBlockReference
          NvmFeeRef: NvmNameOfFeeBlock=FeeBlockConfiguration37
      NVM_BLOCK_CMS_NXTRMANUFSCRATCHPAD: NvmNvramBlockIdentifier=31, NvmNvBlockLength=64, NvmUseServicePorts=true, NvmSelectBlockForReadall=true, NvmRamBlockDataAddress=Nvm_NxtrManfScrpd_Cnt_u8, NvmUseInitCallback=false, NvmInitBlockCallback=NULL_PTR, NvmJobendCbkAtReadAll=false
        NvmTargetBlockReference
          NvmFeeRef: NvmNameOfFeeBlock=FeeBlockConfiguration38
      NVM_BLOCK_CMS_IGNCNTR: NvmNvramBlockIdentifier=32, NvmNvBlockLength=2, NvmUseServicePorts=true, NvmSelectBlockForReadall=true, NvmRamBlockDataAddress=Nvm_IgnCntr_Cnt_u16, NvmUseInitCallback=false, NvmInitBlockCallback=NULL_PTR, NvmJobendCbkAtReadAll=false
        NvmTargetBlockReference
          NvmFeeRef: NvmNameOfFeeBlock=FeeBlockConfiguration39
      NVM_BLOCK_STAMD_TYPEH: NvmNvramBlockIdentifier=33, NvmNvBlockLength=100, NvmUseServicePorts=true, NvmSelectBlockForReadall=true, NvmRamBlockDataAddress=TypeHData_Cnt_u08, NvmUseInitCallback=false, NvmInitBlockCallback=NULL_PTR, NvmJobendCbkAtReadAll=false
        NvmTargetBlockReference
          NvmFeeRef: NvmNameOfFeeBlock=FeeBlockConfiguration40
      NVM_BLOCK_STAMD_CLOSECHECK: NvmNvramBlockIdentifier=34, NvmNvBlockLength=4, NvmUseServicePorts=true, NvmSelectBlockForReadall=true, NvmRamBlockDataAddress=CloseCheck_Cnt_u32, NvmUseInitCallback=false, NvmInitBlockCallback=NULL_PTR, NvmJobendCbkAtReadAll=false
        NvmTargetBlockReference
          NvmFeeRef: NvmNameOfFeeBlock=FeeBlockConfiguration41
      NVM_BLOCK_DIAGMGR_BLACKBOX: NvmNvramBlockIdentifier=35, NvmNvBlockLength=192, NvmUseServicePorts=true, NvmSelectBlockForReadall=true, NvmRamBlockDataAddress=NTCBlackBoxData_Cnt_str, NvmUseInitCallback=false, NvmInitBlockCallback=NULL_PTR, NvmJobendCbkAtReadAll=false
        NvmTargetBlockReference
          NvmFeeRef: NvmNameOfFeeBlock=FeeBlockConfiguration42
      Rte_NvmBlock_Sa_DigHwTrqSENT_DigTrqTrim: NvmNvramBlockIdentifier=36, NvmNvBlockLength=5, NvmUseServicePorts=true, NvmSelectBlockForReadall=true, NvmRamBlockDataAddress=Rte_Sa_DigHwTrqSENT_DigTrqTrim, NvmUseInitCallback=false, NvmInitBlockCallback=NULL_PTR, NvmJobendCbkAtReadAll=false
        NvmTargetBlockReference
          NvmFeeRef: NvmNameOfFeeBlock=FeeBlockConfiguration49
      Rte_NvmBlock_Sa_DigMSB_DigMSBEOLData: NvmNvramBlockIdentifier=37, NvmNvBlockLength=4102, NvmUseServicePorts=true, NvmSelectBlockForReadall=true, NvmRamBlockDataAddress=Rte_Sa_DigMSB_DigMSBEOLData, NvmUseInitCallback=false, NvmInitBlockCallback=NULL_PTR, NvmJobendCbkAtReadAll=false
        NvmTargetBlockReference
          NvmFeeRef: NvmNameOfFeeBlock=FeeBlockConfiguration22
      NVM_BLOCK_SER_BASEMODELPN: NvmNvramBlockIdentifier=38, NvmNvBlockLength=4, NvmUseServicePorts=true, NvmSelectBlockForReadall=true, NvmRamBlockDataAddress=Nvm_BaseModelPartNumber_Cnt_u8, NvmUseInitCallback=false, NvmInitBlockCallback=NULL_PTR, NvmJobendCbkAtReadAll=false
        NvmTargetBlockReference
          NvmFeeRef: NvmNameOfFeeBlock=FeeBlockConfiguration26
      NVM_BLOCK_SER_BASEMODELPNAC: NvmNvramBlockIdentifier=39, NvmNvBlockLength=2, NvmUseServicePorts=true, NvmSelectBlockForReadall=true, NvmRamBlockDataAddress=Nvm_BaseModelPartNumberAlphaCode_Cnt_u8, NvmUseInitCallback=false, NvmInitBlockCallback=NULL_PTR, NvmJobendCbkAtReadAll=false
        NvmTargetBlockReference
          NvmFeeRef: NvmNameOfFeeBlock=FeeBlockConfiguration27
      NVM_BLOCK_SER_CALPRGFLAG: NvmNvramBlockIdentifier=40, NvmNvBlockLength=1, NvmUseServicePorts=true, NvmSelectBlockForReadall=true, NvmRamBlockDataAddress=Nvm_CalProgFlag_Cnt_u8, NvmUseInitCallback=false, NvmInitBlockCallback=NULL_PTR, NvmJobendCbkAtReadAll=false
        NvmTargetBlockReference
          NvmFeeRef: NvmNameOfFeeBlock=FeeBlockConfiguration52
      Rte_NvmBlock_AbsHwPos_EOLVehCntrOffset: NvmNvramBlockIdentifier=41, NvmNvBlockLength=6, NvmUseServicePorts=true, NvmSelectBlockForReadall=true, NvmRamBlockDataAddress=Rte_AbsHwPos_EOLVehCntrOffset, NvmUseInitCallback=false, NvmInitBlockCallback=NULL_PTR, NvmJobendCbkAtReadAll=false
        NvmTargetBlockReference
          NvmFeeRef: NvmNameOfFeeBlock=FeeBlockConfiguration30
      Rte_NvmBlock_DigColPs_DigColPsEOL: NvmNvramBlockIdentifier=42, NvmNvBlockLength=20, NvmUseServicePorts=true, NvmSelectBlockForReadall=true, NvmRamBlockDataAddress=Rte_DigColPs_DigColPsEOL, NvmUseInitCallback=false, NvmInitBlockCallback=NULL_PTR, NvmJobendCbkAtReadAll=false
        NvmTargetBlockReference
          NvmFeeRef: NvmNameOfFeeBlock=FeeBlockConfiguration32
      Rte_NvmBlock_Ap_TrqCanc_CogTrqRplComp: NvmNvramBlockIdentifier=43, NvmNvBlockLength=18, NvmUseServicePorts=true, NvmSelectBlockForReadall=true, NvmRamBlockDataAddress=Rte_Ap_TrqCanc_CogTrqRplComp, NvmUseInitCallback=false, NvmInitBlockCallback=NULL_PTR, NvmJobendCbkAtReadAll=false
        NvmTargetBlockReference
          NvmFeeRef: NvmNameOfFeeBlock=FeeBlockConfiguration45
      NVM_BLOCK_SER_PREVREPAIRSHOPCODE: NvmNvramBlockIdentifier=44, NvmNvBlockLength=10, NvmUseServicePorts=true, NvmSelectBlockForReadall=true, NvmRamBlockDataAddress=Nvm_PrevRepairShopCode_Cnt_u8, NvmUseInitCallback=false, NvmInitBlockCallback=NULL_PTR, NvmJobendCbkAtReadAll=false
        NvmTargetBlockReference
          NvmFeeRef: NvmNameOfFeeBlock=FeeBlockConfiguration46
      Rte_NvmBlock_Ap_AstLmt_SteerAsstDefeat: NvmNvramBlockIdentifier=45, NvmNvBlockLength=1, NvmUseServicePorts=true, NvmSelectBlockForReadall=true, NvmRamBlockDataAddress=Rte_Ap_AstLmt_SteerAsstDefeat, NvmUseInitCallback=false, NvmInitBlockCallback=NULL_PTR, NvmJobendCbkAtReadAll=false
        NvmTargetBlockReference
          NvmFeeRef: NvmNameOfFeeBlock=FeeBlockConfiguration47
      Rte_NvmBlock_Ap_TSMit_TSMitDisableEOL: NvmNvramBlockIdentifier=46, NvmNvBlockLength=2, NvmUseServicePorts=true, NvmSelectBlockForReadall=true, NvmRamBlockDataAddress=Rte_Ap_TSMit_TSMitDisableEOL, NvmUseInitCallback=false, NvmInitBlockCallback=NULL_PTR, NvmJobendCbkAtReadAll=false
        NvmTargetBlockReference
          NvmFeeRef: NvmNameOfFeeBlock=FeeBlockConfiguration50
      Rte_NvmBlock_Ap_TSMit_TSMitGainLrn: NvmNvramBlockIdentifier=47, NvmNvBlockLength=8, NvmUseServicePorts=true, NvmSelectBlockForReadall=true, NvmRamBlockDataAddress=Rte_Ap_TSMit_TSMitGainLrn, NvmUseInitCallback=false, NvmInitBlockCallback=NULL_PTR, NvmJobendCbkAtReadAll=false
        NvmTargetBlockReference
          NvmFeeRef: NvmNameOfFeeBlock=FeeBlockConfiguration51
      NVM_BLOCK_CMS_NXTRMECFLAG: NvmNvramBlockIdentifier=48, NvmNvBlockLength=1, NvmUseServicePorts=true, NvmSelectBlockForReadall=true, NvmRamBlockDataAddress=Nvm_NMECReachedZero_Cnt_lgc, NvmUseInitCallback=false, NvmInitBlockCallback=NULL_PTR, NvmJobendCbkAtReadAll=false
        NvmTargetBlockReference
          NvmFeeRef: NvmNameOfFeeBlock=FeeBlockConfiguration59
      NVM_BLOCK_SER_SEED_SPS: NvmNvramBlockIdentifier=49, NvmNvBlockLength=6, NvmUseServicePorts=true, NvmSelectBlockForReadall=true, NvmRamBlockDataAddress=Nvm_SPSSeed_Cnt_str, NvmUseInitCallback=false, NvmInitBlockCallback=NULL_PTR, NvmJobendCbkAtReadAll=false
        NvmTargetBlockReference
          NvmFeeRef: NvmNameOfFeeBlock=FeeBlockConfiguration53
      NVM_BLOCK_SER_KEY_SPS: NvmNvramBlockIdentifier=50, NvmNvBlockLength=6, NvmUseServicePorts=true, NvmSelectBlockForReadall=true, NvmRamBlockDataAddress=Nvm_SPSKey_Cnt_str, NvmUseInitCallback=false, NvmInitBlockCallback=NULL_PTR, NvmJobendCbkAtReadAll=false
        NvmTargetBlockReference
          NvmFeeRef: NvmNameOfFeeBlock=FeeBlockConfiguration57
      NVM_BLOCK_SER_SEED_CPID: NvmNvramBlockIdentifier=51, NvmNvBlockLength=6, NvmUseServicePorts=true, NvmSelectBlockForReadall=true, NvmRamBlockDataAddress=Nvm_CPIDSeed_Cnt_str, NvmUseInitCallback=false, NvmInitBlockCallback=NULL_PTR, NvmJobendCbkAtReadAll=false
        NvmTargetBlockReference
          NvmFeeRef: NvmNameOfFeeBlock=FeeBlockConfiguration54
      NVM_BLOCK_SER_KEY_CPID: NvmNvramBlockIdentifier=52, NvmNvBlockLength=6, NvmUseServicePorts=true, NvmSelectBlockForReadall=true, NvmRamBlockDataAddress=Nvm_CPIDKey_Cnt_str, NvmUseInitCallback=false, NvmInitBlockCallback=NULL_PTR, NvmJobendCbkAtReadAll=false
        NvmTargetBlockReference
          NvmFeeRef: NvmNameOfFeeBlock=FeeBlockConfiguration58
      NVM_BLOCK_SER_SEED_NEXTEER: NvmNvramBlockIdentifier=53, NvmNvBlockLength=6, NvmUseServicePorts=true, NvmSelectBlockForReadall=true, NvmRamBlockDataAddress=Nvm_NexteerSeed_Cnt_str, NvmUseInitCallback=false, NvmInitBlockCallback=NULL_PTR, NvmJobendCbkAtReadAll=false
        NvmTargetBlockReference
          NvmFeeRef: NvmNameOfFeeBlock=FeeBlockConfiguration55
      NVM_BLOCK_SER_KEY_NEXTEER: NvmNvramBlockIdentifier=54, NvmNvBlockLength=6, NvmUseServicePorts=true, NvmSelectBlockForReadall=true, NvmRamBlockDataAddress=Nvm_NexteerKey_Cnt_str, NvmUseInitCallback=false, NvmInitBlockCallback=NULL_PTR, NvmJobendCbkAtReadAll=false
        NvmTargetBlockReference
          NvmFeeRef: NvmNameOfFeeBlock=FeeBlockConfiguration56
      Rte_NvmBlock_VehDyn_MotPosReset: NvmNvramBlockIdentifier=55, NvmNvBlockLength=5, NvmUseServicePorts=true, NvmSelectBlockForReadall=true, NvmRamBlockDataAddress=Rte_VehDyn_MotPosReset, NvmUseInitCallback=false, NvmInitBlockCallback=NULL_PTR, NvmJobendCbkAtReadAll=false
        NvmTargetBlockReference
          NvmFeeRef: NvmNameOfFeeBlock=FeeBlockConfiguration60
      NVM_BLOCK_SER_ECU_ID: NvmNvramBlockIdentifier=56, NvmNvBlockLength=16, NvmUseServicePorts=true, NvmSelectBlockForReadall=true, NvmRamBlockDataAddress=Nvm_EcuId_Cnt_u8, NvmUseInitCallback=false, NvmInitBlockCallback=NULL_PTR, NvmJobendCbkAtReadAll=false
        NvmTargetBlockReference
          NvmFeeRef: NvmNameOfFeeBlock=FeeBlockConfiguration61
      NVM_BLOCK_SER_APP_NBID: NvmNvramBlockIdentifier=57, NvmNvBlockLength=2, NvmUseServicePorts=true, NvmSelectBlockForReadall=true, NvmRamBlockDataAddress=Nvm_AppNbid_Cnt_u16, NvmUseInitCallback=false, NvmInitBlockCallback=NULL_PTR, NvmJobendCbkAtReadAll=false
        NvmTargetBlockReference
          NvmFeeRef: NvmNameOfFeeBlock=FeeBlockConfiguration62
      NVM_BLOCK_SER_BCID: NvmNvramBlockIdentifier=58, NvmNvBlockLength=2, NvmUseServicePorts=true, NvmSelectBlockForReadall=true, NvmRamBlockDataAddress=Nvm_Bcid_Cnt_u16, NvmUseInitCallback=false, NvmInitBlockCallback=NULL_PTR, NvmJobendCbkAtReadAll=false
        NvmTargetBlockReference
          NvmFeeRef: NvmNameOfFeeBlock=FeeBlockConfiguration63
      NVM_BLOCK_SER_SBAT: NvmNvramBlockIdentifier=59, NvmNvBlockLength=822, NvmUseServicePorts=true, NvmSelectBlockForReadall=true, NvmRamBlockDataAddress=Nvm_Sbat_Cnt_u8, NvmUseInitCallback=false, NvmInitBlockCallback=NULL_PTR, NvmJobendCbkAtReadAll=false
        NvmTargetBlockReference
          NvmFeeRef: NvmNameOfFeeBlock=FeeBlockConfiguration64
      NvM_NVM_BLOCK_DEM: NvmNvramBlockIdentifier=60, NvmNvBlockLength=1300, NvmUseServicePorts=false, NvmSelectBlockForReadall=true, NvmRamBlockDataAddress=Dem_NvData_BufferOpt, NvmUseInitCallback=true, NvmInitBlockCallback=Dem_NvDataInit, NvmJobendCbkAtReadAll=true
        NvmTargetBlockReference
          NvmFeeRef: NvmNameOfFeeBlock=FeeBlockConfiguration65
      Rte_NvmBlock_SrlComOutput_DTCTrigSts: NvmNvramBlockIdentifier=61, NvmNvBlockLength=40, NvmUseServicePorts=true, NvmSelectBlockForReadall=true, NvmRamBlockDataAddress=Rte_SrlComOutput_DTCTrigSts, NvmUseInitCallback=false, NvmInitBlockCallback=NULL_PTR, NvmJobendCbkAtReadAll=false
        NvmTargetBlockReference
          NvmFeeRef: NvmNameOfFeeBlock=FeeBlockConfiguration66
    NvmCommon:
      NvmDevErrorDetect = true
      NvmApiConfigClass = NvmApiConfigClass3
      NvmVersionInfoApi = false
      NvmSetRamBlockStatusApi = true
      NvmDrvModeSwitch = true
      NvmPollingMode = true
      NvmDynamicConfiguration = true
      NvmJobPrioritization = false
      NvmCrcNumOfBytes = 65535
      NvmDatasetSelectionBits = 1
      NvmSizeImmediateJobQueue = 1
      NvmSizeStandardJobQueue = 8
      NvmMaxNoOfWriteRetries = 3
      NvmTotalNumOfNvramBlocks = 2
      NvmCompiledConfigId = 1
      NvmMultiBlockCallback = EcuM_CB_NfyNvMJobEnd
    Nvm_30_CommonVendorParams:
      NvmDebugReporting = true
      NvmCfgIncludeDet = Det.h
      NvmErrorhook = Det_ReportError
      NvmCfgChkStatusUninit = true
      NvmCfgChkRamBlockLengths = false
      NvmCfgChkRomBlockLengths = false
      NvmCfgChkBlockLengthStrict = true
      NvmCfgChkMngmtType = true
      NvmCfgChkBlockProtection = true
      NvmCfgChkBlockPending = false
      NvmCfgChkDoParamChk = true
      NvmCfgChkParamBlockid = true
      NvmCfgChkParamDataIndex = true
      NvmCfgChkParamPointer = true
      NvmCfgIncludeDem = Dem.h
      NvmSeterror = Dem_ReportErrorStatus
      NvmCfgCbkIncludeList = Cd_NvMProxy_Cfg.h
      NvmCfgCbkIncludeList = Ap_DemIf.h
      NvmCfgCbkIncludeList = Ap_DfltConfigData.h
      NvmCfgCbkIncludeList = Ap_DiagMgr.h
      NvmCfgCbkIncludeList = Ap_StaMd_Cfg.h
      NvmCfgCbkIncludeList = EcuM_Cbk.h
      NvmMultiblockId = MultiBlockRequest
      NvmServiceComponentName = NvM
      Nvm_UseLongSwcNames = true
      NvmSrvPortInitBlockPrefix = Nvm_RpNotifyInit_
      NvmSrvPortJobEndPrefix = NvM_RpNotifyJobEnd_
      NvmCrcIntBuffer = true
      NvmCrcPreserveValue = true
      NvmKillWriteAllApi = false
      NvmLockSet = SuspendAllInterrupts
    ConfigBlock (NvmConfigBlockDescriptor):
      NvmNvramBlockIdentifier = 1
      NvmDeviceName = Fee
      NvmBlockManagementType = NVM_BLOCK_REDUNDANT
      NvmBlockUseCrc = true
      NvmBlockCRCType = NVM_CRC16
      NvmCalcRamBlockCrc = true
      NvmBlockJobPriority = 127
      NvmNvBlockLength = 2
      NvmNvBlockNum = 2
      NvmUseServicePorts = true
      NvmWriteBlockOnce = false
      NvmBlockWriteProt = false
      NvmResistantToChangedSw = true
      NvmSelectBlockForReadall = true
      NvmRomBlockDataAddress = NULL_PTR
      NvmUseInitCallback = false
      NvmInitBlockCallback = NULL_PTR
      NvmUseJobendCallback = false
      NvmJobendCbkAtReadAll = false
      NvmSingleBlockCallback = (unset)
      NvmRequirementId = (unset)
      NvmTargetBlockReference
        NvmFeeRef: NvmNameOfFeeBlock=FeeBlockConfiguration3
  module config Rte: implementation-config-variant=VARIANT-PRE-COMPILE, module-description=Rte_Impl
    RteGeneration: RteMeasurementSupport=true, RteXcpEventSupport=false, RteA2LVersion=V160, RteCalibrationSupport=NONE, RteOptimizationMode=MEMORY, RteVfbTrace=0
    100 x SwComponentInstance:
      AbsHwPos_Ap_AbsHwPos_ECU_Composition: SoftwareComponentInstanceRef=AbsHwPos, ImplementationRef=Ap_AbsHwPos_Implementation
        5 x RunnableEntityMapping, all with ActivationOffset=0, RteCyclicTriggerImplementation=Auto:
          Task_Init_10_30_Timer0: PositionInTask=30, RTEEventRef=AbsHwPos_Init1_InitEvent, MappedToTaskRef=Task_Init_10
          Task_2ms_10_55_Timer0: PositionInTask=55, RTEEventRef=TMT_AbsHwPos_Per2, MappedToTaskRef=Task_2ms_10
          Task_2ms_10_52_Timer0: PositionInTask=52, RTEEventRef=TMT_AbsHwPos_Per1, MappedToTaskRef=Task_2ms_10
          Task_10ms_10_2_Timer0: PositionInTask=2, RTEEventRef=TMT_AbsHwPos_Per4, MappedToTaskRef=Task_10ms_10
          Task_4ms_10_1_Timer0: PositionInTask=1, RTEEventRef=TMT_AbsHwPos_Per3, MappedToTaskRef=Task_4ms_10
        MAP_Rte_NvmBlock_AbsHwPos_EOLVehCntrOffset (NVRamAllocation): SwNvRamMappingReference=AbsHwPos.EOLVehCntrOffsetBlock, NvmBlockRef=Rte_NvmBlock_AbsHwPos_EOLVehCntrOffset
      Ap_ActivePull_Ap_ActivePull_ECU_Composition: SoftwareComponentInstanceRef=Ap_ActivePull, ImplementationRef=Ap_ActivePull_Implementation
        5 x RunnableEntityMapping, all with ActivationOffset=0, RteCyclicTriggerImplementation=Auto:
          Task_Trans_9_3_TrigModeSwitch0: PositionInTask=3, RTEEventRef=MST_ActivePull_Trns1_0, MappedToTaskRef=Task_Trans_9
          Task_2ms_9_1_Timer0: PositionInTask=1, RTEEventRef=TMT_ActivePull_Per1, MappedToTaskRef=Task_2ms_9
          Task_2ms_9_2_Timer0: PositionInTask=2, RTEEventRef=TMT_ActivePull_Per2, MappedToTaskRef=Task_2ms_9
          Task_100ms_9_3_Timer0: PositionInTask=3, RTEEventRef=TMT_ActivePull_Per3, MappedToTaskRef=Task_100ms_9
          Task_Init_9_6_Timer0: PositionInTask=6, RTEEventRef=ActivePull_Init1_InitEvent, MappedToTaskRef=Task_Init_9
      Ap_AssistFirewall_Ap_AssistFirewall_ECU_Composition: SoftwareComponentInstanceRef=Ap_AssistFirewall, ImplementationRef=Ap_AssistFirewall_Implementation
        Task_2ms_10_20_Timer0 (RunnableEntityMapping): PositionInTask=20, ActivationOffset=0, RteCyclicTriggerImplementation=Auto, RTEEventRef=TMT_AssistFirewall_Per1, MappedToTaskRef=Task_2ms_10
        Task_Init_10_33_Timer0 (RunnableEntityMapping): PositionInTask=33, ActivationOffset=0, RteCyclicTriggerImplementation=Auto, RTEEventRef=AssistFirewall_Init1_InitEvent, MappedToTaskRef=Task_Init_10
      Ap_AstLmt_Ap_AstLmt_ECU_Composition: SoftwareComponentInstanceRef=Ap_AstLmt, ImplementationRef=Ap_AstLmt_Implementation
        Task_2ms_10_25_Timer0 (RunnableEntityMapping): PositionInTask=25, ActivationOffset=0, RteCyclicTriggerImplementation=Auto, RTEEventRef=TMT_AstLmt_Per1, MappedToTaskRef=Task_2ms_10
        Task_Init_10_37_Timer0 (RunnableEntityMapping): PositionInTask=37, ActivationOffset=0, RteCyclicTriggerImplementation=Auto, RTEEventRef=AstLmt_InitEvent, MappedToTaskRef=Task_Init_10
        MAP_Rte_NvmBlock_Ap_AstLmt_SteerAsstDefeat (NVRamAllocation): SwNvRamMappingReference=Ap_AstLmt.SteeringAsstDefeat, NvmBlockRef=Rte_NvmBlock_Ap_AstLmt_SteerAsstDefeat
      Ap_AvgFricLrn_Ap_AvgFricLrn_ECU_Composition: SoftwareComponentInstanceRef=Ap_AvgFricLrn, ImplementationRef=Ap_AvgFricLrn_Implementation
        3 x RunnableEntityMapping, all with ActivationOffset=0, RteCyclicTriggerImplementation=Auto:
          Task_Trans_9_4_TrigModeSwitch0: PositionInTask=4, RTEEventRef=MST_AvgFricLrn_Trns1_0, MappedToTaskRef=Task_Trans_9
          Task_10ms_9_3_Timer0: PositionInTask=3, RTEEventRef=TMT_AvgFricLrn_Per1, MappedToTaskRef=Task_10ms_9
          Task_Init_9_5_Timer0: PositionInTask=5, RTEEventRef=AvgFricLrn_Init1_InitEvent, MappedToTaskRef=Task_Init_9
        MAP_Rte_NvmBlock_Ap_AvgFricLrn_AvgFricLrnData (NVRamAllocation): SwNvRamMappingReference=Ap_AvgFricLrn.AvgFricLrnBlk, NvmBlockRef=Rte_NvmBlock_Ap_AvgFricLrn_AvgFricLrnData
      Ap_BVDiag_Ap_BVDiag_ECU_Composition: SoftwareComponentInstanceRef=Ap_BVDiag, ImplementationRef=Ap_BVDiag_Implementation
        Task_10ms_9_6_Timer0 (RunnableEntityMapping): PositionInTask=6, ActivationOffset=0, RteCyclicTriggerImplementation=Auto, RTEEventRef=TMT_BVDiag_Per1, MappedToTaskRef=Task_10ms_9
      Ap_DampingFirewall_Ap_DampingFirewall_ECU_Composition: SoftwareComponentInstanceRef=Ap_DampingFirewall, ImplementationRef=Ap_DampingFirewall_Implementation
        Task_2ms_10_22_Timer0 (RunnableEntityMapping): PositionInTask=22, ActivationOffset=0, RteCyclicTriggerImplementation=Auto, RTEEventRef=TMT_DampingFirewall_Per1, MappedToTaskRef=Task_2ms_10
        Task_Init_10_18_Timer0 (RunnableEntityMapping):
          PositionInTask = 18
          ActivationOffset = 0
          RteCyclicTriggerImplementation = Auto
          RTEEventRef = DampingFirewall_Init1_InitEvent
          MappedToTaskRef = Task_Init_10
      Ap_DiagMgr8_Ap_DiagMgr8_ECU_Composition: SoftwareComponentInstanceRef=Ap_DiagMgr8, ImplementationRef=Ap_DiagMgr8_Implementation
        3 x RunnableEntityMapping, all with PositionInTask=0, ActivationOffset=0, RteCyclicTriggerImplementation=Auto:
          Task_Trans_8_0_TrigModeSwitch0: RTEEventRef=MST_DiagMgr8_Trns_0, MappedToTaskRef=Task_Trans_8
          Task_Init_8_0_Timer0: RTEEventRef=DiagMgr8_InitEvent, MappedToTaskRef=Task_Init_8
          Task_100ms_8_0_Timer0: RTEEventRef=TMT_DiagMgr8_Per, MappedToTaskRef=Task_100ms_8
      Ap_DiagMgr9_Ap_DiagMgr9_ECU_Composition: SoftwareComponentInstanceRef=Ap_DiagMgr9, ImplementationRef=Ap_DiagMgr9_Implementation
        5 x RunnableEntityMapping, all with ActivationOffset=0, RteCyclicTriggerImplementation=Auto:
          Task_Trans_9_1_TrigModeSwitch0: PositionInTask=1, RTEEventRef=MST_DiagMgr_Trns1_0, MappedToTaskRef=Task_Trans_9
          Task_100ms_9_7_Timer0: PositionInTask=7, RTEEventRef=TMT_DiagMgr_Per2, MappedToTaskRef=Task_100ms_9
          Task_Trans_9_0_TrigModeSwitch0: PositionInTask=0, RTEEventRef=MST_DiagMgr9_Trns_0, MappedToTaskRef=Task_Trans_9
          Task_Init_9_0_Timer0: PositionInTask=0, RTEEventRef=DiagMgr9_InitEvent, MappedToTaskRef=Task_Init_9
          Task_100ms_9_6_Timer0: PositionInTask=6, RTEEventRef=TMT_DiagMgr9_Per, MappedToTaskRef=Task_100ms_9
      Ap_EtDmpFw_Ap_EtDmpFw_ECU_Composition: SoftwareComponentInstanceRef=Ap_EtDmpFw, ImplementationRef=Ap_EtDmpFw_Implementation
        Task_2ms_10_62_Timer0 (RunnableEntityMapping): PositionInTask=62, ActivationOffset=0, RteCyclicTriggerImplementation=Auto, RTEEventRef=TMT_EtDmpFw_Per1, MappedToTaskRef=Task_2ms_10
      Ap_GCCDiag_Ap_GCCDiag_ECU_Composition: SoftwareComponentInstanceRef=Ap_GCCDiag, ImplementationRef=Ap_GCCDiag_Implementation
        Task_2ms_10_64_Timer0 (RunnableEntityMapping): PositionInTask=64, ActivationOffset=0, RteCyclicTriggerImplementation=Auto, RTEEventRef=TMT_GCCDiag_Per1, MappedToTaskRef=Task_2ms_10
        Task_Init_10_34_Timer0 (RunnableEntityMapping): PositionInTask=34, ActivationOffset=0, RteCyclicTriggerImplementation=Auto, RTEEventRef=GCCDiag_Init1_InitEvent, MappedToTaskRef=Task_Init_10
      Ap_GMStrtStop_Ap_GMStrtStop_ECU_Composition: SoftwareComponentInstanceRef=Ap_GMStrtStop, ImplementationRef=Ap_GMStrtStop_Implementation
        Task_2ms_10_23_Timer0 (RunnableEntityMapping): PositionInTask=23, ActivationOffset=0, RteCyclicTriggerImplementation=Auto, RTEEventRef=TMT_StrtStop_Per1, MappedToTaskRef=Task_2ms_10
        Task_Init_10_19_Timer0 (RunnableEntityMapping): PositionInTask=19, ActivationOffset=0, RteCyclicTriggerImplementation=Auto, RTEEventRef=StrtStop_Init1_InitEvent, MappedToTaskRef=Task_Init_10
      Ap_GenPosTraj_Ap_GenPosTraj_ECU_Composition: SoftwareComponentInstanceRef=Ap_GenPosTraj, ImplementationRef=Ap_GenPosTraj_Implementation
        Task_2ms_10_61_Timer0 (RunnableEntityMapping): PositionInTask=61, ActivationOffset=0, RteCyclicTriggerImplementation=Auto, RTEEventRef=TMT_GenPosTraj_Per1, MappedToTaskRef=Task_2ms_10
      Ap_HOWDetect_Ap_HOWDetect_ECU_Composition: SoftwareComponentInstanceRef=Ap_HOWDetect, ImplementationRef=Ap_HOWDetect_Implementation
        Task_Init_10_24_Timer0 (RunnableEntityMapping): PositionInTask=24, ActivationOffset=0, RteCyclicTriggerImplementation=Auto, RTEEventRef=HOWDetect_Init1_InitEvent, MappedToTaskRef=Task_Init_10
        Task_2ms_10_27_Timer0 (RunnableEntityMapping): PositionInTask=27, ActivationOffset=0, RteCyclicTriggerImplementation=Auto, RTEEventRef=TMT_HOWDetect_Per1, MappedToTaskRef=Task_2ms_10
      Ap_HwPwUp_Ap_HwPwUp_ECU_Composition: SoftwareComponentInstanceRef=Ap_HwPwUp, ImplementationRef=Ap_HwPwUp_Implementation
        4 x RunnableEntityMapping, all with ActivationOffset=0, RteCyclicTriggerImplementation=Auto:
          Task_2ms_10_40_Timer0: PositionInTask=40, RTEEventRef=TMT_HwPwUp_Per1, MappedToTaskRef=Task_2ms_10
          Task_Trans_10_2_TrigModeSwitch1: PositionInTask=2, RTEEventRef=MST_HwPwUp_Trns1_1, MappedToTaskRef=Task_Trans_10
          Task_Trans_10_2_TrigModeSwitch0: PositionInTask=2, RTEEventRef=MST_HwPwUp_Trns1_0, MappedToTaskRef=Task_Trans_10
          Task_Trans_10_8_TrigModeSwitch0: PositionInTask=8, RTEEventRef=MST_HwPwUp_Trns2_0, MappedToTaskRef=Task_Trans_10
      Ap_LmtCod_Ap_LmtCod_ECU_Composition: SoftwareComponentInstanceRef=Ap_LmtCod, ImplementationRef=Ap_LmtCod_Implementation
        Task_2ms_9_5_Timer0 (RunnableEntityMapping): PositionInTask=5, ActivationOffset=0, RteCyclicTriggerImplementation=Auto, RTEEventRef=TMT_LmtCod_Per1, MappedToTaskRef=Task_2ms_9
      Ap_LrnEOT_Ap_LrnEOT_ECU_Composition: SoftwareComponentInstanceRef=Ap_LrnEOT, ImplementationRef=Ap_LrnEOT_Implementation
        Task_Init_9_8_Timer0 (RunnableEntityMapping): PositionInTask=8, ActivationOffset=0, RteCyclicTriggerImplementation=Auto, RTEEventRef=LrnEOT_Init1_InitEvent, MappedToTaskRef=Task_Init_9
        Task_10ms_9_4_Timer0 (RunnableEntityMapping): PositionInTask=4, ActivationOffset=0, RteCyclicTriggerImplementation=Auto, RTEEventRef=TMT_LrnEOT_Per1, MappedToTaskRef=Task_10ms_9
        MAP_Rte_NvmBlock_Ap_LrnEOT_LearnedEOT (NVRamAllocation): SwNvRamMappingReference=Ap_LrnEOT.EOTLearnedBlk, NvmBlockRef=Rte_NvmBlock_Ap_LrnEOT_LearnedEOT
      Ap_MtrTempEst_Ap_MtrTempEst_ECU_Composition: SoftwareComponentInstanceRef=Ap_MtrTempEst, ImplementationRef=Ap_MtrTempEst_Implementation
        Task_100ms_9_2_Timer0 (RunnableEntityMapping): PositionInTask=2, ActivationOffset=0, RteCyclicTriggerImplementation=Auto, RTEEventRef=TMT_MtrTempEst_Per1, MappedToTaskRef=Task_100ms_9
        Task_Init_9_2_Timer0 (RunnableEntityMapping): PositionInTask=2, ActivationOffset=0, RteCyclicTriggerImplementation=Auto, RTEEventRef=MtrTempEst_Init1_InitEvent, MappedToTaskRef=Task_Init_9
      Ap_PICurrCntrl_Ap_PICurrCntrl_ECU_Composition: SoftwareComponentInstanceRef=Ap_PICurrCntrl, ImplementationRef=Ap_PICurrCntrl_Implementation
        Task_2ms_10_58_Timer0 (RunnableEntityMapping): PositionInTask=58, ActivationOffset=0, RteCyclicTriggerImplementation=Auto, RTEEventRef=TMT_PICurrCntrl_Per2, MappedToTaskRef=Task_2ms_10
        Task_Init_10_27_Timer0 (RunnableEntityMapping): PositionInTask=27, ActivationOffset=0, RteCyclicTriggerImplementation=Auto, RTEEventRef=PICurrCntrl_InitEvent, MappedToTaskRef=Task_Init_10
      Ap_PosServo_Ap_PosServo_ECU_Composition: SoftwareComponentInstanceRef=Ap_PosServo, ImplementationRef=Ap_PosServo_Implementation
        Task_Init_10_40_Timer0 (RunnableEntityMapping): PositionInTask=40, ActivationOffset=0, RteCyclicTriggerImplementation=Auto, RTEEventRef=PosServo_Init1_InitEvent, MappedToTaskRef=Task_Init_10
        Task_2ms_10_12_Timer0 (RunnableEntityMapping): PositionInTask=12, ActivationOffset=0, RteCyclicTriggerImplementation=Auto, RTEEventRef=TMT_PosServo_Per1, MappedToTaskRef=Task_2ms_10
      Ap_PwrLmtFuncCr_Ap_PwrLmtFuncCr_ECU_Composition: SoftwareComponentInstanceRef=Ap_PwrLmtFuncCr, ImplementationRef=Ap_PwrLmtFuncCr_Implementation
        3 x RunnableEntityMapping, all with ActivationOffset=0, RteCyclicTriggerImplementation=Auto:
          Task_Init_10_21_Timer0: PositionInTask=21, RTEEventRef=PwrLmtFuncCr_Init1_InitEvent, MappedToTaskRef=Task_Init_10
          Task_2ms_10_29_Timer0: PositionInTask=29, RTEEventRef=TMT_PwrLmtFuncCr_Per1, MappedToTaskRef=Task_2ms_10
          Task_10ms_10_4_Timer0: PositionInTask=4, RTEEventRef=TMT_PwrLmtFuncCr_Per2, MappedToTaskRef=Task_10ms_10
      Ap_SASPlausDiag_Ap_SASPlausDiag_ECU_Composition: SoftwareComponentInstanceRef=Ap_SASPlausDiag, ImplementationRef=Ap_SASPlausDiag_Implementation
        Task_2ms_10_54_Timer0 (RunnableEntityMapping): PositionInTask=54, ActivationOffset=0, RteCyclicTriggerImplementation=Auto, RTEEventRef=TMT_SASPlausDiag_Per1, MappedToTaskRef=Task_2ms_10
      Ap_SignlCondn_Ap_SignlCondn_ECU_Composition: SoftwareComponentInstanceRef=Ap_SignlCondn, ImplementationRef=Ap_SignlCondn_Implementation
        Task_2ms_10_63_Timer0 (RunnableEntityMapping): PositionInTask=63, ActivationOffset=0, RteCyclicTriggerImplementation=Auto, RTEEventRef=TMT_SignlCondn_Per1, MappedToTaskRef=Task_2ms_10
      Ap_StaMd8_Ap_StaMd8_ECU_Composition: SoftwareComponentInstanceRef=Ap_StaMd8, ImplementationRef=Ap_StaMd8_Implementation
        Task_2ms_8_0_Timer0 (RunnableEntityMapping): PositionInTask=0, ActivationOffset=0, RteCyclicTriggerImplementation=Auto, RTEEventRef=TMT_StaMd8_Per1, MappedToTaskRef=Task_2ms_8
        StaMds8_MilestoneRqst_WARMINIT_ExclArea (ExclusiveAreaImplementation): ExclusiveAreaImplMechanism=INTERRUPT_BLOCKING, ExclusiveAreaRef=StaMds8_MilestoneRqst_WARMINIT_ExclArea
      Ap_StaMd9_Ap_StaMd9_ECU_Composition: SoftwareComponentInstanceRef=Ap_StaMd9, ImplementationRef=Ap_StaMd9_Implementation
        Task_2ms_9_7_Timer0 (RunnableEntityMapping): PositionInTask=7, ActivationOffset=0, RteCyclicTriggerImplementation=Auto, RTEEventRef=TMT_StaMd9_Per1, MappedToTaskRef=Task_2ms_9
        StaMds9_MilestoneRqst_WARMINIT_ExclArea (ExclusiveAreaImplementation): ExclusiveAreaImplMechanism=INTERRUPT_BLOCKING, ExclusiveAreaRef=StaMds9_MilestoneRqst_WARMINIT_ExclArea
        Task_TrnsB_9_0_Timer0 (RunnableEntityMapping): PositionInTask=0, ActivationOffset=0, RteCyclicTriggerImplementation=None, RTEEventRef=TMT_StaMd9_Trns_DemShutdown, MappedToTaskRef=Task_TrnsB_9
      Ap_StabilityComp2_Ap_StabilityComp2_ECU_Composition: SoftwareComponentInstanceRef=Ap_StabilityComp2, ImplementationRef=Ap_StabilityComp2_Implementation
        Task_2ms_8_1_Timer0 (RunnableEntityMapping): PositionInTask=1, ActivationOffset=0, RteCyclicTriggerImplementation=Auto, RTEEventRef=TMT_StabilityComp2_Per1, MappedToTaskRef=Task_2ms_8
        Task_Init_8_1_Timer0 (RunnableEntityMapping): PositionInTask=1, ActivationOffset=0, RteCyclicTriggerImplementation=Auto, RTEEventRef=StabilityComp2_Init1_InitEvent, MappedToTaskRef=Task_Init_8
      Ap_Sweep_Ap_Sweep_ECU_Composition: SoftwareComponentInstanceRef=Ap_Sweep, ImplementationRef=Ap_Sweep_Implementation
        Task_Init_10_35_Timer0 (RunnableEntityMapping): PositionInTask=35, ActivationOffset=0, RteCyclicTriggerImplementation=Auto, RTEEventRef=Sweep_InitEvent, MappedToTaskRef=Task_Init_10
        Task_2ms_10_7_Timer0 (RunnableEntityMapping): PositionInTask=7, ActivationOffset=0, RteCyclicTriggerImplementation=Auto, RTEEventRef=TMT_Sweep_Per1, MappedToTaskRef=Task_2ms_10
      Ap_Sweep2_Ap_Sweep2_ECU_Composition: SoftwareComponentInstanceRef=Ap_Sweep2, ImplementationRef=Ap_Sweep2_Implementation
        Task_2ms_10_26_Timer0 (RunnableEntityMapping): PositionInTask=26, ActivationOffset=0, RteCyclicTriggerImplementation=Auto, RTEEventRef=TMT_Sweep2_Per1, MappedToTaskRef=Task_2ms_10
      Ap_TSMit_Ap_TSMit_ECU_Composition: SoftwareComponentInstanceRef=Ap_TSMit, ImplementationRef=Ap_TSMit_Implementation
        Task_Init_10_29_Timer0 (RunnableEntityMapping): PositionInTask=29, ActivationOffset=0, RteCyclicTriggerImplementation=Auto, RTEEventRef=TSMit_Init1_InitEvent, MappedToTaskRef=Task_Init_10
        Task_10ms_10_5_Timer0 (RunnableEntityMapping): PositionInTask=5, ActivationOffset=0, RteCyclicTriggerImplementation=Auto, RTEEventRef=TMT_TSMit_Per1, MappedToTaskRef=Task_10ms_10
        MAP_Rte_NvmBlock_Ap_TSMit_TSMitDisableEOL (NVRamAllocation): SwNvRamMappingReference=Ap_TSMit.TSMit_Enable_Block, NvmBlockRef=Rte_NvmBlock_Ap_TSMit_TSMitDisableEOL
        MAP_Rte_NvmBlock_Ap_TSMit_TSMitGainLrn (NVRamAllocation): SwNvRamMappingReference=Ap_TSMit.TSMit_Gain_Block, NvmBlockRef=Rte_NvmBlock_Ap_TSMit_TSMitGainLrn
      Ap_ThrmlDutyCycle_Ap_ThrmlDutyCycle_ECU_Composition: SoftwareComponentInstanceRef=Ap_ThrmlDutyCycle, ImplementationRef=Ap_ThrmlDutyCycle_Implementation
        Task_100ms_9_8_Timer0 (RunnableEntityMapping): PositionInTask=8, ActivationOffset=0, RteCyclicTriggerImplementation=Auto, RTEEventRef=TMT_ThrmlDutyCycle_Per1, MappedToTaskRef=Task_100ms_9
        Task_Init_9_4_Timer0 (RunnableEntityMapping): PositionInTask=4, ActivationOffset=0, RteCyclicTriggerImplementation=Auto, RTEEventRef=ThrmlDutyCycle_Init1_InitEvent, MappedToTaskRef=Task_Init_9
      Ap_TqRsDg_Ap_TqRsDg_ECU_Composition: SoftwareComponentInstanceRef=Ap_TqRsDg, ImplementationRef=Ap_TqRsDg_Implementation
        Task_Init_10_17_Timer0 (RunnableEntityMapping): PositionInTask=17, ActivationOffset=0, RteCyclicTriggerImplementation=Auto, RTEEventRef=TqRsDg_Init1_InitEvent, MappedToTaskRef=Task_Init_10
        Task_2ms_10_36_Timer0 (RunnableEntityMapping): PositionInTask=36, ActivationOffset=0, RteCyclicTriggerImplementation=Auto, RTEEventRef=TMT_TqRsDg_Per1, MappedToTaskRef=Task_2ms_10
      Ap_TrqArblim_Ap_TrqArblim_ECU_Composition: SoftwareComponentInstanceRef=Ap_TrqArblim, ImplementationRef=Ap_TrqArblim_Implementation
        Task_Init_10_38_Timer0 (RunnableEntityMapping): PositionInTask=38, ActivationOffset=0, RteCyclicTriggerImplementation=Auto, RTEEventRef=TrqArblim_InitEvent, MappedToTaskRef=Task_Init_10
        Task_2ms_10_13_Timer0 (RunnableEntityMapping): PositionInTask=13, ActivationOffset=0, RteCyclicTriggerImplementation=Auto, RTEEventRef=TMT_TrqArblim_Per1, MappedToTaskRef=Task_2ms_10
      Ap_TrqCanc_Ap_TrqCanc_ECU_Composition: SoftwareComponentInstanceRef=Ap_TrqCanc, ImplementationRef=Ap_TrqCanc_Implementation
        Task_2ms_10_57_Timer0 (RunnableEntityMapping): PositionInTask=57, ActivationOffset=0, RteCyclicTriggerImplementation=Auto, RTEEventRef=TMT_TrqCanc_Per1, MappedToTaskRef=Task_2ms_10
        Task_Init_10_36_Timer0 (RunnableEntityMapping): PositionInTask=36, ActivationOffset=0, RteCyclicTriggerImplementation=Auto, RTEEventRef=TrqCanc_InitEvent, MappedToTaskRef=Task_Init_10
        MAP_Rte_NvmBlock_Ap_TrqCanc_CogTrqRplComp (NVRamAllocation): SwNvRamMappingReference=Ap_TrqCanc.CogTrqRplCompBlk, NvmBlockRef=Rte_NvmBlock_Ap_TrqCanc_CogTrqRplComp
        MAP_Rte_NvmBlock_Ap_TrqCanc_CogTrqCal (NVRamAllocation): SwNvRamMappingReference=Ap_TrqCanc.CogTrqCalBlk, NvmBlockRef=Rte_NvmBlock_Ap_TrqCanc_CogTrqCal
      Ap_TrqOsc_Ap_TrqOsc_ECU_Composition: SoftwareComponentInstanceRef=Ap_TrqOsc, ImplementationRef=Ap_TrqOsc_Implementation
        Task_2ms_10_11_Timer0 (RunnableEntityMapping): PositionInTask=11, ActivationOffset=0, RteCyclicTriggerImplementation=Auto, RTEEventRef=TMT_TrqOsc_Per1, MappedToTaskRef=Task_2ms_10
        Task_Init_10_32_Timer0 (RunnableEntityMapping): PositionInTask=32, ActivationOffset=0, RteCyclicTriggerImplementation=Auto, RTEEventRef=TrqOsc_InitEvent, MappedToTaskRef=Task_Init_10
      Ap_TuningSelAuth_Ap_TuningSelAuth_ECU_Composition: SoftwareComponentInstanceRef=Ap_TuningSelAuth, ImplementationRef=Ap_TuningSelAuth_Implementation
        Task_Init_10_7_Timer0 (RunnableEntityMapping): PositionInTask=7, ActivationOffset=0, RteCyclicTriggerImplementation=Auto, RTEEventRef=TuningSelAuth_Init1_InitEvent, MappedToTaskRef=Task_Init_10
        Task_10ms_10_0_Timer0 (RunnableEntityMapping): PositionInTask=0, ActivationOffset=0, RteCyclicTriggerImplementation=Auto, RTEEventRef=TMT_TuningSelAuth_Per1, MappedToTaskRef=Task_10ms_10
      Ap_WIRInputQual_Ap_WIRInputQual_ECU_Composition: SoftwareComponentInstanceRef=Ap_WIRInputQual, ImplementationRef=Ap_WIRInputQual_Implementation
        Task_2ms_10_43_Timer0 (RunnableEntityMapping): PositionInTask=43, ActivationOffset=0, RteCyclicTriggerImplementation=Auto, RTEEventRef=TMT_WIRInputQual_Per1, MappedToTaskRef=Task_2ms_10
      Ap_WhlImbRej_Ap_WhlImbRej_ECU_Composition: SoftwareComponentInstanceRef=Ap_WhlImbRej, ImplementationRef=Ap_WhlImbRej_Implementation
        4 x RunnableEntityMapping, all with ActivationOffset=0, RteCyclicTriggerImplementation=Auto:
          Task_2ms_10_44_Timer0: PositionInTask=44, RTEEventRef=TMT_WhlImbRej_Per1, MappedToTaskRef=Task_2ms_10
          Task_2ms_10_45_Timer0: PositionInTask=45, RTEEventRef=TMT_WhlImbRej_Per3, MappedToTaskRef=Task_2ms_10
          Task_4ms_10_4_Timer0: PositionInTask=4, RTEEventRef=TMT_WhlImbRej_Per2, MappedToTaskRef=Task_4ms_10
          Task_Init_10_12_Timer0: PositionInTask=12, RTEEventRef=WhlImbRej_Init1_InitEvent, MappedToTaskRef=Task_Init_10
      Ap_ePWM2_Ap_ePWM2_ECU_Composition: SoftwareComponentInstanceRef=Ap_ePWM2, ImplementationRef=Ap_ePWM2_Implementation
        3 x RunnableEntityMapping, all with ActivationOffset=0, RteCyclicTriggerImplementation=Auto:
          Task_2ms_10_33_Timer0: PositionInTask=33, RTEEventRef=TMT_ePWM2_Per1, MappedToTaskRef=Task_2ms_10
          Task_Trans_10_12_TrigModeSwitch0: PositionInTask=12, RTEEventRef=MST_ePWM2_Trns1_0, MappedToTaskRef=Task_Trans_10
          Task_Trans_10_1_TrigModeSwitch0: PositionInTask=1, RTEEventRef=MST_ePWM2_Trns2_0, MappedToTaskRef=Task_Trans_10
      Assist_Ap_Assist_ECU_Composition: SoftwareComponentInstanceRef=Assist, ImplementationRef=Ap_Assist_Implementation
        Task_2ms_10_16_Timer0 (RunnableEntityMapping): PositionInTask=16, ActivationOffset=0, RteCyclicTriggerImplementation=Auto, RTEEventRef=TMT_Assist_Per1, MappedToTaskRef=Task_2ms_10
      BatteryVoltage_Ap_BatteryVoltage_ECU_Composition: SoftwareComponentInstanceRef=BatteryVoltage, ImplementationRef=Ap_BatteryVoltage_Implementation
        3 x RunnableEntityMapping, all with ActivationOffset=0, RteCyclicTriggerImplementation=Auto:
          Task_4ms_9_0_Timer0: PositionInTask=0, RTEEventRef=TMT_BatteryVoltage_Per2, MappedToTaskRef=Task_4ms_9
          Task_Init_9_7_Timer0: PositionInTask=7, RTEEventRef=BatteryVoltage_Init1_InitEvent, MappedToTaskRef=Task_Init_9
          Task_2ms_9_0_Timer0: PositionInTask=0, RTEEventRef=TMT_BatteryVoltage_Per1, MappedToTaskRef=Task_2ms_9
        MAP_Rte_NvmBlock_BatteryVoltage_OvervoltageData (NVRamAllocation): SwNvRamMappingReference=BatteryVoltage.OvervoltageBlock, NvmBlockRef=Rte_NvmBlock_BatteryVoltage_OvervoltageData
      BkCpPc_Sa_BkCpPc_ECU_Composition: SoftwareComponentInstanceRef=BkCpPc, ImplementationRef=Sa_BkCpPc_Implementation
        3 x RunnableEntityMapping, all with ActivationOffset=0, RteCyclicTriggerImplementation=Auto:
          Task_Trans_10_7_TrigModeSwitch0: PositionInTask=7, RTEEventRef=MST_BkCpPc_Trns1_0, MappedToTaskRef=Task_Trans_10
          Task_Trans_10_3_TrigModeSwitch0: PositionInTask=3, RTEEventRef=MST_BkCpPc_Trns2_0, MappedToTaskRef=Task_Trans_10
          Task_2ms_10_66_Timer0: PositionInTask=66, RTEEventRef=TMT_BkCpPc_Per1, MappedToTaskRef=Task_2ms_10
      CDD_CDD_ECU_Composition: ServiceComponentPrototypeRef=CDD, ImplementationRef=CDD_Implementation
        Task_10ms_SchM9_3_Timer0 (RunnableEntityMapping): PositionInTask=3, ActivationOffset=0, RteCyclicTriggerImplementation=Auto, RTEEventRef=TMT_Cdd_Mainfunction, MappedToTaskRef=Task_10ms_SchM9
      CDDInterface_Sa_CDDInterface_ECU_Composition: SoftwareComponentInstanceRef=CDDInterface, ImplementationRef=Sa_CDDInterface_Implementation
        6 x RunnableEntityMapping, all with ActivationOffset=0, RteCyclicTriggerImplementation=Auto:
          Task_2ms_10_2_Timer0: PositionInTask=2, RTEEventRef=TMT_CDDInterface_Per1, MappedToTaskRef=Task_2ms_10
          Task_Init_10_0_Timer0: PositionInTask=0, RTEEventRef=CDDInterface_Init1_InitEvent, MappedToTaskRef=Task_Init_10
          Task_10ms_10_1_Timer0: PositionInTask=1, RTEEventRef=TMT_CDDInterface_Per4, MappedToTaskRef=Task_10ms_10
          Task_Init_10_41_Timer0: PositionInTask=41, RTEEventRef=CDDInterface_Init3_InitEvent, MappedToTaskRef=Task_Init_10
          Task_2ms_10_38_Timer0: PositionInTask=38, RTEEventRef=TMT_CDDInterface_Per2, MappedToTaskRef=Task_2ms_10
          Task_Init_10_8_Timer0: PositionInTask=8, RTEEventRef=CDDInterface_Init2_InitEvent, MappedToTaskRef=Task_Init_10
      Cd_Nhet1_Cd_Nhet1_ECU_Composition: SoftwareComponentInstanceRef=Cd_Nhet1, ImplementationRef=Cd_Nhet1_Implementation
        Task_2ms_10_5_Timer0 (RunnableEntityMapping): PositionInTask=5, ActivationOffset=0, RteCyclicTriggerImplementation=Auto, RTEEventRef=TMT_Nhet1_Per2, MappedToTaskRef=Task_2ms_10
        Task_2ms_10_3_Timer0 (RunnableEntityMapping): PositionInTask=3, ActivationOffset=0, RteCyclicTriggerImplementation=Auto, RTEEventRef=TMT_Nhet1_Per1, MappedToTaskRef=Task_2ms_10
      Cd_uDiag_Cd_uDiag_ECU_Composition: SoftwareComponentInstanceRef=Cd_uDiag, ImplementationRef=Cd_uDiag_Implementation
        7 x RunnableEntityMapping, all with ActivationOffset=0, RteCyclicTriggerImplementation=Auto:
          Task_4ms_10_2_Timer0: PositionInTask=2, RTEEventRef=TMT_uDiagLossOfExec_Per3, MappedToTaskRef=Task_4ms_10
          Task_10ms_10_7_Timer0: PositionInTask=7, RTEEventRef=TMT_uDiagVIM_Per, MappedToTaskRef=Task_10ms_10
          Task_10ms_10_6_Timer0: PositionInTask=6, RTEEventRef=TMT_uDiagECC_Per, MappedToTaskRef=Task_10ms_10
          Task_Init_10_5_Timer0: PositionInTask=5, RTEEventRef=uDiagPeriphStartup_InitEvent, MappedToTaskRef=Task_Init_10
          Task_100ms_10_8_Timer0: PositionInTask=8, RTEEventRef=TMT_uDiagStaticRegs_Per, MappedToTaskRef=Task_100ms_10
          Task_Init_10_4_Timer0: PositionInTask=4, RTEEventRef=uDiagResetHandler_InitEvent, MappedToTaskRef=Task_Init_10
          Task_2ms_10_49_Timer0: PositionInTask=49, RTEEventRef=TMT_uDiagLossOfExec_Per2, MappedToTaskRef=Task_2ms_10
      CmMtrCurr_Sa_CmMtrCurr_ECU_Composition: SoftwareComponentInstanceRef=CmMtrCurr, ImplementationRef=Sa_CmMtrCurr_Implementation
        4 x RunnableEntityMapping, all with ActivationOffset=0, RteCyclicTriggerImplementation=Auto:
          Task_2ms_10_34_Timer0: PositionInTask=34, RTEEventRef=TMT_CmMtrCurr_Per2, MappedToTaskRef=Task_2ms_10
          Task_100ms_10_2_Timer0: PositionInTask=2, RTEEventRef=TMT_CmMtrCurr_Per1, MappedToTaskRef=Task_100ms_10
          Task_2ms_10_35_Timer0: PositionInTask=35, RTEEventRef=TMT_CmMtrCurr_Per3, MappedToTaskRef=Task_2ms_10
          Task_Init_10_10_Timer0: PositionInTask=10, RTEEventRef=CmMtrCurr_InitEvent, MappedToTaskRef=Task_Init_10
        MAP_Rte_NvmBlock_CmMtrCurr_ShCurrCal (NVRamAllocation): SwNvRamMappingReference=CmMtrCurr.ShCurrCalBlk, NvmBlockRef=Rte_NvmBlock_CmMtrCurr_ShCurrCal
        MAP_Rte_NvmBlock_CmMtrCurr_CurrTempOffset (NVRamAllocation): SwNvRamMappingReference=CmMtrCurr.CurrTempOffsetBlk, NvmBlockRef=Rte_NvmBlock_CmMtrCurr_CurrTempOffset
      ComM_ComM_ECU_Composition: ServiceComponentPrototypeRef=ComM, ImplementationRef=ComM_Implementation
        Task_10ms_SchM9_2_Timer0 (RunnableEntityMapping): PositionInTask=2, ActivationOffset=0, RteCyclicTriggerImplementation=Auto, RTEEventRef=TMT_ComM_MainFunction_0, MappedToTaskRef=Task_10ms_SchM9
      ComplErr_Ap_ComplErr_ECU_Composition: SoftwareComponentInstanceRef=ComplErr, ImplementationRef=Ap_ComplErr_Implementation
        Task_2ms_10_51_Timer0 (RunnableEntityMapping): PositionInTask=51, ActivationOffset=0, RteCyclicTriggerImplementation=Auto, RTEEventRef=TMT_ComplErr_Per1, MappedToTaskRef=Task_2ms_10
      CtrlTemp_Sa_CtrlTemp_ECU_Composition: SoftwareComponentInstanceRef=CtrlTemp, ImplementationRef=Sa_CtrlTemp_Implementation
        3 x RunnableEntityMapping, all with ActivationOffset=0, RteCyclicTriggerImplementation=Auto:
          Task_Init_9_1_Timer0: PositionInTask=1, RTEEventRef=CtrlTemp_Init1_InitEvent, MappedToTaskRef=Task_Init_9
          Task_100ms_9_0_Timer0: PositionInTask=0, RTEEventRef=TMT_CtrlTemp_Per2, MappedToTaskRef=Task_100ms_9
          Task_2ms_9_4_Timer0: PositionInTask=4, RTEEventRef=TMT_CtrlTemp_Per1, MappedToTaskRef=Task_2ms_9
      CtrldDisShtdn_Ap_CtrldDisShtdn_ECU_Composition: SoftwareComponentInstanceRef=CtrldDisShtdn, ImplementationRef=Ap_CtrldDisShtdn_Implementation
        Task_2ms_10_28_Timer0 (RunnableEntityMapping): PositionInTask=28, ActivationOffset=0, RteCyclicTriggerImplementation=Auto, RTEEventRef=TMT_CtrldDisShtdn_Per1, MappedToTaskRef=Task_2ms_10
      CurrCmd_Ap_CurrCmd_ECU_Composition: SoftwareComponentInstanceRef=CurrCmd, ImplementationRef=Ap_CurrCmd_Implementation
        Task_Init_10_11_Timer0 (RunnableEntityMapping): PositionInTask=11, ActivationOffset=0, RteCyclicTriggerImplementation=Auto, RTEEventRef=CurrCmd_InitEvent, MappedToTaskRef=Task_Init_10
        Task_2ms_10_37_Timer0 (RunnableEntityMapping): PositionInTask=37, ActivationOffset=0, RteCyclicTriggerImplementation=Auto, RTEEventRef=TMT_CurrCmd_Per1, MappedToTaskRef=Task_2ms_10
      CurrParamComp_Ap_CurrParamComp_ECU_Composition: SoftwareComponentInstanceRef=CurrParamComp, ImplementationRef=Ap_CurrParamComp_Implementation
        3 x RunnableEntityMapping, all with ActivationOffset=0, RteCyclicTriggerImplementation=Auto:
          Task_Init_10_13_Timer0: PositionInTask=13, RTEEventRef=CurrParamComp_InitEvent, MappedToTaskRef=Task_Init_10
          Task_2ms_10_48_Timer0: PositionInTask=48, RTEEventRef=TMT_CurrParamComp_Per1, MappedToTaskRef=Task_2ms_10
          Task_100ms_10_0_Timer0: PositionInTask=0, RTEEventRef=TMT_CurrParamComp_Per2, MappedToTaskRef=Task_100ms_10
        MAP_Rte_NvmBlock_CurrParamComp_EOLNomMtrParam (NVRamAllocation): SwNvRamMappingReference=CurrParamComp.EOLNomMtrParamBlk, NvmBlockRef=Rte_NvmBlock_CurrParamComp_EOLNomMtrParam
      CustPerSrvcs_Ap_CustPerSrvcs_ECU_Composition: SoftwareComponentInstanceRef=CustPerSrvcs, ImplementationRef=Ap_CustPerSrvcs_Implementation
        3 x RunnableEntityMapping, all with ActivationOffset=0, RteCyclicTriggerImplementation=Auto:
          Task_Trans_9_5_TrigModeSwitch0: PositionInTask=5, RTEEventRef=MST_CustPerSrvcs_Trns1_0, MappedToTaskRef=Task_Trans_9
          Task_Init_9_9_Timer0: PositionInTask=9, RTEEventRef=CustPerSrvcs_Init1_InitEvent, MappedToTaskRef=Task_Init_9
          Task_100ms_9_1_Timer0: PositionInTask=1, RTEEventRef=TMT_CustPerSrvcs_Per1, MappedToTaskRef=Task_100ms_9
      Damping_Ap_Damping_ECU_Composition: SoftwareComponentInstanceRef=Damping, ImplementationRef=Ap_Damping_Implementation
        Task_Init_10_16_Timer0 (RunnableEntityMapping): PositionInTask=16, ActivationOffset=0, RteCyclicTriggerImplementation=Auto, RTEEventRef=Damping_Init1_InitEvent, MappedToTaskRef=Task_Init_10
        Task_2ms_10_18_Timer0 (RunnableEntityMapping): PositionInTask=18, ActivationOffset=0, RteCyclicTriggerImplementation=Auto, RTEEventRef=TMT_Damping_Per1, MappedToTaskRef=Task_2ms_10
      DemIf_Ap_DemIf_ECU_Composition: SoftwareComponentInstanceRef=DemIf, ImplementationRef=Ap_DemIf_Implementation
        Task_10ms_9_2_Timer0 (RunnableEntityMapping): PositionInTask=2, ActivationOffset=0, RteCyclicTriggerImplementation=Auto, RTEEventRef=TMT_DemIf_Per1, MappedToTaskRef=Task_10ms_9
      DiagMgr_Ap_DiagMgr10_ECU_Composition: SoftwareComponentInstanceRef=DiagMgr, ImplementationRef=Ap_DiagMgr10_Implementation
        4 x RunnableEntityMapping, all with ActivationOffset=0, RteCyclicTriggerImplementation=Auto:
          Task_Trans_10_0_TrigModeSwitch0: PositionInTask=0, RTEEventRef=MST_DiagMgr10_Trns_0, MappedToTaskRef=Task_Trans_10
          Task_Init_10_1_Timer0: PositionInTask=1, RTEEventRef=DiagMgr10_InitEvent, MappedToTaskRef=Task_Init_10
          Task_100ms_10_3_Timer0: PositionInTask=3, RTEEventRef=TMT_DiagMgr10_Per, MappedToTaskRef=Task_100ms_10
          Task_2ms_10_67_Timer0: PositionInTask=67, RTEEventRef=TMT_DiagMgr_Per1, MappedToTaskRef=Task_2ms_10
      DigColPs_Sa_DigColPs_ECU_Composition: SoftwareComponentInstanceRef=DigColPs, ImplementationRef=Sa_DigColPs_Implementation
        4 x RunnableEntityMapping, all with ActivationOffset=0, RteCyclicTriggerImplementation=Auto:
          Task_4ms_10_0_Timer0: PositionInTask=0, RTEEventRef=TMT_DigColPs_Per2, MappedToTaskRef=Task_4ms_10
          Task_100ms_10_7_Timer0: PositionInTask=7, RTEEventRef=TMT_DigColPs_Per3, MappedToTaskRef=Task_100ms_10
          Task_2ms_10_50_Timer0: PositionInTask=50, RTEEventRef=TMT_DigColPs_Per1, MappedToTaskRef=Task_2ms_10
          Task_Init_10_28_Timer0: PositionInTask=28, RTEEventRef=DigColPs_Init1_InitEvent, MappedToTaskRef=Task_Init_10
        MAP_Rte_NvmBlock_DigColPs_DigColPsEOL (NVRamAllocation): SwNvRamMappingReference=DigColPs.DigColPosSnsrEOLBlk, NvmBlockRef=Rte_NvmBlock_DigColPs_DigColPsEOL
      DigPhsReasDiag_Ap_DigPhsReasDiag_ECU_Composition: SoftwareComponentInstanceRef=DigPhsReasDiag, ImplementationRef=Ap_DigPhsReasDiag_Implementation
        3 x RunnableEntityMapping, all with ActivationOffset=0, RteCyclicTriggerImplementation=Auto:
          Task_Init_10_9_Timer0: PositionInTask=9, RTEEventRef=DigPhsReasDiag_InitEvent, MappedToTaskRef=Task_Init_10
          Task_Trans_10_10_TrigModeSwitch0: PositionInTask=10, RTEEventRef=MST_DigPhsReasDiag_Trans1_0, MappedToTaskRef=Task_Trans_10
          Task_2ms_10_59_Timer0: PositionInTask=59, RTEEventRef=TMT_DigPhsReasDiag_Per1, MappedToTaskRef=Task_2ms_10
      EOTActuatorMng_Ap_EOTActuatorMng_ECU_Composition: SoftwareComponentInstanceRef=EOTActuatorMng, ImplementationRef=Ap_EOTActuatorMng_Implementation
        Task_2ms_10_60_Timer0 (RunnableEntityMapping): PositionInTask=60, ActivationOffset=0, RteCyclicTriggerImplementation=Auto, RTEEventRef=TMT_EOTActuatorMng_Per1, MappedToTaskRef=Task_2ms_10
      FltInjection_Ap_FltInjection_ECU_Composition: SoftwareComponentInstanceRef=FltInjection, ImplementationRef=Ap_FltInjection_Implementation
        Task_2ms_9_11_Timer0 (RunnableEntityMapping): PositionInTask=11, ActivationOffset=0, RteCyclicTriggerImplementation=Auto, RTEEventRef=TMT_FltInjection_Per1, MappedToTaskRef=Task_2ms_9
      FrqDepDmpnInrtCmp_Ap_FrqDepDmpnInrtCmp_ECU_Composition: SoftwareComponentInstanceRef=FrqDepDmpnInrtCmp, ImplementationRef=Ap_FrqDepDmpnInrtCmp_Implementation
        Task_Init_10_15_Timer0 (RunnableEntityMapping): PositionInTask=15, ActivationOffset=0, RteCyclicTriggerImplementation=Auto, RTEEventRef=FrqDepDmpnInrtCmp_InitEvent, MappedToTaskRef=Task_Init_10
        Task_2ms_10_19_Timer0 (RunnableEntityMapping): PositionInTask=19, ActivationOffset=0, RteCyclicTriggerImplementation=Auto, RTEEventRef=TMT_FrqDepDmpnInrtCmp_Per1, MappedToTaskRef=Task_2ms_10
      HiLoadStall_Ap_HiLoadStall_ECU_Composition: SoftwareComponentInstanceRef=HiLoadStall, ImplementationRef=Ap_HiLoadStall_Implementation
        Task_2ms_9_6_Timer0 (RunnableEntityMapping): PositionInTask=6, ActivationOffset=0, RteCyclicTriggerImplementation=Auto, RTEEventRef=TMT_HiLoadStall_Per1, MappedToTaskRef=Task_2ms_9
      HighFreqAssist_Ap_HighFreqAssist_ECU_Composition: SoftwareComponentInstanceRef=HighFreqAssist, ImplementationRef=Ap_HighFreqAssist_Implementation
        Task_2ms_10_46_Timer0 (RunnableEntityMapping): PositionInTask=46, ActivationOffset=0, RteCyclicTriggerImplementation=Auto, RTEEventRef=TMT_HighFreqAssist_Per1, MappedToTaskRef=Task_2ms_10
      HystComp_Ap_HystComp_ECU_Composition: SoftwareComponentInstanceRef=HystComp, ImplementationRef=Ap_HystComp_Implementation
        Task_2ms_10_17_Timer0 (RunnableEntityMapping): PositionInTask=17, ActivationOffset=0, RteCyclicTriggerImplementation=Auto, RTEEventRef=TMT_HystComp_Per1, MappedToTaskRef=Task_2ms_10
        Task_Init_10_14_Timer0 (RunnableEntityMapping): PositionInTask=14, ActivationOffset=0, RteCyclicTriggerImplementation=Auto, RTEEventRef=HystComp_Init1_InitEvent, MappedToTaskRef=Task_Init_10
      IoHwAbsDigSig_IoHwAbstraction_ECU_Composition: SoftwareComponentInstanceRef=IoHwAbsDigSig, ImplementationRef=IoHwAbstraction_Implementation
        Task_10ms_SchM9_4_Timer0 (RunnableEntityMapping): PositionInTask=4, ActivationOffset=0, RteCyclicTriggerImplementation=Auto, RTEEventRef=TMT_IoHwAb_MainFunctionDummy, MappedToTaskRef=Task_10ms_SchM9
      IoHwAbstractionUsr_IoHwAbstractionUsr_ECU_Composition: SoftwareComponentInstanceRef=IoHwAbstractionUsr, ImplementationRef=IoHwAbstractionUsr_Implementation
        3 x RunnableEntityMapping, all with ActivationOffset=0, RteCyclicTriggerImplementation=Auto:
          Task_2ms_10_1_Timer0: PositionInTask=1, RTEEventRef=TMT_IoHwAb_StartADC, MappedToTaskRef=Task_2ms_10
          Task_2ms_10_31_Timer0: PositionInTask=31, RTEEventRef=TMT_IoHwAb_ReadADC, MappedToTaskRef=Task_2ms_10
          Task_Init_10_6_Timer0: PositionInTask=6, RTEEventRef=IoHwAb_InitEvent, MappedToTaskRef=Task_Init_10
      MtrDrvDiag_Sa_MtrDrvDiag_ECU_Composition: SoftwareComponentInstanceRef=MtrDrvDiag, ImplementationRef=Sa_MtrDrvDiag_Implementation
        3 x RunnableEntityMapping, all with ActivationOffset=0, RteCyclicTriggerImplementation=Auto:
          Task_Trans_10_5_TrigModeSwitch0: PositionInTask=5, RTEEventRef=MST_MtrDrvDiag_Trns1_0, MappedToTaskRef=Task_Trans_10
          Task_2ms_10_42_Timer0: PositionInTask=42, RTEEventRef=TMT_MtrDrvDiag_Per2, MappedToTaskRef=Task_2ms_10
          Task_2ms_10_41_Timer0: PositionInTask=41, RTEEventRef=TMT_MtrDrvDiag_Per1, MappedToTaskRef=Task_2ms_10
      NexteerLibs_NexteerLibs_ECU_Composition: ServiceComponentPrototypeRef=NexteerLibs, ImplementationRef=NexteerLibs_Implementation
        Task_2ms_10_39_Timer0 (RunnableEntityMapping): PositionInTask=39, ActivationOffset=0, RteCyclicTriggerImplementation=Auto, RTEEventRef=TMT_SystemTime_Per1, MappedToTaskRef=Task_2ms_10
      NtWrap_NtWrap_ECU_Composition: SoftwareComponentInstanceRef=NtWrap, ImplementationRef=NtWrap_Implementation
        Task_100ms_10_4_Timer0 (RunnableEntityMapping): PositionInTask=4, ActivationOffset=0, RteCyclicTriggerImplementation=Auto, RTEEventRef=TMT_NtWrap_Per1, MappedToTaskRef=Task_100ms_10
      NvM_NvM_ECU_Composition: ServiceComponentPrototypeRef=NvM, ImplementationRef=NvM_Implementation
        Task_10ms_SchM9_1_Timer0 (RunnableEntityMapping): PositionInTask=1, ActivationOffset=0, RteCyclicTriggerImplementation=Auto, RTEEventRef=TMT_NvM_MainFunction, MappedToTaskRef=Task_10ms_SchM9
      NvMProxy_NvMProxy_ECU_Composition: ServiceComponentPrototypeRef=NvMProxy, ImplementationRef=NvMProxy_Implementation
        Task_10ms_SchM9_0_Timer0 (RunnableEntityMapping): PositionInTask=0, ActivationOffset=0, RteCyclicTriggerImplementation=Auto, RTEEventRef=TMT_NvMProxy_MainFunction, MappedToTaskRef=Task_10ms_SchM9
      PeakCurrEst_Ap_PeakCurrEst_ECU_Composition: SoftwareComponentInstanceRef=PeakCurrEst, ImplementationRef=Ap_PeakCurrEst_Implementation
        Task_100ms_10_1_Timer0 (RunnableEntityMapping): PositionInTask=1, ActivationOffset=0, RteCyclicTriggerImplementation=Auto, RTEEventRef=TMT_PeakCurrEst_Per2, MappedToTaskRef=Task_100ms_10
        Task_2ms_10_56_Timer0 (RunnableEntityMapping): PositionInTask=56, ActivationOffset=0, RteCyclicTriggerImplementation=Auto, RTEEventRef=TMT_PeakCurrEst_Per1, MappedToTaskRef=Task_2ms_10
      Polarity_Ap_Polarity_ECU_Composition: SoftwareComponentInstanceRef=Polarity, ImplementationRef=Ap_Polarity_Implementation
        Task_10ms_10_3_Timer0 (RunnableEntityMapping): PositionInTask=3, ActivationOffset=0, RteCyclicTriggerImplementation=Auto, RTEEventRef=TMT_Polarity_Per1, MappedToTaskRef=Task_10ms_10
        Task_Init_10_3_Timer0 (RunnableEntityMapping): PositionInTask=3, ActivationOffset=0, RteCyclicTriggerImplementation=Auto, RTEEventRef=Polarity_Init1_InitEvent, MappedToTaskRef=Task_Init_10
      QuadDet_Ap_QuadDet_ECU_Composition: SoftwareComponentInstanceRef=QuadDet, ImplementationRef=Ap_QuadDet_Implementation
        Task_2ms_10_47_Timer0 (RunnableEntityMapping): PositionInTask=47, ActivationOffset=0, RteCyclicTriggerImplementation=Auto, RTEEventRef=TMT_QuadDet_Per1, MappedToTaskRef=Task_2ms_10
      Return_Ap_Return_ECU_Composition: SoftwareComponentInstanceRef=Return, ImplementationRef=Ap_Return_Implementation
        Task_2ms_10_14_Timer0 (RunnableEntityMapping): PositionInTask=14, ActivationOffset=0, RteCyclicTriggerImplementation=Auto, RTEEventRef=TMT_Return_Per1, MappedToTaskRef=Task_2ms_10
      ReturnFirewall_Ap_ReturnFirewall_ECU_Composition: SoftwareComponentInstanceRef=ReturnFirewall, ImplementationRef=Ap_ReturnFirewall_Implementation
        Task_2ms_10_15_Timer0 (RunnableEntityMapping): PositionInTask=15, ActivationOffset=0, RteCyclicTriggerImplementation=Auto, RTEEventRef=TMT_ReturnFirewall_Per1, MappedToTaskRef=Task_2ms_10
      RteErrata_RteErrata10_ECU_Composition: SoftwareComponentInstanceRef=RteErrata, ImplementationRef=RteErrata10_Implementation
        4 x RunnableEntityMapping, all with PositionInTask=13, ActivationOffset=0, RteCyclicTriggerImplementation=Auto, MappedToTaskRef=Task_Trans_10:
          Task_Trans_10_13_TrigModeSwitch3: RTEEventRef=MST_RteErrata10_Trns_3
          Task_Trans_10_13_TrigModeSwitch2: RTEEventRef=MST_RteErrata10_Trns_2
          Task_Trans_10_13_TrigModeSwitch1: RTEEventRef=MST_RteErrata10_Trns_1
          Task_Trans_10_13_TrigModeSwitch0: RTEEventRef=MST_RteErrata10_Trns_0
      RteErrata8_RteErrata8_ECU_Composition: SoftwareComponentInstanceRef=RteErrata8, ImplementationRef=RteErrata8_Implementation
        4 x RunnableEntityMapping, all with PositionInTask=1, ActivationOffset=0, RteCyclicTriggerImplementation=Auto, MappedToTaskRef=Task_Trans_8:
          Task_Trans_8_1_TrigModeSwitch3: RTEEventRef=MST_RteErrata8_Trns_3
          Task_Trans_8_1_TrigModeSwitch2: RTEEventRef=MST_RteErrata8_Trns_2
          Task_Trans_8_1_TrigModeSwitch1: RTEEventRef=MST_RteErrata8_Trns_1
          Task_Trans_8_1_TrigModeSwitch0: RTEEventRef=MST_RteErrata8_Trns_0
      RteErrata9_RteErrata9_ECU_Composition: SoftwareComponentInstanceRef=RteErrata9, ImplementationRef=RteErrata9_Implementation
        4 x RunnableEntityMapping, all with PositionInTask=8, ActivationOffset=0, RteCyclicTriggerImplementation=Auto, MappedToTaskRef=Task_Trans_9:
          Task_Trans_9_8_TrigModeSwitch3: RTEEventRef=MST_RteErrata9_Trns_3
          Task_Trans_9_8_TrigModeSwitch2: RTEEventRef=MST_RteErrata9_Trns_2
          Task_Trans_9_8_TrigModeSwitch1: RTEEventRef=MST_RteErrata9_Trns_1
          Task_Trans_9_8_TrigModeSwitch0: RTEEventRef=MST_RteErrata9_Trns_0
      Sa_DigHwTrqSENT_Sa_DigHwTrqSENT_ECU_Composition: SoftwareComponentInstanceRef=Sa_DigHwTrqSENT, ImplementationRef=Sa_DigHwTrqSENT_Implementation
        4 x RunnableEntityMapping, all with ActivationOffset=0, RteCyclicTriggerImplementation=Auto:
          Task_Init_10_22_Timer0: PositionInTask=22, RTEEventRef=DigHwTrqSENT_Init1_InitEvent, MappedToTaskRef=Task_Init_10
          Task_4ms_10_3_Timer0: PositionInTask=3, RTEEventRef=TMT_DigHwTrqSENT_Per2, MappedToTaskRef=Task_4ms_10
          Task_100ms_10_5_Timer0: PositionInTask=5, RTEEventRef=TMT_DigHwTrqSENT_Per3, MappedToTaskRef=Task_100ms_10
          Task_2ms_10_6_Timer0: PositionInTask=6, RTEEventRef=TMT_DigHwTrqSENT_Per1, MappedToTaskRef=Task_2ms_10
        MAP_Rte_NvmBlock_Sa_DigHwTrqSENT_DigTrqTrim (NVRamAllocation): SwNvRamMappingReference=Sa_DigHwTrqSENT.DigHwTrqSENTTrim, NvmBlockRef=Rte_NvmBlock_Sa_DigHwTrqSENT_DigTrqTrim
      Sa_DigMSB_Sa_DigMSB_ECU_Composition: SoftwareComponentInstanceRef=Sa_DigMSB, ImplementationRef=Sa_DigMSB_Implementation
        3 x RunnableEntityMapping, all with ActivationOffset=0, RteCyclicTriggerImplementation=Auto:
          Task_100ms_10_6_Timer0: PositionInTask=6, RTEEventRef=TMT_DigMSB_Per3, MappedToTaskRef=Task_100ms_10
          Task_Init_10_23_Timer0: PositionInTask=23, RTEEventRef=DigMSB_InitEvent, MappedToTaskRef=Task_Init_10
          Task_2ms_10_4_Timer0: PositionInTask=4, RTEEventRef=TMT_DigMSB_Per2, MappedToTaskRef=Task_2ms_10
        MAP_Rte_NvmBlock_Sa_DigMSB_DigMSBEOLData (NVRamAllocation): SwNvRamMappingReference=Sa_DigMSB.DigMSBEOLBlk, NvmBlockRef=Rte_NvmBlock_Sa_DigMSB_DigMSBEOLData
      Sa_MtrVel_Sa_MtrVel_ECU_Composition: SoftwareComponentInstanceRef=Sa_MtrVel, ImplementationRef=Sa_MtrVel_Implementation
        3 x RunnableEntityMapping, all with ActivationOffset=0, RteCyclicTriggerImplementation=Auto:
          Task_Init_10_25_Timer0: PositionInTask=25, RTEEventRef=MtrVel_InitEvent, MappedToTaskRef=Task_Init_10
          Task_2ms_10_9_Timer0: PositionInTask=9, RTEEventRef=TMT_MtrVel_Per1, MappedToTaskRef=Task_2ms_10
          Task_2ms_10_8_Timer0: PositionInTask=8, RTEEventRef=TMT_MtrVel_Per2, MappedToTaskRef=Task_2ms_10
      Sa_MtrVel2_Sa_MtrVel2_ECU_Composition: SoftwareComponentInstanceRef=Sa_MtrVel2, ImplementationRef=Sa_MtrVel2_Implementation
        3 x RunnableEntityMapping, all with ActivationOffset=0, RteCyclicTriggerImplementation=Auto:
          Task_Init_8_2_Timer0: PositionInTask=2, RTEEventRef=MtrVel2_InitEvent, MappedToTaskRef=Task_Init_8
          Task_2ms_8_2_Timer0: PositionInTask=2, RTEEventRef=TMT_MtrVel2_Per1, MappedToTaskRef=Task_2ms_8
          Task_2ms_8_3_Timer0: PositionInTask=3, RTEEventRef=TMT_MtrVel2_Per2, MappedToTaskRef=Task_2ms_8
      Sa_MtrVel3_Sa_MtrVel3_ECU_Composition: SoftwareComponentInstanceRef=Sa_MtrVel3, ImplementationRef=Sa_MtrVel3_Implementation
        Task_Init_10_26_Timer0 (RunnableEntityMapping): PositionInTask=26, ActivationOffset=0, RteCyclicTriggerImplementation=Auto, RTEEventRef=MtrVel3_InitEvent, MappedToTaskRef=Task_Init_10
      Sa_OvrVoltMon_Sa_OvrVoltMon_ECU_Composition: SoftwareComponentInstanceRef=Sa_OvrVoltMon, ImplementationRef=Sa_OvrVoltMon_Implementation
        Task_2ms_10_65_Timer0 (RunnableEntityMapping): PositionInTask=65, ActivationOffset=0, RteCyclicTriggerImplementation=Auto, RTEEventRef=TMT_OvrVoltMon_Per1, MappedToTaskRef=Task_2ms_10
      Sa_ShtdnMech_Sa_ShtdnMech_ECU_Composition: SoftwareComponentInstanceRef=Sa_ShtdnMech, ImplementationRef=Sa_ShtdnMech_Implementation
        Task_10ms_10_9_Timer0 (RunnableEntityMapping): PositionInTask=9, ActivationOffset=0, RteCyclicTriggerImplementation=Auto, RTEEventRef=TMT_ShtdnMech_Per1, MappedToTaskRef=Task_10ms_10
      Sa_TmprlMon2_Sa_TmprlMon2_ECU_Composition: SoftwareComponentInstanceRef=Sa_TmprlMon2, ImplementationRef=Sa_TmprlMon2_Implementation
        Task_2ms_8_4_Timer0 (RunnableEntityMapping): PositionInTask=4, ActivationOffset=0, RteCyclicTriggerImplementation=Auto, RTEEventRef=TMT_TmprlMon2_Per1, MappedToTaskRef=Task_2ms_8
      SrlComInput_Ap_SrlComInput_ECU_Composition: SoftwareComponentInstanceRef=SrlComInput, ImplementationRef=Ap_SrlComInput_Implementation
        4 x RunnableEntityMapping, all with ActivationOffset=0, RteCyclicTriggerImplementation=Auto:
          Task_Init_9_10_Timer0: PositionInTask=10, RTEEventRef=SrlComInput_InitEvent, MappedToTaskRef=Task_Init_9
          Task_10ms_9_0_Timer0: PositionInTask=0, RTEEventRef=TMT_SrlComInput_Per2, MappedToTaskRef=Task_10ms_9
          Task_100ms_9_4_Timer0: PositionInTask=4, RTEEventRef=TMT_SrlComInput_Per3, MappedToTaskRef=Task_100ms_9
          Task_2ms_9_8_Timer0: PositionInTask=8, RTEEventRef=TMT_SrlComInput_Per1, MappedToTaskRef=Task_2ms_9
      SrlComOutput_Ap_SrlComOutput_ECU_Composition: SoftwareComponentInstanceRef=SrlComOutput, ImplementationRef=Ap_SrlComOutput_Implementation
        4 x RunnableEntityMapping, all with ActivationOffset=0, RteCyclicTriggerImplementation=Auto:
          Task_Init_9_11_Timer0: PositionInTask=11, RTEEventRef=SrlComOutput_Init1_InitEvent, MappedToTaskRef=Task_Init_9
          Task_10ms_9_1_Timer0: PositionInTask=1, RTEEventRef=TMT_SrlComOutput_Per2, MappedToTaskRef=Task_10ms_9
          Task_Trans_9_6_TrigModeSwitch0: PositionInTask=6, RTEEventRef=MST_SrlComOutput_Trns1_0, MappedToTaskRef=Task_Trans_9
          Task_100ms_9_5_Timer0: PositionInTask=5, RTEEventRef=TMT_SrlComOutput_Per1, MappedToTaskRef=Task_100ms_9
        MAP_Rte_NvmBlock_SrlComOutput_DTCTrigSts (NVRamAllocation): SwNvRamMappingReference=SrlComOutput.DTCTriggeredStsBlk, NvmBlockRef=Rte_NvmBlock_SrlComOutput_DTCTrigSts
      StOpCtrl_Ap_StOpCtrl_ECU_Composition: SoftwareComponentInstanceRef=StOpCtrl, ImplementationRef=Ap_StOpCtrl_Implementation
        Task_2ms_10_24_Timer0 (RunnableEntityMapping): PositionInTask=24, ActivationOffset=0, RteCyclicTriggerImplementation=Auto, RTEEventRef=TMT_StOpCtrl_Per1, MappedToTaskRef=Task_2ms_10
      StaMd_Ap_StaMd_ECU_Composition: SoftwareComponentInstanceRef=StaMd, ImplementationRef=Ap_StaMd_Implementation
        Task_2ms_10_68_Timer0 (RunnableEntityMapping): PositionInTask=68, ActivationOffset=0, RteCyclicTriggerImplementation=Auto, RTEEventRef=TMT_StaMd_Per1, MappedToTaskRef=Task_2ms_10
        StaMds_MilestoneRqst_WARMINIT_ExclArea (ExclusiveAreaImplementation): ExclusiveAreaImplMechanism=INTERRUPT_BLOCKING, ExclusiveAreaRef=StaMds_MilestoneRqst_WARMINIT_ExclArea
        Task_Trans_10_9_TrigModeSwitch0 (RunnableEntityMapping): PositionInTask=9, ActivationOffset=0, RteCyclicTriggerImplementation=Auto, RTEEventRef=MST_StaMd_Trns1_0, MappedToTaskRef=Task_Trans_10
        Task_Init_10_2_Timer0 (RunnableEntityMapping): PositionInTask=2, ActivationOffset=0, RteCyclicTriggerImplementation=Auto, RTEEventRef=StaMd_Init1_InitEvent, MappedToTaskRef=Task_Init_10
      StabilityComp_Ap_StabilityComp_ECU_Composition: SoftwareComponentInstanceRef=StabilityComp, ImplementationRef=Ap_StabilityComp_Implementation
        Task_2ms_10_21_Timer0 (RunnableEntityMapping): PositionInTask=21, ActivationOffset=0, RteCyclicTriggerImplementation=Auto, RTEEventRef=TMT_StabilityComp_Per1, MappedToTaskRef=Task_2ms_10
        Task_Init_10_20_Timer0 (RunnableEntityMapping): PositionInTask=20, ActivationOffset=0, RteCyclicTriggerImplementation=Auto, RTEEventRef=StabilityComp_Init1_InitEvent, MappedToTaskRef=Task_Init_10
      TmprlMon_Sa_TmprlMon_ECU_Composition: SoftwareComponentInstanceRef=TmprlMon, ImplementationRef=Sa_TmprlMon_Implementation
        5 x RunnableEntityMapping, all with ActivationOffset=0, RteCyclicTriggerImplementation=Auto:
          Task_10ms_10_8_Timer0: PositionInTask=8, RTEEventRef=TMT_TmprlMon_Per3, MappedToTaskRef=Task_10ms_10
          Task_Trans_10_6_TrigModeSwitch0: PositionInTask=6, RTEEventRef=MST_TmprlMon_Trns2_0, MappedToTaskRef=Task_Trans_10
          Task_2ms_10_0_Timer0: PositionInTask=0, RTEEventRef=TMT_TmprlMon_Per1, MappedToTaskRef=Task_2ms_10
          Task_2ms_10_30_Timer0: PositionInTask=30, RTEEventRef=TMT_TmprlMon_Per2, MappedToTaskRef=Task_2ms_10
          Task_Trans_10_4_TrigModeSwitch0: PositionInTask=4, RTEEventRef=MST_TmprlMon_Trns1_0, MappedToTaskRef=Task_Trans_10
      TrqCmdScl_Ap_TrqCmdScl_ECU_Composition: SoftwareComponentInstanceRef=TrqCmdScl, ImplementationRef=Ap_TrqCmdScl_Implementation
        Task_2ms_10_32_Timer0 (RunnableEntityMapping): PositionInTask=32, ActivationOffset=0, RteCyclicTriggerImplementation=Auto, RTEEventRef=TMT_TrqCmdScl_Per1, MappedToTaskRef=Task_2ms_10
        MAP_Rte_NvmBlock_TrqCmdScl_TorqueCmdSF_Uls_f32 (NVRamAllocation): SwNvRamMappingReference=TrqCmdScl.TorqueCmdSF_EOLData, NvmBlockRef=Rte_NvmBlock_TrqCmdScl_TorqueCmdSF_Uls_f32
      TrqOvlSta_Ap_TrqOvlSta_ECU_Composition: SoftwareComponentInstanceRef=TrqOvlSta, ImplementationRef=Ap_TrqOvlSta_Implementation
        Task_2ms_10_10_Timer0 (RunnableEntityMapping): PositionInTask=10, ActivationOffset=0, RteCyclicTriggerImplementation=Auto, RTEEventRef=TMT_TrqOvlSta_Per1, MappedToTaskRef=Task_2ms_10
        Task_Init_10_39_Timer0 (RunnableEntityMapping): PositionInTask=39, ActivationOffset=0, RteCyclicTriggerImplementation=Auto, RTEEventRef=TrqOvlSta_InitEvent, MappedToTaskRef=Task_Init_10
      VehDyn_Ap_VehDyn_ECU_Composition: SoftwareComponentInstanceRef=VehDyn, ImplementationRef=Ap_VehDyn_Implementation
        3 x RunnableEntityMapping, all with ActivationOffset=0, RteCyclicTriggerImplementation=Auto:
          Task_2ms_10_53_Timer0: PositionInTask=53, RTEEventRef=TMT_VehDyn_Per1, MappedToTaskRef=Task_2ms_10
          Task_Init_10_31_Timer0: PositionInTask=31, RTEEventRef=VehDyn_Init1_InitEvent, MappedToTaskRef=Task_Init_10
          Task_Trans_10_11_TrigModeSwitch0: PositionInTask=11, RTEEventRef=MST_VehDyn_Trns1_0, MappedToTaskRef=Task_Trans_10
        MAP_Rte_NvmBlock_VehDyn_MotPosReset (NVRamAllocation): SwNvRamMappingReference=VehDyn.VehDynReset, NvmBlockRef=Rte_NvmBlock_VehDyn_MotPosReset
      VehPwrMd_Ap_VehPwrMd_ECU_Composition: SoftwareComponentInstanceRef=VehPwrMd, ImplementationRef=Ap_VehPwrMd_Implementation
        4 x RunnableEntityMapping, all with ActivationOffset=0, RteCyclicTriggerImplementation=Auto:
          Task_Trans_9_2_TrigModeSwitch0: PositionInTask=2, RTEEventRef=MST_VehPwrMd_Trns2_0, MappedToTaskRef=Task_Trans_9
          Task_2ms_9_9_Timer0: PositionInTask=9, RTEEventRef=TMT_VehPwrMd_Per1, MappedToTaskRef=Task_2ms_9
          Task_Trans_9_7_TrigModeSwitch0: PositionInTask=7, RTEEventRef=MST_VehPwrMd_Trns1_0, MappedToTaskRef=Task_Trans_9
          Task_Init_9_3_Timer0: PositionInTask=3, RTEEventRef=VehPwrMd_Init1_InitEvent, MappedToTaskRef=Task_Init_9
      VehSpdLmt_Ap_VehSpdLmt_ECU_Composition: SoftwareComponentInstanceRef=VehSpdLmt, ImplementationRef=Ap_VehSpdLmt_Implementation
        Task_2ms_9_3_Timer0 (RunnableEntityMapping): PositionInTask=3, ActivationOffset=0, RteCyclicTriggerImplementation=Auto, RTEEventRef=TMT_VehSpdLmt_Per1, MappedToTaskRef=Task_2ms_9
      WdgM_WdgM_ECU_Composition: ServiceComponentPrototypeRef=WdgM, ImplementationRef=WdgM_Implementation
        Task_10ms_SchM9_5_Timer0 (RunnableEntityMapping): PositionInTask=5, ActivationOffset=0, RteCyclicTriggerImplementation=Auto, RTEEventRef=TMT_MainFunction, MappedToTaskRef=Task_10ms_SchM9
      Xcp_Ap_ApXcp_ECU_Composition: SoftwareComponentInstanceRef=Xcp, ImplementationRef=Ap_ApXcp_Implementation
        Task_2ms_9_10_Timer0 (RunnableEntityMapping): PositionInTask=10, ActivationOffset=0, RteCyclicTriggerImplementation=Auto, RTEEventRef=TMT_DAQ_2msTL, MappedToTaskRef=Task_2ms_9
        Task_10ms_9_5_Timer0 (RunnableEntityMapping): PositionInTask=5, ActivationOffset=0, RteCyclicTriggerImplementation=Auto, RTEEventRef=TMT_ApXcp_Per1, MappedToTaskRef=Task_10ms_9
    75 x ComponentTypeCalibration, all with CalibrationSupportEnabled=false:
      Ap_AbsHwPos: ComponentTypeRef=Ap_AbsHwPos
      Ap_ActivePull: ComponentTypeRef=Ap_ActivePull
      Ap_AssistFirewall: ComponentTypeRef=Ap_AssistFirewall
      Ap_AstLmt: ComponentTypeRef=Ap_AstLmt
      Ap_AvgFricLrn: ComponentTypeRef=Ap_AvgFricLrn
      Ap_BVDiag: ComponentTypeRef=Ap_BVDiag
      Ap_DampingFirewall: ComponentTypeRef=Ap_DampingFirewall
      Ap_DiagMgr8: ComponentTypeRef=Ap_DiagMgr8
      Ap_DiagMgr9: ComponentTypeRef=Ap_DiagMgr9
      Ap_EtDmpFw: ComponentTypeRef=Ap_EtDmpFw
      Ap_GCCDiag: ComponentTypeRef=Ap_GCCDiag
      Ap_GMStrtStop: ComponentTypeRef=Ap_GMStrtStop
      Ap_GenPosTraj: ComponentTypeRef=Ap_GenPosTraj
      Ap_HOWDetect: ComponentTypeRef=Ap_HOWDetect
      Ap_HwPwUp: ComponentTypeRef=Ap_HwPwUp
      Ap_LmtCod: ComponentTypeRef=Ap_LmtCod
      Ap_LrnEOT: ComponentTypeRef=Ap_LrnEOT
      Ap_MtrTempEst: ComponentTypeRef=Ap_MtrTempEst
      Ap_PICurrCntrl: ComponentTypeRef=Ap_PICurrCntrl
      Ap_PosServo: ComponentTypeRef=Ap_PosServo
      Ap_PwrLmtFuncCr: ComponentTypeRef=Ap_PwrLmtFuncCr
      Ap_SASPlausDiag: ComponentTypeRef=Ap_SASPlausDiag
      Ap_SignlCondn: ComponentTypeRef=Ap_SignlCondn
      Ap_StaMd8: ComponentTypeRef=Ap_StaMd8
      Ap_StaMd9: ComponentTypeRef=Ap_StaMd9
      Ap_StabilityComp2: ComponentTypeRef=Ap_StabilityComp2
      Ap_Sweep: ComponentTypeRef=Ap_Sweep
      Ap_Sweep2: ComponentTypeRef=Ap_Sweep2
      Ap_TSMit: ComponentTypeRef=Ap_TSMit
      Ap_ThrmlDutyCycle: ComponentTypeRef=Ap_ThrmlDutyCycle
      Ap_TqRsDg: ComponentTypeRef=Ap_TqRsDg
      Ap_TrqArblim: ComponentTypeRef=Ap_TrqArblim
      Ap_TrqCanc: ComponentTypeRef=Ap_TrqCanc
      Ap_TrqOsc: ComponentTypeRef=Ap_TrqOsc
      Ap_TuningSelAuth: ComponentTypeRef=Ap_TuningSelAuth
      Ap_WIRInputQual: ComponentTypeRef=Ap_WIRInputQual
      Ap_WhlImbRej: ComponentTypeRef=Ap_WhlImbRej
      Ap_ePWM2: ComponentTypeRef=Ap_ePWM2
      Ap_Assist: ComponentTypeRef=Ap_Assist
      Ap_BatteryVoltage: ComponentTypeRef=Ap_BatteryVoltage
      Ap_ComplErr: ComponentTypeRef=Ap_ComplErr
      Ap_CtrldDisShtdn: ComponentTypeRef=Ap_CtrldDisShtdn
      Ap_CurrCmd: ComponentTypeRef=Ap_CurrCmd
      Ap_CurrParamComp: ComponentTypeRef=Ap_CurrParamComp
      Ap_CustPerSrvcs: ComponentTypeRef=Ap_CustPerSrvcs
      Ap_Damping: ComponentTypeRef=Ap_Damping
      Ap_DemIf: ComponentTypeRef=Ap_DemIf
      Ap_DiagMgr10: ComponentTypeRef=Ap_DiagMgr10
      Ap_DigPhsReasDiag: ComponentTypeRef=Ap_DigPhsReasDiag
      Ap_EOTActuatorMng: ComponentTypeRef=Ap_EOTActuatorMng
      Ap_FltInjection: ComponentTypeRef=Ap_FltInjection
      Ap_FrqDepDmpnInrtCmp: ComponentTypeRef=Ap_FrqDepDmpnInrtCmp
      Ap_HiLoadStall: ComponentTypeRef=Ap_HiLoadStall
      Ap_HighFreqAssist: ComponentTypeRef=Ap_HighFreqAssist
      Ap_HystComp: ComponentTypeRef=Ap_HystComp
      NtWrap: ComponentTypeRef=NtWrap
      Ap_PeakCurrEst: ComponentTypeRef=Ap_PeakCurrEst
      Ap_Polarity: ComponentTypeRef=Ap_Polarity
      Ap_QuadDet: ComponentTypeRef=Ap_QuadDet
      Ap_Return: ComponentTypeRef=Ap_Return
      Ap_ReturnFirewall: ComponentTypeRef=Ap_ReturnFirewall
      RteErrata10: ComponentTypeRef=RteErrata10
      RteErrata8: ComponentTypeRef=RteErrata8
      RteErrata9: ComponentTypeRef=RteErrata9
      Ap_SrlComInput: ComponentTypeRef=Ap_SrlComInput
      Ap_SrlComOutput: ComponentTypeRef=Ap_SrlComOutput
      Ap_StOpCtrl: ComponentTypeRef=Ap_StOpCtrl
      Ap_StaMd: ComponentTypeRef=Ap_StaMd
      Ap_StabilityComp: ComponentTypeRef=Ap_StabilityComp
      Ap_TrqCmdScl: ComponentTypeRef=Ap_TrqCmdScl
      Ap_TrqOvlSta: ComponentTypeRef=Ap_TrqOvlSta
      Ap_VehDyn: ComponentTypeRef=Ap_VehDyn
      Ap_VehPwrMd: ComponentTypeRef=Ap_VehPwrMd
      Ap_VehSpdLmt: ComponentTypeRef=Ap_VehSpdLmt
      Ap_ApXcp: ComponentTypeRef=Ap_ApXcp
  module config StaMd: implementation-config-variant=VARIANT-POST-BUILD
    StaMdGeneral:
      TypeHDataSize = 100
      StaMdCPEnable = StaMd_Per1_CP1
      StaMdCPEnable = StaMd8_Per1_CP0
      StaMdTODType = TOD_SteadyState
      StaMdNvMWriteAllAPI = NvMProxy_WriteAll
      StaMdTrnsDiagMgrShtDwnTaskActivation = Task_TrnsB_9
      GenerateExcludeOsAppRef = Ap_0
      StaMdCoreOsAppRef = Ap_10
      StaMdSComOsAppRef = Ap_9
      StaMdSysCovOsAppRef = Ap_8
    CommonPublishedInformation: ArMajorVersion=3, ArMinorVersion=2, ArPatchVersion=0, SwMajorVersion=0, SwMinorVersion=0, SwPatchVersion=0, ModuleId=0, VendorId=0
  module config TmprlMon: implementation-config-variant=VARIANT-POST-BUILD
    TmprlMonGeneral: TmprlMonCPEnable=TmprlMon_Per1_CP0
    CommonPublishedInformation: ArMajorVersion=3, ArMinorVersion=2, ArPatchVersion=0, SwMajorVersion=0, SwMinorVersion=0, SwPatchVersion=0, ModuleId=0, VendorId=0
  module config Assist: implementation-config-variant=VARIANT-POST-BUILD
    AssistGeneral
    CommonPublishedInformation: ArMajorVersion=3, ArMinorVersion=2, ArPatchVersion=0, SwMajorVersion=0, SwMinorVersion=0, SwPatchVersion=0, ModuleId=0, VendorId=0
  module config Damping: implementation-config-variant=VARIANT-POST-BUILD
    DampingGeneral
    CommonPublishedInformation: ArMajorVersion=3, ArMinorVersion=2, ArPatchVersion=0, SwMajorVersion=0, SwMinorVersion=0, SwPatchVersion=0, ModuleId=0, VendorId=0
  module config Return: implementation-config-variant=VARIANT-POST-BUILD
    ReturnGeneral
    CommonPublishedInformation: ArMajorVersion=3, ArMinorVersion=2, ArPatchVersion=0, SwMajorVersion=0, SwMinorVersion=0, SwPatchVersion=0, ModuleId=0, VendorId=0
  module config HwPwUp: implementation-config-variant=VARIANT-POST-BUILD
    HwPwUpGeneral: HwPwUpPgmSpecMask=0
    CommonPublishedInformation: ArMajorVersion=3, ArMinorVersion=2, ArPatchVersion=0, SwMajorVersion=0, SwMinorVersion=0, SwPatchVersion=0, ModuleId=0, VendorId=0
  module config MtrDrvDiag: implementation-config-variant=VARIANT-POST-BUILD
    MtrDrvDiagGeneral
    CommonPublishedInformation: ArMajorVersion=3, ArMinorVersion=2, ArPatchVersion=0, SwMajorVersion=0, SwMinorVersion=0, SwPatchVersion=0, ModuleId=0, VendorId=0
  module config AssistFirewall: implementation-config-variant=VARIANT-PRE-COMPILE
    AssistFirewallGeneral
    CommonPublishedInformation: ArMajorVersion=3, ArMinorVersion=2, ArPatchVersion=0, SwMajorVersion=0, SwMinorVersion=0, SwPatchVersion=0, ModuleId=0, VendorId=0
  module config CtrldDisShtdn: implementation-config-variant=VARIANT-PRE-COMPILE
    CtrldDisShtdnGeneral
    CommonPublishedInformation: ArMajorVersion=3, ArMinorVersion=2, ArPatchVersion=0, SwMajorVersion=0, SwMinorVersion=0, SwPatchVersion=0, ModuleId=0, VendorId=0
  module config DampingFirewall: implementation-config-variant=VARIANT-PRE-COMPILE
    DampingFirewallGeneral
    CommonPublishedInformation: ArMajorVersion=3, ArMinorVersion=2, ArPatchVersion=0, SwMajorVersion=0, SwMinorVersion=0, SwPatchVersion=0, ModuleId=0, VendorId=0
  module config DiagMgr: implementation-config-variant=VARIANT-PRE-COMPILE
    DiagMgrConfigSet
      137 x DiagMgrEventParameter, all with DiagMgrEventID=(unset):
        NTC_Num_FlashWrapperLgcFlt: DiagMgrNTC=1, DiagMgrEventKind=DIAGMGR_EVENT_KIND_SWC, OsApplicationRef=Ap_10
        NTC_Num_FlashECCCorr: DiagMgrNTC=2, DiagMgrEventKind=DIAGMGR_EVENT_KIND_SWC, OsApplicationRef=Ap_10
        NTC_Num_FlashECCMemFlt: DiagMgrNTC=3, DiagMgrEventKind=DIAGMGR_EVENT_KIND_SWC, OsApplicationRef=Ap_10
        NTC_Num_FlashCRCMemFault: DiagMgrNTC=4, DiagMgrEventKind=DIAGMGR_EVENT_KIND_BSW, OsApplicationRef=Ap_10
        NTC_Num_EEPROMDiagPolarityStr: DiagMgrNTC=15, DiagMgrEventKind=DIAGMGR_EVENT_KIND_SWC, OsApplicationRef=Ap_10
        NTC_Num_RAMDiag_GeneralFlt: DiagMgrNTC=16, DiagMgrEventKind=DIAGMGR_EVENT_KIND_SWC, OsApplicationRef=Ap_10
        NTC_Num_RAMDiag_WrprLgcFlt: DiagMgrNTC=17, DiagMgrEventKind=DIAGMGR_EVENT_KIND_SWC, OsApplicationRef=Ap_10
        NTC_Num_RAMDiag_ECCCorrIndFlt: DiagMgrNTC=18, DiagMgrEventKind=DIAGMGR_EVENT_KIND_SWC, OsApplicationRef=Ap_10
        NTC_Num_RAMDiag_ECCMemFlt: DiagMgrNTC=19, DiagMgrEventKind=DIAGMGR_EVENT_KIND_SWC, OsApplicationRef=Ap_10
        NTC_Num_RAMDiag_VIMRamFlt: DiagMgrNTC=23, DiagMgrEventKind=DIAGMGR_EVENT_KIND_SWC, OsApplicationRef=Ap_10
        NTC_Num_RAMDiag_NHET1RamFlt: DiagMgrNTC=24, DiagMgrEventKind=DIAGMGR_EVENT_KIND_SWC, OsApplicationRef=Ap_10
        NTC_Num_RAMDiag_NHET2RamFlt: DiagMgrNTC=25, DiagMgrEventKind=DIAGMGR_EVENT_KIND_SWC, OsApplicationRef=Ap_10
        NTC_Num_RAMDiag_ADC1RamFlt: DiagMgrNTC=26, DiagMgrEventKind=DIAGMGR_EVENT_KIND_SWC, OsApplicationRef=Ap_10
        NTC_Num_RAMDiag_DCANRamFault: DiagMgrNTC=27, DiagMgrEventKind=DIAGMGR_EVENT_KIND_SWC, OsApplicationRef=Ap_10
        NTC_Num_RAMDiag_ADC2RamFlt: DiagMgrNTC=28, DiagMgrEventKind=DIAGMGR_EVENT_KIND_SWC, OsApplicationRef=Ap_10
        NTC_Num_RAMDiag_HETTU1RamFlt: DiagMgrNTC=29, DiagMgrEventKind=DIAGMGR_EVENT_KIND_BSW, OsApplicationRef=Ap_10
        NTC_Num_RAMDiag_HETTU2RamFlt: DiagMgrNTC=30, DiagMgrEventKind=DIAGMGR_EVENT_KIND_SWC, OsApplicationRef=Ap_10
        NTC_Num_CPU_RegVer: DiagMgrNTC=32, DiagMgrEventKind=DIAGMGR_EVENT_KIND_SWC, OsApplicationRef=Ap_10
        NTC_Num_CPU_CoreInitFlt: DiagMgrNTC=33, DiagMgrEventKind=DIAGMGR_EVENT_KIND_BSW, OsApplicationRef=Ap_10
        NTC_Num_CPU_CoreRunTimeFlt: DiagMgrNTC=34, DiagMgrEventKind=DIAGMGR_EVENT_KIND_SWC, OsApplicationRef=Ap_10
        NTC_Num_CPU_ClockMon: DiagMgrNTC=35, DiagMgrEventKind=DIAGMGR_EVENT_KIND_SWC, OsApplicationRef=Ap_10
        NTC_Num_CPU_eFuseFlt: DiagMgrNTC=36, DiagMgrEventKind=DIAGMGR_EVENT_KIND_SWC, OsApplicationRef=Ap_10
        NTC_Num_CPU_FactPrcsErr: DiagMgrNTC=40, DiagMgrEventKind=DIAGMGR_EVENT_KIND_SWC, OsApplicationRef=Ap_10
        NTC_Num_PropExeDiag_RunTimeDiag: DiagMgrNTC=43, DiagMgrEventKind=DIAGMGR_EVENT_KIND_SWC, OsApplicationRef=Ap_10
        NTC_Num_PropExeDiag_COPTimeout: DiagMgrNTC=44, DiagMgrEventKind=DIAGMGR_EVENT_KIND_SWC, OsApplicationRef=Ap_10
        NTC_Num_PropExeDiag_PrefetchAbort: DiagMgrNTC=48, DiagMgrEventKind=DIAGMGR_EVENT_KIND_SWC, OsApplicationRef=Ap_10
        NTC_Num_PropExeDiag_DataAbort: DiagMgrNTC=49, DiagMgrEventKind=DIAGMGR_EVENT_KIND_SWC, OsApplicationRef=Ap_10
        NTC_Num_PerDiag_ADC1Flt: DiagMgrNTC=50, DiagMgrEventKind=DIAGMGR_EVENT_KIND_BSW, OsApplicationRef=Ap_10
        NTC_Num_PerDiag_ADC2Flt: DiagMgrNTC=51, DiagMgrEventKind=DIAGMGR_EVENT_KIND_BSW, OsApplicationRef=Ap_10
        NTC_Num_PerDiag_IllegalAccess: DiagMgrNTC=53, DiagMgrEventKind=DIAGMGR_EVENT_KIND_SWC, OsApplicationRef=Ap_10
        NTC_Num_TmpMonFunc: DiagMgrNTC=64, DiagMgrEventKind=DIAGMGR_EVENT_KIND_SWC, OsApplicationRef=Ap_10
        NTC_Num_TmpMonRunTimeFlt: DiagMgrNTC=65, DiagMgrEventKind=DIAGMGR_EVENT_KIND_SWC, OsApplicationRef=Ap_10
        NTC_Num_Thermistor: DiagMgrNTC=69, DiagMgrEventKind=DIAGMGR_EVENT_KIND_SWC, OsApplicationRef=Ap_9
        NTC_Num_RefSupplyVltg: DiagMgrNTC=70, DiagMgrEventKind=DIAGMGR_EVENT_KIND_SWC, OsApplicationRef=Ap_10
        NTC_Num_CPUSupplyOvervoltage: DiagMgrNTC=72, DiagMgrEventKind=DIAGMGR_EVENT_KIND_SWC, OsApplicationRef=Ap_10
        NTC_Num_GateDrvFlt: DiagMgrNTC=77, DiagMgrEventKind=DIAGMGR_EVENT_KIND_SWC, OsApplicationRef=Ap_10
        NTC_Num_OnStateSingleFET: DiagMgrNTC=78, DiagMgrEventKind=DIAGMGR_EVENT_KIND_SWC, OsApplicationRef=Ap_10
        NTC_Num_OnStateMultiFET: DiagMgrNTC=79, DiagMgrEventKind=DIAGMGR_EVENT_KIND_SWC, OsApplicationRef=Ap_10
        NTC_Num_DigPhaseVoltageVerf: DiagMgrNTC=82, DiagMgrEventKind=DIAGMGR_EVENT_KIND_SWC, OsApplicationRef=Ap_10
        NTC_Num_DutyCycleExceeded: DiagMgrNTC=148, DiagMgrEventKind=DIAGMGR_EVENT_KIND_SWC, OsApplicationRef=Ap_9
        NTC_Num_AbsTempThermLimit: DiagMgrNTC=149, DiagMgrEventKind=DIAGMGR_EVENT_KIND_SWC, OsApplicationRef=Ap_9
        NTC_Num_OpVoltage: DiagMgrNTC=176, DiagMgrEventKind=DIAGMGR_EVENT_KIND_SWC, OsApplicationRef=Ap_9
        NTC_Num_ReducedAsstLowVoltage: DiagMgrNTC=178, DiagMgrEventKind=DIAGMGR_EVENT_KIND_SWC, OsApplicationRef=Ap_10
        NTC_Num_OpVoltageOvrMax: DiagMgrNTC=181, DiagMgrEventKind=DIAGMGR_EVENT_KIND_SWC, OsApplicationRef=Ap_9
        NTC_Num_IgnConfDiag: DiagMgrNTC=184, DiagMgrEventKind=DIAGMGR_EVENT_KIND_SWC, OsApplicationRef=Ap_9
        NTC_Num_EEPROMCloseFailed: DiagMgrNTC=191, DiagMgrEventKind=DIAGMGR_EVENT_KIND_SWC, OsApplicationRef=Ap_10
        NTC_Num_VLF_00: DiagMgrNTC=224, DiagMgrEventKind=DIAGMGR_EVENT_KIND_SWC, OsApplicationRef=Ap_10
        NTC_Num_BusOffCh1: DiagMgrNTC=256, DiagMgrEventKind=DIAGMGR_EVENT_KIND_SWC, OsApplicationRef=Ap_9
        NTC_Num_BusOffCh2: DiagMgrNTC=272, DiagMgrEventKind=DIAGMGR_EVENT_KIND_SWC, OsApplicationRef=Ap_9
        NTC_Num_InvalidMsg_M: DiagMgrNTC=288, DiagMgrEventKind=DIAGMGR_EVENT_KIND_SWC, OsApplicationRef=Ap_9
        NTC_Num_MissingMsg_M: DiagMgrNTC=289, DiagMgrEventKind=DIAGMGR_EVENT_KIND_SWC, OsApplicationRef=Ap_9
        NTC_Num_MissingMsg_N: DiagMgrNTC=297, DiagMgrEventKind=DIAGMGR_EVENT_KIND_SWC, OsApplicationRef=Ap_9
        NTC_Num_MissingMsg_O: DiagMgrNTC=305, DiagMgrEventKind=DIAGMGR_EVENT_KIND_SWC, OsApplicationRef=Ap_9
        NTC_Num_MissingMsg_P: DiagMgrNTC=313, DiagMgrEventKind=DIAGMGR_EVENT_KIND_SWC, OsApplicationRef=Ap_9
        NTC_Num_MissingMsg_Q: DiagMgrNTC=321, DiagMgrEventKind=DIAGMGR_EVENT_KIND_SWC, OsApplicationRef=Ap_9
        NTC_Num_InvalidMsg_R: DiagMgrNTC=328, DiagMgrEventKind=DIAGMGR_EVENT_KIND_SWC, OsApplicationRef=Ap_9
        NTC_Num_MissingMsg_R: DiagMgrNTC=329, DiagMgrEventKind=DIAGMGR_EVENT_KIND_SWC, OsApplicationRef=Ap_9
        NTC_Num_MissingMsg_S: DiagMgrNTC=337, DiagMgrEventKind=DIAGMGR_EVENT_KIND_SWC, OsApplicationRef=Ap_9
        NTC_Num_InvalidMsg_W: DiagMgrNTC=368, DiagMgrEventKind=DIAGMGR_EVENT_KIND_SWC, OsApplicationRef=Ap_9
        NTC_Num_MissingMsg_W: DiagMgrNTC=369, DiagMgrEventKind=DIAGMGR_EVENT_KIND_SWC, OsApplicationRef=Ap_9
        NTC_Num_InvalidMsg_Y: DiagMgrNTC=384, DiagMgrEventKind=DIAGMGR_EVENT_KIND_SWC, OsApplicationRef=Ap_9
        NTC_Num_AssistFWFltMode: DiagMgrNTC=201, DiagMgrEventKind=DIAGMGR_EVENT_KIND_SWC, OsApplicationRef=Ap_10
        NTC_Num_AssistFWReached: DiagMgrNTC=198, DiagMgrEventKind=DIAGMGR_EVENT_KIND_SWC, OsApplicationRef=Ap_10
        NTC_Num_DampingFWFltMode: DiagMgrNTC=200, DiagMgrEventKind=DIAGMGR_EVENT_KIND_SWC, OsApplicationRef=Ap_10
        NTC_Num_DampingFWReached: DiagMgrNTC=197, DiagMgrEventKind=DIAGMGR_EVENT_KIND_SWC, OsApplicationRef=Ap_10
        NTC_Num_PerDiag_DMAFlt: DiagMgrNTC=54, DiagMgrEventKind=DIAGMGR_EVENT_KIND_BSW, OsApplicationRef=Ap_10
        NTC_Num_StaMdsSysC: DiagMgrNTC=203, DiagMgrEventKind=DIAGMGR_EVENT_KIND_SWC, OsApplicationRef=Ap_8
        NTC_NUM_SysFailureForCtrlVolt: DiagMgrNTC=209, DiagMgrEventKind=DIAGMGR_EVENT_KIND_SWC, OsApplicationRef=Ap_9
        NTC_Num_VBICFltMode: DiagMgrNTC=202, DiagMgrEventKind=DIAGMGR_EVENT_KIND_SWC, OsApplicationRef=Ap_10
        NTC_Num_CPU_MPUViolation: DiagMgrNTC=37, DiagMgrEventKind=DIAGMGR_EVENT_KIND_SWC, OsApplicationRef=Ap_10
        NTC_Num_PowerRelayInitFlt: DiagMgrNTC=66, DiagMgrEventKind=DIAGMGR_EVENT_KIND_SWC, OsApplicationRef=Ap_10
        NTC_Num_PrgFlwDeadlnFlt: DiagMgrNTC=42, DiagMgrEventKind=DIAGMGR_EVENT_KIND_SWC, OsApplicationRef=Ap_10
        NTC_Num_SigPath1CrossChk: DiagMgrNTC=192, DiagMgrEventKind=DIAGMGR_EVENT_KIND_SWC, OsApplicationRef=Ap_10
        NTC_Num_ReturnFWReached: DiagMgrNTC=199, DiagMgrEventKind=DIAGMGR_EVENT_KIND_SWC, OsApplicationRef=Ap_10
        NTC_Num_PriSnsrTrqStorFlt: DiagMgrNTC=12, DiagMgrEventKind=DIAGMGR_EVENT_KIND_SWC, OsApplicationRef=Ap_10
        NTC_Num_T1vsT2: DiagMgrNTC=101, DiagMgrEventKind=DIAGMGR_EVENT_KIND_SWC, OsApplicationRef=Ap_10
        NTC_Num_TrqSensorNotTrimmed: DiagMgrNTC=507, DiagMgrEventKind=DIAGMGR_EVENT_KIND_SWC, OsApplicationRef=Ap_10
        NTC_Num_T1OutofRange: DiagMgrNTC=102, DiagMgrEventKind=DIAGMGR_EVENT_KIND_BSW, OsApplicationRef=Ap_10
        NTC_Num_T2OutofRange: DiagMgrNTC=103, DiagMgrEventKind=DIAGMGR_EVENT_KIND_SWC, OsApplicationRef=Ap_10
        NTC_Num_PriMSB_SinCosCorr: DiagMgrNTC=112, DiagMgrEventKind=DIAGMGR_EVENT_KIND_SWC, OsApplicationRef=Ap_10
        NTC_Num_TurnCntr_PosLoss: DiagMgrNTC=128, DiagMgrEventKind=DIAGMGR_EVENT_KIND_SWC, OsApplicationRef=Ap_10
        NTC_Num_PriVsSec_SinCosCorr: DiagMgrNTC=114, DiagMgrEventKind=DIAGMGR_EVENT_KIND_SWC, OsApplicationRef=Ap_10
        NTC_NUM_SysFailureForRotVel: DiagMgrNTC=204, DiagMgrEventKind=DIAGMGR_EVENT_KIND_SWC, OsApplicationRef=Ap_10
        NTC_NUM_SysFailForRedntRotVel: DiagMgrNTC=205, DiagMgrEventKind=DIAGMGR_EVENT_KIND_SWC, OsApplicationRef=Ap_8
        NTC_Num_CurrentMeasCrossChk: DiagMgrNTC=86, DiagMgrEventKind=DIAGMGR_EVENT_KIND_SWC, OsApplicationRef=Ap_10
        NTC_Num_CurrentReas: DiagMgrNTC=169, DiagMgrEventKind=DIAGMGR_EVENT_KIND_SWC, OsApplicationRef=Ap_10
        NTC_Num_EEPROMDiagMtrStr: DiagMgrNTC=11, DiagMgrEventKind=DIAGMGR_EVENT_KIND_SWC, OsApplicationRef=Ap_10
        NTC_Num_HWAtoMtrAngleCorr: DiagMgrNTC=117, DiagMgrEventKind=DIAGMGR_EVENT_KIND_SWC, OsApplicationRef=Ap_10
        NTC_Num_KinematicIntDiag: DiagMgrNTC=144, DiagMgrEventKind=DIAGMGR_EVENT_KIND_SWC, OsApplicationRef=Ap_10
        NTC_Num_HWASensorNotTrimmed: DiagMgrNTC=504, DiagMgrEventKind=DIAGMGR_EVENT_KIND_SWC, OsApplicationRef=Ap_10
        NTC_Num_HWASnsrCommFault: DiagMgrNTC=109, DiagMgrEventKind=DIAGMGR_EVENT_KIND_SWC, OsApplicationRef=Ap_10
        NTC_Num_HWACrossChecks: DiagMgrNTC=108, DiagMgrEventKind=DIAGMGR_EVENT_KIND_SWC, OsApplicationRef=Ap_10
        NTC_Num_HWASensorRel: DiagMgrNTC=110, DiagMgrEventKind=DIAGMGR_EVENT_KIND_SWC, OsApplicationRef=Ap_10
        NTC_Num_HWASensorAbs: DiagMgrNTC=111, DiagMgrEventKind=DIAGMGR_EVENT_KIND_SWC, OsApplicationRef=Ap_10
        NTC_Num_MissingMsg_AJ: DiagMgrNTC=473, DiagMgrEventKind=DIAGMGR_EVENT_KIND_SWC, OsApplicationRef=Ap_9
        NTC_Num_MissingMsg_AB: DiagMgrNTC=409, DiagMgrEventKind=DIAGMGR_EVENT_KIND_SWC, OsApplicationRef=Ap_9
        NTC_Num_MissingMsg_AF: DiagMgrNTC=441, DiagMgrEventKind=DIAGMGR_EVENT_KIND_SWC, OsApplicationRef=Ap_9
        NTC_Num_MissingMsg_AA: DiagMgrNTC=401, DiagMgrEventKind=DIAGMGR_EVENT_KIND_SWC, OsApplicationRef=Ap_9
        NTC_Num_MissingMsg_AK: DiagMgrNTC=481, DiagMgrEventKind=DIAGMGR_EVENT_KIND_SWC, OsApplicationRef=Ap_9
        NTC_Num_MissingMsg_AC: DiagMgrNTC=417, DiagMgrEventKind=DIAGMGR_EVENT_KIND_SWC, OsApplicationRef=Ap_9
        NTC_Num_MissingMsg_ParkAssistParallel: DiagMgrNTC=465, DiagMgrEventKind=DIAGMGR_EVENT_KIND_SWC, OsApplicationRef=Ap_9
        NTC_Num_MissingMsg_AG: DiagMgrNTC=449, DiagMgrEventKind=DIAGMGR_EVENT_KIND_SWC, OsApplicationRef=Ap_9
        NTC_Num_MissingMsg_AH: DiagMgrNTC=457, DiagMgrEventKind=DIAGMGR_EVENT_KIND_SWC, OsApplicationRef=Ap_9
        NTC_Num_MissingMsg_U: DiagMgrNTC=353, DiagMgrEventKind=DIAGMGR_EVENT_KIND_SWC, OsApplicationRef=Ap_9
        NTC_Num_MissingMsg_V: DiagMgrNTC=361, DiagMgrEventKind=DIAGMGR_EVENT_KIND_SWC, OsApplicationRef=Ap_9
        NTC_Num_InvalidMsg_U: DiagMgrNTC=352, DiagMgrEventKind=DIAGMGR_EVENT_KIND_SWC, OsApplicationRef=Ap_9
        NTC_Num_InvalidMsg_V: DiagMgrNTC=360, DiagMgrEventKind=DIAGMGR_EVENT_KIND_SWC, OsApplicationRef=Ap_9
        NTC_Num_InvalidMsg_ParkAssistParallel: DiagMgrNTC=464, DiagMgrEventKind=DIAGMGR_EVENT_KIND_SWC, OsApplicationRef=Ap_9
        NTC_Num_InvalidMsg_AJ: DiagMgrNTC=472, DiagMgrEventKind=DIAGMGR_EVENT_KIND_SWC, OsApplicationRef=Ap_9
        NTC_Num_InvalidMsg_AK: DiagMgrNTC=480, DiagMgrEventKind=DIAGMGR_EVENT_KIND_SWC, OsApplicationRef=Ap_9
        NTC_Num_InvalidMsg_AB: DiagMgrNTC=408, DiagMgrEventKind=DIAGMGR_EVENT_KIND_SWC, OsApplicationRef=Ap_9
        NTC_Num_InvalidMsg_AC: DiagMgrNTC=416, DiagMgrEventKind=DIAGMGR_EVENT_KIND_SWC, OsApplicationRef=Ap_9
        NTC_Num_InvalidMsg_AH: DiagMgrNTC=456, DiagMgrEventKind=DIAGMGR_EVENT_KIND_SWC, OsApplicationRef=Ap_9
        NTC_Num_InvalidMsg_P: DiagMgrNTC=312, DiagMgrEventKind=DIAGMGR_EVENT_KIND_SWC, OsApplicationRef=Ap_9
        NTC_Num_InvalidMsg_AA: DiagMgrNTC=400, DiagMgrEventKind=DIAGMGR_EVENT_KIND_SWC, OsApplicationRef=Ap_9
        NTC_Num_MissingMsg_X: DiagMgrNTC=377, DiagMgrEventKind=DIAGMGR_EVENT_KIND_SWC, OsApplicationRef=Ap_9
        NTC_Num_InvalidMsg_X: DiagMgrNTC=376, DiagMgrEventKind=DIAGMGR_EVENT_KIND_SWC, OsApplicationRef=Ap_9
        NTC_Num_EEPROMDiag: DiagMgrNTC=10, DiagMgrEventKind=DIAGMGR_EVENT_KIND_SWC, OsApplicationRef=Ap_10
        NTC_Num_NvMBlkDftActA: DiagMgrNTC=6, DiagMgrEventKind=DIAGMGR_EVENT_KIND_SWC, OsApplicationRef=Ap_10
        NTC_Num_NvMBlkDftActB: DiagMgrNTC=7, DiagMgrEventKind=DIAGMGR_EVENT_KIND_SWC, OsApplicationRef=Ap_10
        NTC_Num_NvMBlkDftActC: DiagMgrNTC=8, DiagMgrEventKind=DIAGMGR_EVENT_KIND_SWC, OsApplicationRef=Ap_10
        NTC_Num_MissingMsg_AD: DiagMgrNTC=425, DiagMgrEventKind=DIAGMGR_EVENT_KIND_SWC, OsApplicationRef=Ap_9
        NTC_Num_SecMSB_SinCosCorr: DiagMgrNTC=113, DiagMgrEventKind=DIAGMGR_EVENT_KIND_SWC, OsApplicationRef=Ap_10
        NTC_Num_TurnCntr_MainResets: DiagMgrNTC=133, DiagMgrEventKind=DIAGMGR_EVENT_KIND_SWC, OsApplicationRef=Ap_10
        NTC_Num_TurnCntr_SensorPosFlt: DiagMgrNTC=130, DiagMgrEventKind=DIAGMGR_EVENT_KIND_SWC, OsApplicationRef=Ap_10
        NTC_Num_TurnCntr_LowBattery: DiagMgrNTC=185, DiagMgrEventKind=DIAGMGR_EVENT_KIND_BSW, OsApplicationRef=Ap_10
        NTC_Num_InvalidMsg_N: DiagMgrNTC=296, DiagMgrEventKind=DIAGMGR_EVENT_KIND_SWC, OsApplicationRef=Ap_9
        NTC_Num_BattTransOverVolt: DiagMgrNTC=182, DiagMgrEventKind=DIAGMGR_EVENT_KIND_BSW, OsApplicationRef=Ap_9
        NTC_Num_InvalidMsg_T: DiagMgrNTC=344, DiagMgrEventKind=DIAGMGR_EVENT_KIND_SWC, OsApplicationRef=Ap_9
        NTC_Num_MissingMsg_T: DiagMgrNTC=345, DiagMgrEventKind=DIAGMGR_EVENT_KIND_SWC, OsApplicationRef=Ap_9
        NTC_Num_InvalidMsg_AG: DiagMgrNTC=448, DiagMgrEventKind=DIAGMGR_EVENT_KIND_SWC, OsApplicationRef=Ap_9
        NTC_Num_OpTrqVsHwTrq: DiagMgrNTC=168, DiagMgrEventKind=DIAGMGR_EVENT_KIND_SWC, OsApplicationRef=Ap_10
        NTC_Num_CalNotPrgmd: DiagMgrNTC=498, DiagMgrEventKind=DIAGMGR_EVENT_KIND_SWC, OsApplicationRef=Ap_9
        NTC_Num_PeripheralStartupFlt: DiagMgrNTC=55, DiagMgrEventKind=DIAGMGR_EVENT_KIND_SWC, OsApplicationRef=Ap_10
        NTC_Num_GateDrvFltInProcess: DiagMgrNTC=76, DiagMgrEventKind=DIAGMGR_EVENT_KIND_SWC, OsApplicationRef=Ap_10
        NTC_Num_HighFriction: DiagMgrNTC=145, DiagMgrEventKind=DIAGMGR_EVENT_KIND_SWC, OsApplicationRef=Ap_9
        NTC_Num_VLF_01: DiagMgrNTC=225, DiagMgrEventKind=DIAGMGR_EVENT_KIND_SWC, OsApplicationRef=Ap_10
    DiagMgrGeneral:
      DiagMgrCPEnable = DiagMgr8_Per_CP0
      DiagMgrDevErrorDetect = true
      DiagMgrVersionInfoApi = false
      DiagMgrRecoverPeriod = .1
      DiagMgrFailPeriod = .002
      DiagMgrDemIfPeriod = .1
      NumOfDemEvents = 26
      DiagMgrDemIfOsAppRef = Ap_9
      DiagMgrFailActionOsAppRef = Ap_10
    CommonPublishedInformation: ArMajorVersion=3, ArMinorVersion=2, ArPatchVersion=0, SwMajorVersion=0, SwMinorVersion=0, SwPatchVersion=0, ModuleId=0, VendorId=0
  module config LmtCod: implementation-config-variant=VARIANT-PRE-COMPILE
    LmtCodGeneral
    CommonPublishedInformation: ArMajorVersion=3, ArMinorVersion=2, ArPatchVersion=0, SwMajorVersion=0, SwMinorVersion=0, SwPatchVersion=0, ModuleId=0, VendorId=0
  module config uDiag: implementation-config-variant=VARIANT-PRE-COMPILE
    RuntimeRegCheck (uDiagRegChkConfigSet)
      233 x uDiagRegCheck:
        GHVSRC: uDiagRegAddress=4294967112, uDiagRegValue=16842753
        RCLKSRC: uDiagRegAddress=4294967120, uDiagRegValue=9
        BMMCR1: uDiagRegAddress=4294967236, uDiagRegValue=10
        CLKCNTL: uDiagRegAddress=4294967248, uDiagRegValue=16843008
        GLOBALCTRL1: uDiagRegAddress=4294901920, uDiagRegValue=0
        PINMMR00: uDiagRegAddress=4294961936, uDiagRegValue=33685504
        PINMMR01: uDiagRegAddress=4294961940, uDiagRegValue=16843776
        PINMMR02: uDiagRegAddress=4294961944, uDiagRegValue=67174657
        PINMMR03: uDiagRegAddress=4294961948, uDiagRegValue=17039361
        PINMMR04: uDiagRegAddress=4294961952, uDiagRegValue=269484292
        PINMMR05: uDiagRegAddress=4294961956, uDiagRegValue=17302532
        PINMMR06: uDiagRegAddress=4294961960, uDiagRegValue=16843024
        PINMMR07: uDiagRegAddress=4294961964, uDiagRegValue=16843009
        PINMMR08: uDiagRegAddress=4294961968, uDiagRegValue=16843009
        PINMMR09: uDiagRegAddress=4294961972, uDiagRegValue=16843009
        PINMMR10: uDiagRegAddress=4294961976, uDiagRegValue=16843009
        PINMMR11: uDiagRegAddress=4294961980, uDiagRegValue=16843009
        PINMMR12: uDiagRegAddress=4294961984, uDiagRegValue=16843009
        PINMMR13: uDiagRegAddress=4294961988, uDiagRegValue=16843009
        PINMMR14: uDiagRegAddress=4294961992, uDiagRegValue=16843009
        PINMMR15: uDiagRegAddress=4294961996, uDiagRegValue=16843009
        PINMMR16: uDiagRegAddress=4294962000, uDiagRegValue=16843009
        PINMMR17: uDiagRegAddress=4294962004, uDiagRegValue=16843009
        PINMMR18: uDiagRegAddress=4294962008, uDiagRegValue=65537
        PINMMR19: uDiagRegAddress=4294962012, uDiagRegValue=16843009
        PINMMR20: uDiagRegAddress=4294962016, uDiagRegValue=16843009
        PINMMR21: uDiagRegAddress=4294962020, uDiagRegValue=16842753
        PINMMR22: uDiagRegAddress=4294962024, uDiagRegValue=16843009
        PINMMR23: uDiagRegAddress=4294962028, uDiagRegValue=1
        PINMMR24: uDiagRegAddress=4294962032, uDiagRegValue=0
        PINMMR25: uDiagRegAddress=4294962036, uDiagRegValue=0
        PINMMR26: uDiagRegAddress=4294962040, uDiagRegValue=16842752
        PINMMR27: uDiagRegAddress=4294962044, uDiagRegValue=16843009
        PINMMR28: uDiagRegAddress=4294962048, uDiagRegValue=16843009
        PINMMR29: uDiagRegAddress=4294962052, uDiagRegValue=257
        PINMMR30: uDiagRegAddress=4294962056, uDiagRegValue=514
        FRDCNTL: uDiagRegAddress=4294471680, uDiagRegValue=785
        FEDACTRL1: uDiagRegAddress=4294471688, uDiagRegValue=656906
        RAMCTRL_EVEN: uDiagRegAddress=4294965248, uDiagRegValue=327690
        RAMTHRESHOLD_EVEN: uDiagRegAddress=4294965252, uDiagRegValue=1
        RAMINTCTRL_EVEN: uDiagRegAddress=4294965260, uDiagRegValue=1
        RAMTEST_EVEN: uDiagRegAddress=4294965296, uDiagRegValue=5
        RAMCTRL_ODD: uDiagRegAddress=4294965504, uDiagRegValue=327690
        RAMTHRESHOLD_ODD: uDiagRegAddress=4294965508, uDiagRegValue=1
        RAMINTCTRL_ODD: uDiagRegAddress=4294965516, uDiagRegValue=1
        RAMTEST_ODD: uDiagRegAddress=4294965552, uDiagRegValue=5
        PACT: uDiagRegAddress=4294960512, uDiagRegValue=0
        STCGCR1: uDiagRegAddress=4294960644, uDiagRegValue=5
        CCMKEYR: uDiagRegAddress=4294964740, uDiagRegValue=0
        PLLCTL1: uDiagRegAddress=4294967152, uDiagRegValue=352000
        PLLCTL2: uDiagRegAddress=4294967156, uDiagRegValue=29184
        PLLCTL3: uDiagRegAddress=4294959360, uDiagRegValue=1610964736
        DCCGCTRL_DCC1: uDiagRegAddress=4294962176, uDiagRegValue=10
        DCCCNT0SEED_DCC1: uDiagRegAddress=4294962184, uDiagRegValue=9333
        DCCVALID0SEED_DCC1: uDiagRegAddress=4294962188, uDiagRegValue=39666
        DCCCNT1SEED_DCC1: uDiagRegAddress=4294962192, uDiagRegValue=9800
        DCCCNT1CLKSRC_DCC1: uDiagRegAddress=4294962212, uDiagRegValue=40963
        DCCCNT0CLKSRC_DCC1: uDiagRegAddress=4294962216, uDiagRegValue=0
        DCCGCTRL_DCC2: uDiagRegAddress=4294964224, uDiagRegValue=10
        DCCCNT0SEED_DCC2: uDiagRegAddress=4294964232, uDiagRegValue=19417
        DCCVALID0SEED_DCC2: uDiagRegAddress=4294964236, uDiagRegValue=1201
        DCCCNT1SEED_DCC2: uDiagRegAddress=4294964240, uDiagRegValue=80000
        DCCCNT1CLKSRC_DCC2: uDiagRegAddress=4294964260, uDiagRegValue=40968
        DCCCNT0CLKSRC_DCC2: uDiagRegAddress=4294964264, uDiagRegValue=0
        ESMEEPAPR1: uDiagRegAddress=4294964480, uDiagRegValue=0
        ESMIESR1: uDiagRegAddress=4294964488, uDiagRegValue=1420299214
        ESMILSR1: uDiagRegAddress=4294964496, uDiagRegValue=2048
        ESMLTCPR: uDiagRegAddress=4294964532, uDiagRegValue=16383
        ESMIEPSR4: uDiagRegAddress=4294964544, uDiagRegValue=0
        ESMIESR4: uDiagRegAddress=4294964552, uDiagRegValue=1073741860
        ESMILSR4: uDiagRegAddress=4294964560, uDiagRegValue=0
        RTIGCTRL: uDiagRegAddress=4294966272, uDiagRegValue=3
        RTITBCTRL: uDiagRegAddress=4294966276, uDiagRegValue=0
        RTISETINTENA: uDiagRegAddress=4294966400, uDiagRegValue=1
        RTIDWDCTRL: uDiagRegAddress=4294966416, uDiagRegValue=2844088794
        RTIDWDPRLD: uDiagRegAddress=4294966420, uDiagRegValue=57
        RTIWWDRXNCTRL: uDiagRegAddress=4294966436, uDiagRegValue=5
        RTIWWDSIZECTRL: uDiagRegAddress=4294966440, uDiagRegValue=5
        CRC_CTRL1: uDiagRegAddress=4261412872, uDiagRegValue=0
        PARCTL: uDiagRegAddress=4294966768, uDiagRegValue=10
        FIRQPR0_FIQ_IRQ: uDiagRegAddress=4294966800, uDiagRegValue=3
        FIRQPR1_FIQ_IRQ: uDiagRegAddress=4294966804, uDiagRegValue=0
        FIRQPR2_FIQ_IRQ: uDiagRegAddress=4294966808, uDiagRegValue=0
        CHANCTRL1: uDiagRegAddress=4294966912, uDiagRegValue=75779
        CHANCTRL2: uDiagRegAddress=4294967004, uDiagRegValue=50529027
        DREQASI0: uDiagRegAddress=4294963284, uDiagRegValue=438046224
        DREQASI1: uDiagRegAddress=4294963288, uDiagRegValue=68426759
        DREQASI2: uDiagRegAddress=4294963292, uDiagRegValue=134941195
        DREQASI3: uDiagRegAddress=4294963296, uDiagRegValue=504172047
        PAR0: uDiagRegAddress=4294963348, uDiagRegValue=1145308224
        PAR1: uDiagRegAddress=4294963352, uDiagRegValue=67125248
        DMAPCR: uDiagRegAddress=4294963624, uDiagRegValue=10
        DMAMPCTRL: uDiagRegAddress=4294963632, uDiagRegValue=252250377
        DMAMPROS: uDiagRegAddress=4294963640, uDiagRegValue=4278845440
        DMAMPROE: uDiagRegAddress=4294963644, uDiagRegValue=4282859519
        DMAMPR1S: uDiagRegAddress=4294963648, uDiagRegValue=4244081664
        DMAMPR1E: uDiagRegAddress=4294963652, uDiagRegValue=4261413375
        DMAMPR3S: uDiagRegAddress=4294963664, uDiagRegValue=2097152
        DMAMPR3E: uDiagRegAddress=4294963668, uDiagRegValue=4294967295
        ADOPMODECR_ADC1: uDiagRegAddress=4294426628, uDiagRegValue=2148794369
        ADCLOCKCR_ADC1: uDiagRegAddress=4294426632, uDiagRegValue=4
        ADCALCR_ADC1: uDiagRegAddress=4294426636, uDiagRegValue=0
        ADEVMODECR_ADC1: uDiagRegAddress=4294426640, uDiagRegValue=65585
        ADG1MODECR_ADC1: uDiagRegAddress=4294426644, uDiagRegValue=65584
        ADG2MODECR_ADC1: uDiagRegAddress=4294426648, uDiagRegValue=65592
        ADEVSRC_ADC1: uDiagRegAddress=4294426652, uDiagRegValue=0
        ADG1SRC_ADC1: uDiagRegAddress=4294426656, uDiagRegValue=0
        ADG2SRC_ADC1: uDiagRegAddress=4294426660, uDiagRegValue=1
        ADEVINTENA_ADC1: uDiagRegAddress=4294426664, uDiagRegValue=0
        ADG1INTENA_ADC1: uDiagRegAddress=4294426668, uDiagRegValue=0
        ADG2INTENA_ADC1: uDiagRegAddress=4294426672, uDiagRegValue=0
        ADBNDCR_ADC1: uDiagRegAddress=4294426712, uDiagRegValue=1966110
        ADBNDEND_ADC1: uDiagRegAddress=4294426716, uDiagRegValue=2
        ADEVSAMP_ADC1: uDiagRegAddress=4294426720, uDiagRegValue=6
        ADG1SAMP_ADC1: uDiagRegAddress=4294426724, uDiagRegValue=6
        ADG2SAMP_ADC1: uDiagRegAddress=4294426728, uDiagRegValue=6
        ADEVSEL_ADC1: uDiagRegAddress=4294426744, uDiagRegValue=0
        ADG1SEL_ADC1: uDiagRegAddress=4294426748, uDiagRegValue=0
        ADG2SEL_ADC1: uDiagRegAddress=4294426752, uDiagRegValue=8481
        ADPARCR_ADC1: uDiagRegAddress=4294427008, uDiagRegValue=10
        ADOPMODECR_ADC2: uDiagRegAddress=4294427140, uDiagRegValue=2148794369
        ADCLOCKCR_ADC2: uDiagRegAddress=4294427144, uDiagRegValue=4
        ADCALCR_ADC2: uDiagRegAddress=4294427148, uDiagRegValue=0
        ADEVMODECR_ADC2: uDiagRegAddress=4294427152, uDiagRegValue=65584
        ADG1MODECR_ADC2: uDiagRegAddress=4294427156, uDiagRegValue=65592
        ADG2MODECR_ADC2: uDiagRegAddress=4294427160, uDiagRegValue=65584
        ADEVSRC_ADC2: uDiagRegAddress=4294427164, uDiagRegValue=0
        ADG1SRC_ADC2: uDiagRegAddress=4294427168, uDiagRegValue=3
        ADG2SRC_ADC2: uDiagRegAddress=4294427172, uDiagRegValue=0
        ADEVINTENA_ADC2: uDiagRegAddress=4294427176, uDiagRegValue=0
        ADG1INTENA_ADC2: uDiagRegAddress=4294427180, uDiagRegValue=0
        ADG2INTENA_ADC2: uDiagRegAddress=4294427184, uDiagRegValue=0
        ADBNDCR_ADC2: uDiagRegAddress=4294427224, uDiagRegValue=2
        ADBNDEND_ADC2: uDiagRegAddress=4294427228, uDiagRegValue=2
        ADEVSAMP_ADC2: uDiagRegAddress=4294427232, uDiagRegValue=6
        ADG1SAMP_ADC2: uDiagRegAddress=4294427236, uDiagRegValue=6
        ADG2SAMP_ADC2: uDiagRegAddress=4294427240, uDiagRegValue=6
        ADEVSEL_ADC2: uDiagRegAddress=4294427256, uDiagRegValue=0
        ADG1SEL_ADC2: uDiagRegAddress=4294427260, uDiagRegValue=8451
        ADG2SEL_ADC2: uDiagRegAddress=4294427264, uDiagRegValue=0
        ADPARCR_ADC2: uDiagRegAddress=4294427520, uDiagRegValue=10
        HETGCR_HET1: uDiagRegAddress=4294424576, uDiagRegValue=393217
        HETPFR_HET1: uDiagRegAddress=4294424580, uDiagRegValue=1792
        HETEXC1_HET1: uDiagRegAddress=4294424604, uDiagRegValue=0
        HETPRY_HET1: uDiagRegAddress=4294424612, uDiagRegValue=0
        HETAND_HET1: uDiagRegAddress=4294424620, uDiagRegValue=0
        HETHRSH_HET1: uDiagRegAddress=4294424628, uDiagRegValue=0
        HETXOR_HET1: uDiagRegAddress=4294424632, uDiagRegValue=0
        HETREQENS_HET1: uDiagRegAddress=4294424636, uDiagRegValue=22
        HETREQDS_HET1: uDiagRegAddress=4294424644, uDiagRegValue=16
        HETPCR_HET1: uDiagRegAddress=4294424692, uDiagRegValue=10
        HETPPR_HET1: uDiagRegAddress=4294424700, uDiagRegValue=0
        HETLBPSEL_HET1: uDiagRegAddress=4294424716, uDiagRegValue=0
        HETLBPDIR_HET1: uDiagRegAddress=4294424720, uDiagRegValue=327680
        HETPINDIS_HET1: uDiagRegAddress=4294424724, uDiagRegValue=0
        HETGCR_HET2: uDiagRegAddress=4294424832, uDiagRegValue=196609
        HETPFR_HET2: uDiagRegAddress=4294424836, uDiagRegValue=1024
        HETEXC1_HET2: uDiagRegAddress=4294424860, uDiagRegValue=0
        HETPRY_HET2: uDiagRegAddress=4294424868, uDiagRegValue=0
        HETAND_HET2: uDiagRegAddress=4294424876, uDiagRegValue=0
        HETHRSH_HET2: uDiagRegAddress=4294424884, uDiagRegValue=244
        HETXOR_HET2: uDiagRegAddress=4294424888, uDiagRegValue=0
        HETREQENS_HET2: uDiagRegAddress=4294424892, uDiagRegValue=0
        HETREQDS_HET2: uDiagRegAddress=4294424900, uDiagRegValue=0
        HETDIR_HET2: uDiagRegAddress=4294424908, uDiagRegValue=0
        HETPCR_HET2: uDiagRegAddress=4294424948, uDiagRegValue=10
        HETPPR_HET2: uDiagRegAddress=4294424956, uDiagRegValue=0
        HETLBPSEL_HET2: uDiagRegAddress=4294424972, uDiagRegValue=0
        HETLBPDIR_HET2: uDiagRegAddress=4294424976, uDiagRegValue=327680
        HETPINDIS_HET2: uDiagRegAddress=4294424980, uDiagRegValue=0
        HTU__GC_HTU1: uDiagRegAddress=4294419456, uDiagRegValue=65792
        HTU__INTMAP_HTU1: uDiagRegAddress=4294419500, uDiagRegValue=0
        HTU__BIM_HTU1: uDiagRegAddress=4294419516, uDiagRegValue=0
        HTU__DCTRL_HTU1: uDiagRegAddress=4294419540, uDiagRegValue=0
        HTU__PCR_HTU1: uDiagRegAddress=4294419556, uDiagRegValue=10
        HTU__GC_HTU2: uDiagRegAddress=4294419712, uDiagRegValue=0
        HTU__CPENA_HTU2: uDiagRegAddress=4294419716, uDiagRegValue=0
        HTU__INTMAP_HTU2: uDiagRegAddress=4294419756, uDiagRegValue=0
        HTU__BIM_HTU2: uDiagRegAddress=4294419772, uDiagRegValue=0
        HTU__MP1S_HTU2: uDiagRegAddress=4294419788, uDiagRegValue=0
        HTU__MP1E_HTU2: uDiagRegAddress=4294419792, uDiagRegValue=0
        HTU__DCTRL_HTU2: uDiagRegAddress=4294419796, uDiagRegValue=0
        HTU__PCR_HTU2: uDiagRegAddress=4294419812, uDiagRegValue=10
        HTU__MP0S_HTU2: uDiagRegAddress=4294419828, uDiagRegValue=0
        HTU__MP0E_HTU2: uDiagRegAddress=4294419832, uDiagRegValue=0
        HTU_IHADDRCT_HTU1: uDiagRegAddress=4283301896, uDiagRegValue=0
        HTU_ITCOUNT_HTU1: uDiagRegAddress=4283301900, uDiagRegValue=0
        HTU_IFADDRA_HTU2: uDiagRegAddress=4283170816, uDiagRegValue=0
        HTU_IFADDRB_HTU2: uDiagRegAddress=4283170820, uDiagRegValue=0
        HTU_IHADDRCT_HTU2: uDiagRegAddress=4283170824, uDiagRegValue=0
        HTU_ITCOUNT_HTU2: uDiagRegAddress=4283170828, uDiagRegValue=0
        GIOGCR0: uDiagRegAddress=4294425600, uDiagRegValue=1
        GIOINTDET: uDiagRegAddress=4294425608, uDiagRegValue=0
        GIOPOL: uDiagRegAddress=4294425612, uDiagRegValue=0
        GIODIR_A_: uDiagRegAddress=4294425652, uDiagRegValue=237
        GIODIR_B_: uDiagRegAddress=4294425684, uDiagRegValue=0
        HTU__MP1S_HTU1: uDiagRegAddress=4294419532, uDiagRegValue=0
        HTU__MP1E_HTU1: uDiagRegAddress=4294419536, uDiagRegValue=0
        DMA_CP00_IDADDR: uDiagRegAddress=4294443012, uDiagRegValue=4261412968
        DMA_CP00_ITCOUNT: uDiagRegAddress=4294443016, uDiagRegValue=65537
        DMA_CP00_CHCTRL: uDiagRegAddress=4294443024, uDiagRegValue=61440
        DMA_CP01_IDADDR: uDiagRegAddress=4294443044, uDiagRegValue=4261412960
        DMA_CP01_CHCTRL: uDiagRegAddress=4294443056, uDiagRegValue=61704
        DMA_CP02_ISADDR: uDiagRegAddress=4294443072, uDiagRegValue=4278977026
        DMA_CP02_ITCOUNT: uDiagRegAddress=4294443080, uDiagRegValue=65539
        DMA_CP02_CHCTRL: uDiagRegAddress=4294443088, uDiagRegValue=20767
        DMA_CP02_EIOFF: uDiagRegAddress=4294443092, uDiagRegValue=131076
        DMA_CP03_ISADDR: uDiagRegAddress=4294443104, uDiagRegValue=4281991170
        DMA_CP03_ITCOUNT: uDiagRegAddress=4294443112, uDiagRegValue=65540
        DMA_CP03_CHCTRL: uDiagRegAddress=4294443120, uDiagRegValue=20767
        DMA_CP03_EIOFF: uDiagRegAddress=4294443124, uDiagRegValue=131076
        DMA_CP05_IDADDR: uDiagRegAddress=4294443172, uDiagRegValue=4282777832
        DMA_CP05_ITCOUNT: uDiagRegAddress=4294443176, uDiagRegValue=65537
        DMA_CP05_CHCTRL: uDiagRegAddress=4294443184, uDiagRegValue=499969
        DMA_CP06_IDADDR: uDiagRegAddress=4294443204, uDiagRegValue=4244081680
        DMA_CP06_CHCTRL: uDiagRegAddress=4294443216, uDiagRegValue=20767
        DMA_CP09_ISADDR: uDiagRegAddress=4294443296, uDiagRegValue=4282253554
        DMA_CP09_ITCOUNT: uDiagRegAddress=4294443304, uDiagRegValue=65540
        DMA_CP09_CHCTRL: uDiagRegAddress=4294443312, uDiagRegValue=20767
        DMA_CP09_EIOFF: uDiagRegAddress=4294443316, uDiagRegValue=131076
        DMA_CP12_ISADDR: uDiagRegAddress=4294443392, uDiagRegValue=4278845954
        DMA_CP12_ITCOUNT: uDiagRegAddress=4294443400, uDiagRegValue=65539
        DMA_CP12_CHCTRL: uDiagRegAddress=4294443408, uDiagRegValue=20767
        DMA_CP12_EIOFF: uDiagRegAddress=4294443412, uDiagRegValue=131076
        DMA_PAR0: uDiagRegAddress=4294963348, uDiagRegValue=1145308224
        DMA_PAR1: uDiagRegAddress=4294963352, uDiagRegValue=67125248
        HTU__CPENA_HTU1: uDiagRegAddress=4294419460, uDiagRegValue=20
        HTU__GCR_HTU1: uDiagRegAddress=4294419456, uDiagRegValue=65792
        HTU__MPCS_HTU1: uDiagRegAddress=4294419568, uDiagRegValue=7
        HTUDCP1__ITCOUNT_HTU1: uDiagRegAddress=4283301916, uDiagRegValue=524289
        HTUDCP1__IHADDRCT_HTU1: uDiagRegAddress=4283301912, uDiagRegValue=263080
        HTUDCP2__ITCOUNT_HTU1: uDiagRegAddress=4283301932, uDiagRegValue=524289
        HTUDCP2__IHADDRCT_HTU1: uDiagRegAddress=4283301928, uDiagRegValue=263544
      13 x uDiagRegCheckLnk:
        FBPARERR: uDiagRegAddress=4294966776, uDiagRegValueLnk=VIM_Fallback, uDiagRegUseSizeofInOffset=false, uDiagRegValueLnkOffset=0
        HTU__MP0S_HTU1: uDiagRegAddress=4294419572, uDiagRegValueLnk=Nhet_HtuDataTrq_Cnt_G_str, uDiagRegUseSizeofInOffset=false, uDiagRegValueLnkOffset=0
        HTU__MP0E_HTU1: uDiagRegAddress=4294419576, uDiagRegValueLnk=Nhet_HtuDataTrq_Cnt_G_str, uDiagRegUseSizeofInOffset=true, uDiagRegValueLnkOffset=-4
        HTUDCP1_IFADDRA_HTU1: uDiagRegAddress=4283301904, uDiagRegValueLnk=Nhet_HtuDataTrq_Cnt_G_str.HtuDataTrq1_Cnt_u32[0], uDiagRegUseSizeofInOffset=false, uDiagRegValueLnkOffset=0
        DMA_DMAMPR2S: uDiagRegAddress=4294963656, uDiagRegValueLnk=DMAData_G_str, uDiagRegUseSizeofInOffset=false, uDiagRegValueLnkOffset=0
        DMA_DMAMPR2E: uDiagRegAddress=4294963660, uDiagRegValueLnk=DMAData_G_str, uDiagRegUseSizeofInOffset=true, uDiagRegValueLnkOffset=-1
        DMA_CP02_IDADDR: uDiagRegAddress=4294443076, uDiagRegValueLnk=DMAData_G_str.FastSPI_Cnt_u16[0], uDiagRegUseSizeofInOffset=false, uDiagRegValueLnkOffset=0
        DMA_CP03_IDADDR: uDiagRegAddress=4294443108, uDiagRegValueLnk=DMAData_G_str.FastADC_Cnt_u16[0], uDiagRegUseSizeofInOffset=false, uDiagRegValueLnkOffset=0
        DMA_CP05_ISADDR: uDiagRegAddress=4294443168, uDiagRegValueLnk=DMAData_G_str.PWMPeriod_Cnt_u32, uDiagRegUseSizeofInOffset=false, uDiagRegValueLnkOffset=0
        DMA_CP06_ISADDR: uDiagRegAddress=4294443200, uDiagRegValueLnk=DMAData_G_str.PWMCmp_Cnt_u16[0][0], uDiagRegUseSizeofInOffset=false, uDiagRegValueLnkOffset=0
        DMA_CP09_IDADDR: uDiagRegAddress=4294443300, uDiagRegValueLnk=DMAData_G_str.SlowADC_Cnt_u16[0], uDiagRegUseSizeofInOffset=false, uDiagRegValueLnkOffset=0
        DMA_CP12_IDADDR: uDiagRegAddress=4294443396, uDiagRegValueLnk=DMAData_G_str.SlowSPI_Cnt_u16[0], uDiagRegUseSizeofInOffset=false, uDiagRegValueLnkOffset=0
        HTUDCP2_IFADDRA_HTU1: uDiagRegAddress=4283301920, uDiagRegValueLnk=Nhet_HtuDataTrq_Cnt_G_str.HtuDataTrq2_Cnt_u32[0], uDiagRegUseSizeofInOffset=false, uDiagRegValueLnkOffset=0
    CommonPublishedInformation: ArMajorVersion=1, ArMinorVersion=2, ArPatchVersion=0, SwMajorVersion=1, SwMinorVersion=0, SwPatchVersion=0, ModuleId=104, VendorId=0
    uDiagGeneral:
      uDiagVCLK_kHz = 80000
      uDiagEnableFPUDiag = STD_OFF
      uDiagGladiatorCompatible = STD_OFF
      uDiagVIMPerTrusted = STD_OFF
      uDiagECCPerTrusted = STD_OFF
      uDiagVimTableName = osaIRQTable
      uDiagCPEnable = uDiagStaticRegs_Per_CP1
      uDiagCPEnable = uDiagLossOfExec_Per3_CP0
      WdgMVersion = TTTech_v2.0.3
      uDiagIncludes = Nhet.h
      uDiagIncludes = Usr_RegCkDefs.h
      uDiagIncludes = Dma.h
  module config TqRsDg: implementation-config-variant=VARIANT-POST-BUILD
    TqRsDgGeneral
    CommonPublishedInformation: ArMajorVersion=3, ArMinorVersion=2, ArPatchVersion=0, SwMajorVersion=0, SwMinorVersion=0, SwPatchVersion=0, ModuleId=0, VendorId=0
  module config StabilityComp: implementation-config-variant=VARIANT-POST-BUILD
    StabilityCompGeneral
    CommonPublishedInformation: ArMajorVersion=3, ArMinorVersion=2, ArPatchVersion=0, SwMajorVersion=0, SwMinorVersion=0, SwPatchVersion=0, ModuleId=0, VendorId=0
  module config EOTActuatorMng: implementation-config-variant=VARIANT-POST-BUILD
    EOTActuatorMngGeneral
    CommonPublishedInformation: ArMajorVersion=3, ArMinorVersion=2, ArPatchVersion=0, SwMajorVersion=0, SwMinorVersion=0, SwPatchVersion=0, ModuleId=0, VendorId=0
  module config HystComp: implementation-config-variant=VARIANT-POST-BUILD
    HystCompGeneral
    CommonPublishedInformation: ArMajorVersion=3, ArMinorVersion=2, ArPatchVersion=0, SwMajorVersion=0, SwMinorVersion=0, SwPatchVersion=0, ModuleId=0, VendorId=0
  module config LrnEOT: implementation-config-variant=VARIANT-POST-BUILD
    LrnEOTGeneral
    CommonPublishedInformation: ArMajorVersion=3, ArMinorVersion=2, ArPatchVersion=0, SwMajorVersion=0, SwMinorVersion=0, SwPatchVersion=0, ModuleId=0, VendorId=0
  module config Polarity: implementation-config-variant=VARIANT-POST-BUILD
    PolarityGeneral
    CommonPublishedInformation: ArMajorVersion=3, ArMinorVersion=2, ArPatchVersion=0, SwMajorVersion=0, SwMinorVersion=0, SwPatchVersion=0, ModuleId=0, VendorId=0
  module config BatteryVoltage: implementation-config-variant=VARIANT-POST-BUILD
    BatteryVoltageGeneral: BatteryVoltageCPEnable=BatteryVoltage_Per1_CP0
    CommonPublishedInformation: ArMajorVersion=3, ArMinorVersion=2, ArPatchVersion=0, SwMajorVersion=0, SwMinorVersion=0, SwPatchVersion=0, ModuleId=0, VendorId=0
  module config AstLmt: implementation-config-variant=VARIANT-POST-BUILD
    AstLmtGeneral
    CommonPublishedInformation: ArMajorVersion=3, ArMinorVersion=2, ArPatchVersion=0, SwMajorVersion=0, SwMinorVersion=0, SwPatchVersion=0, ModuleId=0, VendorId=0
  module config ThrmlDutyCycle: implementation-config-variant=VARIANT-POST-BUILD
    ThrmlDutyCycleGeneral: ThrmlDutyCycleCPEnable=ThrmlDutyCycle_Per1_CP1
    CommonPublishedInformation: ArMajorVersion=3, ArMinorVersion=2, ArPatchVersion=0, SwMajorVersion=0, SwMinorVersion=0, SwPatchVersion=0, ModuleId=0, VendorId=0
  module config MtrTempEst: implementation-config-variant=VARIANT-POST-BUILD
    MtrTempEstGeneral
    CommonPublishedInformation: ArMajorVersion=3, ArMinorVersion=2, ArPatchVersion=0, SwMajorVersion=0, SwMinorVersion=0, SwPatchVersion=0, ModuleId=0, VendorId=0
  module config AvgFricLrn: implementation-config-variant=VARIANT-POST-BUILD
    AvgFricLrnGeneral
    CommonPublishedInformation: ArMajorVersion=3, ArMinorVersion=2, ArPatchVersion=0, SwMajorVersion=0, SwMinorVersion=0, SwPatchVersion=0, ModuleId=0, VendorId=0
  module config CmMtrCurr: implementation-config-variant=VARIANT-POST-BUILD
    CmMtrCurrGeneral
    CommonPublishedInformation: ArMajorVersion=3, ArMinorVersion=2, ArPatchVersion=0, SwMajorVersion=0, SwMinorVersion=0, SwPatchVersion=0, ModuleId=0, VendorId=0
    CmMtrCurrPhaseConfig: CmMtrCurrConfig=MTRCURRPHASEBA
  module config CurrCmd: implementation-config-variant=VARIANT-POST-BUILD
    CurrCmdGeneral
    CommonPublishedInformation: ArMajorVersion=3, ArMinorVersion=2, ArPatchVersion=0, SwMajorVersion=0, SwMinorVersion=0, SwPatchVersion=0, ModuleId=0, VendorId=0
  module config CurrParamComp: implementation-config-variant=VARIANT-POST-BUILD
    CurrParamCompGeneral: CurrParamCompCPEnable=CurrParamComp_Per2_CP0
    CommonPublishedInformation: ArMajorVersion=3, ArMinorVersion=2, ArPatchVersion=0, SwMajorVersion=0, SwMinorVersion=0, SwPatchVersion=0, ModuleId=0, VendorId=0
  module config PeakCurrEst: implementation-config-variant=VARIANT-POST-BUILD
    PeakCurrEstGeneral
    CommonPublishedInformation: ArMajorVersion=3, ArMinorVersion=2, ArPatchVersion=0, SwMajorVersion=0, SwMinorVersion=0, SwPatchVersion=0, ModuleId=0, VendorId=0
  module config QuadDet: implementation-config-variant=VARIANT-POST-BUILD
    QuadDetGeneral
    CommonPublishedInformation: ArMajorVersion=3, ArMinorVersion=2, ArPatchVersion=0, SwMajorVersion=0, SwMinorVersion=0, SwPatchVersion=0, ModuleId=0, VendorId=0
  module config TrqCmdScl: implementation-config-variant=VARIANT-POST-BUILD
    TrqCmdSclGeneral
    CommonPublishedInformation: ArMajorVersion=3, ArMinorVersion=2, ArPatchVersion=0, SwMajorVersion=0, SwMinorVersion=0, SwPatchVersion=0, ModuleId=0, VendorId=0
  module config TuningSelAuth: implementation-config-variant=VARIANT-POST-BUILD
    TuningSelAuthGeneral: TuningSelAuthCPEnable=TuningSelAuth_Per1_CP0
    CommonPublishedInformation: ArMajorVersion=3, ArMinorVersion=2, ArPatchVersion=0, SwMajorVersion=0, SwMinorVersion=0, SwPatchVersion=0, ModuleId=0, VendorId=0
  module config VehPwrMd: implementation-config-variant=VARIANT-POST-BUILD
    VehPwrMdGeneral: VehPwrMdCPEnable=VehPwrMd_Per1_CP1
    CommonPublishedInformation: ArMajorVersion=3, ArMinorVersion=2, ArPatchVersion=0, SwMajorVersion=0, SwMinorVersion=0, SwPatchVersion=0, ModuleId=0, VendorId=0
  module config PwrLmtFuncCr: implementation-config-variant=VARIANT-PRE-COMPILE
    PwrLmtFuncCrGeneral
    CommonPublishedInformation: ArMajorVersion=3, ArMinorVersion=2, ArPatchVersion=0, SwMajorVersion=0, SwMinorVersion=0, SwPatchVersion=0, ModuleId=0, VendorId=0
  module config BVDiag: implementation-config-variant=VARIANT-POST-BUILD
    BVDiagGeneral: BVDiagCPEnable=BVDiag_Per1_CP1
    CommonPublishedInformation: ArMajorVersion=3, ArMinorVersion=2, ArPatchVersion=0, SwMajorVersion=0, SwMinorVersion=0, SwPatchVersion=0, ModuleId=0, VendorId=0
