[part 2 of 2: package /DaVinci_Project]
AUTOSAR XML (schema 302)
package /DaVinci_Project  (continued)
  module config Os: implementation-config-variant=VARIANT-PRE-COMPILE, module-description=Os_Impl
    14 x OsAlarm, all with OsAlarmAccessingApplication=Ap_9, OsAlarmCounterRef=SystemTimer:
      Alarm_10ms_SchM9
        OsAlarmAction
          OsAlarmActivateTask: OsAlarmActivateTaskRef=Task_10ms_SchM9
        OsAlarmAutostart:
          OsAlarmAlarmTime = 1
          OsAlarmAutostartType = RELATIVE
          OsAlarmCycleTime = 10
          OsAlarmStaticAlarm = false
          OsAlarmAlarmUnit = MSEC
          OsAlarmAppModeRef = OSDEFAULTAPPMODE
      Alarm_4ms_SchM0: OsAlarmAccessingApplication=Ap_0
        OsAlarmAction
          OsAlarmActivateTask: OsAlarmActivateTaskRef=Task_4ms_SchM0
        OsAlarmAutostart:
          OsAlarmAlarmTime = 1
          OsAlarmAutostartType = RELATIVE
          OsAlarmCycleTime = 4
          OsAlarmStaticAlarm = false
          OsAlarmAlarmUnit = MSEC
          OsAlarmAppModeRef = OSDEFAULTAPPMODE
      Rte_Al_TE_Task_100ms_10_0_100ms: OsAlarmAccessingApplication=Ap_10
        OsAlarmAction
          OsAlarmActivateTask: OsAlarmActivateTaskRef=Task_100ms_10
      Rte_Al_TE_Task_100ms_9_0_100ms: OsAlarmAccessingApplication=Ap_10
        OsAlarmAction
          OsAlarmActivateTask: OsAlarmActivateTaskRef=Task_100ms_9
      Rte_Al_TE_Task_10ms_10_0_10ms: OsAlarmAccessingApplication=Ap_10
        OsAlarmAction
          OsAlarmActivateTask: OsAlarmActivateTaskRef=Task_10ms_10
      Rte_Al_TE_Task_10ms_9_0_10ms: OsAlarmAccessingApplication=Ap_10
        OsAlarmAction
          OsAlarmActivateTask: OsAlarmActivateTaskRef=Task_10ms_9
      Rte_Al_TE_Task_2ms_10_0_2ms: OsAlarmAccessingApplication=Ap_10
        OsAlarmAction
          OsAlarmActivateTask: OsAlarmActivateTaskRef=Task_2ms_10
      Rte_Al_TE_Task_2ms_8_0_2ms: OsAlarmAccessingApplication=Ap_10
        OsAlarmAction
          OsAlarmActivateTask: OsAlarmActivateTaskRef=Task_2ms_8
      Rte_Al_TE_Task_2ms_9_0_2ms: OsAlarmAccessingApplication=Ap_10
        OsAlarmAction
          OsAlarmActivateTask: OsAlarmActivateTaskRef=Task_2ms_9
      Rte_Al_TE_Task_4ms_10_0_4ms: OsAlarmAccessingApplication=Ap_10
        OsAlarmAction
          OsAlarmActivateTask: OsAlarmActivateTaskRef=Task_4ms_10
      Rte_Al_TE_BatteryVoltage_BatteryVoltage_Per2: OsAlarmAccessingApplication=Ap_10
        OsAlarmAction
          OsAlarmActivateTask: OsAlarmActivateTaskRef=Task_4ms_9
      Rte_Al_TE_Ap_DiagMgr8_DiagMgr8_Per: OsAlarmAccessingApplication=Ap_10
        OsAlarmAction
          OsAlarmActivateTask: OsAlarmActivateTaskRef=Task_100ms_8
      Alarm_100ms_SchM0: OsAlarmAccessingApplication=Ap_0
        OsAlarmAction
          OsAlarmActivateTask: OsAlarmActivateTaskRef=Task_100ms_SchM0
        OsAlarmAutostart:
          OsAlarmAlarmTime = 1
          OsAlarmAutostartType = RELATIVE
          OsAlarmCycleTime = 100
          OsAlarmStaticAlarm = false
          OsAlarmAlarmUnit = MSEC
          OsAlarmAppModeRef = OSDEFAULTAPPMODE
      Alarm_100ms_SchM9
        OsAlarmAction
          OsAlarmActivateTask: OsAlarmActivateTaskRef=Task_100ms_SchM9
        OsAlarmAutostart:
          OsAlarmAlarmTime = 1
          OsAlarmAutostartType = RELATIVE
          OsAlarmCycleTime = 100
          OsAlarmStaticAlarm = false
          OsAlarmAlarmUnit = MSEC
          OsAlarmAppModeRef = OSDEFAULTAPPMODE
    OSDEFAULTAPPMODE (OsAppMode): OsAppModeId=(unset)
    4 x OsApplication, all with OsApplicationMPUArea4Size=0, OsApplicationMPUArea4Access=0, OsApplicationMPUArea6Size=0, OsApplicationMPUArea6Access=0, OsApplicationMPUArea9Size=0, OsApplicationMPUArea9Access=0, OsApplicationMPUArea10Size=0, OsApplicationMPUArea10Access=0, OsApplicationMPUArea11Size=0, OsApplicationMPUArea11Access=0, OsApplicationMPUArea4Start=0, OsApplicationMPUArea6Start=0, OsApplicationMPUArea9Start=0, OsApplicationMPUArea10Start=0, OsApplicationMPUArea11Start=0:
      Ap_10: OsTrusted=false, OsAppGenerateStub=false, OsApplicationProtectionRegionSizeNoInitData=16384, OsApplicationProtectionRegionSizeInitData=1024, OsApplicationMPUArea8Size=268435456, OsApplicationMPUArea8Access=4864, OsApplicationNonTrusted_Function=NtWrapS_AssistLmtFunc_Scom_ManualTrqCmd, OsApplicationNonTrusted_Function=NtWrapS_SCom_EOLNomMtrParam_Set, OsApplicationNonTrusted_Function=NtWrapS_TrqCmdScl_SCom_Set, OsApplicationNonTrusted_Function=NtWrapS_Polarity_SCom_SetPolarity, OsApplicationNonTrusted_Function=NtWrapS_CmMtrCurr_SCom_CalGain, OsApplicationNonTrusted_Function=NtWrapS_CmMtrCurr_SCom_CalOffset, OsApplicationNonTrusted_Function=NtWrapS_CmMtrCurr_SCom_SetMtrCurrCals, OsApplicationNonTrusted_Function=NtWrapS_XcpWriteAp10, OsApplicationNonTrusted_Function=NtWrapS_TrqCanc_Scom_SetCogTrqCal, OsApplicationNonTrusted_Function=NtWrapS_DigHwTrqSENT_SCom_ClrTrqTrim, OsApplicationNonTrusted_Function=NtWrapS_DigHwTrqSENT_SCom_SetTrqTrim, OsApplicationNonTrusted_Function=NtWrapS_DigHwTrqSENT_SCom_WriteData, OsApplicationNonTrusted_Function=NtWrapS_DigColPs_SCom_CustSetTrim, OsApplicationNonTrusted_Function=NtWrapS_DigColPs_SCom_CustClearTrim, OsApplicationNonTrusted_Function=NtWrapS_DigColPs_SCom_NxtSetTrim, OsApplicationNonTrusted_Function=NtWrapS_DigColPs_SCom_NxtClearTrim, OsApplicationNonTrusted_Function=NtWrapS_GenPosTraj_SCom_SetInputParam, OsApplicationNonTrusted_Function=NtWrapS_TSMit_SCom_GainReset, OsApplicationNonTrusted_Function=NtWrapS_VehDyn_SCom_ForceCenter, OsApplicationMPUArea8Start=4026531840, OsAppAlarmRef=Rte_Al_TE_Task_100ms_10_0_100ms, OsAppAlarmRef=Rte_Al_TE_Task_10ms_10_0_10ms, OsAppAlarmRef=Rte_Al_TE_Task_2ms_10_0_2ms, OsAppAlarmRef=Rte_Al_TE_Task_4ms_10_0_4ms, OsAppIsrRef=Isr_I2c, OsAppTaskRef=Task_100ms_10, OsAppTaskRef=Task_10ms_10, OsAppTaskRef=Task_2ms_10, OsAppTaskRef=Task_4ms_10, OsAppTaskRef=Task_Bkgnd, OsAppTaskRef=Task_Init_10, OsAppTaskRef=Task_Trans_10
        OsApplicationHooks: OsAppErrorHook=false, OsAppShutdownHook=false, OsAppStartupHook=false
      Ap_8: OsTrusted=false, OsAppGenerateStub=false, OsApplicationProtectionRegionSizeNoInitData=512, OsApplicationProtectionRegionSizeInitData=512, OsApplicationMPUArea8Size=268435456, OsApplicationMPUArea8Access=4864, OsApplicationNonTrusted_Function=NtWrapS_XcpWriteAp8, OsApplicationMPUArea8Start=4026531840, OsAppAlarmRef=Rte_Al_TE_Task_2ms_8_0_2ms, OsAppAlarmRef=Rte_Al_TE_Ap_DiagMgr8_DiagMgr8_Per, OsAppTaskRef=Task_100ms_8, OsAppTaskRef=Task_2ms_8, OsAppTaskRef=Task_Init_8, OsAppTaskRef=Task_Trans_8
        OsApplicationHooks: OsAppErrorHook=false, OsAppShutdownHook=false, OsAppStartupHook=false
      Ap_9: OsTrusted=false, OsAppGenerateStub=true, OsApplicationProtectionRegionSizeNoInitData=16384, OsApplicationProtectionRegionSizeInitData=8192, OsApplicationMPUArea8Size=268435456, OsApplicationMPUArea8Access=4864, OsApplicationNonTrusted_Function=NtWrapS_XcpWriteAp9, OsApplicationMPUArea8Start=4026531840, OsAppAlarmRef=Alarm_10ms_SchM9, OsAppAlarmRef=Rte_Al_TE_Task_100ms_9_0_100ms, OsAppAlarmRef=Rte_Al_TE_Task_10ms_9_0_10ms, OsAppAlarmRef=Rte_Al_TE_Task_2ms_9_0_2ms, OsAppAlarmRef=Rte_Al_TE_BatteryVoltage_BatteryVoltage_Per2, OsAppAlarmRef=Alarm_100ms_SchM9, OsAppCounterRef=SystemTimer, OsAppIsrRef=Gpt_IsrInt0, OsAppIsrRef=DCan1_level0_Irq, OsAppIsrRef=DCan2_level0_Irq, OsAppIsrRef=Isr_OvervoltThresh, OsAppResourceRef=RES_SCHEDULER, OsAppTaskRef=Task_100ms_9, OsAppTaskRef=Task_10ms_9, OsAppTaskRef=Task_2ms_9, OsAppTaskRef=Task_Trans_9, OsAppTaskRef=Task_Init_9, OsAppTaskRef=Task_10ms_SchM9, OsAppTaskRef=Task_Init_SchM9, OsAppTaskRef=Task_4ms_9, OsAppTaskRef=Task_TrnsB_9, OsAppTaskRef=Task_100ms_SchM9
        OsApplicationHooks: OsAppErrorHook=false, OsAppShutdownHook=false, OsAppStartupHook=false
        84 x OsApplicationTrustedFunction, all with OsApplicationReturnType=Std_ReturnType:
          Rte_TrustedCall_Ap_ActivePull_SystemTime_DtrmnElapsedTime_mS_u32: OsTrustedFunctionName=Rte_TrustedCall_Ap_ActivePull_SystemTime_DtrmnElapsedTime_mS_u32, OsApplicationParams=UInt32 InitialTime, UInt32 *ElapsedTime
          Rte_TrustedCall_Ap_ActivePull_SystemTime_GetSystemTime_mS_u32: OsTrustedFunctionName=Rte_TrustedCall_Ap_ActivePull_SystemTime_GetSystemTime_mS_u32, OsApplicationParams=UInt32 *CurrentTime
          Rte_TrustedCall_Ap_AvgFricLrn_SystemTime_DtrmnElapsedTime_mS_u32: OsTrustedFunctionName=Rte_TrustedCall_Ap_AvgFricLrn_SystemTime_DtrmnElapsedTime_mS_u32, OsApplicationParams=UInt32 InitialTime, UInt32 *ElapsedTime
          Rte_TrustedCall_Ap_AvgFricLrn_SystemTime_GetSystemTime_mS_u32: OsTrustedFunctionName=Rte_TrustedCall_Ap_AvgFricLrn_SystemTime_GetSystemTime_mS_u32, OsApplicationParams=UInt32 *CurrentTime
          Rte_TrustedCall_Ap_BVDiag_SystemTime_DtrmnElapsedTime_mS_u16: OsTrustedFunctionName=Rte_TrustedCall_Ap_BVDiag_SystemTime_DtrmnElapsedTime_mS_u16, OsApplicationParams=UInt32 InitialTime, UInt16 *ElapsedTime
          Rte_TrustedCall_Ap_BVDiag_SystemTime_GetSystemTime_mS_u32: OsTrustedFunctionName=Rte_TrustedCall_Ap_BVDiag_SystemTime_GetSystemTime_mS_u32, OsApplicationParams=UInt32 *CurrentTime
          Rte_TrustedCall_Ap_CurrParamComp_EOLNomMtrParamBlk_WriteBlock: OsTrustedFunctionName=Rte_TrustedCall_Ap_CurrParamComp_EOLNomMtrParamBlk_WriteBlock, OsApplicationParams=const NvM_DestPtr *DstPtr
          Rte_TrustedCall_Ap_StaMd_CloseCheckData_GetErrorStatus: OsTrustedFunctionName=Rte_TrustedCall_Ap_StaMd_CloseCheckData_GetErrorStatus, OsApplicationParams=NvM_RequestResultType *ErrorStatus
          Rte_TrustedCall_Ap_StaMd_CloseCheckData_WriteBlock: OsTrustedFunctionName=Rte_TrustedCall_Ap_StaMd_CloseCheckData_WriteBlock, OsApplicationParams=const NvM_DestPtr *DstPtr
          Rte_TrustedCall_Ap_StaMd_StaMd_Per1_CP1_CheckpointReached: OsTrustedFunctionName=Rte_TrustedCall_Ap_StaMd_StaMd_Per1_CP1_CheckpointReached, OsApplicationParams=void
          Rte_TrustedCall_Ap_StaMd_TypeHData_WriteBlock: OsTrustedFunctionName=Rte_TrustedCall_Ap_StaMd_TypeHData_WriteBlock, OsApplicationParams=const NvM_DestPtr *DstPtr
          Rte_TrustedCall_Ap_TrqCanc_EOLCogTrqCanc_WriteBlock: OsTrustedFunctionName=Rte_TrustedCall_Ap_TrqCanc_EOLCogTrqCanc_WriteBlock, OsApplicationParams=const NvM_DestPtr *DstPtr
          Rte_TrustedCall_Ap_TrqCmdScl_TrqCmdScl_WriteBlock: OsTrustedFunctionName=Rte_TrustedCall_Ap_TrqCmdScl_TrqCmdScl_WriteBlock, OsApplicationParams=const NvM_DestPtr *DstPtr
          Rte_TrustedCall_Sa_CDDInterface_CDDPorts_ApplyMtrElecMechPol: OsTrustedFunctionName=Rte_TrustedCall_Sa_CDDInterface_CDDPorts_ApplyMtrElecMechPol, OsApplicationParams=SInt8 MtrElecMechPol_Cnt_s8
          Rte_TrustedCall_Sa_CDDInterface_CDDPorts_ClearPhsReasSum: OsTrustedFunctionName=Rte_TrustedCall_Sa_CDDInterface_CDDPorts_ClearPhsReasSum, OsApplicationParams=UInt16 DataAccessBfr_Cnt_T_u16
          Rte_TrustedCall_Sa_CmMtrCurr_EOLCurrTempOffset_WriteBlock: OsTrustedFunctionName=Rte_TrustedCall_Sa_CmMtrCurr_EOLCurrTempOffset_WriteBlock, OsApplicationParams=const NvM_DestPtr *DstPtr
          Rte_TrustedCall_Sa_CmMtrCurr_EOLShCurrCal_SetRamBlockStatus: OsTrustedFunctionName=Rte_TrustedCall_Sa_CmMtrCurr_EOLShCurrCal_SetRamBlockStatus, OsApplicationParams=Boolean RamBlockStatus
          Rte_TrustedCall_Sa_CmMtrCurr_EOLShCurrCal_WriteBlock: OsTrustedFunctionName=Rte_TrustedCall_Sa_CmMtrCurr_EOLShCurrCal_WriteBlock, OsApplicationParams=const NvM_DestPtr *DstPtr
          Rte_TrustedCall_Ap_LrnEOT_NxtrDiagMgr_GetNTCFailed: OsTrustedFunctionName=Rte_TrustedCall_Ap_LrnEOT_NxtrDiagMgr_GetNTCFailed, OsApplicationParams=NTCNumber NTC_Cnt_T_enum, Boolean *NTCFailed_Ptr_T_lgc
          Rte_TrustedCall_Ap_LrnEOT_SystemTime_DtrmnElapsedTime_mS_u16: OsTrustedFunctionName=Rte_TrustedCall_Ap_LrnEOT_SystemTime_DtrmnElapsedTime_mS_u16, OsApplicationParams=UInt32 InitialTime, UInt16 *ElapsedTime
          Rte_TrustedCall_Ap_LrnEOT_SystemTime_GetSystemTime_mS_u32: OsTrustedFunctionName=Rte_TrustedCall_Ap_LrnEOT_SystemTime_GetSystemTime_mS_u32, OsApplicationParams=UInt32 *CurrentTime
          Rte_TrustedCall_Ap_DemIf_SystemTime_DtrmnElapsedTime_mS_u16: OsTrustedFunctionName=Rte_TrustedCall_Ap_DemIf_SystemTime_DtrmnElapsedTime_mS_u16, OsApplicationParams=UInt32 InitialTime, UInt16 *ElapsedTime
          Rte_TrustedCall_Ap_DemIf_SystemTime_DtrmnElapsedTime_mS_u32: OsTrustedFunctionName=Rte_TrustedCall_Ap_DemIf_SystemTime_DtrmnElapsedTime_mS_u32, OsApplicationParams=UInt32 InitialTime, UInt32 *ElapsedTime
          Rte_TrustedCall_Ap_DemIf_SystemTime_GetSystemTime_mS_u32: OsTrustedFunctionName=Rte_TrustedCall_Ap_DemIf_SystemTime_GetSystemTime_mS_u32, OsApplicationParams=UInt32 *CurrentTime
          Rte_TrustedCall_Ap_SrlComInput_SystemTime_DtrmnElapsedTime_mS_u16: OsTrustedFunctionName=Rte_TrustedCall_Ap_SrlComInput_SystemTime_DtrmnElapsedTime_mS_u16, OsApplicationParams=UInt32 InitialTime, UInt16 *ElapsedTime
          Rte_TrustedCall_Ap_SrlComInput_SystemTime_GetSystemTime_mS_u32: OsTrustedFunctionName=Rte_TrustedCall_Ap_SrlComInput_SystemTime_GetSystemTime_mS_u32, OsApplicationParams=UInt32 *CurrentTime
          Rte_TrustedCall_Ap_SrlComOutput_SystemTime_DtrmnElapsedTime_mS_u16: OsTrustedFunctionName=Rte_TrustedCall_Ap_SrlComOutput_SystemTime_DtrmnElapsedTime_mS_u16, OsApplicationParams=UInt32 InitialTime, UInt16 *ElapsedTime
          Rte_TrustedCall_Ap_SrlComOutput_SystemTime_GetSystemTime_mS_u32: OsTrustedFunctionName=Rte_TrustedCall_Ap_SrlComOutput_SystemTime_GetSystemTime_mS_u32, OsApplicationParams=UInt32 *CurrentTime
          Rte_TrustedCall_Ap_VehPwrMd_SystemTime_DtrmnElapsedTime_mS_u16: OsTrustedFunctionName=Rte_TrustedCall_Ap_VehPwrMd_SystemTime_DtrmnElapsedTime_mS_u16, OsApplicationParams=UInt32 InitialTime, UInt16 *ElapsedTime
          Rte_TrustedCall_Ap_VehPwrMd_SystemTime_GetSystemTime_mS_u32: OsTrustedFunctionName=Rte_TrustedCall_Ap_VehPwrMd_SystemTime_GetSystemTime_mS_u32, OsApplicationParams=UInt32 *CurrentTime
          Rte_TrustedCall_Ap_StaMd_TOD_OP_SET: OsTrustedFunctionName=Rte_TrustedCall_Ap_StaMd_TOD_OP_SET, OsApplicationParams=IoHwAb_BoolType signal
          Rte_TrustedCall_Sa_MtrDrvDiag_FetDrvReset_OP_SET: OsTrustedFunctionName=Rte_TrustedCall_Sa_MtrDrvDiag_FetDrvReset_OP_SET, OsApplicationParams=IoHwAb_BoolType signal
          Rte_TrustedCall_Sa_MtrDrvDiag_FetFlt1Data_OP_GET: OsTrustedFunctionName=Rte_TrustedCall_Sa_MtrDrvDiag_FetFlt1Data_OP_GET, OsApplicationParams=IoHwAb_BoolType *signal
          Rte_TrustedCall_Sa_MtrDrvDiag_FetFlt2Clk_OP_GET: OsTrustedFunctionName=Rte_TrustedCall_Sa_MtrDrvDiag_FetFlt2Clk_OP_GET, OsApplicationParams=IoHwAb_BoolType *signal
          Rte_TrustedCall_Sa_MtrDrvDiag_FetFlt2Clk_OP_SET: OsTrustedFunctionName=Rte_TrustedCall_Sa_MtrDrvDiag_FetFlt2Clk_OP_SET, OsApplicationParams=IoHwAb_BoolType signal
          Rte_TrustedCall_Sa_MtrDrvDiag_IoHwAbPortConfig_SetFetFlt2ToOutput: OsTrustedFunctionName=Rte_TrustedCall_Sa_MtrDrvDiag_IoHwAbPortConfig_SetFetFlt2ToOutput, OsApplicationParams=IoHwAb_BoolType signal
          Rte_TrustedCall_Sa_OvrVoltMon_phyOvrVoltFdbk_OP_GET: OsTrustedFunctionName=Rte_TrustedCall_Sa_OvrVoltMon_phyOvrVoltFdbk_OP_GET, OsApplicationParams=IoHwAb_BoolType *signal
          Rte_TrustedCall_Sa_ShtdnMech_FetDrvReset_OP_GET: OsTrustedFunctionName=Rte_TrustedCall_Sa_ShtdnMech_FetDrvReset_OP_GET, OsApplicationParams=IoHwAb_BoolType *signal
          Rte_TrustedCall_Sa_ShtdnMech_SysFault2_OP_GET: OsTrustedFunctionName=Rte_TrustedCall_Sa_ShtdnMech_SysFault2_OP_GET, OsApplicationParams=IoHwAb_BoolType *signal
          Rte_TrustedCall_Sa_ShtdnMech_SysFault3_OP_GET: OsTrustedFunctionName=Rte_TrustedCall_Sa_ShtdnMech_SysFault3_OP_GET, OsApplicationParams=IoHwAb_BoolType *signal
          Rte_TrustedCall_Sa_TmprlMon2_WdMonitor_OP_SET: OsTrustedFunctionName=Rte_TrustedCall_Sa_TmprlMon2_WdMonitor_OP_SET, OsApplicationParams=IoHwAb_BoolType signal
          Rte_TrustedCall_Sa_TmprlMon_FetDrvCntl_OP_GET: OsTrustedFunctionName=Rte_TrustedCall_Sa_TmprlMon_FetDrvCntl_OP_GET, OsApplicationParams=IoHwAb_BoolType *signal
          Rte_TrustedCall_Sa_TmprlMon_PwrSwitchEn_OP_GET: OsTrustedFunctionName=Rte_TrustedCall_Sa_TmprlMon_PwrSwitchEn_OP_GET, OsApplicationParams=IoHwAb_BoolType *signal
          Rte_TrustedCall_Sa_TmprlMon_SysFault2_OP_GET: OsTrustedFunctionName=Rte_TrustedCall_Sa_TmprlMon_SysFault2_OP_GET, OsApplicationParams=IoHwAb_BoolType *signal
          Rte_TrustedCall_Sa_TmprlMon_SysFault2_OP_SET: OsTrustedFunctionName=Rte_TrustedCall_Sa_TmprlMon_SysFault2_OP_SET, OsApplicationParams=IoHwAb_BoolType signal
          Rte_TrustedCall_Sa_TmprlMon_SysFault3_OP_GET: OsTrustedFunctionName=Rte_TrustedCall_Sa_TmprlMon_SysFault3_OP_GET, OsApplicationParams=IoHwAb_BoolType *signal
          Rte_TrustedCall_Sa_TmprlMon_SysFault3_OP_SET: OsTrustedFunctionName=Rte_TrustedCall_Sa_TmprlMon_SysFault3_OP_SET, OsApplicationParams=IoHwAb_BoolType signal
          Rte_TrustedCall_Sa_TmprlMon_WdMonitor_OP_SET: OsTrustedFunctionName=Rte_TrustedCall_Sa_TmprlMon_WdMonitor_OP_SET, OsApplicationParams=IoHwAb_BoolType signal
          Rte_TrustedCall_Sa_TmprlMon_WdReset_OP_SET: OsTrustedFunctionName=Rte_TrustedCall_Sa_TmprlMon_WdReset_OP_SET, OsApplicationParams=IoHwAb_BoolType signal
          Rte_TrustedCall_Ap_DiagMgr8_DiagMgr8_Per_CP0_CheckpointReached: OsTrustedFunctionName=Rte_TrustedCall_Ap_DiagMgr8_DiagMgr8_Per_CP0_CheckpointReached, OsApplicationParams=void
          Rte_TrustedCall_Ap_StaMd8_StaMd8_Per1_CP0_CheckpointReached: OsTrustedFunctionName=Rte_TrustedCall_Ap_StaMd8_StaMd8_Per1_CP0_CheckpointReached, OsApplicationParams=void
          Rte_TrustedCall_Ap_StabilityComp2_StabilityComp2_Per1_CP1_CheckpointReached: OsTrustedFunctionName=Rte_TrustedCall_Ap_StabilityComp2_StabilityComp2_Per1_CP1_CheckpointReached, OsApplicationParams=void
          Rte_TrustedCall_Sa_ShtdnMech_ShtdnMech_Per1_CP1_CheckpointReached: OsTrustedFunctionName=Rte_TrustedCall_Sa_ShtdnMech_ShtdnMech_Per1_CP1_CheckpointReached, OsApplicationParams=void
          Rte_TrustedCall_Sa_TmprlMon_TmprlMon_Per1_CP0_CheckpointReached: OsTrustedFunctionName=Rte_TrustedCall_Sa_TmprlMon_TmprlMon_Per1_CP0_CheckpointReached, OsApplicationParams=void
          Rte_TrustedCall_Sa_DigHwTrqSENT_NvM_DigHwTrqSENTTrim_Srv_GetErrorStatus: OsTrustedFunctionName=Rte_TrustedCall_Sa_DigHwTrqSENT_NvM_DigHwTrqSENTTrim_Srv_GetErrorStatus, OsApplicationParams=NvM_RequestResultType *ErrorStatus
          Rte_TrustedCall_Sa_DigHwTrqSENT_NvM_DigHwTrqSENTTrim_Srv_WriteBlock: OsTrustedFunctionName=Rte_TrustedCall_Sa_DigHwTrqSENT_NvM_DigHwTrqSENTTrim_Srv_WriteBlock, OsApplicationParams=const NvM_DestPtr *DstPtr
          Rte_TrustedCall_Ap_AbsHwPos_EOLVehCntrOffset_GetErrorStatus: OsTrustedFunctionName=Rte_TrustedCall_Ap_AbsHwPos_EOLVehCntrOffset_GetErrorStatus, OsApplicationParams=NvM_RequestResultType *ErrorStatus
          Rte_TrustedCall_Ap_AbsHwPos_EOLVehCntrOffset_WriteBlock: OsTrustedFunctionName=Rte_TrustedCall_Ap_AbsHwPos_EOLVehCntrOffset_WriteBlock, OsApplicationParams=const NvM_DestPtr *DstPtr
          Rte_TrustedCall_Sa_DigColPs_EOLDigColPosCals_WriteBlock: OsTrustedFunctionName=Rte_TrustedCall_Sa_DigColPs_EOLDigColPosCals_WriteBlock, OsApplicationParams=const NvM_DestPtr *DstPtr
          Rte_TrustedCall_Ap_Polarity_Polarity_WriteBlock: OsTrustedFunctionName=Rte_TrustedCall_Ap_Polarity_Polarity_WriteBlock, OsApplicationParams=const NvM_DestPtr *DstPtr
          Rte_TrustedCall_Ap_TrqCanc_EOLCogTrqRplComp_WriteBlock: OsTrustedFunctionName=Rte_TrustedCall_Ap_TrqCanc_EOLCogTrqRplComp_WriteBlock, OsApplicationParams=const NvM_DestPtr *DstPtr
          Rte_TrustedCall_Ap_AstLmt_SteeringAsstDefeat_WriteBlock: OsTrustedFunctionName=Rte_TrustedCall_Ap_AstLmt_SteeringAsstDefeat_WriteBlock, OsApplicationParams=const NvM_DestPtr *DstPtr
          Rte_TrustedCall_Ap_TSMit_TSMitDisableEOL_WriteBlock: OsTrustedFunctionName=Rte_TrustedCall_Ap_TSMit_TSMitDisableEOL_WriteBlock, OsApplicationParams=const NvM_DestPtr *DstPtr
          Rte_TrustedCall_Ap_TSMit_TSMitGainLrn_SetRamBlockStatus: OsTrustedFunctionName=Rte_TrustedCall_Ap_TSMit_TSMitGainLrn_SetRamBlockStatus, OsApplicationParams=Boolean RamBlockStatus
          Rte_TrustedCall_Ap_TSMit_TSMitGainLrn_WriteBlock: OsTrustedFunctionName=Rte_TrustedCall_Ap_TSMit_TSMitGainLrn_WriteBlock, OsApplicationParams=const NvM_DestPtr *DstPtr
          Rte_TrustedCall_Ap_Assist_FltInjection_SCom_FltInjection: OsTrustedFunctionName=Rte_TrustedCall_Ap_Assist_FltInjection_SCom_FltInjection, OsApplicationParams=Float *SignalPath_Uls_f32, FltInjectionLocType LocationKey_Cnt_enum
          Rte_TrustedCall_Ap_Damping_FltInjection_SCom_FltInjection: OsTrustedFunctionName=Rte_TrustedCall_Ap_Damping_FltInjection_SCom_FltInjection, OsApplicationParams=Float *SignalPath_Uls_f32, FltInjectionLocType LocationKey_Cnt_enum
          Rte_TrustedCall_Ap_EtDmpFw_FaultInjection_SCom_FltInjection: OsTrustedFunctionName=Rte_TrustedCall_Ap_EtDmpFw_FaultInjection_SCom_FltInjection, OsApplicationParams=Float *SignalPath_Uls_f32, FltInjectionLocType LocationKey_Cnt_enum
          Rte_TrustedCall_Ap_FltInjection_SystemTime_DtrmnElapsedTime_mS_u32: OsTrustedFunctionName=Rte_TrustedCall_Ap_FltInjection_SystemTime_DtrmnElapsedTime_mS_u32, OsApplicationParams=UInt32 InitialTime, UInt32 *ElapsedTime
          Rte_TrustedCall_Ap_FltInjection_SystemTime_GetSystemTime_mS_u32: OsTrustedFunctionName=Rte_TrustedCall_Ap_FltInjection_SystemTime_GetSystemTime_mS_u32, OsApplicationParams=UInt32 *CurrentTime
          Rte_TrustedCall_Ap_FrqDepDmpnInrtCmp_FltInjection_SCom_FltInjection: OsTrustedFunctionName=Rte_TrustedCall_Ap_FrqDepDmpnInrtCmp_FltInjection_SCom_FltInjection, OsApplicationParams=Float *SignalPath_Uls_f32, FltInjectionLocType LocationKey_Cnt_enum
          Rte_TrustedCall_Ap_GCCDiag_FltInjection_SCom_FltInjection: OsTrustedFunctionName=Rte_TrustedCall_Ap_GCCDiag_FltInjection_SCom_FltInjection, OsApplicationParams=Float *SignalPath_Uls_f32, FltInjectionLocType LocationKey_Cnt_enum
          Rte_TrustedCall_Ap_HystComp_FltInjection_SCom_FltInjection: OsTrustedFunctionName=Rte_TrustedCall_Ap_HystComp_FltInjection_SCom_FltInjection, OsApplicationParams=Float *SignalPath_Uls_f32, FltInjectionLocType LocationKey_Cnt_enum
          Rte_TrustedCall_Ap_Return_FltInjection_SCom_FltInjection: OsTrustedFunctionName=Rte_TrustedCall_Ap_Return_FltInjection_SCom_FltInjection, OsApplicationParams=Float *SignalPath_Uls_f32, FltInjectionLocType LocationKey_Cnt_enum
          Rte_TrustedCall_Ap_SignlCondn_FaultInjection_SCom_FltInjection: OsTrustedFunctionName=Rte_TrustedCall_Ap_SignlCondn_FaultInjection_SCom_FltInjection, OsApplicationParams=Float *SignalPath_Uls_f32, FltInjectionLocType LocationKey_Cnt_enum
          Rte_TrustedCall_Ap_StabilityComp_FaultInjection_SCom_FltInjection: OsTrustedFunctionName=Rte_TrustedCall_Ap_StabilityComp_FaultInjection_SCom_FltInjection, OsApplicationParams=Float *SignalPath_Uls_f32, FltInjectionLocType LocationKey_Cnt_enum
          Rte_TrustedCall_Ap_TrqArblim_FaultInjection_SCom_FltInjection: OsTrustedFunctionName=Rte_TrustedCall_Ap_TrqArblim_FaultInjection_SCom_FltInjection, OsApplicationParams=Float *SignalPath_Uls_f32, FltInjectionLocType LocationKey_Cnt_enum
          Rte_TrustedCall_Ap_TrqOvlSta_FaultInjection_SCom_FltInjection: OsTrustedFunctionName=Rte_TrustedCall_Ap_TrqOvlSta_FaultInjection_SCom_FltInjection, OsApplicationParams=Float *SignalPath_Uls_f32, FltInjectionLocType LocationKey_Cnt_enum
          Rte_TrustedCall_Sa_DigHwTrqSENT_FaultInjection_SCom_FltInjection: OsTrustedFunctionName=Rte_TrustedCall_Sa_DigHwTrqSENT_FaultInjection_SCom_FltInjection, OsApplicationParams=Float *SignalPath_Uls_f32, FltInjectionLocType LocationKey_Cnt_enum
          Rte_TrustedCall_Cd_uDiag_uDiagStaticRegs_Per_CP1_CheckpointReached: OsTrustedFunctionName=Rte_TrustedCall_Cd_uDiag_uDiagStaticRegs_Per_CP1_CheckpointReached, OsApplicationParams=void
          Rte_TrustedCall_Cd_uDiag_uDiagLossOfExec_Per3_CP0_CheckpointReached: OsTrustedFunctionName=Rte_TrustedCall_Cd_uDiag_uDiagLossOfExec_Per3_CP0_CheckpointReached, OsApplicationParams=void
          Rte_TrustedCall_Ap_VehDyn_NVM_VehDynReset_Srv_WriteBlock: OsTrustedFunctionName=Rte_TrustedCall_Ap_VehDyn_NVM_VehDynReset_Srv_WriteBlock, OsApplicationParams=const NvM_DestPtr *DstPtr
          Rte_TrustedCall_Ap_TuningSelAuth_TuningSelAuth_Per1_CP0_CheckpointReached: OsTrustedFunctionName=Rte_TrustedCall_Ap_TuningSelAuth_TuningSelAuth_Per1_CP0_CheckpointReached, OsApplicationParams=void
          Rte_TrustedCall_Ap_CurrParamComp_CurrParamComp_Per2_CP0_CheckpointReached: OsTrustedFunctionName=Rte_TrustedCall_Ap_CurrParamComp_CurrParamComp_Per2_CP0_CheckpointReached, OsApplicationParams=void
      Ap_0: OsTrusted=true, OsAppGenerateStub=false, OsApplicationProtectionRegionSizeNoInitData=0, OsApplicationProtectionRegionSizeInitData=0, OsApplicationMPUArea8Size=0, OsApplicationMPUArea8Access=0, OsApplicationMPUArea8Start=0, OsAppAlarmRef=Alarm_4ms_SchM0, OsAppAlarmRef=Alarm_100ms_SchM0, OsAppIsrRef=Isr_MtrCtrl, OsAppIsrRef=Isr_ESMH, OsAppIsrRef=Isr_ESML, OsAppIsrRef=FlsTst_CrcIrq, OsAppTaskRef=Task_4ms_SchM0, OsAppTaskRef=Task_100ms_SchM0
        OsApplicationHooks: OsAppErrorHook=false, OsAppShutdownHook=false, OsAppStartupHook=false
        23 x OsApplicationTrustedFunction:
          OsApplicationTrustedFunction: OsTrustedFunctionName=NtWrapS_NvMProxy_Init, OsApplicationParams=void, OsApplicationReturnType=void
          OsApplicationTrustedFunction1: OsTrustedFunctionName=TWrapS_Appdesc_BLTransition, OsApplicationParams=void, OsApplicationReturnType=void
          OsApplicationTrustedFunction2: OsTrustedFunctionName=NtWrapS_PwmCdd_Init, OsApplicationParams=void, OsApplicationReturnType=void
          OsApplicationTrustedFunction3: OsTrustedFunctionName=NtWrapS_Adc2_Init1, OsApplicationParams=void, OsApplicationReturnType=void
          OsApplicationTrustedFunction4: OsTrustedFunctionName=NtWrapS_Wdg_TMS570LS3x_Init, OsApplicationParams=void, OsApplicationReturnType=void
          OsApplicationTrustedFunction5: OsTrustedFunctionName=NtWrapS_WdgM_Init, OsApplicationParams=void, OsApplicationReturnType=void
          OsApplicationTrustedFunction6: OsTrustedFunctionName=NtWrapS_Adc_Init, OsApplicationParams=void, OsApplicationReturnType=void
          OsApplicationTrustedFunction7: OsTrustedFunctionName=TWrapS_XcpWriteAp0, OsApplicationParams=void, OsApplicationReturnType=void
          OsApplicationTrustedFunction8: OsTrustedFunctionName=NtWrapS_ProcessF0FF, OsApplicationParams=uint8* t_SrvcData_Cnt_T_u08, uint16 RequestDataIdx_Cnt_T_u16, OsApplicationReturnType=void
          OsApplicationTrustedFunction9: OsTrustedFunctionName=NtWrapS_StaMd_Init1, OsApplicationParams=void, OsApplicationReturnType=void
          OsApplicationTrustedFunction10: OsTrustedFunctionName=TWrapS_FeeIf_Init, OsApplicationParams=void, OsApplicationReturnType=void
          OsApplicationTrustedFunction11: OsTrustedFunctionName=TWrapS_Fee_MainFunction, OsApplicationParams=void, OsApplicationReturnType=void
          OsApplicationTrustedFunction12: OsTrustedFunctionName=TWrapS_Fee_Read, OsApplicationParams=uint16 BlockNumber,uint16 BlockOffset,uint8* DataBufferPtr,uint16 Length, OsApplicationReturnType=Std_ReturnType
          OsApplicationTrustedFunction13: OsTrustedFunctionName=TWrapS_Fee_Write, OsApplicationParams=uint16 BlockNumber,uint8* DataBufferPtr, OsApplicationReturnType=Std_ReturnType
          OsApplicationTrustedFunction14: OsTrustedFunctionName=TWrapS_Fee_EraseImmediateBlock, OsApplicationParams=uint16 BlockNumber, OsApplicationReturnType=Std_ReturnType
          OsApplicationTrustedFunction15: OsTrustedFunctionName=TWrapS_Fee_InvalidateBlock, OsApplicationParams=uint16 BlockNumber, OsApplicationReturnType=Std_ReturnType
          OsApplicationTrustedFunction16: OsTrustedFunctionName=TWrapS_Fee_Cancel, OsApplicationParams=void, OsApplicationReturnType=void
          OsApplicationTrustedFunction17: OsTrustedFunctionName=TWrapS_Fee_GetStatus, OsApplicationParams=void, OsApplicationReturnType=uint8
          OsApplicationTrustedFunction18: OsTrustedFunctionName=TWrapS_Fee_GetJobResult, OsApplicationParams=void, OsApplicationReturnType=uint8
          OsApplicationTrustedFunction19: OsTrustedFunctionName=TWrapS_uDiagVIM_RednRpdShtdn, OsApplicationParams=void, OsApplicationReturnType=void
          OsApplicationTrustedFunction20: OsTrustedFunctionName=TWrapS_uDiagECC_RednRpdShtdn, OsApplicationParams=void, OsApplicationReturnType=void
          OsApplicationTrustedFunction21: OsTrustedFunctionName=TWrapS_Dma_InvalidateSlowADCGroup, OsApplicationParams=void, OsApplicationReturnType=void
          OsApplicationTrustedFunction22: OsTrustedFunctionName=TWrapS_TI_Fee_SuspendResumeErase, OsApplicationParams=uint8 Command, OsApplicationReturnType=void
    SystemTimer (OsCounter): OsCounterMaxAllowedValue=2147483647, OsCounterMinCycle=1, OsCounterTicksPerBase=1, OsCounterType=SOFTWARE, OsSecondsPerTick=1234567890
    15 x OsEvent:
      Rte_Ev_MS_Task_Trans_10: OsEventMask=4
      Rte_Ev_OnEntry_Task_Trans_10_StaMd_SystemState_Mode_DISABLE
      Rte_Ev_OnEntry_Task_Trans_10_StaMd_SystemState_Mode_OFF
      Rte_Ev_OnEntry_Task_Trans_10_StaMd_SystemState_Mode_OPERATE
      Rte_Ev_OnEntry_Task_Trans_10_StaMd_SystemState_Mode_WARMINIT
      Rte_Ev_Run_DiagMgr_DiagMgr10_Trns
      Rte_Ev_MS_Task_Trans_9: OsEventMask=4
      Rte_Ev_OnEntry_Task_Trans_9_Ap_StaMd9_SystemState9_Mode_OFF
      Rte_Ev_OnExit_Task_Trans_9_Ap_StaMd9_SystemState9_Mode_OFF
      Rte_Ev_Run_Ap_HwPwUp_HwPwUp_Trns1
      Rte_Ev_Run_Ap_ePWM2_ePWM2_Trns2
      Rte_Ev_Run_Ap_DiagMgr8_DiagMgr8_Trns
      Rte_Ev_OnEntry_Task_Trans_9_Ap_StaMd9_SystemState9_Mode_OPERATE
      Rte_Ev_Run_RteErrata8_RteErrata8_Trns
      Rte_Ev_Run_RteErrata9_RteErrata9_Trns
    9 x OsIsr, all with OsIsrAnalysisPriority=0, OsIsrComputationTime=0, OsIsrPeriod=0, OsIsrDeadline=0, OsIsrProtectionRegionSizeNoInitData=0, OsIsrProtectionRegionSizeInitData=0:
      Isr_MtrCtrl: OsIsrCategory=CATEGORY_1, OsIsrEnableNesting=false, OsIsrNonTrustFctStackSize=0, OsIsrInterruptTarget=IRQ, OsIsrInterruptSource=INTR40
        OsIsrInterruptPriority
          NON_AUTO: OsIsrInterruptPriority=2
        OsIsrUseSpecialFunctionName
          FALSE
      DCan1_level0_Irq: OsIsrCategory=CATEGORY_2, OsIsrEnableNesting=true, OsIsrNonTrustFctStackSize=508, OsIsrInterruptTarget=IRQ, OsIsrInterruptSource=INTR16
        OsIsrInterruptPriority
          NON_AUTO: OsIsrInterruptPriority=16
        OsIsrUseSpecialFunctionName
          FALSE
      Isr_ESMH: OsIsrCategory=CATEGORY_1, OsIsrEnableNesting=false, OsIsrNonTrustFctStackSize=0, OsIsrInterruptTarget=FIQ, OsIsrInterruptSource=INTR0
        OsIsrInterruptPriority
          NON_AUTO: OsIsrInterruptPriority=0
        OsIsrUseSpecialFunctionName
          FALSE
      Gpt_IsrInt0: OsIsrCategory=CATEGORY_2, OsIsrEnableNesting=true, OsIsrNonTrustFctStackSize=0, OsIsrInterruptTarget=IRQ, OsIsrInterruptSource=INTR2
        OsIsrInterruptPriority
          NON_AUTO: OsIsrInterruptPriority=4
        OsIsrUseSpecialFunctionName
          FALSE
      Isr_ESML: OsIsrCategory=CATEGORY_2, OsIsrEnableNesting=false, OsIsrNonTrustFctStackSize=0, OsIsrInterruptTarget=IRQ, OsIsrInterruptSource=INTR20
        OsIsrInterruptPriority
          NON_AUTO: OsIsrInterruptPriority=20
        OsIsrUseSpecialFunctionName
          FALSE
      FlsTst_CrcIrq: OsIsrCategory=CATEGORY_2, OsIsrEnableNesting=false, OsIsrNonTrustFctStackSize=0, OsIsrInterruptTarget=IRQ, OsIsrInterruptSource=INTR19
        OsIsrInterruptPriority
          NON_AUTO: OsIsrInterruptPriority=19
        OsIsrUseSpecialFunctionName
          FALSE
      DCan2_level0_Irq: OsIsrCategory=CATEGORY_2, OsIsrEnableNesting=true, OsIsrNonTrustFctStackSize=0, OsIsrInterruptTarget=IRQ, OsIsrInterruptSource=INTR35
        OsIsrInterruptPriority
          NON_AUTO: OsIsrInterruptPriority=35
        OsIsrUseSpecialFunctionName
          FALSE
      Isr_I2c: OsIsrCategory=CATEGORY_2, OsIsrEnableNesting=false, OsIsrNonTrustFctStackSize=0, OsIsrInterruptTarget=IRQ, OsIsrInterruptSource=INTR66
        OsIsrInterruptPriority
          NON_AUTO: OsIsrInterruptPriority=8
        OsIsrUseSpecialFunctionName
          FALSE
      Isr_OvervoltThresh: OsIsrCategory=CATEGORY_2, OsIsrEnableNesting=true, OsIsrNonTrustFctStackSize=0, OsIsrInterruptTarget=IRQ, OsIsrInterruptSource=INTR31
        OsIsrInterruptPriority
          NON_AUTO: OsIsrInterruptPriority=31
        OsIsrUseSpecialFunctionName
          FALSE
    OsOS:
      OsScalabilityClass = SC3
      OsStackMonitoring = true
      OsOSStackUsageMeasurement = AUTO
      OsStatus = EXTENDED
      OsUseGetServiceId = true
      OsUseParameterAccess = true
      OsUseResScheduler = true
      OsOSUseGeneratedFastAlarm = true
      OsOSThumbMode = true
      OsOSFPUSupport = true
      OsOSORTIDebugSupport = false
      OsOSTypeHeaderInclude = false
      OsOSCpuFrequency = 80
      OsOSAbortStackSize = 252
      OsOSAPIStackSize = 508
      OsOSTimerClockDivider = 160
      OsOSTickTime = 2000
      OsOSSupervisorStackSize = 508
      OsOSIRQMaxNesting = 6
      OsOSIRQStackOffset = 508
      OsOSUserConfigurationVersion = 0
      OsOSSystemTimer = UserDefined
      OsOSErrorInfoLevel = STANDARD
      OsOSOSInternalChecks = Additional
      OsOSCompiler = TI
      OsOSORTIDebugLevel = ORTI_20
      OsHooks: OsErrorHook=true, OsPostTaskHook=false, OsPreTaskHook=false, OsProtectionHook=true, OsShutdownHook=true, OsStartupHook=true
      OsOSSCHEDULE
        AUTO
      OsOSCC
        AUTO
      OsOSProtectionHookReaction
        Selected: OsOSSHUTDOWN=true
      OsOSSystemTimerIntPrio
        NON_AUTO: OsOSSystemTimerIntPrio=3
      OsOSMemoryProtection
        TRUE: OsOSMPUCodeRegionBase=0, OsOSMPUCodeRegionSize=786432, OsOSIRQHandlerStackSize=1020, OsOSOSDataSize=1020, OsOSGlobalSharedMemRegionSize=1020
      OsOSRESETHandler
        AUTO
      OsOSUDEFHandler
        NON_AUTO: OsOSUDEFHandler=_undefinst
      OsOSFIQHandler
        NON_AUTO: OsOSFIQHandler=Isr_ESMH
      33 x OsOSPeripheralRegion:
        OS_MEM_AREA_GIOA
          Region:
            OsOSStartAddress = 4294425600
            OsOSEndAddress = 4294425855
            OsOSIdentifier = OS_MEM_AREA_GIOA
            OsOSACCESSING_APPLICATION = Ap_10
            OsOSACCESSING_APPLICATION = Ap_8
            OsOSACCESSING_APPLICATION = Ap_9
        OS_MEM_AREA_GIOB
          Region:
            OsOSStartAddress = 4294425600
            OsOSEndAddress = 4294425855
            OsOSIdentifier = OS_MEM_AREA_GIOB
            OsOSACCESSING_APPLICATION = Ap_10
            OsOSACCESSING_APPLICATION = Ap_8
            OsOSACCESSING_APPLICATION = Ap_9
        OS_MEM_AREA_CAN1
          Region:
            OsOSStartAddress = 4294433792
            OsOSEndAddress = 4294434303
            OsOSIdentifier = OS_MEM_AREA_CAN1
            OsOSACCESSING_APPLICATION = Ap_10
            OsOSACCESSING_APPLICATION = Ap_8
            OsOSACCESSING_APPLICATION = Ap_9
        OS_MEM_AREA_CAN2
          Region:
            OsOSStartAddress = 4294434304
            OsOSEndAddress = 4294434815
            OsOSIdentifier = OS_MEM_AREA_CAN2
            OsOSACCESSING_APPLICATION = Ap_10
            OsOSACCESSING_APPLICATION = Ap_8
            OsOSACCESSING_APPLICATION = Ap_9
        OS_MEM_AREA_CAN3
          Region:
            OsOSStartAddress = 4294434816
            OsOSEndAddress = 4294435327
            OsOSIdentifier = OS_MEM_AREA_CAN3
            OsOSACCESSING_APPLICATION = Ap_10
            OsOSACCESSING_APPLICATION = Ap_8
            OsOSACCESSING_APPLICATION = Ap_9
        OS_MEM_AREA_LIN
          Region:
            OsOSStartAddress = 4294435840
            OsOSEndAddress = 4294436095
            OsOSIdentifier = OS_MEM_AREA_LIN
            OsOSACCESSING_APPLICATION = Ap_10
            OsOSACCESSING_APPLICATION = Ap_8
            OsOSACCESSING_APPLICATION = Ap_9
        OS_MEM_AREA_SCI
          Region:
            OsOSStartAddress = 4294436096
            OsOSEndAddress = 4294436351
            OsOSIdentifier = OS_MEM_AREA_SCI
            OsOSACCESSING_APPLICATION = Ap_10
            OsOSACCESSING_APPLICATION = Ap_8
            OsOSACCESSING_APPLICATION = Ap_9
        OS_MEM_AREA_IIC
          Region:
            OsOSStartAddress = 4294431744
            OsOSEndAddress = 4294431999
            OsOSIdentifier = OS_MEM_AREA_IIC
            OsOSACCESSING_APPLICATION = Ap_10
            OsOSACCESSING_APPLICATION = Ap_8
            OsOSACCESSING_APPLICATION = Ap_9
        OS_MEM_AREA_SPI1
          Region:
            OsOSStartAddress = 4294439936
            OsOSEndAddress = 4294440447
            OsOSIdentifier = OS_MEM_AREA_SPI1
            OsOSACCESSING_APPLICATION = Ap_10
            OsOSACCESSING_APPLICATION = Ap_8
            OsOSACCESSING_APPLICATION = Ap_9
        OS_MEM_AREA_SPI2
          Region:
            OsOSStartAddress = 4294440448
            OsOSEndAddress = 4294440959
            OsOSIdentifier = OS_MEM_AREA_SPI2
            OsOSACCESSING_APPLICATION = Ap_10
            OsOSACCESSING_APPLICATION = Ap_8
            OsOSACCESSING_APPLICATION = Ap_9
        OS_MEM_AREA_SPI3
          Region:
            OsOSStartAddress = 4294440960
            OsOSEndAddress = 4294441471
            OsOSIdentifier = OS_MEM_AREA_SPI3
            OsOSACCESSING_APPLICATION = Ap_10
            OsOSACCESSING_APPLICATION = Ap_8
            OsOSACCESSING_APPLICATION = Ap_9
        OS_MEM_AREA_SPI4
          Region:
            OsOSStartAddress = 4294441472
            OsOSEndAddress = 4294441983
            OsOSIdentifier = OS_MEM_AREA_SPI4
            OsOSACCESSING_APPLICATION = Ap_10
            OsOSACCESSING_APPLICATION = Ap_8
            OsOSACCESSING_APPLICATION = Ap_9
        OS_MEM_AREA_SPI5
          Region:
            OsOSStartAddress = 4294441984
            OsOSEndAddress = 4294442495
            OsOSIdentifier = OS_MEM_AREA_SPI5
            OsOSACCESSING_APPLICATION = Ap_10
            OsOSACCESSING_APPLICATION = Ap_8
            OsOSACCESSING_APPLICATION = Ap_9
        OS_MEM_AREA_NHET1
          Region:
            OsOSStartAddress = 4294424576
            OsOSEndAddress = 4294424831
            OsOSIdentifier = OS_MEM_AREA_NHET1
            OsOSACCESSING_APPLICATION = Ap_10
            OsOSACCESSING_APPLICATION = Ap_8
            OsOSACCESSING_APPLICATION = Ap_9
        OS_MEM_AREA_NHET2
          Region:
            OsOSStartAddress = 4294424832
            OsOSEndAddress = 4294425087
            OsOSIdentifier = OS_MEM_AREA_NHET2
            OsOSACCESSING_APPLICATION = Ap_10
            OsOSACCESSING_APPLICATION = Ap_8
            OsOSACCESSING_APPLICATION = Ap_9
        OS_MEM_AREA_SYS
          Region:
            OsOSStartAddress = 4294967040
            OsOSEndAddress = 4294967295
            OsOSIdentifier = OS_MEM_AREA_SYS
            OsOSACCESSING_APPLICATION = Ap_10
            OsOSACCESSING_APPLICATION = Ap_8
            OsOSACCESSING_APPLICATION = Ap_9
        OS_MEM_AREA_ADC1
          Region:
            OsOSStartAddress = 4294426624
            OsOSEndAddress = 4294427135
            OsOSIdentifier = OS_MEM_AREA_ADC1
            OsOSACCESSING_APPLICATION = Ap_10
            OsOSACCESSING_APPLICATION = Ap_8
            OsOSACCESSING_APPLICATION = Ap_9
        OS_MEM_AREA_ADC2
          Region:
            OsOSStartAddress = 4294427136
            OsOSEndAddress = 4294427647
            OsOSIdentifier = OS_MEM_AREA_ADC2
            OsOSACCESSING_APPLICATION = Ap_10
            OsOSACCESSING_APPLICATION = Ap_8
            OsOSACCESSING_APPLICATION = Ap_9
        OS_MEM_AREA_RTP
          Region:
            OsOSStartAddress = 4294965760
            OsOSEndAddress = 4294966015
            OsOSIdentifier = OS_MEM_AREA_RTP
            OsOSACCESSING_APPLICATION = Ap_10
            OsOSACCESSING_APPLICATION = Ap_8
            OsOSACCESSING_APPLICATION = Ap_9
        OS_MEM_AREA_DMM
          Region:
            OsOSStartAddress = 4294964992
            OsOSEndAddress = 4294965247
            OsOSIdentifier = OS_MEM_AREA_DMM
            OsOSACCESSING_APPLICATION = Ap_10
            OsOSACCESSING_APPLICATION = Ap_8
            OsOSACCESSING_APPLICATION = Ap_9
        OS_MEM_AREA_IOMM
          Region:
            OsOSStartAddress = 4294961664
            OsOSEndAddress = 4294962175
            OsOSIdentifier = OS_MEM_AREA_IOMM
            OsOSACCESSING_APPLICATION = Ap_10
            OsOSACCESSING_APPLICATION = Ap_8
            OsOSACCESSING_APPLICATION = Ap_9
        OS_MEM_AREA_RTI
          Region:
            OsOSStartAddress = 4294966272
            OsOSEndAddress = 4294966527
            OsOSIdentifier = OS_MEM_AREA_RTI
            OsOSACCESSING_APPLICATION = Ap_10
            OsOSACCESSING_APPLICATION = Ap_8
            OsOSACCESSING_APPLICATION = Ap_9
        OS_MEM_AREA_ESMEPSR
          Region:
            OsOSStartAddress = 4294964516
            OsOSEndAddress = 4294964519
            OsOSIdentifier = OS_MEM_AREA_ESMEPSR
            OsOSACCESSING_APPLICATION = Ap_10
            OsOSACCESSING_APPLICATION = Ap_8
            OsOSACCESSING_APPLICATION = Ap_9
        OS_MEM_AREA_VIM
          Region:
            OsOSStartAddress = 4294966784
            OsOSEndAddress = 4294966859
            OsOSIdentifier = OS_MEM_AREA_VIM
            OsOSACCESSING_APPLICATION = Ap_10
            OsOSACCESSING_APPLICATION = Ap_8
            OsOSACCESSING_APPLICATION = Ap_9
        OS_MEM_AREA_ESMEKR
          Region:
            OsOSStartAddress = 4294964536
            OsOSEndAddress = 4294964545
            OsOSIdentifier = OS_MEM_AREA_ESMEKR
            OsOSACCESSING_APPLICATION = Ap_10
            OsOSACCESSING_APPLICATION = Ap_8
            OsOSACCESSING_APPLICATION = Ap_9
        OS_MEM_AREA_SPI_REG1
          Region:
            OsOSStartAddress = 4294439936
            OsOSEndAddress = 4294440447
            OsOSIdentifier = OS_MEM_AREA_SPI_REG1
            OsOSACCESSING_APPLICATION = Ap_10
            OsOSACCESSING_APPLICATION = Ap_8
            OsOSACCESSING_APPLICATION = Ap_9
        OS_MEM_AREA_SPI_REG3
          Region:
            OsOSStartAddress = 4294440960
            OsOSEndAddress = 4294441471
            OsOSIdentifier = OS_MEM_AREA_SPI_REG3
            OsOSACCESSING_APPLICATION = Ap_10
            OsOSACCESSING_APPLICATION = Ap_8
            OsOSACCESSING_APPLICATION = Ap_9
        OS_MEM_AREA_SPI_REG5
          Region:
            OsOSStartAddress = 4294441984
            OsOSEndAddress = 4294442495
            OsOSIdentifier = OS_MEM_AREA_SPI_REG5
            OsOSACCESSING_APPLICATION = Ap_10
            OsOSACCESSING_APPLICATION = Ap_8
            OsOSACCESSING_APPLICATION = Ap_9
        OS_MEM_AREA_SPI_RAM1
          Region:
            OsOSStartAddress = 4279107584
            OsOSEndAddress = 4279238655
            OsOSIdentifier = OS_MEM_AREA_SPI_RAM1
            OsOSACCESSING_APPLICATION = Ap_10
            OsOSACCESSING_APPLICATION = Ap_8
            OsOSACCESSING_APPLICATION = Ap_9
        OS_MEM_AREA_SPI_RAM3
          Region:
            OsOSStartAddress = 4278976512
            OsOSEndAddress = 4279107583
            OsOSIdentifier = OS_MEM_AREA_SPI_RAM3
            OsOSACCESSING_APPLICATION = Ap_10
            OsOSACCESSING_APPLICATION = Ap_8
            OsOSACCESSING_APPLICATION = Ap_9
        OS_MEM_AREA_SPI_RAM5
          Region:
            OsOSStartAddress = 4278845440
            OsOSEndAddress = 4278976511
            OsOSIdentifier = OS_MEM_AREA_SPI_RAM5
            OsOSACCESSING_APPLICATION = Ap_10
            OsOSACCESSING_APPLICATION = Ap_8
            OsOSACCESSING_APPLICATION = Ap_9
        OS_MEM_AREA_SYSECR
          Region:
            OsOSStartAddress = 4294967264
            OsOSEndAddress = 4294967267
            OsOSIdentifier = OS_MEM_AREA_SYSECR
            OsOSACCESSING_APPLICATION = Ap_10
            OsOSACCESSING_APPLICATION = Ap_8
            OsOSACCESSING_APPLICATION = Ap_9
        OS_MEM_AREA_FLASH
          Region:
            OsOSStartAddress = 4294471680
            OsOSEndAddress = 4294472708
            OsOSIdentifier = OS_MEM_AREA_FLASH
            OsOSACCESSING_APPLICATION = Ap_9
            OsOSACCESSING_APPLICATION = Ap_0
      OsOSTimingMeasurement
        FALSE
      OsOSAPIOptimization
        Manual:
          OsOSActivateTask = true
          OsOSTerminateTask = true
          OsOSChainTask = true
          OsOSSchedule = true
          OsOSGetTaskID = true
          OsOSGetTaskState = true
          OsOSDisableAllInterrupts = true
          OsOSEnableAllInterrupts = true
          OsOSSuspendOSInterrupts = true
          OsOSResumeOSInterrupts = true
          OsOSSuspendAllInterrupts = true
          OsOSResumeAllInterrupts = true
          OsOSGetResource = true
          OsOSReleaseResource = true
          OsOSSetEvent = true
          OsOSClearEvent = true
          OsOSGetEvent = true
          OsOSWaitEvent = true
          OsOSGetAlarmBase = true
          OsOSGetAlarm = true
          OsOSSetRelAlarm = true
          OsOSSetAbsAlarm = true
          OsOSCancelAlarm = true
          OsOSGetActiveApplicationMode = true
          OsOSIncrementCounter = true
          OsOSStartCOM = true
          OsOSStopCOM = true
          OsOSSendMessage = true
          OsOSReceiveMessage = true
          OsOSGetMessageStatus = true
          OsOSInitMessage = true
          OsOSGetCOMApplicationMode = true
          OsOSStartScheduleTableAbs = true
          OsOSStartScheduleTableRel = true
          OsOSStopScheduleTable = true
          OsOSNextScheduleTable = true
          OsOSGetScheduleTableStatus = true
          OsOSStartScheduleTableSynchron = true
          OsOSSyncScheduleTable = true
          OsOSSetScheduleTableAsync = true
          OsOSGetApplicationID = true
          OsOSGetISRID = true
          OsOSCallTrustedFunction = true
          OsOSCallNonTrustedFunction = true
          OsOSCheckISRMemoryAccess = true
          OsOSCheckTaskMemoryAccess = true
          OsOSCheckObjectAccess = true
          OsOSCheckObjectOwnership = true
          OsOSTerminateApplication = true
          OsOSGetTaskMaxExecutionTime = true
          OsOSGetISRMaxExecutionTime = true
          OsOSGetTaskMaxBlockingTime = true
          OsOSGetISRMaxBlockingTime = true
          OsOSGetTaskMinInterArrivalTime = true
          OsOSGetISRMinInterArrivalTime = true
    RES_SCHEDULER (OsResource): OsResourceProperty=STANDARD
    23 x OsTask, all with OsTaskActivation=1, OsTaskComputationTime=0, OsTaskPeriod=0, OsTaskDeadline=0, OsTaskProtectionRegionSizeNoInitData=0, OsTaskProtectionRegionSizeInitData=0:
      Task_10ms_SchM9: OsTaskPriority=3, OsTaskSchedule=FULL, OsTaskTYPE=BASIC, OsTaskNotUsingSchedule=false, OsTaskStackSize=2044, OsTaskNonTrustFctStackSize=508, OsTaskAccessingApplication=Ap_9
      Task_Bkgnd: OsTaskPriority=0, OsTaskSchedule=FULL, OsTaskTYPE=BASIC, OsTaskNotUsingSchedule=true, OsTaskStackSize=1020, OsTaskNonTrustFctStackSize=0
        OsTaskAutostart: OsTaskAppModeRef=OSDEFAULTAPPMODE
      Task_4ms_SchM0: OsTaskPriority=80, OsTaskSchedule=NON, OsTaskTYPE=BASIC, OsTaskNotUsingSchedule=false, OsTaskStackSize=1020, OsTaskNonTrustFctStackSize=0, OsTaskAccessingApplication=Ap_0
      Task_Init_SchM9: OsTaskPriority=1, OsTaskSchedule=FULL, OsTaskTYPE=BASIC, OsTaskNotUsingSchedule=false, OsTaskStackSize=1020, OsTaskNonTrustFctStackSize=508, OsTaskAccessingApplication=Ap_9
        OsTaskAutostart: OsTaskAppModeRef=OSDEFAULTAPPMODE
      Task_100ms_10: OsTaskPriority=32, OsTaskSchedule=FULL, OsTaskTYPE=BASIC, OsTaskNotUsingSchedule=false, OsTaskStackSize=1020, OsTaskNonTrustFctStackSize=0, OsTaskAccessingApplication=Ap_10, OsTaskAccessingApplication=Ap_8, OsTaskAccessingApplication=Ap_9
      Task_100ms_8: OsTaskPriority=31, OsTaskSchedule=FULL, OsTaskTYPE=BASIC, OsTaskNotUsingSchedule=false, OsTaskStackSize=1020, OsTaskNonTrustFctStackSize=0, OsTaskAccessingApplication=Ap_8, OsTaskAccessingApplication=Ap_10, OsTaskAccessingApplication=Ap_9
      Task_100ms_9: OsTaskPriority=30, OsTaskSchedule=FULL, OsTaskTYPE=BASIC, OsTaskNotUsingSchedule=false, OsTaskStackSize=1020, OsTaskNonTrustFctStackSize=0, OsTaskAccessingApplication=Ap_9, OsTaskAccessingApplication=Ap_10
      Task_10ms_10: OsTaskPriority=42, OsTaskSchedule=FULL, OsTaskTYPE=BASIC, OsTaskNotUsingSchedule=false, OsTaskStackSize=1020, OsTaskNonTrustFctStackSize=0, OsTaskAccessingApplication=Ap_10, OsTaskAccessingApplication=Ap_8, OsTaskAccessingApplication=Ap_9
      Task_10ms_9: OsTaskPriority=40, OsTaskSchedule=FULL, OsTaskTYPE=BASIC, OsTaskNotUsingSchedule=false, OsTaskStackSize=1020, OsTaskNonTrustFctStackSize=0, OsTaskAccessingApplication=Ap_9, OsTaskAccessingApplication=Ap_10, OsTaskAccessingApplication=Ap_8
      Task_2ms_10: OsTaskPriority=62, OsTaskSchedule=FULL, OsTaskTYPE=BASIC, OsTaskNotUsingSchedule=false, OsTaskStackSize=1020, OsTaskNonTrustFctStackSize=0, OsTaskAccessingApplication=Ap_10, OsTaskAccessingApplication=Ap_8, OsTaskAccessingApplication=Ap_9
      Task_2ms_8: OsTaskPriority=61, OsTaskSchedule=FULL, OsTaskTYPE=BASIC, OsTaskNotUsingSchedule=false, OsTaskStackSize=1020, OsTaskNonTrustFctStackSize=0, OsTaskAccessingApplication=Ap_8, OsTaskAccessingApplication=Ap_10, OsTaskAccessingApplication=Ap_9
      Task_2ms_9: OsTaskPriority=60, OsTaskSchedule=FULL, OsTaskTYPE=BASIC, OsTaskNotUsingSchedule=false, OsTaskStackSize=1020, OsTaskNonTrustFctStackSize=0, OsTaskAccessingApplication=Ap_9, OsTaskAccessingApplication=Ap_10, OsTaskAccessingApplication=Ap_8
      Task_4ms_10: OsTaskPriority=52, OsTaskSchedule=FULL, OsTaskTYPE=BASIC, OsTaskNotUsingSchedule=false, OsTaskStackSize=1020, OsTaskNonTrustFctStackSize=0, OsTaskAccessingApplication=Ap_10, OsTaskAccessingApplication=Ap_8, OsTaskAccessingApplication=Ap_9
      Task_Trans_10: OsTaskPriority=12, OsTaskSchedule=FULL, OsTaskTYPE=EXTENDED, OsTaskNotUsingSchedule=false, OsTaskStackSize=1020, OsTaskNonTrustFctStackSize=0, OsTaskAccessingApplication=Ap_10, OsTaskAccessingApplication=Ap_8, OsTaskAccessingApplication=Ap_9, OsTaskEventRef=Rte_Ev_MS_Task_Trans_10, OsTaskEventRef=Rte_Ev_OnEntry_Task_Trans_10_StaMd_SystemState_Mode_DISABLE, OsTaskEventRef=Rte_Ev_OnEntry_Task_Trans_10_StaMd_SystemState_Mode_OFF, OsTaskEventRef=Rte_Ev_OnEntry_Task_Trans_10_StaMd_SystemState_Mode_OPERATE, OsTaskEventRef=Rte_Ev_OnEntry_Task_Trans_10_StaMd_SystemState_Mode_WARMINIT, OsTaskEventRef=Rte_Ev_Run_DiagMgr_DiagMgr10_Trns, OsTaskEventRef=Rte_Ev_Run_Ap_HwPwUp_HwPwUp_Trns1, OsTaskEventRef=Rte_Ev_Run_Ap_ePWM2_ePWM2_Trns2
      Task_Trans_9: OsTaskPriority=10, OsTaskSchedule=FULL, OsTaskTYPE=EXTENDED, OsTaskNotUsingSchedule=false, OsTaskStackSize=1020, OsTaskNonTrustFctStackSize=0, OsTaskAccessingApplication=Ap_9, OsTaskAccessingApplication=Ap_10, OsTaskAccessingApplication=Ap_8, OsTaskEventRef=Rte_Ev_MS_Task_Trans_9, OsTaskEventRef=Rte_Ev_OnEntry_Task_Trans_9_Ap_StaMd9_SystemState9_Mode_OFF, OsTaskEventRef=Rte_Ev_OnExit_Task_Trans_9_Ap_StaMd9_SystemState9_Mode_OFF, OsTaskEventRef=Rte_Ev_OnEntry_Task_Trans_9_Ap_StaMd9_SystemState9_Mode_OPERATE, OsTaskEventRef=Rte_Ev_Run_RteErrata9_RteErrata9_Trns
      Task_Init_10: OsTaskPriority=72, OsTaskSchedule=FULL, OsTaskTYPE=BASIC, OsTaskNotUsingSchedule=false, OsTaskStackSize=1020, OsTaskNonTrustFctStackSize=0, OsTaskAccessingApplication=Ap_10, OsTaskAccessingApplication=Ap_8, OsTaskAccessingApplication=Ap_9
      Task_Init_8: OsTaskPriority=71, OsTaskSchedule=FULL, OsTaskTYPE=BASIC, OsTaskNotUsingSchedule=false, OsTaskStackSize=1020, OsTaskNonTrustFctStackSize=0, OsTaskAccessingApplication=Ap_8, OsTaskAccessingApplication=Ap_10, OsTaskAccessingApplication=Ap_9
      Task_Init_9: OsTaskPriority=70, OsTaskSchedule=FULL, OsTaskTYPE=BASIC, OsTaskNotUsingSchedule=false, OsTaskStackSize=1020, OsTaskNonTrustFctStackSize=0, OsTaskAccessingApplication=Ap_9, OsTaskAccessingApplication=Ap_10, OsTaskAccessingApplication=Ap_8
      Task_Trans_8: OsTaskPriority=11, OsTaskSchedule=FULL, OsTaskTYPE=EXTENDED, OsTaskNotUsingSchedule=false, OsTaskStackSize=1020, OsTaskNonTrustFctStackSize=0, OsTaskAccessingApplication=Ap_8, OsTaskAccessingApplication=Ap_10, OsTaskAccessingApplication=Ap_9, OsTaskEventRef=Rte_Ev_Run_Ap_DiagMgr8_DiagMgr8_Trns, OsTaskEventRef=Rte_Ev_Run_RteErrata8_RteErrata8_Trns
      Task_4ms_9: OsTaskPriority=50, OsTaskSchedule=FULL, OsTaskTYPE=BASIC, OsTaskNotUsingSchedule=false, OsTaskStackSize=1020, OsTaskNonTrustFctStackSize=0, OsTaskAccessingApplication=Ap_10, OsTaskAccessingApplication=Ap_9
      Task_TrnsB_9: OsTaskPriority=13, OsTaskSchedule=FULL, OsTaskTYPE=BASIC, OsTaskNotUsingSchedule=false, OsTaskStackSize=1020, OsTaskNonTrustFctStackSize=0, OsTaskAccessingApplication=Ap_9, OsTaskAccessingApplication=Ap_10
      Task_100ms_SchM0: OsTaskPriority=2, OsTaskSchedule=FULL, OsTaskTYPE=BASIC, OsTaskNotUsingSchedule=false, OsTaskStackSize=1020, OsTaskNonTrustFctStackSize=0, OsTaskAccessingApplication=Ap_9, OsTaskAccessingApplication=Ap_0
      Task_100ms_SchM9: OsTaskPriority=4, OsTaskSchedule=FULL, OsTaskTYPE=BASIC, OsTaskNotUsingSchedule=false, OsTaskStackSize=1020, OsTaskNonTrustFctStackSize=0, OsTaskAccessingApplication=Ap_9
    OsImplementationInformation: OsVectorOilVersion=3.2, OsVectorImplementationName=TMS570LS3x.i32, OsBswmdStyleVersion=2
    OsCom:
      OsComErrorHook = false
      OsComUseGetServiceId = false
      OsComUseParameterAccess = false
      OsComStartComExtension = false
      OsComUseCOM = false
      OsComStatus = COMSTANDARD
    VectorCommonData: BswmdVersion=5.07.00
  module config Dio: implementation-config-variant=VARIANT-LINK-TIME, module-description=Dio_Impl
    DioGeneral:
      DioDevErrorDetect = true
      DioVersionInfoApi = true
      DioMaskedWritePortApi = false
      DioCfgSupportGio = true
      DioCfgSupportCan = true
      DioCfgDoParamCheck = true
      DioCfgReportDet = true
      DioCfgChkParamChannel = true
      DioCfgChkParamPort = true
      DioCfgChkParamGroup = true
      DioCfgChkParamVinfo = true
      DioReportDet = Det_ReportError
      DioCfgIncludeDet = Det.h
      DioCfgChannelApi = true
      DioCfgPortApi = true
      DioCfgGroupApi = true
      DioSpecialRegisterAccessEnabled = true
      DioSpecialRegisterAccessOnlyForWrite = true
      DioSpecialRegisterAccessOnlyForPrivilegedModeRegisters = true
      DioIrqHandling = (unset)
    DioVectorCommonData (VectorCommonData): BswmdVersion=2.01.00
    DioPackageMapping337 (DioPackageMapping): DioPackageName=Pin_337, DioPortDefMaskName=DIO_PORT_DEF_MASK_IN_PKG_A
    DioPackageMapping144 (DioPackageMapping): DioPackageName=Pin_144, DioPortDefMaskName=DIO_PORT_DEF_MASK_IN_PKG_B
    24 x DioPortDefinition, all with DioPortDefMaskInPkgC=0, DioPortDefMaskInPkgD=0, DioPortDefMaskInPkgE=0, DioPortDefMaskInPkgF=0, DioPortDefMaskInPkgG=0, DioPortDefMaskInPkgH=0, DioPortDefMaskInPkgI=0, DioPortDefMaskInPkgJ=0:
      DioPortGioA: DioPortDefName=GIOA, DioPortDefPortId=12046, DioPortDefMaskInPkgA=255, DioPortDefMaskInPkgB=231
      DioPortGioB: DioPortDefName=GIOB, DioPortDefPortId=12054, DioPortDefMaskInPkgA=255, DioPortDefMaskInPkgB=255
      DioPortNHet1: DioPortDefName=NHET1, DioPortDefPortId=11796, DioPortDefMaskInPkgA=4294967295, DioPortDefMaskInPkgB=4292870143
      DioPortNHet2: DioPortDefName=NHET2, DioPortDefPortId=11860, DioPortDefMaskInPkgA=393215, DioPortDefMaskInPkgB=2796171
      DioPortCan1Tx: DioPortDefName=CAN1, DioPortDefPortId=79736, DioPortDefMaskInPkgA=1, DioPortDefMaskInPkgB=1
      DioPortCan1Rx: DioPortDefName=CAN1, DioPortDefPortId=79737, DioPortDefMaskInPkgA=1, DioPortDefMaskInPkgB=1
      DioPortCan2Tx: DioPortDefName=CAN2, DioPortDefPortId=79864, DioPortDefMaskInPkgA=1, DioPortDefMaskInPkgB=1
      DioPortCan2Rx: DioPortDefName=CAN2, DioPortDefPortId=79865, DioPortDefMaskInPkgA=1, DioPortDefMaskInPkgB=1
      DioPortCan3Tx: DioPortDefName=CAN3, DioPortDefPortId=79992, DioPortDefMaskInPkgA=1, DioPortDefMaskInPkgB=1
      DioPortCan3Rx: DioPortDefName=CAN3, DioPortDefPortId=79993, DioPortDefMaskInPkgA=1, DioPortDefMaskInPkgB=1
      DioPortAdc1: DioPortDefName=ADC1, DioPortDefPortId=274496, DioPortDefMaskInPkgA=1, DioPortDefMaskInPkgB=1
      DioPortAdc2: DioPortDefName=ADC2, DioPortDefPortId=274624, DioPortDefMaskInPkgA=1, DioPortDefMaskInPkgB=1
      DioPortLin: DioPortDefName=LIN, DioPortDefPortId=14609, DioPortDefMaskInPkgA=6, DioPortDefMaskInPkgB=6
      DioPortSci: DioPortDefName=SCI, DioPortDefPortId=14673, DioPortDefMaskInPkgA=6, DioPortDefMaskInPkgB=6
      DioPortIic: DioPortDefName=IIC, DioPortDefPortId=13588, DioPortDefMaskInPkgA=3, DioPortDefMaskInPkgB=3
      DioPortSpi1: DioPortDefName=SPI1, DioPortDefPortId=15623, DioPortDefMaskInPkgA=33689407, DioPortDefMaskInPkgB=33689399
      DioPortSpi2: DioPortDefName=SPI2, DioPortDefPortId=15751, DioPortDefMaskInPkgA=3843, DioPortDefMaskInPkgB=0
      DioPortSpi3: DioPortDefName=SPI3, DioPortDefPortId=15879, DioPortDefMaskInPkgA=3903, DioPortDefMaskInPkgB=3903
      DioPortSpi4: DioPortDefName=SPI4, DioPortDefPortId=16007, DioPortDefMaskInPkgA=3841, DioPortDefMaskInPkgB=3841
      DioPortSpi5: DioPortDefName=SPI5, DioPortDefPortId=16135, DioPortDefMaskInPkgA=235802383, DioPortDefMaskInPkgB=3841
      DioPortRtp: DioPortDefName=RTP, DioPortDefPortId=147087, DioPortDefMaskInPkgA=524287, DioPortDefMaskInPkgB=0
      DioPortEclk: DioPortDefName=SYS, DioPortDefPortId=147394, DioPortDefMaskInPkgA=1, DioPortDefMaskInPkgB=1
      DioPortDmm: DioPortDefName=DMMDATA, DioPortDefPortId=146909, DioPortDefMaskInPkgA=524287, DioPortDefMaskInPkgB=36224
      DioPortEsm: DioPortDefName=ESMEPSR, DioPortDefPortId=146761, DioPortDefMaskInPkgA=1, DioPortDefMaskInPkgB=1
    7 x DioPort, all with DioPortId=0:
      NHet: DioPortDefRef=DioPortNHet1
        7 x DioChannel:
          NHet_Ch4: DioChannelId=4
          NHet_Ch8: DioChannelId=8
          NHet_Ch15: DioChannelId=15
          NHet_Ch20: DioChannelId=20
          NHet_Ch22: DioChannelId=22
          NHet_Ch24: DioChannelId=24
          NHet_Ch26: DioChannelId=26
        DioChGrpNHet (DioChannelGroup): DioChannelGroupIdentification=&DioChGrpNHet, DioPortMask=1, DioPortOffset=0
      Adc1: DioPortDefRef=DioPortAdc1
        ADC1_Ch0 (DioChannel): DioChannelId=0
        DioChannelGroupAdc1 (DioChannelGroup): DioChannelGroupIdentification=&DioChannelGroupAdc1, DioPortMask=1, DioPortOffset=0
      Spi3: DioPortDefRef=DioPortSpi3
        SPI3_NCS1 (DioChannel): DioChannelId=1
        SPI_TCCS (DioChannel): DioChannelId=0
        DioChannelGroupSpi3 (DioChannelGroup): DioChannelGroupIdentification=&DioChannelGroupSpi3, DioPortMask=1, DioPortOffset=0
      CAN3_Rx: DioPortDefRef=DioPortCan3Rx
        Can3Rx (DioChannel): DioChannelId=0
        DioChannelGroupCan3Rx (DioChannelGroup): DioChannelGroupIdentification=&DioChannelGroupCan3Rx, DioPortMask=1, DioPortOffset=0
      CAN3_Tx: DioPortDefRef=DioPortCan3Tx
        Can3Tx (DioChannel): DioChannelId=0
        DioChannelGroupCan3Tx (DioChannelGroup): DioChannelGroupIdentification=&DioChannelGroupCanTx, DioPortMask=1, DioPortOffset=0
      Spi5: DioPortDefRef=DioPortSpi5
        SPI5NENA (DioChannel): DioChannelId=8
        SPI5MISO (DioChannel): DioChannelId=11
        DioChannelGroupSpi5 (DioChannelGroup): DioChannelGroupIdentification=&DioChannelGroupSpi5, DioPortMask=1, DioPortOffset=0
      Esm: DioPortDefRef=DioPortEsm
        nERROR (DioChannel): DioChannelId=0
        DioChannelGroupEsm (DioChannelGroup): DioChannelGroupIdentification=&DioChannelGroupEsm, DioPortMask=1, DioPortOffset=0
  module config Gpt: implementation-config-variant=VARIANT-POST-BUILD, module-description=Gpt_Impl
    Gpt_Runtime (GptChannelConfigSet):
      GptChannelPrescaleClk0 = 79
      GptChannelPrescaleClk1 = 79
      GptMcuVariant = McuModuleConfiguration
      GptMcuClockconfig = McuClockSettingConfig
      GptMainclock = RTICLK1
      GptClockFrequency = 8E+01
      SystemTime_uS (GptChannelConfiguration):
        GptChannelClkSrc = 0
        GptChannelMode = GPT_MODE_CONTINUOUS
        GptChannelPrescale = 0
        GptEnableWakeup = false
        GptNotification = SystemTick
        GptHwChannel = 0
        GptChannelId = 0
        GptResolution = 1
        GptWakeupConfiguration
    GptConfigurationOfOptApiServices:
      GptDeinitApi = false
      GptEnableDisableNotificationApi = true
      GptTimeElapsedApi = false
      GptTimeRemainingApi = false
      GptVersionInfoApi = false
      GptWakeupFunctionalityApi = true
    GptDriverConfiguration:
      GptDevErrorDetect = false
      GptReportWakeupSource = true
      GptCfgWakeupInclude = EcuM_Cbk.h
      GptErrorhook = Det_ReportError
      GptCfgIncludeDet = Det.h
      GptCfgChkUninit = true
      GptCfgChkParamChl = false
      GptCfgChkParamMode = true
      GptCfgChkParamValue = true
      GptCfgChkParamVinfo = true
      GptCfgChkBusy = true
      GptCfgIncludeList = ApplCallbacks.h
      GptCfgChkParamConfig = true
      GptCfgDoParamChk = true
      GptCfgChkParamWakeupchl = false
      GptCfgChkNotifptr = true
      GptCfgDebugReporting = true
      GptCfgChkAlreadyInit = true
      GptCfgChkNotStarted = true
      GptSpecRegAccEnabled = true
      GptSpecRegAccOnlyForWrite = true
      GptSpecRegAccOnlyForPrivModeReg = true
      GptSpecRegAccNotInInit = false
      GptNativeIsr = GPT_ISR_CAT2
      GptIrqHandling = SuspendAllInterrupts
  module config Mcu: implementation-config-variant=VARIANT-POST-BUILD, module-description=Mcu_Impl
    McuGeneralConfiguration:
      McuBank0Pwr = ActiveMode
      McuBank1Pwr = ActiveMode
      McuBank{2..6}Pwr = SleepMode
      McuBank7Pwr = ActiveMode
      McuDevErrorDetect = false
      McuPerformResetApi = true
      McuVersionInfoApi = true
      McuDoParamCheck = true
      McuCheckParamConfig = true
      McuCheckParamMode = true
      McuCheckParamClock = true
      McuCheckParamRamSection = true
      McuCheckVersionInfo = true
      McuCheckUninit = true
      McuCheckPllStatus = true
      McuDevErrorReport = true
      McuErrorHook = Det_ReportError
      McuIncludeDet = Det.h
      McuProdErrorReport = true
      McuUseInitRamApi = false
      McuCopyTrimFromOtp = true
      McuSraEnabled = false
      McuSraOnlyForWrite = false
      McuSraOnlyForPrivModeRegs = false
      McuSraNotInInit = false
      McuErrataFmzPll17Workaround = false
      McuIrqHandling = SuspendAllInterrupts
      McuMemInit:
        McuInitMibSpiP1Ram = true
        McuInitMibSpiP3Ram = true
        McuInitMibSpiP5Ram = true
        McuInitDcan{1..3}Ram = true
        McuInitMibAdc1Ram = true
        McuInitMibAdc2Ram = true
        McuInitNhet1Ram = true
        McuInitNhet2Ram = true
        McuInitHetTu1Ram = true
        McuInitHetTu2Ram = true
        McuInitDmaRam = true
        McuInitVimRam = false
        McuInitFlexRayTuRam = true
      McuPeripheralSelect:
        McuUseMibSpiP1 = true
        McuUseSpiP2 = true
        McuUseMibSpiP3 = true
        McuUseSpiP4 = true
        McuUseMibSpiP5 = true
        McuUseLin = true
        McuUseSci = true
        McuUseDcan{1..3} = true
        McuUseI2c = true
        McuUseFlexRay = true
        McuUseFlexRayTu = true
        McuUseMibAdc1 = true
        McuUseMibAdc2 = true
        McuUseGio = true
        McuUseNhet1 = true
        McuUseNhet2 = true
        McuUseHetTu1 = true
        McuUseHetTu2 = true
        McuUseDmm = false
    McuModuleConfiguration: McuClockSrcFailureNotification=DISABLED
      McuClockSettingConfig
        McuClockReferencePoint: McuClockReferencePointFrequency=20
        McuLpo:
          McuLpoEnableBias = true
          McuLpoTrimLow = Trim100Comma00Percent
          McuLpoTrimHigh = Trim100Comma00Percent
          McuLpoLowref = 80
          McuLpoHighref = 100
          McuLpoLowfreq = 0.08
          McuLpoHighfreq = 10
        PLL (McuPllConfig):
          McuPllRefClkDiv = 6
          McuPllOdDiv = 2
          McuPllRDiv = 1
          McuPllMul = 96
          McuPllIntClk = 2.5
          McuPllOutputClk = 320
          McuPllFreq = 160
          McuPllFmBwadj = 8
          McuPllFmMode = FM_Disabled
          McuPllFmNs = 1
          McuPllFmFs = 1.667
          McuPllFmNv = 1
          McuPllFmDepth = 0
          McuPllResetOnPllSlip = true
          McuPllBypassOnPllSlip = true
          McuPllResetOnOsciFail = true
        PLL2 (McuPll2Config): McuPll2RefClkDiv=5, McuPll2OdDiv=5, McuPll2RDiv=1, McuPll2Mul=100, McuPll2IntClk=4, McuPll2OutputClk=400, McuPll2Freq=80
        ExtClkIn (McuExtClocks): McuExtClk1Freq=80, McuExtClk2Freq=80
        McuClocks
          McuClockSrc:
            McuUseOsciClk = true
            McuUsePllClk = true
            McuUse32KhzOsciClk = false
            McuUseExtClk1 = false
            McuUseLpoLow = true
            McuUseLpoHigh = true
            McuUsePll2Clk = false
            McuUseExtClk2 = false
            McuUseGclk = true
            McuUseHclk = true
            McuUseVclkp = true
            McuUseVclk2 = true
            McuUseVclka1 = true
            McuUseVclka2 = true
            McuUseRtiClk1 = true
            McuUseVclk3 = true
            McuUseVclka4 = true
            McuUseVclka4Pre = false
            McuVclka1 = Vclk
            McuVclka2 = Vclk
            McuVclka4 = Vclk
            McuVclka4r = DivderbyOne
            McuRti1Div = DivderbyOne
            McuAVclk1Freq = 80
            McuAVclk2Freq = 80
            McuAVclk4sFreq = 80
            McuAVclk4divrFreq = 80
            McuRTI1Freq = 80
            McuRti1Src = Vclk
          ClockDomains (McuClockDomains):
            McuEclkSelector = VCLK
            McuEclkPrescaler = 0
            McuEclkSuspendMode = true
            McuGclkFreq = 160
            McuHclkFreq = 160
            McuVclkFreq = 80
            McuVclk2Freq = 80
            McuVclk3Freq = 80
            McuFrdCntlAswsten = 1
            McuFrdCntlRwait = 3
            McuGhvwake = PLL
            McuHvlpm = PLL
            McuGhvsrc = PLL
            McuTreeVclkDiv = 2
            McuTreeVclk2Div = 2
            McuTreeVclk3Div = 2
      McuModeConf (McuModeSettingConf): McuPowerMode=DozeMode, McuMode=0
      McuRamConf (McuRamSectorSettingConf): McuRamDefaultValue=0, McuRamBaseAddress=134217728, McuRamSectionSize=81920, McuCopyRomToRam=false, McuRomBaseAddress=0
  module config Port: implementation-config-variant=VARIANT-POST-BUILD, module-description=Port_Impl
    Port_Runtime (PortConfigSet)
      20 x PortContainer, all with PortAvailablePackage1=true:
        GIOA: PortNumberOfPortPins=8, PortUse=true, PortName=GIO A, PortRegPostfix=GIOA, PortAvailablePackage0=false, PortAvailablePackage2=true, PortAvailablePackage3=false, PortAvailablePackage4=false, PortRegBaseAddr=4294425648, PortRegStructure=PORT_REG_STRUCT_REGULAR_NO_FUNC, PortContainsPrivReg=false
          8 x PortPin, all with PortPinDirectionChangeable=false, PortPinInitialMode=PORT_PIN_MODE_DIO, PortPinLevelValue=PORT_PIN_LEVEL_LOW, PortPinMode=PORT_PIN_MODE_DIO, PortPinOpenDrain=PORT_PUSH_PULL, PortPinPullSelect=PORT_PULL_DOWN, PortPinRefresh=false, PortPinAvailablePackage0=false, PortPinAvailablePackage1=true, PortPinAvailablePackage2=true, PortPinAvailablePackage3=false, PortPinAvailablePackage4=false, PortPinSlewRate=PORT_PIN_SLEW_RATE_NA:
            PortPinGioA_0: PortPinDirection=PORT_PIN_OUT, PortPinId=0, PortPinChannelName=(unset), PortPinName=GIOA0
            PortPinGioA_1: PortPinDirection=PORT_PIN_IN, PortPinId=1, PortPinChannelName=(unset), PortPinName=GIOA1
            PortPinGioA_2: PortPinDirection=PORT_PIN_OUT, PortPinId=2, PortPinChannelName=(unset), PortPinName=GIOA2
            PortPinGioA_3: PortPinDirection=PORT_PIN_OUT, PortPinId=3, PortPinChannelName=(unset), PortPinName=GIOA3
            PortPinGioA_4: PortPinDirection=PORT_PIN_IN, PortPinId=4, PortPinChannelName=(unset), PortPinName=GIOA4
            PortPinGioA_5: PortPinDirection=PORT_PIN_OUT, PortPinId=5, PortPinChannelName=GA_UPPER, PortPinName=GIOA5
            PortPinGioA_6: PortPinDirection=PORT_PIN_OUT, PortPinId=6, PortPinChannelName=GA_LOWER, PortPinName=GIOA6
            PortPinGioA_7: PortPinDirection=PORT_PIN_OUT, PortPinId=7, PortPinChannelName=GB_UPPER, PortPinName=GIOA7
        GIOB: PortNumberOfPortPins=8, PortUse=false, PortName=GIO B, PortRegPostfix=GIOB, PortAvailablePackage0=true, PortAvailablePackage2=true, PortAvailablePackage3=false, PortAvailablePackage4=false, PortRegBaseAddr=4294425680, PortRegStructure=PORT_REG_STRUCT_REGULAR_NO_FUNC, PortContainsPrivReg=false
          8 x PortPin, all with PortPinDirectionChangeable=false, PortPinInitialMode=PORT_PIN_MODE_DIO, PortPinLevelValue=PORT_PIN_LEVEL_LOW, PortPinMode=PORT_PIN_MODE_DIO, PortPinOpenDrain=PORT_PUSH_PULL, PortPinPullSelect=PORT_PULL_UP, PortPinRefresh=false, PortPinChannelName=(unset), PortPinAvailablePackage0=true, PortPinAvailablePackage1=true, PortPinAvailablePackage2=true, PortPinAvailablePackage3=false, PortPinAvailablePackage4=false, PortPinSlewRate=PORT_PIN_SLEW_RATE_NA:
            PortPinGioB_{0..2}: PortPinDirection=PORT_PIN_IN, PortPinId={0..2}, PortPinName=GIOB{0..2}
            PortPinGioB_3: PortPinDirection=PORT_PIN_OUT, PortPinId=3, PortPinName=GIOB3
            PortPinGioB_4: PortPinDirection=PORT_PIN_OUT, PortPinId=4, PortPinName=GIOB4
            PortPinGioB_{5..7}: PortPinDirection=PORT_PIN_IN, PortPinId={5..7}, PortPinName=GIOB{5..7}
        CAN1: PortNumberOfPortPins=2, PortUse=false, PortName=CAN 1, PortRegPostfix=CAN1, PortAvailablePackage0=false, PortAvailablePackage2=true, PortAvailablePackage3=false, PortAvailablePackage4=false, PortRegBaseAddr=4294434272, PortRegStructure=PORT_REG_STRUCT_SHORT, PortContainsPrivReg=true
          PortPinCan1_0 (PortPin):
            PortPinDirection = PORT_PIN_OUT
            PortPinDirectionChangeable = false
            PortPinId = 0
            PortPinInitialMode = PORT_PIN_MODE_CAN
            PortPinLevelValue = PORT_PIN_LEVEL_LOW
            PortPinMode = PORT_PIN_MODE_DIO
            PortPinOpenDrain = PORT_PUSH_PULL
            PortPinPullSelect = PORT_PULL_UP
            PortPinRefresh = true
            PortPinChannelName = (unset)
            PortPinAvailablePackage0 = false
            PortPinAvailablePackage1 = true
            PortPinAvailablePackage2 = true
            PortPinAvailablePackage3 = false
            PortPinAvailablePackage4 = false
            PortPinSlewRate = PORT_PIN_SLEW_RATE_NA
            PortPinName = CAN1TX
          PortPinCan1_1 (PortPin):
            PortPinDirection = PORT_PIN_OUT
            PortPinDirectionChangeable = false
            PortPinId = 1
            PortPinInitialMode = PORT_PIN_MODE_CAN
            PortPinLevelValue = PORT_PIN_LEVEL_LOW
            PortPinMode = PORT_PIN_MODE_DIO
            PortPinOpenDrain = PORT_PUSH_PULL
            PortPinPullSelect = PORT_PULL_UP
            PortPinRefresh = false
            PortPinChannelName = (unset)
            PortPinAvailablePackage0 = false
            PortPinAvailablePackage1 = true
            PortPinAvailablePackage2 = true
            PortPinAvailablePackage3 = false
            PortPinAvailablePackage4 = false
            PortPinSlewRate = PORT_PIN_SLEW_RATE_NA
            PortPinName = CAN1RX
        CAN2: PortNumberOfPortPins=2, PortUse=false, PortName=CAN 2, PortRegPostfix=CAN2, PortAvailablePackage0=false, PortAvailablePackage2=true, PortAvailablePackage3=false, PortAvailablePackage4=false, PortRegBaseAddr=4294434784, PortRegStructure=PORT_REG_STRUCT_SHORT, PortContainsPrivReg=true
          PortPinCan2_0 (PortPin):
            PortPinDirection = PORT_PIN_IN
            PortPinDirectionChangeable = false
            PortPinId = 0
            PortPinInitialMode = PORT_PIN_MODE_DIO
            PortPinLevelValue = PORT_PIN_LEVEL_LOW
            PortPinMode = PORT_PIN_MODE_DIO
            PortPinOpenDrain = PORT_PUSH_PULL
            PortPinPullSelect = PORT_PULL_UP
            PortPinRefresh = false
            PortPinChannelName = (unset)
            PortPinAvailablePackage0 = false
            PortPinAvailablePackage1 = true
            PortPinAvailablePackage2 = true
            PortPinAvailablePackage3 = false
            PortPinAvailablePackage4 = false
            PortPinSlewRate = PORT_PIN_SLEW_RATE_NA
            PortPinName = CAN2TX
          PortPinCan2_1 (PortPin):
            PortPinDirection = PORT_PIN_IN
            PortPinDirectionChangeable = false
            PortPinId = 1
            PortPinInitialMode = PORT_PIN_MODE_DIO
            PortPinLevelValue = PORT_PIN_LEVEL_LOW
            PortPinMode = PORT_PIN_MODE_DIO
            PortPinOpenDrain = PORT_PUSH_PULL
            PortPinPullSelect = PORT_PULL_UP
            PortPinRefresh = false
            PortPinChannelName = (unset)
            PortPinAvailablePackage0 = false
            PortPinAvailablePackage1 = true
            PortPinAvailablePackage2 = true
            PortPinAvailablePackage3 = false
            PortPinAvailablePackage4 = false
            PortPinSlewRate = PORT_PIN_SLEW_RATE_NA
            PortPinName = CAN2RX
        CAN3: PortNumberOfPortPins=2, PortUse=true, PortName=CAN 3, PortRegPostfix=CAN3, PortAvailablePackage0=false, PortAvailablePackage2=true, PortAvailablePackage3=false, PortAvailablePackage4=false, PortRegBaseAddr=4294435296, PortRegStructure=PORT_REG_STRUCT_SHORT, PortContainsPrivReg=true
          PortPinCan3_0 (PortPin):
            PortPinDirection = PORT_PIN_OUT
            PortPinDirectionChangeable = false
            PortPinId = 0
            PortPinInitialMode = PORT_PIN_MODE_DIO
            PortPinLevelValue = PORT_PIN_LEVEL_LOW
            PortPinMode = PORT_PIN_MODE_DIO
            PortPinOpenDrain = PORT_PUSH_PULL
            PortPinPullSelect = PORT_PULL_UP
            PortPinRefresh = false
            PortPinChannelName = WdReset
            PortPinAvailablePackage0 = false
            PortPinAvailablePackage1 = true
            PortPinAvailablePackage2 = true
            PortPinAvailablePackage3 = false
            PortPinAvailablePackage4 = false
            PortPinSlewRate = PORT_PIN_SLEW_RATE_NA
            PortPinName = CAN3TX
          PortPinCan3_1 (PortPin):
            PortPinDirection = PORT_PIN_OUT
            PortPinDirectionChangeable = false
            PortPinId = 1
            PortPinInitialMode = PORT_PIN_MODE_DIO
            PortPinLevelValue = PORT_PIN_LEVEL_LOW
            PortPinMode = PORT_PIN_MODE_DIO
            PortPinOpenDrain = PORT_PUSH_PULL
            PortPinPullSelect = PORT_PULL_UP
            PortPinRefresh = false
            PortPinChannelName = WdMonitor
            PortPinAvailablePackage0 = false
            PortPinAvailablePackage1 = true
            PortPinAvailablePackage2 = true
            PortPinAvailablePackage3 = false
            PortPinAvailablePackage4 = false
            PortPinSlewRate = PORT_PIN_SLEW_RATE_NA
            PortPinName = CAN3RX
        LIN: PortNumberOfPortPins=2, PortUse=false, PortName=LIN, PortRegPostfix=LIN, PortAvailablePackage0=false, PortAvailablePackage2=true, PortAvailablePackage3=false, PortAvailablePackage4=false, PortRegBaseAddr=4294435900, PortRegStructure=PORT_REG_STRUCT_REGULAR_SLEW_1, PortContainsPrivReg=false
          PortPinLin1_0 (PortPin):
            PortPinDirection = PORT_PIN_IN
            PortPinDirectionChangeable = false
            PortPinId = 1
            PortPinInitialMode = PORT_PIN_MODE_DIO
            PortPinLevelValue = PORT_PIN_LEVEL_LOW
            PortPinMode = PORT_PIN_MODE_DIO
            PortPinOpenDrain = PORT_PUSH_PULL
            PortPinPullSelect = PORT_PULL_UP
            PortPinRefresh = false
            PortPinChannelName = (unset)
            PortPinAvailablePackage0 = false
            PortPinAvailablePackage1 = true
            PortPinAvailablePackage2 = true
            PortPinAvailablePackage3 = false
            PortPinAvailablePackage4 = false
            PortPinSlewRate = PORT_PIN_SLEW_RATE_NA
            PortPinName = LINRX
          PortPinLin1_1 (PortPin):
            PortPinDirection = PORT_PIN_IN
            PortPinDirectionChangeable = false
            PortPinId = 2
            PortPinInitialMode = PORT_PIN_MODE_DIO
            PortPinLevelValue = PORT_PIN_LEVEL_LOW
            PortPinMode = PORT_PIN_MODE_DIO
            PortPinOpenDrain = PORT_PUSH_PULL
            PortPinPullSelect = PORT_PULL_UP
            PortPinRefresh = false
            PortPinChannelName = (unset)
            PortPinAvailablePackage0 = false
            PortPinAvailablePackage1 = true
            PortPinAvailablePackage2 = true
            PortPinAvailablePackage3 = false
            PortPinAvailablePackage4 = false
            PortPinSlewRate = PORT_PIN_SLEW_RATE_NA
            PortPinName = LINTX
        SCI: PortNumberOfPortPins=2, PortUse=false, PortName=SCI, PortRegPostfix=SCI, PortAvailablePackage0=false, PortAvailablePackage2=true, PortAvailablePackage3=false, PortAvailablePackage4=false, PortRegBaseAddr=4294436156, PortRegStructure=PORT_REG_STRUCT_REGULAR_SLEW_1, PortContainsPrivReg=false
          PortPinSci1_0 (PortPin):
            PortPinDirection = PORT_PIN_IN
            PortPinDirectionChangeable = false
            PortPinId = 1
            PortPinInitialMode = PORT_PIN_MODE_DIO
            PortPinLevelValue = PORT_PIN_LEVEL_LOW
            PortPinMode = PORT_PIN_MODE_DIO
            PortPinOpenDrain = PORT_PUSH_PULL
            PortPinPullSelect = PORT_PULL_UP
            PortPinRefresh = false
            PortPinChannelName = (unset)
            PortPinAvailablePackage0 = false
            PortPinAvailablePackage1 = true
            PortPinAvailablePackage2 = true
            PortPinAvailablePackage3 = false
            PortPinAvailablePackage4 = false
            PortPinSlewRate = PORT_PIN_SLEW_RATE_NA
            PortPinName = SCIRX
          PortPinSci1_1 (PortPin):
            PortPinDirection = PORT_PIN_IN
            PortPinDirectionChangeable = false
            PortPinId = 2
            PortPinInitialMode = PORT_PIN_MODE_DIO
            PortPinLevelValue = PORT_PIN_LEVEL_LOW
            PortPinMode = PORT_PIN_MODE_DIO
            PortPinOpenDrain = PORT_PUSH_PULL
            PortPinPullSelect = PORT_PULL_UP
            PortPinRefresh = false
            PortPinChannelName = (unset)
            PortPinAvailablePackage0 = false
            PortPinAvailablePackage1 = true
            PortPinAvailablePackage2 = true
            PortPinAvailablePackage3 = false
            PortPinAvailablePackage4 = false
            PortPinSlewRate = PORT_PIN_SLEW_RATE_NA
            PortPinName = SCITX
        I2C: PortNumberOfPortPins=2, PortUse=false, PortName=I2C, PortRegPostfix=IIC, PortAvailablePackage0=false, PortAvailablePackage2=true, PortAvailablePackage3=false, PortAvailablePackage4=false, PortRegBaseAddr=4294431816, PortRegStructure=PORT_REG_STRUCT_REGULAR_SLEW_1, PortContainsPrivReg=false
          PortPinIic_0 (PortPin):
            PortPinDirection = PORT_PIN_OUT
            PortPinDirectionChangeable = false
            PortPinId = 0
            PortPinInitialMode = PORT_PIN_MODE_DIO
            PortPinLevelValue = PORT_PIN_LEVEL_LOW
            PortPinMode = PORT_PIN_MODE_DIO
            PortPinOpenDrain = PORT_OPEN_DRAIN
            PortPinPullSelect = PORT_PULL_UP
            PortPinRefresh = false
            PortPinChannelName = (unset)
            PortPinAvailablePackage0 = false
            PortPinAvailablePackage1 = true
            PortPinAvailablePackage2 = true
            PortPinAvailablePackage3 = false
            PortPinAvailablePackage4 = false
            PortPinSlewRate = PORT_PIN_SLEW_RATE_NA
            PortPinName = I2C_SCL
          PortPinIic_1 (PortPin):
            PortPinDirection = PORT_PIN_OUT
            PortPinDirectionChangeable = false
            PortPinId = 1
            PortPinInitialMode = PORT_PIN_MODE_DIO
            PortPinLevelValue = PORT_PIN_LEVEL_LOW
            PortPinMode = PORT_PIN_MODE_DIO
            PortPinOpenDrain = PORT_OPEN_DRAIN
            PortPinPullSelect = PORT_PULL_UP
            PortPinRefresh = false
            PortPinChannelName = (unset)
            PortPinAvailablePackage0 = false
            PortPinAvailablePackage1 = true
            PortPinAvailablePackage2 = true
            PortPinAvailablePackage3 = false
            PortPinAvailablePackage4 = false
            PortPinSlewRate = PORT_PIN_SLEW_RATE_NA
            PortPinName = I2C_SDA
        SPI1: PortNumberOfPortPins=16, PortUse=false, PortName=MBSPI 1, PortRegPostfix=SPI1, PortAvailablePackage0=true, PortAvailablePackage2=true, PortAvailablePackage3=true, PortAvailablePackage4=true, PortRegBaseAddr=4294439956, PortRegStructure=PORT_REG_STRUCT_REGULAR_SLEW_2, PortContainsPrivReg=false
          12 x PortPin, all with PortPinDirectionChangeable=false, PortPinMode=PORT_PIN_MODE_DIO, PortPinOpenDrain=PORT_PUSH_PULL, PortPinPullSelect=PORT_PULL_UP, PortPinRefresh=false, PortPinChannelName=(unset), PortPinAvailablePackage0=true, PortPinAvailablePackage1=true, PortPinAvailablePackage2=true, PortPinAvailablePackage3=true, PortPinSlewRate=PORT_PIN_SLEW_RATE_NA:
            PortPinSpi1_0: PortPinDirection=PORT_PIN_OUT, PortPinId=9, PortPinInitialMode=PORT_PIN_MODE_SPI, PortPinLevelValue=PORT_PIN_LEVEL_LOW, PortPinAvailablePackage4=true, PortPinName=SPI1CLK
            PortPinSpi1_1: PortPinDirection=PORT_PIN_OUT, PortPinId=0, PortPinInitialMode=PORT_PIN_MODE_SPI, PortPinLevelValue=PORT_PIN_LEVEL_LOW, PortPinAvailablePackage4=true, PortPinName=SPI1NCS0
            PortPinSpi1_2: PortPinDirection=PORT_PIN_IN, PortPinId=1, PortPinInitialMode=PORT_PIN_MODE_DIO, PortPinLevelValue=PORT_PIN_LEVEL_LOW, PortPinAvailablePackage4=true, PortPinName=SPI1NCS1
            PortPinSpi1_3: PortPinDirection=PORT_PIN_IN, PortPinId=2, PortPinInitialMode=PORT_PIN_MODE_DIO, PortPinLevelValue=PORT_PIN_LEVEL_LOW, PortPinAvailablePackage4=false, PortPinName=SPI1NCS2
            PortPinSpi1_4: PortPinDirection=PORT_PIN_OUT, PortPinId=3, PortPinInitialMode=PORT_PIN_MODE_SPI, PortPinLevelValue=PORT_PIN_LEVEL_LOW, PortPinAvailablePackage4=false, PortPinName=SPI1NCS3
            PortPinSpi1_5: PortPinDirection=PORT_PIN_IN, PortPinId=4, PortPinInitialMode=PORT_PIN_MODE_SPI, PortPinLevelValue=PORT_PIN_LEVEL_LOW, PortPinAvailablePackage4=false, PortPinName=SPI1NCS4
            PortPinSpi1_6: PortPinDirection=PORT_PIN_IN, PortPinId=5, PortPinInitialMode=PORT_PIN_MODE_SPI, PortPinLevelValue=PORT_PIN_LEVEL_LOW, PortPinAvailablePackage4=false, PortPinName=SPI1NCS5
            PortPinSpi1_7: PortPinDirection=PORT_PIN_OUT, PortPinId=8, PortPinInitialMode=PORT_PIN_MODE_SPI, PortPinLevelValue=PORT_PIN_LEVEL_HIGH, PortPinAvailablePackage4=true, PortPinName=SPI1NENA
            PortPinSpi1_8: PortPinDirection=PORT_PIN_OUT, PortPinId=10, PortPinInitialMode=PORT_PIN_MODE_SPI, PortPinLevelValue=PORT_PIN_LEVEL_LOW, PortPinAvailablePackage4=true, PortPinName=SPI1SIMO0
            PortPinSpi1_9: PortPinDirection=PORT_PIN_OUT, PortPinId=17, PortPinInitialMode=PORT_PIN_MODE_SPI, PortPinLevelValue=PORT_PIN_LEVEL_LOW, PortPinAvailablePackage4=true, PortPinName=SPI1SIMO1
            PortPinSpi1_10: PortPinDirection=PORT_PIN_IN, PortPinId=11, PortPinInitialMode=PORT_PIN_MODE_SPI, PortPinLevelValue=PORT_PIN_LEVEL_LOW, PortPinAvailablePackage4=true, PortPinName=SPI1SOMI0
            PortPinSpi1_11: PortPinDirection=PORT_PIN_IN, PortPinId=25, PortPinInitialMode=PORT_PIN_MODE_SPI, PortPinLevelValue=PORT_PIN_LEVEL_LOW, PortPinAvailablePackage4=true, PortPinName=SPI1SOMI1
        SPI2: PortNumberOfPortPins=8, PortUse=false, PortName=SPI 2, PortRegPostfix=SPI2, PortAvailablePackage0=false, PortAvailablePackage2=true, PortAvailablePackage3=false, PortAvailablePackage4=false, PortRegBaseAddr=4294440468, PortRegStructure=PORT_REG_STRUCT_REGULAR_SLEW_2, PortContainsPrivReg=false
          6 x PortPin, all with PortPinDirection=PORT_PIN_IN, PortPinDirectionChangeable=false, PortPinInitialMode=PORT_PIN_MODE_DIO, PortPinLevelValue=PORT_PIN_LEVEL_LOW, PortPinMode=PORT_PIN_MODE_DIO, PortPinOpenDrain=PORT_PUSH_PULL, PortPinPullSelect=PORT_PULL_UP, PortPinRefresh=false, PortPinChannelName=(unset), PortPinAvailablePackage0=false, PortPinAvailablePackage1=true, PortPinAvailablePackage2=true, PortPinAvailablePackage3=false, PortPinAvailablePackage4=false, PortPinSlewRate=PORT_PIN_SLEW_RATE_NA:
            PortPinSpi2_0: PortPinId=9, PortPinName=SPI2CLK
            PortPinSpi2_1: PortPinId=0, PortPinName=SPI2NCS0
            PortPinSpi2_2: PortPinId=1, PortPinName=SPI2NCS1
            PortPinSpi2_5: PortPinId=8, PortPinName=SPI2NENA
            PortPinSpi2_6: PortPinId=10, PortPinName=SPI2SIMO
            PortPinSpi2_7: PortPinId=11, PortPinName=SPI2SOMI
        SPI3: PortNumberOfPortPins=16, PortUse=true, PortName=MBSPI 3, PortRegPostfix=SPI3, PortAvailablePackage0=true, PortAvailablePackage2=true, PortAvailablePackage3=true, PortAvailablePackage4=true, PortRegBaseAddr=4294440980, PortRegStructure=PORT_REG_STRUCT_REGULAR_SLEW_2, PortContainsPrivReg=false
          10 x PortPin, all with PortPinDirectionChangeable=false, PortPinLevelValue=PORT_PIN_LEVEL_LOW, PortPinMode=PORT_PIN_MODE_DIO, PortPinOpenDrain=PORT_PUSH_PULL, PortPinPullSelect=PORT_PULL_UP, PortPinRefresh=false, PortPinAvailablePackage0=true, PortPinAvailablePackage1=true, PortPinAvailablePackage2=true, PortPinAvailablePackage3=true, PortPinSlewRate=PORT_PIN_SLEW_RATE_NA:
            PortPinSpi3_0: PortPinDirection=PORT_PIN_OUT, PortPinId=9, PortPinInitialMode=PORT_PIN_MODE_SPI, PortPinChannelName=(unset), PortPinAvailablePackage4=true, PortPinName=SPI3CLK
            PortPinSpi3_1: PortPinDirection=PORT_PIN_OUT, PortPinId=0, PortPinInitialMode=PORT_PIN_MODE_SPI, PortPinChannelName=(unset), PortPinAvailablePackage4=true, PortPinName=SPI3NCS0
            PortPinSpi3_2: PortPinDirection=PORT_PIN_OUT, PortPinId=1, PortPinInitialMode=PORT_PIN_MODE_DIO, PortPinChannelName=FetDrvReset, PortPinAvailablePackage4=true, PortPinName=SPI3NCS1
            PortPinSpi3_3: PortPinDirection=PORT_PIN_OUT, PortPinId=2, PortPinInitialMode=PORT_PIN_MODE_DIO, PortPinChannelName=POS_SDA_DSP, PortPinAvailablePackage4=false, PortPinName=SPI3NCS2
            PortPinSpi3_4: PortPinDirection=PORT_PIN_IN, PortPinId=3, PortPinInitialMode=PORT_PIN_MODE_DIO, PortPinChannelName=POS_SCL_DSP, PortPinAvailablePackage4=false, PortPinName=SPI3NCS3
            PortPinSpi3_7: PortPinDirection=PORT_PIN_IN, PortPinId=8, PortPinInitialMode=PORT_PIN_MODE_SPI, PortPinChannelName=(unset), PortPinAvailablePackage4=true, PortPinName=SPI3NENA
            PortPinSpi3_8: PortPinDirection=PORT_PIN_OUT, PortPinId=10, PortPinInitialMode=PORT_PIN_MODE_SPI, PortPinChannelName=(unset), PortPinAvailablePackage4=true, PortPinName=SPI3SIMO
            PortPinSpi3_10: PortPinDirection=PORT_PIN_IN, PortPinId=11, PortPinInitialMode=PORT_PIN_MODE_SPI, PortPinChannelName=(unset), PortPinAvailablePackage4=true, PortPinName=SPI3SOMI
            PortPinSpi3_5: PortPinDirection=PORT_PIN_IN, PortPinId=4, PortPinInitialMode=PORT_PIN_MODE_SPI, PortPinChannelName=(unset), PortPinAvailablePackage4=true, PortPinName=SPI3NCS4
            PortPinSpi3_6: PortPinDirection=PORT_PIN_IN, PortPinId=5, PortPinInitialMode=PORT_PIN_MODE_SPI, PortPinChannelName=(unset), PortPinAvailablePackage4=true, PortPinName=SPI3NCS5
        SPI4: PortNumberOfPortPins=8, PortUse=false, PortName=SPI 4, PortRegPostfix=SPI4, PortAvailablePackage0=false, PortAvailablePackage2=true, PortAvailablePackage3=false, PortAvailablePackage4=false, PortRegBaseAddr=4294441492, PortRegStructure=PORT_REG_STRUCT_REGULAR_SLEW_2, PortContainsPrivReg=false
          5 x PortPin, all with PortPinDirection=PORT_PIN_IN, PortPinDirectionChangeable=false, PortPinInitialMode=PORT_PIN_MODE_DIO, PortPinLevelValue=PORT_PIN_LEVEL_LOW, PortPinMode=PORT_PIN_MODE_DIO, PortPinOpenDrain=PORT_PUSH_PULL, PortPinPullSelect=PORT_PULL_UP, PortPinRefresh=false, PortPinChannelName=(unset), PortPinAvailablePackage0=false, PortPinAvailablePackage1=true, PortPinAvailablePackage2=true, PortPinAvailablePackage3=false, PortPinAvailablePackage4=false, PortPinSlewRate=PORT_PIN_SLEW_RATE_NA:
            PortPinSpi4_0: PortPinId=9, PortPinName=SPI4CLK
            PortPinSpi4_1: PortPinId=0, PortPinName=SPI4NCS0
            PortPinSpi4_5: PortPinId=8, PortPinName=SPI4NENA
            PortPinSpi4_6: PortPinId=10, PortPinName=SPI4SIMO
            PortPinSpi4_7: PortPinId=11, PortPinName=SPI4SOMI
        SPI5: PortNumberOfPortPins=16, PortUse=true, PortName=MBSPI 5, PortRegPostfix=SPI5, PortAvailablePackage0=true, PortAvailablePackage2=true, PortAvailablePackage3=true, PortAvailablePackage4=true, PortRegBaseAddr=4294442004, PortRegStructure=PORT_REG_STRUCT_REGULAR_SLEW_2, PortContainsPrivReg=false
          14 x PortPin, all with PortPinDirectionChangeable=false, PortPinInitialMode=PORT_PIN_MODE_SPI, PortPinLevelValue=PORT_PIN_LEVEL_LOW, PortPinMode=PORT_PIN_MODE_DIO, PortPinOpenDrain=PORT_PUSH_PULL, PortPinRefresh=false, PortPinChannelName=(unset), PortPinAvailablePackage0=true, PortPinAvailablePackage1=true, PortPinAvailablePackage2=true, PortPinAvailablePackage3=true, PortPinSlewRate=PORT_PIN_SLEW_RATE_NA:
            PortPinSpi5_0: PortPinDirection=PORT_PIN_OUT, PortPinId=9, PortPinPullSelect=PORT_PULL_UP, PortPinAvailablePackage4=true, PortPinName=SPI5CLK
            PortPinSpi5_1: PortPinDirection=PORT_PIN_OUT, PortPinId=0, PortPinPullSelect=PORT_PULL_UP, PortPinAvailablePackage4=true, PortPinName=SPI5NCS0
            PortPinSpi5_2: PortPinDirection=PORT_PIN_IN, PortPinId=1, PortPinPullSelect=PORT_PULL_UP, PortPinAvailablePackage4=true, PortPinName=SPI5NCS1
            PortPinSpi5_3: PortPinDirection=PORT_PIN_IN, PortPinId=2, PortPinPullSelect=PORT_PULL_UP, PortPinAvailablePackage4=false, PortPinName=SPI5NCS2
            PortPinSpi5_4: PortPinDirection=PORT_PIN_IN, PortPinId=3, PortPinPullSelect=PORT_PULL_UP, PortPinAvailablePackage4=false, PortPinName=SPI5NCS3
            PortPinSpi5_5: PortPinDirection=PORT_PIN_IN, PortPinId=8, PortPinPullSelect=PORT_PULL_DOWN, PortPinAvailablePackage4=true, PortPinName=SPI5NENA
            PortPinSpi5_6: PortPinDirection=PORT_PIN_OUT, PortPinId=10, PortPinPullSelect=PORT_PULL_UP, PortPinAvailablePackage4=true, PortPinName=SPI5SIMO0
            PortPinSpi5_7: PortPinDirection=PORT_PIN_OUT, PortPinId=17, PortPinPullSelect=PORT_PULL_UP, PortPinAvailablePackage4=true, PortPinName=SPI5SIMO1
            PortPinSpi5_8: PortPinDirection=PORT_PIN_OUT, PortPinId=18, PortPinPullSelect=PORT_PULL_UP, PortPinAvailablePackage4=true, PortPinName=SPI5SIMO2
            PortPinSpi5_9: PortPinDirection=PORT_PIN_OUT, PortPinId=19, PortPinPullSelect=PORT_PULL_UP, PortPinAvailablePackage4=true, PortPinName=SPI5SIMO3
            PortPinSpi5_10: PortPinDirection=PORT_PIN_IN, PortPinId=11, PortPinPullSelect=PORT_PULL_UP, PortPinAvailablePackage4=true, PortPinName=SPI5SOMI0
            PortPinSpi5_11: PortPinDirection=PORT_PIN_IN, PortPinId=25, PortPinPullSelect=PORT_PULL_UP, PortPinAvailablePackage4=true, PortPinName=SPI5SOMI1
            PortPinSpi5_12: PortPinDirection=PORT_PIN_IN, PortPinId=26, PortPinPullSelect=PORT_PULL_UP, PortPinAvailablePackage4=true, PortPinName=SPI5SOMI2
            PortPinSpi5_13: PortPinDirection=PORT_PIN_IN, PortPinId=27, PortPinPullSelect=PORT_PULL_UP, PortPinAvailablePackage4=true, PortPinName=SPI5SOMI3
        NHET1: PortNumberOfPortPins=32, PortUse=true, PortName=NHET1, PortRegPostfix=NHET1, PortAvailablePackage0=false, PortAvailablePackage2=true, PortAvailablePackage3=false, PortAvailablePackage4=false, PortRegBaseAddr=4294424648, PortRegStructure=PORT_REG_STRUCT_REGULAR_NO_FUNC, PortContainsPrivReg=false
          32 x PortPin, all with PortPinDirectionChangeable=false, PortPinInitialMode=PORT_PIN_MODE_DIO, PortPinMode=PORT_PIN_MODE_DIO, PortPinPullSelect=PORT_PULL_DOWN, PortPinRefresh=false, PortPinAvailablePackage0=false, PortPinAvailablePackage1=true, PortPinAvailablePackage2=true, PortPinAvailablePackage3=false, PortPinAvailablePackage4=false, PortPinSlewRate=PORT_PIN_SLEW_RATE_NA:
            PortPinNHet1_0: PortPinDirection=PORT_PIN_OUT, PortPinId=0, PortPinLevelValue=PORT_PIN_LEVEL_LOW, PortPinOpenDrain=PORT_PUSH_PULL, PortPinChannelName=GB_LOWER, PortPinName=NHET1_0
            PortPinNHet1_1: PortPinDirection=PORT_PIN_IN, PortPinId=1, PortPinLevelValue=PORT_PIN_LEVEL_LOW, PortPinOpenDrain=PORT_PUSH_PULL, PortPinChannelName=(unset), PortPinName=NHET1_1
            PortPinNHet1_2: PortPinDirection=PORT_PIN_OUT, PortPinId=2, PortPinLevelValue=PORT_PIN_LEVEL_LOW, PortPinOpenDrain=PORT_PUSH_PULL, PortPinChannelName=GC_UPPER, PortPinName=NHET1_2
            PortPinNHet1_3: PortPinDirection=PORT_PIN_IN, PortPinId=3, PortPinLevelValue=PORT_PIN_LEVEL_LOW, PortPinOpenDrain=PORT_PUSH_PULL, PortPinChannelName=(unset), PortPinName=NHET1_3
            PortPinNHet1_4: PortPinDirection=PORT_PIN_IN, PortPinId=4, PortPinLevelValue=PORT_PIN_LEVEL_LOW, PortPinOpenDrain=PORT_PUSH_PULL, PortPinChannelName=FetDrvCntl, PortPinName=NHET1_4
            PortPinNHet1_5: PortPinDirection=PORT_PIN_OUT, PortPinId=5, PortPinLevelValue=PORT_PIN_LEVEL_LOW, PortPinOpenDrain=PORT_PUSH_PULL, PortPinChannelName=GC_LOWER, PortPinName=NHET1_5
            PortPinNHet1_6: PortPinDirection=PORT_PIN_IN, PortPinId=6, PortPinLevelValue=PORT_PIN_LEVEL_LOW, PortPinOpenDrain=PORT_PUSH_PULL, PortPinChannelName=(unset), PortPinName=NHET1_6
            PortPinNHet1_7: PortPinDirection=PORT_PIN_IN, PortPinId=7, PortPinLevelValue=PORT_PIN_LEVEL_LOW, PortPinOpenDrain=PORT_PUSH_PULL, PortPinChannelName=(unset), PortPinName=NHET1_7
            PortPinNHet1_8: PortPinDirection=PORT_PIN_IN, PortPinId=8, PortPinLevelValue=PORT_PIN_LEVEL_LOW, PortPinOpenDrain=PORT_PUSH_PULL, PortPinChannelName=PwrSwitchEn, PortPinName=NHET1_8
            PortPinNHet1_9: PortPinDirection=PORT_PIN_IN, PortPinId=9, PortPinLevelValue=PORT_PIN_LEVEL_LOW, PortPinOpenDrain=PORT_PUSH_PULL, PortPinChannelName=(unset), PortPinName=NHET1_9
            PortPinNHet1_10: PortPinDirection=PORT_PIN_IN, PortPinId=10, PortPinLevelValue=PORT_PIN_LEVEL_LOW, PortPinOpenDrain=PORT_PUSH_PULL, PortPinChannelName=T1_SENT, PortPinName=NHET1_10
            PortPinNHet1_11: PortPinDirection=PORT_PIN_IN, PortPinId=11, PortPinLevelValue=PORT_PIN_LEVEL_LOW, PortPinOpenDrain=PORT_PUSH_PULL, PortPinChannelName=(unset), PortPinName=NHET1_11
            PortPinNHet1_12: PortPinDirection=PORT_PIN_OUT, PortPinId=12, PortPinLevelValue=PORT_PIN_LEVEL_LOW, PortPinOpenDrain=PORT_OPEN_DRAIN, PortPinChannelName=T1_SENT_Sync, PortPinName=NHET1_12
            PortPinNHet1_13: PortPinDirection=PORT_PIN_IN, PortPinId=13, PortPinLevelValue=PORT_PIN_LEVEL_LOW, PortPinOpenDrain=PORT_PUSH_PULL, PortPinChannelName=(unset), PortPinName=NHET1_13
            PortPinNHet1_14: PortPinDirection=PORT_PIN_OUT, PortPinId=14, PortPinLevelValue=PORT_PIN_LEVEL_LOW, PortPinOpenDrain=PORT_PUSH_PULL, PortPinChannelName=SPI_50us_Trigger, PortPinName=NHET1_14
            PortPinNHet1_15: PortPinDirection=PORT_PIN_OUT, PortPinId=15, PortPinLevelValue=PORT_PIN_LEVEL_LOW, PortPinOpenDrain=PORT_PUSH_PULL, PortPinChannelName=SysFault2, PortPinName=NHET1_15
            PortPinNHet1_16: PortPinDirection=PORT_PIN_OUT, PortPinId=16, PortPinLevelValue=PORT_PIN_LEVEL_LOW, PortPinOpenDrain=PORT_PUSH_PULL, PortPinChannelName=ePWM_Sync, PortPinName=NHET1_16
            PortPinNHet1_17: PortPinDirection=PORT_PIN_IN, PortPinId=17, PortPinLevelValue=PORT_PIN_LEVEL_LOW, PortPinOpenDrain=PORT_PUSH_PULL, PortPinChannelName=(unset), PortPinName=NHET1_17
            PortPinNHet1_18: PortPinDirection=PORT_PIN_OUT, PortPinId=18, PortPinLevelValue=PORT_PIN_LEVEL_LOW, PortPinOpenDrain=PORT_PUSH_PULL, PortPinChannelName=SPI_1m_Trigger, PortPinName=NHET1_18
            PortPinNHet1_19: PortPinDirection=PORT_PIN_IN, PortPinId=19, PortPinLevelValue=PORT_PIN_LEVEL_LOW, PortPinOpenDrain=PORT_PUSH_PULL, PortPinChannelName=(unset), PortPinName=NHET1_19
            PortPinNHet1_20: PortPinDirection=PORT_PIN_OUT, PortPinId=20, PortPinLevelValue=PORT_PIN_LEVEL_HIGH, PortPinOpenDrain=PORT_PUSH_PULL, PortPinChannelName=TODReset, PortPinName=NHET1_20
            PortPinNHet1_21: PortPinDirection=PORT_PIN_IN, PortPinId=21, PortPinLevelValue=PORT_PIN_LEVEL_LOW, PortPinOpenDrain=PORT_PUSH_PULL, PortPinChannelName=(unset), PortPinName=NHET1_21
            PortPinNHet1_22: PortPinDirection=PORT_PIN_IN, PortPinId=22, PortPinLevelValue=PORT_PIN_LEVEL_LOW, PortPinOpenDrain=PORT_PUSH_PULL, PortPinChannelName=OvrVoltFdbk, PortPinName=NHET1_22
            PortPinNHet1_23: PortPinDirection=PORT_PIN_IN, PortPinId=23, PortPinLevelValue=PORT_PIN_LEVEL_LOW, PortPinOpenDrain=PORT_PUSH_PULL, PortPinChannelName=(unset), PortPinName=NHET1_23
            PortPinNHet1_24: PortPinDirection=PORT_PIN_IN, PortPinId=24, PortPinLevelValue=PORT_PIN_LEVEL_LOW, PortPinOpenDrain=PORT_PUSH_PULL, PortPinChannelName=FetFlt1Data, PortPinName=NHET1_24
            PortPinNHet1_25: PortPinDirection=PORT_PIN_IN, PortPinId=25, PortPinLevelValue=PORT_PIN_LEVEL_LOW, PortPinOpenDrain=PORT_PUSH_PULL, PortPinChannelName=(unset), PortPinName=NHET1_25
            PortPinNHet1_26: PortPinDirection=PORT_PIN_IN, PortPinId=26, PortPinLevelValue=PORT_PIN_LEVEL_LOW, PortPinOpenDrain=PORT_PUSH_PULL, PortPinChannelName=FetFlt2_Clk, PortPinName=NHET1_26
            PortPinNHet1_27: PortPinDirection=PORT_PIN_IN, PortPinId=27, PortPinLevelValue=PORT_PIN_LEVEL_LOW, PortPinOpenDrain=PORT_PUSH_PULL, PortPinChannelName=(unset), PortPinName=NHET1_27
            PortPinNHet1_28: PortPinDirection=PORT_PIN_IN, PortPinId=28, PortPinLevelValue=PORT_PIN_LEVEL_LOW, PortPinOpenDrain=PORT_PUSH_PULL, PortPinChannelName=T2_SENT, PortPinName=NHET1_28
            PortPinNHet1_29: PortPinDirection=PORT_PIN_IN, PortPinId=29, PortPinLevelValue=PORT_PIN_LEVEL_LOW, PortPinOpenDrain=PORT_PUSH_PULL, PortPinChannelName=(unset), PortPinName=NHET1_29
            PortPinNHet1_30: PortPinDirection=PORT_PIN_OUT, PortPinId=30, PortPinLevelValue=PORT_PIN_LEVEL_LOW, PortPinOpenDrain=PORT_OPEN_DRAIN, PortPinChannelName=T2_SENT_Sync, PortPinName=NHET1_30
            PortPinNHet1_31: PortPinDirection=PORT_PIN_IN, PortPinId=31, PortPinLevelValue=PORT_PIN_LEVEL_LOW, PortPinOpenDrain=PORT_PUSH_PULL, PortPinChannelName=(unset), PortPinName=NHET1_31
        NHET2: PortNumberOfPortPins=32, PortUse=true, PortName=NHET2, PortRegPostfix=NHET2, PortAvailablePackage0=false, PortAvailablePackage2=true, PortAvailablePackage3=false, PortAvailablePackage4=false, PortRegBaseAddr=4294424904, PortRegStructure=PORT_REG_STRUCT_REGULAR_NO_FUNC, PortContainsPrivReg=false
          18 x PortPin, all with PortPinDirection=PORT_PIN_IN, PortPinDirectionChangeable=false, PortPinInitialMode=PORT_PIN_MODE_DIO, PortPinLevelValue=PORT_PIN_LEVEL_LOW, PortPinMode=PORT_PIN_MODE_DIO, PortPinOpenDrain=PORT_PUSH_PULL, PortPinRefresh=false, PortPinAvailablePackage0=false, PortPinAvailablePackage1=true, PortPinAvailablePackage2=true, PortPinAvailablePackage3=false, PortPinAvailablePackage4=false, PortPinSlewRate=PORT_PIN_SLEW_RATE_NA:
            PortPinNHet2_{0..7}: PortPinId={0..7}, PortPinPullSelect=PORT_PULL_DOWN, PortPinChannelName=(unset), PortPinName=NHET2_{0..7}
            PortPinNHet2_8: PortPinId=8, PortPinPullSelect=PORT_PULL_DOWN, PortPinChannelName=PhaseC, PortPinName=NHET2_8
            PortPinNHet2_9: PortPinId=9, PortPinPullSelect=PORT_PULL_DOWN, PortPinChannelName=(unset), PortPinName=NHET2_9
            PortPinNHet2_10: PortPinId=10, PortPinPullSelect=PORT_PULL_DOWN, PortPinChannelName=PhaseA, PortPinName=NHET2_10
            PortPinNHet2_{11..15}: PortPinId={11..15}, PortPinPullSelect=PORT_PULL_DOWN, PortPinChannelName=(unset), PortPinName=NHET2_{11..15}
            PortPinNHet2_16: PortPinId=16, PortPinPullSelect=PORT_PULL_UP, PortPinChannelName=(unset), PortPinName=NHET2_16
            PortPinNHet2_18: PortPinId=18, PortPinPullSelect=PORT_PULL_DOWN, PortPinChannelName=PhaseB, PortPinName=NHET2_18
        SYS: PortNumberOfPortPins=1, PortUse=false, PortName=ECLK, PortRegPostfix=SYS, PortAvailablePackage0=false, PortAvailablePackage2=true, PortAvailablePackage3=false, PortAvailablePackage4=false, PortRegBaseAddr=4294967040, PortRegStructure=PORT_REG_STRUCT_REGULAR_SLEW_1, PortContainsPrivReg=false
          PortPinEcp_0 (PortPin):
            PortPinDirection = PORT_PIN_IN
            PortPinDirectionChangeable = false
            PortPinId = 0
            PortPinInitialMode = PORT_PIN_MODE_DIO
            PortPinLevelValue = PORT_PIN_LEVEL_LOW
            PortPinMode = PORT_PIN_MODE_DIO
            PortPinOpenDrain = PORT_PUSH_PULL
            PortPinPullSelect = PORT_PULL_DOWN
            PortPinRefresh = false
            PortPinChannelName = (unset)
            PortPinAvailablePackage0 = false
            PortPinAvailablePackage1 = true
            PortPinAvailablePackage2 = true
            PortPinAvailablePackage3 = false
            PortPinAvailablePackage4 = false
            PortPinSlewRate = PORT_PIN_SLEW_RATE_SLOW
            PortPinName = ECLK
        ADC1: PortNumberOfPortPins=1, PortUse=true, PortName=MibADC 1, PortRegPostfix=ADC1, PortAvailablePackage0=false, PortAvailablePackage2=true, PortAvailablePackage3=false, PortAvailablePackage4=false, PortRegBaseAddr=4294426872, PortRegStructure=PORT_REG_STRUCT_REGULAR_PERMUTED, PortContainsPrivReg=false
          PortPinADC1_0 (PortPin):
            PortPinDirection = PORT_PIN_IN
            PortPinDirectionChangeable = false
            PortPinId = 0
            PortPinInitialMode = PORT_PIN_MODE_DIO
            PortPinLevelValue = PORT_PIN_LEVEL_LOW
            PortPinMode = PORT_PIN_MODE_DIO
            PortPinOpenDrain = PORT_PUSH_PULL
            PortPinPullSelect = PORT_PULL_DOWN
            PortPinRefresh = false
            PortPinChannelName = EpsEn
            PortPinAvailablePackage0 = false
            PortPinAvailablePackage1 = true
            PortPinAvailablePackage2 = true
            PortPinAvailablePackage3 = false
            PortPinAvailablePackage4 = false
            PortPinSlewRate = PORT_PIN_SLEW_RATE_NA
            PortPinName = AD1EVT
        ADC2: PortNumberOfPortPins=1, PortUse=false, PortName=MibADC 2, PortRegPostfix=ADC2, PortAvailablePackage0=false, PortAvailablePackage2=true, PortAvailablePackage3=false, PortAvailablePackage4=false, PortRegBaseAddr=4294427384, PortRegStructure=PORT_REG_STRUCT_REGULAR_PERMUTED, PortContainsPrivReg=false
          PortPinADC2_0 (PortPin):
            PortPinDirection = PORT_PIN_IN
            PortPinDirectionChangeable = false
            PortPinId = 0
            PortPinInitialMode = PORT_PIN_MODE_DIO
            PortPinLevelValue = PORT_PIN_LEVEL_LOW
            PortPinMode = PORT_PIN_MODE_DIO
            PortPinOpenDrain = PORT_PUSH_PULL
            PortPinPullSelect = PORT_PULL_DOWN
            PortPinRefresh = false
            PortPinChannelName = (unset)
            PortPinAvailablePackage0 = false
            PortPinAvailablePackage1 = true
            PortPinAvailablePackage2 = true
            PortPinAvailablePackage3 = false
            PortPinAvailablePackage4 = false
            PortPinSlewRate = PORT_PIN_SLEW_RATE_NA
            PortPinName = AD2EVT
        RTP: PortNumberOfPortPins=19, PortUse=false, PortName=RTP, PortRegPostfix=RTP, PortAvailablePackage0=false, PortAvailablePackage2=true, PortAvailablePackage3=false, PortAvailablePackage4=false, PortRegBaseAddr=4294965812, PortRegStructure=PORT_REG_STRUCT_REGULAR_NO_SLEW, PortContainsPrivReg=false
          19 x PortPin, all with PortPinDirection=PORT_PIN_IN, PortPinDirectionChangeable=false, PortPinInitialMode=PORT_PIN_MODE_DIO, PortPinLevelValue=PORT_PIN_LEVEL_LOW, PortPinMode=PORT_PIN_MODE_DIO, PortPinOpenDrain=PORT_PUSH_PULL, PortPinPullSelect=PORT_PULL_UP, PortPinRefresh=false, PortPinChannelName=(unset), PortPinAvailablePackage0=false, PortPinAvailablePackage1=true, PortPinAvailablePackage2=true, PortPinAvailablePackage3=false, PortPinAvailablePackage4=false, PortPinSlewRate=PORT_PIN_SLEW_RATE_NA:
            PortPinRtp_{0..15}: PortPinId={0..15}, PortPinName=RPTDATA{0..15}
            PortPinRtp_16: PortPinId=16, PortPinName=RPTSYNC
            PortPinRtp_17: PortPinId=17, PortPinName=RPTCLK
            PortPinRtp_18: PortPinId=18, PortPinName=RPTENA
        DMM: PortNumberOfPortPins=19, PortUse=false, PortName=DMM, PortRegPostfix=DMM, PortAvailablePackage0=true, PortAvailablePackage2=false, PortAvailablePackage3=false, PortAvailablePackage4=false, PortRegBaseAddr=4294965100, PortRegStructure=PORT_REG_STRUCT_REGULAR_NO_SLEW, PortContainsPrivReg=false
          19 x PortPin, all with PortPinDirection=PORT_PIN_IN, PortPinDirectionChangeable=false, PortPinInitialMode=PORT_PIN_MODE_DIO, PortPinLevelValue=PORT_PIN_LEVEL_LOW, PortPinMode=PORT_PIN_MODE_DIO, PortPinOpenDrain=PORT_PUSH_PULL, PortPinPullSelect=PORT_PULL_UP, PortPinRefresh=false, PortPinChannelName=(unset), PortPinAvailablePackage0=true, PortPinAvailablePackage1=true, PortPinAvailablePackage2=false, PortPinAvailablePackage3=false, PortPinAvailablePackage4=false, PortPinSlewRate=PORT_PIN_SLEW_RATE_NA:
            PortPinDmm_0: PortPinId=0, PortPinName=DMMSYNC
            PortPinDmm_1: PortPinId=1, PortPinName=DMMCLK
            PortPinDmm_2: PortPinId=2, PortPinName=DMMDATA0
            PortPinDmm_3: PortPinId=3, PortPinName=DMMDATA1
            PortPinDmm_4: PortPinId=4, PortPinName=DMMDATA2
            PortPinDmm_5: PortPinId=5, PortPinName=DMMDATA3
            PortPinDmm_6: PortPinId=6, PortPinName=DMMDATA4
            PortPinDmm_7: PortPinId=7, PortPinName=DMMDATA5
            PortPinDmm_8: PortPinId=8, PortPinName=DMMDATA6
            PortPinDmm_9: PortPinId=9, PortPinName=DMMDATA7
            PortPinDmm_10: PortPinId=10, PortPinName=DMMDATA8
            PortPinDmm_11: PortPinId=11, PortPinName=DMMDATA9
            PortPinDmm_12: PortPinId=12, PortPinName=DMMDATA10
            PortPinDmm_13: PortPinId=13, PortPinName=DMMDATA11
            PortPinDmm_14: PortPinId=14, PortPinName=DMMDATA12
            PortPinDmm_15: PortPinId=15, PortPinName=DMMDATA13
            PortPinDmm_16: PortPinId=16, PortPinName=DMMDATA14
            PortPinDmm_17: PortPinId=17, PortPinName=DMMDATA15
            PortPinDmm_18: PortPinId=18, PortPinName=DMMnENA
      PortDefaultSettings:
        PortUseDefaultSettings = false
        PortDefaultDirection = PORT_PIN_IN
        PortDefaultLevelValue = PORT_PIN_LEVEL_LOW
        PortDefaultOpenDrain = PORT_PUSH_PULL
        PortDefaultPullSelect = PORT_PULL_UP
        PortDefaultSlewRate = PORT_PIN_SLEW_RATE_NORMAL
      Multiplexing (PortMux):
        PortMuxName = Port Pin Multiplexing
        PortMuxNumberOfPins = 9
        PortMuxNumberOfRegs = 31
        PortMuxRegPostfix = PINMUX
        PortMuxRegBaseAddr = 4294961936
        PortUseMux = true
        PortMuxEmifClkOutput = false
        PortMuxDisableNhet2OutputByGiob2 = false
        PortMuxSelMiiOrRmii = PORT_MUX_SEL_RMII
        PortMuxSelAdcTriggerTable = PORT_MUX_SEL_ADC_TRIG_TABLE_2
        109 x PortMuxPin, all with PortMuxPinId=0, PortMuxPinNumberPackage0=-, PortMuxPinNumberPackage3=-, PortMuxPinNumberPackage4=-:
          Pin_N19_86: PortMuxPinName=AD1EVT, MII_RX_ER, RMII_RX_ER, PortMuxPinFunc=PORT_PIN_MUX_AD1EVT, PortMuxPinRegId=10, PortMuxPinRegPos=0, PortMuxPinNumberPackage1=N19, PortMuxPinNumberPackage2=86, PortMuxPinDirection=PORT_MUX_PIN_DIR_OUTPUT
          Pin_D4: PortMuxPinName=EMIF_ADDR[0], NHET2[1], PortMuxPinFunc=PORT_PIN_MUX_EMIF_ADDR_0, PortMuxPinRegId=22, PortMuxPinRegPos=0, PortMuxPinNumberPackage1=D4, PortMuxPinNumberPackage2=-, PortMuxPinDirection=PORT_MUX_PIN_DIR_OUTPUT
          Pin_D5: PortMuxPinName=EMIF_ADDR[1], NHET2[3], PortMuxPinFunc=PORT_PIN_MUX_EMIF_ADDR_1, PortMuxPinRegId=21, PortMuxPinRegPos=0, PortMuxPinNumberPackage1=D5, PortMuxPinNumberPackage2=-, PortMuxPinDirection=PORT_MUX_PIN_DIR_OUTPUT
          Pin_C8: PortMuxPinName=EMIF_ADDR[10], RTP_DATA[09], PortMuxPinFunc=PORT_PIN_MUX_EMIF_ADDR_10, PortMuxPinRegId=21, PortMuxPinRegPos=16, PortMuxPinNumberPackage1=C8, PortMuxPinNumberPackage2=-, PortMuxPinDirection=PORT_MUX_PIN_DIR_OUTPUT
          Pin_C9: PortMuxPinName=EMIF_ADDR[11], RTP_DATA[08], PortMuxPinFunc=PORT_PIN_MUX_EMIF_ADDR_11, PortMuxPinRegId=20, PortMuxPinRegPos=24, PortMuxPinNumberPackage1=C9, PortMuxPinNumberPackage2=-, PortMuxPinDirection=PORT_MUX_PIN_DIR_OUTPUT
          Pin_C10: PortMuxPinName=EMIF_ADDR[12], RTP_DATA[06], PortMuxPinFunc=PORT_PIN_MUX_EMIF_ADDR_12, PortMuxPinRegId=20, PortMuxPinRegPos=8, PortMuxPinNumberPackage1=C10, PortMuxPinNumberPackage2=-, PortMuxPinDirection=PORT_MUX_PIN_DIR_OUTPUT
          Pin_C11: PortMuxPinName=EMIF_ADDR[13], RTP_DATA[05], PortMuxPinFunc=PORT_PIN_MUX_EMIF_ADDR_13, PortMuxPinRegId=20, PortMuxPinRegPos=0, PortMuxPinNumberPackage1=C11, PortMuxPinNumberPackage2=-, PortMuxPinDirection=PORT_MUX_PIN_DIR_OUTPUT
          Pin_C12: PortMuxPinName=EMIF_ADDR[14], RTP_DATA[04], PortMuxPinFunc=PORT_PIN_MUX_EMIF_ADDR_14, PortMuxPinRegId=18, PortMuxPinRegPos=16, PortMuxPinNumberPackage1=C12, PortMuxPinNumberPackage2=-, PortMuxPinDirection=PORT_MUX_PIN_DIR_OUTPUT
          Pin_C13: PortMuxPinName=EMIF_ADDR[15], RTP_DATA[03], PortMuxPinFunc=PORT_PIN_MUX_EMIF_ADDR_15, PortMuxPinRegId=18, PortMuxPinRegPos=0, PortMuxPinNumberPackage1=C13, PortMuxPinNumberPackage2=-, PortMuxPinDirection=PORT_MUX_PIN_DIR_OUTPUT
          Pin_D14: PortMuxPinName=EMIF_ADDR[16], RTP_DATA[02], PortMuxPinFunc=PORT_PIN_MUX_EMIF_ADDR_16, PortMuxPinRegId=16, PortMuxPinRegPos=16, PortMuxPinNumberPackage1=D14, PortMuxPinNumberPackage2=-, PortMuxPinDirection=PORT_MUX_PIN_DIR_OUTPUT
          Pin_C14: PortMuxPinName=EMIF_ADDR[17], RTP_DATA[01], PortMuxPinFunc=PORT_PIN_MUX_EMIF_ADDR_17, PortMuxPinRegId=16, PortMuxPinRegPos=8, PortMuxPinNumberPackage1=C14, PortMuxPinNumberPackage2=-, PortMuxPinDirection=PORT_MUX_PIN_DIR_OUTPUT
          Pin_D15: PortMuxPinName=EMIF_ADDR[18], RTP_DATA[0], PortMuxPinFunc=PORT_PIN_MUX_EMIF_ADDR_18, PortMuxPinRegId=15, PortMuxPinRegPos=24, PortMuxPinNumberPackage1=D15, PortMuxPinNumberPackage2=-, PortMuxPinDirection=PORT_MUX_PIN_DIR_OUTPUT
          Pin_C15: PortMuxPinName=EMIF_ADDR[19], RTP_nENA, PortMuxPinFunc=PORT_PIN_MUX_EMIF_ADDR_19, PortMuxPinRegId=15, PortMuxPinRegPos=16, PortMuxPinNumberPackage1=C15, PortMuxPinNumberPackage2=-, PortMuxPinDirection=PORT_MUX_PIN_DIR_OUTPUT
          Pin_C16: PortMuxPinName=EMIF_ADDR[20], RTP_nSYNC, PortMuxPinFunc=PORT_PIN_MUX_EMIF_ADDR_20, PortMuxPinRegId=15, PortMuxPinRegPos=8, PortMuxPinNumberPackage1=C16, PortMuxPinNumberPackage2=-, PortMuxPinDirection=PORT_MUX_PIN_DIR_OUTPUT
          Pin_C17: PortMuxPinName=EMIF_ADDR[21], RTP_CLK, PortMuxPinFunc=PORT_PIN_MUX_EMIF_ADDR_21, PortMuxPinRegId=15, PortMuxPinRegPos=0, PortMuxPinNumberPackage1=C17, PortMuxPinNumberPackage2=-, PortMuxPinDirection=PORT_MUX_PIN_DIR_OUTPUT
          Pin_C4: PortMuxPinName=EMIF_ADDR[6], RTP_DATA[13], NHET2[11], PortMuxPinFunc=PORT_PIN_MUX_EMIF_ADDR_6, PortMuxPinRegId=22, PortMuxPinRegPos=16, PortMuxPinNumberPackage1=C4, PortMuxPinNumberPackage2=-, PortMuxPinDirection=PORT_MUX_PIN_DIR_OUTPUT
          Pin_C5: PortMuxPinName=EMIF_ADDR[7], RTP_DATA[12], NHET2[13], PortMuxPinFunc=PORT_PIN_MUX_EMIF_ADDR_7, PortMuxPinRegId=22, PortMuxPinRegPos=8, PortMuxPinNumberPackage1=C5, PortMuxPinNumberPackage2=-, PortMuxPinDirection=PORT_MUX_PIN_DIR_OUTPUT
          Pin_C6: PortMuxPinName=EMIF_ADDR[8], RTP_DATA[11], NHET2[15], PortMuxPinFunc=PORT_PIN_MUX_EMIF_ADDR_8, PortMuxPinRegId=23, PortMuxPinRegPos=0, PortMuxPinNumberPackage1=C6, PortMuxPinNumberPackage2=-, PortMuxPinDirection=PORT_MUX_PIN_DIR_OUTPUT
          Pin_C7: PortMuxPinName=EMIF_ADDR[9], RTP_DATA[10], PortMuxPinFunc=PORT_PIN_MUX_EMIF_ADDR_9, PortMuxPinRegId=21, PortMuxPinRegPos=24, PortMuxPinNumberPackage1=C7, PortMuxPinNumberPackage2=-, PortMuxPinDirection=PORT_MUX_PIN_DIR_OUTPUT
          Pin_D16: PortMuxPinName=EMIF_BA[1], NHET2[5], PortMuxPinFunc=PORT_PIN_MUX_EMIF_BA_1, PortMuxPinRegId=14, PortMuxPinRegPos=24, PortMuxPinNumberPackage1=D16, PortMuxPinNumberPackage2=-, PortMuxPinDirection=PORT_MUX_PIN_DIR_OUTPUT
          Pin_N17: PortMuxPinName=EMIF_nCS[0], RTP_DATA[15], NHET2[7], PortMuxPinFunc=PORT_PIN_MUX_EMIF_nCS_0, PortMuxPinRegId=10, PortMuxPinRegPos=16, PortMuxPinNumberPackage1=N17, PortMuxPinNumberPackage2=-, PortMuxPinDirection=PORT_MUX_PIN_DIR_OUTPUT
          Pin_K17: PortMuxPinName=EMIF_nCS[3], RTP_DATA[14], NHET2[9], PortMuxPinFunc=PORT_PIN_MUX_EMIF_nCS_3, PortMuxPinRegId=11, PortMuxPinRegPos=0, PortMuxPinNumberPackage1=K17, PortMuxPinNumberPackage2=-, PortMuxPinDirection=PORT_MUX_PIN_DIR_OUTPUT
          Pin_M17: PortMuxPinName=EMIF_nCS[4], RTP_DATA[07], PortMuxPinFunc=PORT_PIN_MUX_EMIF_nCS_4, PortMuxPinRegId=11, PortMuxPinRegPos=8, PortMuxPinNumberPackage1=M17, PortMuxPinNumberPackage2=-, PortMuxPinDirection=PORT_MUX_PIN_DIR_OUTPUT
          Pin_D17: PortMuxPinName=EMIF_nWE, EMIF_RNW, PortMuxPinFunc=PORT_PIN_MUX_EMIF_nWE, PortMuxPinRegId=14, PortMuxPinRegPos=16, PortMuxPinNumberPackage1=D17, PortMuxPinNumberPackage2=-, PortMuxPinDirection=PORT_MUX_PIN_DIR_OUTPUT
          Pin_D9: PortMuxPinName=ETMDATA[08], EMIF_ADDR[5], PortMuxPinFunc=PORT_PIN_MUX_ETMDATA_08, PortMuxPinRegId=17, PortMuxPinRegPos=24, PortMuxPinNumberPackage1=D9, PortMuxPinNumberPackage2=-, PortMuxPinDirection=PORT_MUX_PIN_DIR_OUTPUT
          Pin_D8: PortMuxPinName=ETMDATA[09], EMIF_ADDR[4], PortMuxPinFunc=PORT_PIN_MUX_ETMDATA_09, PortMuxPinRegId=19, PortMuxPinRegPos=0, PortMuxPinNumberPackage1=D8, PortMuxPinNumberPackage2=-, PortMuxPinDirection=PORT_MUX_PIN_DIR_OUTPUT
          Pin_D7: PortMuxPinName=ETMDATA[10], EMIF_ADDR[3], PortMuxPinFunc=PORT_PIN_MUX_ETMDATA_10, PortMuxPinRegId=19, PortMuxPinRegPos=24, PortMuxPinNumberPackage1=D7, PortMuxPinNumberPackage2=-, PortMuxPinDirection=PORT_MUX_PIN_DIR_OUTPUT
          Pin_D6: PortMuxPinName=ETMDATA[11], EMIF_ADDR[2], PortMuxPinFunc=PORT_PIN_MUX_ETMDATA_11, PortMuxPinRegId=22, PortMuxPinRegPos=24, PortMuxPinNumberPackage1=D6, PortMuxPinNumberPackage2=-, PortMuxPinDirection=PORT_MUX_PIN_DIR_OUTPUT
          Pin_D13: PortMuxPinName=ETMDATA[12], EMIF_BA[0], PortMuxPinFunc=PORT_PIN_MUX_ETMDATA_12, PortMuxPinRegId=16, PortMuxPinRegPos=0, PortMuxPinNumberPackage1=D13, PortMuxPinNumberPackage2=-, PortMuxPinDirection=PORT_MUX_PIN_DIR_OUTPUT
          Pin_D12: PortMuxPinName=ETMDATA[13], EMIF_nOE, PortMuxPinFunc=PORT_PIN_MUX_ETMDATA_13, PortMuxPinRegId=16, PortMuxPinRegPos=24, PortMuxPinNumberPackage1=D12, PortMuxPinNumberPackage2=-, PortMuxPinDirection=PORT_MUX_PIN_DIR_OUTPUT
          Pin_D11: PortMuxPinName=ETMDATA[14], EMIF_nDQM[1], PortMuxPinFunc=PORT_PIN_MUX_ETMDATA_14, PortMuxPinRegId=17, PortMuxPinRegPos=8, PortMuxPinNumberPackage1=D11, PortMuxPinNumberPackage2=-, PortMuxPinDirection=PORT_MUX_PIN_DIR_OUTPUT
          Pin_D10: PortMuxPinName=ETMDATA[15], EMIF_nDQM[0], PortMuxPinFunc=PORT_PIN_MUX_ETMDATA_15, PortMuxPinRegId=19, PortMuxPinRegPos=16, PortMuxPinNumberPackage1=D10, PortMuxPinNumberPackage2=-, PortMuxPinDirection=PORT_MUX_PIN_DIR_OUTPUT
          Pin_K15: PortMuxPinName=ETMDATA[16], EMIF_DATA[0], PortMuxPinFunc=PORT_PIN_MUX_ETMDATA_16, PortMuxPinRegId=12, PortMuxPinRegPos=8, PortMuxPinNumberPackage1=K15, PortMuxPinNumberPackage2=-, PortMuxPinDirection=PORT_MUX_PIN_DIR_OUTPUT
          Pin_L15: PortMuxPinName=ETMDATA[17], EMIF_DATA[1], PortMuxPinFunc=PORT_PIN_MUX_ETMDATA_17, PortMuxPinRegId=11, PortMuxPinRegPos=16, PortMuxPinNumberPackage1=L15, PortMuxPinNumberPackage2=-, PortMuxPinDirection=PORT_MUX_PIN_DIR_OUTPUT
          Pin_M15: PortMuxPinName=ETMDATA[18], EMIF_DATA[2], PortMuxPinFunc=PORT_PIN_MUX_ETMDATA_18, PortMuxPinRegId=10, PortMuxPinRegPos=24, PortMuxPinNumberPackage1=M15, PortMuxPinNumberPackage2=-, PortMuxPinDirection=PORT_MUX_PIN_DIR_OUTPUT
          Pin_N15: PortMuxPinName=ETMDATA[19], EMIF_DATA[3], PortMuxPinFunc=PORT_PIN_MUX_ETMDATA_19, PortMuxPinRegId=10, PortMuxPinRegPos=8, PortMuxPinNumberPackage1=N15, PortMuxPinNumberPackage2=-, PortMuxPinDirection=PORT_MUX_PIN_DIR_OUTPUT
          Pin_E4: PortMuxPinName=ETMDATA[20], EMIF_DATA[4], PortMuxPinFunc=PORT_PIN_MUX_ETMDATA_20, PortMuxPinRegId=1, PortMuxPinRegPos=16, PortMuxPinNumberPackage1=E4, PortMuxPinNumberPackage2=-, PortMuxPinDirection=PORT_MUX_PIN_DIR_OUTPUT
          Pin_F4: PortMuxPinName=ETMDATA[21], EMIF_DATA[5], PortMuxPinFunc=PORT_PIN_MUX_ETMDATA_21, PortMuxPinRegId=1, PortMuxPinRegPos=24, PortMuxPinNumberPackage1=F4, PortMuxPinNumberPackage2=-, PortMuxPinDirection=PORT_MUX_PIN_DIR_OUTPUT
          Pin_G4: PortMuxPinName=ETMDATA[22], EMIF_DATA[6], PortMuxPinFunc=PORT_PIN_MUX_ETMDATA_22, PortMuxPinRegId=2, PortMuxPinRegPos=8, PortMuxPinNumberPackage1=G4, PortMuxPinNumberPackage2=-, PortMuxPinDirection=PORT_MUX_PIN_DIR_OUTPUT
          Pin_K4: PortMuxPinName=ETMDATA[23], EMIF_DATA[7], PortMuxPinFunc=PORT_PIN_MUX_ETMDATA_23, PortMuxPinRegId=3, PortMuxPinRegPos=0, PortMuxPinNumberPackage1=K4, PortMuxPinNumberPackage2=-, PortMuxPinDirection=PORT_MUX_PIN_DIR_OUTPUT
          Pin_L4: PortMuxPinName=ETMDATA[24], EMIF_DATA[8], PortMuxPinFunc=PORT_PIN_MUX_ETMDATA_24, PortMuxPinRegId=3, PortMuxPinRegPos=24, PortMuxPinNumberPackage1=L4, PortMuxPinNumberPackage2=-, PortMuxPinDirection=PORT_MUX_PIN_DIR_OUTPUT
          Pin_M4: PortMuxPinName=ETMDATA[25], EMIF_DATA[9], PortMuxPinFunc=PORT_PIN_MUX_ETMDATA_25, PortMuxPinRegId=4, PortMuxPinRegPos=8, PortMuxPinNumberPackage1=M4, PortMuxPinNumberPackage2=-, PortMuxPinDirection=PORT_MUX_PIN_DIR_OUTPUT
          Pin_N4: PortMuxPinName=ETMDATA[26], EMIF_DATA[10], PortMuxPinFunc=PORT_PIN_MUX_ETMDATA_26, PortMuxPinRegId=5, PortMuxPinRegPos=24, PortMuxPinNumberPackage1=N4, PortMuxPinNumberPackage2=-, PortMuxPinDirection=PORT_MUX_PIN_DIR_OUTPUT
          Pin_P4: PortMuxPinName=ETMDATA[27], EMIF_DATA[11], PortMuxPinFunc=PORT_PIN_MUX_ETMDATA_27, PortMuxPinRegId=6, PortMuxPinRegPos=8, PortMuxPinNumberPackage1=P4, PortMuxPinNumberPackage2=-, PortMuxPinDirection=PORT_MUX_PIN_DIR_OUTPUT
          Pin_R5: PortMuxPinName=ETMDATA[28], EMIF_DATA[12], PortMuxPinFunc=PORT_PIN_MUX_ETMDATA_28, PortMuxPinRegId=6, PortMuxPinRegPos=24, PortMuxPinNumberPackage1=R5, PortMuxPinNumberPackage2=-, PortMuxPinDirection=PORT_MUX_PIN_DIR_OUTPUT
          Pin_R6: PortMuxPinName=ETMDATA[29], EMIF_DATA[13], PortMuxPinFunc=PORT_PIN_MUX_ETMDATA_29, PortMuxPinRegId=7, PortMuxPinRegPos=0, PortMuxPinNumberPackage1=R6, PortMuxPinNumberPackage2=-, PortMuxPinDirection=PORT_MUX_PIN_DIR_OUTPUT
          Pin_R7: PortMuxPinName=ETMDATA[30], EMIF_DATA[14], PortMuxPinFunc=PORT_PIN_MUX_ETMDATA_30, PortMuxPinRegId=7, PortMuxPinRegPos=24, PortMuxPinNumberPackage1=R7, PortMuxPinNumberPackage2=-, PortMuxPinDirection=PORT_MUX_PIN_DIR_OUTPUT
          Pin_R8: PortMuxPinName=ETMDATA[31], EMIF_DATA[15], PortMuxPinFunc=PORT_PIN_MUX_ETMDATA_31, PortMuxPinRegId=8, PortMuxPinRegPos=24, PortMuxPinNumberPackage1=R8, PortMuxPinNumberPackage2=-, PortMuxPinDirection=PORT_MUX_PIN_DIR_OUTPUT
          Pin_R9: PortMuxPinName=ETMTRACECLKIN, EXTCLKIN2, PortMuxPinFunc=PORT_PIN_MUX_ETMTRACECLKIN, PortMuxPinRegId=9, PortMuxPinRegPos=0, PortMuxPinNumberPackage1=R9, PortMuxPinNumberPackage2=-, PortMuxPinDirection=PORT_MUX_PIN_DIR_OUTPUT
          Pin_C1_9: PortMuxPinName=GIOA[2], Reserved, Reserved, NHET2[0], PortMuxPinFunc=PORT_PIN_MUX_GIOA_2, PortMuxPinRegId=2, PortMuxPinRegPos=0, PortMuxPinNumberPackage1=C1, PortMuxPinNumberPackage2=9, PortMuxPinDirection=PORT_MUX_PIN_DIR_OUTPUT
          Pin_E1: PortMuxPinName=GIOA[3], NHET2[2], PortMuxPinFunc=PORT_PIN_MUX_GIOA_3, PortMuxPinRegId=2, PortMuxPinRegPos=16, PortMuxPinNumberPackage1=E1, PortMuxPinNumberPackage2=-, PortMuxPinDirection=PORT_MUX_PIN_DIR_OUTPUT
          Pin_B5_14: PortMuxPinName=GIOA[5], EXTCLKIN, PortMuxPinFunc=PORT_PIN_MUX_GIOA_5, PortMuxPinRegId=2, PortMuxPinRegPos=24, PortMuxPinNumberPackage1=B5, PortMuxPinNumberPackage2=14, PortMuxPinDirection=PORT_MUX_PIN_DIR_OUTPUT
          Pin_H3_16: PortMuxPinName=GIOA[6], NHET2[4], PortMuxPinFunc=PORT_PIN_MUX_NHET2_4, PortMuxPinRegId=3, PortMuxPinRegPos=16, PortMuxPinNumberPackage1=H3, PortMuxPinNumberPackage2=16, PortMuxPinDirection=PORT_MUX_PIN_DIR_OUTPUT
          Pin_M1_22: PortMuxPinName=GIOA[7], NHET2[6], PortMuxPinFunc=PORT_PIN_MUX_GIOA_7, PortMuxPinRegId=4, PortMuxPinRegPos=0, PortMuxPinNumberPackage1=M1, PortMuxPinNumberPackage2=22, PortMuxPinDirection=PORT_MUX_PIN_DIR_OUTPUT
          Pin_R2_105: PortMuxPinName=MIBSPI1NCS[0], MIBSPI1SOMI[1], MII_TXD[2], PortMuxPinFunc=PORT_PIN_MUX_MIBSPI1NCS_0, PortMuxPinRegId=13, PortMuxPinRegPos=24, PortMuxPinNumberPackage1=R2, PortMuxPinNumberPackage2=105, PortMuxPinDirection=PORT_MUX_PIN_DIR_OUTPUT
          Pin_F3_130: PortMuxPinName=MIBSPI1NCS[1], NHET1[17], MII_COL, PortMuxPinFunc=PORT_PIN_MUX_MIBSPI1NCS_1, PortMuxPinRegId=20, PortMuxPinRegPos=16, PortMuxPinNumberPackage1=F3, PortMuxPinNumberPackage2=130, PortMuxPinDirection=PORT_MUX_PIN_DIR_OUTPUT
          Pin_F3_130_IN: PortMuxPinName=MIBSPI1NCS[1], NHET1[17], PortMuxPinFunc=PORT_PIN_MUX_MIBSPI1NCS_1, PortMuxPinRegId=24, PortMuxPinRegPos=16, PortMuxPinNumberPackage1=F3, PortMuxPinNumberPackage2=130, PortMuxPinDirection=PORT_MUX_PIN_DIR_INPUT
          Pin_G3_40: PortMuxPinName=MIBSPI1NCS[2], NHET1[19], MDIO, PortMuxPinFunc=PORT_PIN_MUX_MIBSPI1NCS_2, PortMuxPinRegId=8, PortMuxPinRegPos=8, PortMuxPinNumberPackage1=G3, PortMuxPinNumberPackage2=40, PortMuxPinDirection=PORT_MUX_PIN_DIR_OUTPUT
          Pin_G3_40_IN: PortMuxPinName=MIBSPI1NCS[2], NHET1[19], PortMuxPinFunc=PORT_PIN_MUX_MIBSPI1NCS_2, PortMuxPinRegId=24, PortMuxPinRegPos=24, PortMuxPinNumberPackage1=G3, PortMuxPinNumberPackage2=40, PortMuxPinDirection=PORT_MUX_PIN_DIR_INPUT
          Pin_J3: PortMuxPinName=MIBSPI1NCS[3], NHET1[21], PortMuxPinFunc=PORT_PIN_MUX_MIBSPI1NCS_3, PortMuxPinRegId=9, PortMuxPinRegPos=24, PortMuxPinNumberPackage1=J3, PortMuxPinNumberPackage2=-, PortMuxPinDirection=PORT_MUX_PIN_DIR_OUTPUT
          Pin_J3_IN: PortMuxPinName=MIBSPI1NCS[3], NHET1[21], PortMuxPinFunc=PORT_PIN_MUX_MIBSPI1NCS_3, PortMuxPinRegId=25, PortMuxPinRegPos=0, PortMuxPinNumberPackage1=J3, PortMuxPinNumberPackage2=-, PortMuxPinDirection=PORT_MUX_PIN_DIR_INPUT
          Pin_G19_96: PortMuxPinName=MIBSPI1NENA, NHET1[23], MII_RXD[2], PortMuxPinFunc=PORT_PIN_MUX_MIBSPI1NENA, PortMuxPinRegId=12, PortMuxPinRegPos=16, PortMuxPinNumberPackage1=G19, PortMuxPinNumberPackage2=96, PortMuxPinDirection=PORT_MUX_PIN_DIR_OUTPUT
          Pin_G19_96_IN: PortMuxPinName=MIBSPI1NENA, NHET1[23], PortMuxPinFunc=PORT_PIN_MUX_MIBSPI1NENA, PortMuxPinRegId=25, PortMuxPinRegPos=8, PortMuxPinNumberPackage1=G19, PortMuxPinNumberPackage2=96, PortMuxPinDirection=PORT_MUX_PIN_DIR_INPUT
          Pin_V10_55: PortMuxPinName=MIBSPI3NCS[0], AD2EVT, GIOB[2], PortMuxPinFunc=PORT_PIN_MUX_MIBSPI3NCS_0, PortMuxPinRegId=9, PortMuxPinRegPos=16, PortMuxPinNumberPackage1=V10, PortMuxPinNumberPackage2=55, PortMuxPinDirection=PORT_MUX_PIN_DIR_OUTPUT
          Pin_V10_55_IN: PortMuxPinName=MIBSPI3NCS[0], GIOB[2], PortMuxPinFunc=PORT_PIN_MUX_MIBSPI3NCS_0, PortMuxPinRegId=29, PortMuxPinRegPos=16, PortMuxPinNumberPackage1=V10, PortMuxPinNumberPackage2=55, PortMuxPinDirection=PORT_MUX_PIN_DIR_INPUT
          Pin_V5_37: PortMuxPinName=MIBSPI3NCS[1], NHET1[25], MDCLK, PortMuxPinFunc=PORT_PIN_MUX_MIBSPI3NCS_1, PortMuxPinRegId=7, PortMuxPinRegPos=8, PortMuxPinNumberPackage1=V5, PortMuxPinNumberPackage2=37, PortMuxPinDirection=PORT_MUX_PIN_DIR_OUTPUT
          Pin_V5_37_IN: PortMuxPinName=MIBSPI3NCS[1], NHET1[25], PortMuxPinFunc=PORT_PIN_MUX_MIBSPI3NCS_1, PortMuxPinRegId=25, PortMuxPinRegPos=16, PortMuxPinNumberPackage1=V5, PortMuxPinNumberPackage2=37, PortMuxPinDirection=PORT_MUX_PIN_DIR_INPUT
          Pin_B2_4: PortMuxPinName=MIBSPI3NCS[2], I2C_SDA, NHET1[27], PortMuxPinFunc=PORT_PIN_MUX_I2C_SDA, PortMuxPinRegId=0, PortMuxPinRegPos=24, PortMuxPinNumberPackage1=B2, PortMuxPinNumberPackage2=4, PortMuxPinDirection=PORT_MUX_PIN_DIR_OUTPUT
          Pin_B2_4_IN: PortMuxPinName=MIBSPI3NCS[2], NHET1[27], PortMuxPinFunc=PORT_PIN_MUX_MIBSPI3NCS_2, PortMuxPinRegId=25, PortMuxPinRegPos=24, PortMuxPinNumberPackage1=B2, PortMuxPinNumberPackage2=4, PortMuxPinDirection=PORT_MUX_PIN_DIR_INPUT
          Pin_C3_3: PortMuxPinName=MIBSPI3NCS[3], I2C_SCL, NHET1[29], PortMuxPinFunc=PORT_PIN_MUX_I2C_SCL, PortMuxPinRegId=0, PortMuxPinRegPos=16, PortMuxPinNumberPackage1=C3, PortMuxPinNumberPackage2=3, PortMuxPinDirection=PORT_MUX_PIN_DIR_OUTPUT
          Pin_C3_3_IN: PortMuxPinName=MIBSPI3NCS[3], NHET1[29], PortMuxPinFunc=PORT_PIN_MUX_MIBSPI3NCS_3, PortMuxPinRegId=26, PortMuxPinRegPos=0, PortMuxPinNumberPackage1=C3, PortMuxPinNumberPackage2=3, PortMuxPinDirection=PORT_MUX_PIN_DIR_INPUT
          Pin_W9_54: PortMuxPinName=MIBSPI3NENA, MIBSPI3NCS[5], NHET1[31], PortMuxPinFunc=PORT_PIN_MUX_MIBSPI3NENA, PortMuxPinRegId=9, PortMuxPinRegPos=8, PortMuxPinNumberPackage1=W9, PortMuxPinNumberPackage2=54, PortMuxPinDirection=PORT_MUX_PIN_DIR_OUTPUT
          Pin_W9_54_IN: PortMuxPinName=MIBSPI3NENA, NHET1[31], PortMuxPinFunc=PORT_PIN_MUX_MIBSPI3NENA, PortMuxPinRegId=26, PortMuxPinRegPos=8, PortMuxPinNumberPackage1=W9, PortMuxPinNumberPackage2=54, PortMuxPinDirection=PORT_MUX_PIN_DIR_INPUT
          Pin_H19_100: PortMuxPinName=MIBSPI5CLK, DMM_DATA[4], MII_TXEN, RMII_TXEN, PortMuxPinFunc=PORT_PIN_MUX_MIBSPI5CLK, PortMuxPinRegId=13, PortMuxPinRegPos=16, PortMuxPinNumberPackage1=H19, PortMuxPinNumberPackage2=100, PortMuxPinDirection=PORT_MUX_PIN_DIR_OUTPUT
          Pin_E19_32: PortMuxPinName=MIBSPI5NCS[0], DMM_DATA[5], PortMuxPinFunc=PORT_PIN_MUX_MIBSPI5NCS_0, PortMuxPinRegId=27, PortMuxPinRegPos=0, PortMuxPinNumberPackage1=E19, PortMuxPinNumberPackage2=32, PortMuxPinDirection=PORT_MUX_PIN_DIR_OUTPUT
          Pin_B6: PortMuxPinName=MIBSPI5NCS[1], DMM_DATA[6], PortMuxPinFunc=PORT_PIN_MUX_MIBSPI5NCS_1, PortMuxPinRegId=27, PortMuxPinRegPos=8, PortMuxPinNumberPackage1=B6, PortMuxPinNumberPackage2=-, PortMuxPinDirection=PORT_MUX_PIN_DIR_OUTPUT
          Pin_W6: PortMuxPinName=MIBSPI5NCS[2], DMM_DATA[2], PortMuxPinFunc=PORT_PIN_MUX_MIBSPI5NCS_2, PortMuxPinRegId=26, PortMuxPinRegPos=16, PortMuxPinNumberPackage1=W6, PortMuxPinNumberPackage2=-, PortMuxPinDirection=PORT_MUX_PIN_DIR_OUTPUT
          Pin_T12: PortMuxPinName=MIBSPI5NCS[3], DMM_DATA[3], PortMuxPinFunc=PORT_PIN_MUX_MIBSPI5NCS_3, PortMuxPinRegId=26, PortMuxPinRegPos=24, PortMuxPinNumberPackage1=T12, PortMuxPinNumberPackage2=-, PortMuxPinDirection=PORT_MUX_PIN_DIR_OUTPUT
          Pin_H18_97: PortMuxPinName=MIBSPI5NENA, DMM_DATA[7], MII_RXD[3], PortMuxPinFunc=PORT_PIN_MUX_MIBSPI5NENA, PortMuxPinRegId=12, PortMuxPinRegPos=24, PortMuxPinNumberPackage1=H18, PortMuxPinNumberPackage2=97, PortMuxPinDirection=PORT_MUX_PIN_DIR_OUTPUT
          Pin_J19_99: PortMuxPinName=MIBSPI5SIMO[0], DMM_DATA[8], MII_TXD[1], RMII_TXD[1], PortMuxPinFunc=PORT_PIN_MUX_MIBSPI5SIMO_0, PortMuxPinRegId=13, PortMuxPinRegPos=8, PortMuxPinNumberPackage1=J19, PortMuxPinNumberPackage2=99, PortMuxPinDirection=PORT_MUX_PIN_DIR_OUTPUT
          Pin_E16: PortMuxPinName=MIBSPI5SIMO[1], DMM_DATA[9], PortMuxPinFunc=PORT_PIN_MUX_MIBSPI5SIMO_1, PortMuxPinRegId=27, PortMuxPinRegPos=16, PortMuxPinNumberPackage1=E16, PortMuxPinNumberPackage2=-, PortMuxPinDirection=PORT_MUX_PIN_DIR_OUTPUT
          Pin_H17: PortMuxPinName=MIBSPI5SIMO[2], DMM_DATA[10], PortMuxPinFunc=PORT_PIN_MUX_MIBSPI5SIMO_2, PortMuxPinRegId=27, PortMuxPinRegPos=24, PortMuxPinNumberPackage1=H17, PortMuxPinNumberPackage2=-, PortMuxPinDirection=PORT_MUX_PIN_DIR_OUTPUT
          Pin_G17: PortMuxPinName=MIBSPI5SIMO[3], DMM_DATA[11], PortMuxPinFunc=PORT_PIN_MUX_MIBSPI5SIMO_3, PortMuxPinRegId=28, PortMuxPinRegPos=0, PortMuxPinNumberPackage1=G17, PortMuxPinNumberPackage2=-, PortMuxPinDirection=PORT_MUX_PIN_DIR_OUTPUT
          Pin_J18_98: PortMuxPinName=MIBSPI5SOMI[0], DMM_DATA[12], MII_TXD[0], RMII_TXD[0], PortMuxPinFunc=PORT_PIN_MUX_MIBSPI5SOMI_0, PortMuxPinRegId=13, PortMuxPinRegPos=0, PortMuxPinNumberPackage1=J18, PortMuxPinNumberPackage2=98, PortMuxPinDirection=PORT_MUX_PIN_DIR_OUTPUT
          Pin_E17: PortMuxPinName=MIBSPI5SOMI[1], DMM_DATA[13], PortMuxPinFunc=PORT_PIN_MUX_MIBSPI5SOMI_1, PortMuxPinRegId=28, PortMuxPinRegPos=8, PortMuxPinNumberPackage1=E17, PortMuxPinNumberPackage2=-, PortMuxPinDirection=PORT_MUX_PIN_DIR_OUTPUT
          Pin_H16: PortMuxPinName=MIBSPI5SOMI[2], DMM_DATA[14], PortMuxPinFunc=PORT_PIN_MUX_MIBSPI5SOMI_2, PortMuxPinRegId=28, PortMuxPinRegPos=16, PortMuxPinNumberPackage1=H16, PortMuxPinNumberPackage2=-, PortMuxPinDirection=PORT_MUX_PIN_DIR_OUTPUT
          Pin_G16: PortMuxPinName=MIBSPI5SOMI[3], DMM_DATA[15], PortMuxPinFunc=PORT_PIN_MUX_MIBSPI5SOMI_3, PortMuxPinRegId=28, PortMuxPinRegPos=24, PortMuxPinNumberPackage1=G16, PortMuxPinNumberPackage2=-, PortMuxPinDirection=PORT_MUX_PIN_DIR_OUTPUT
          Pin_K18_25: PortMuxPinName=NHET1[0], SPI4CLK, PortMuxPinFunc=PORT_PIN_MUX_NHET1_0, PortMuxPinRegId=5, PortMuxPinRegPos=0, PortMuxPinNumberPackage1=K18, PortMuxPinNumberPackage2=25, PortMuxPinDirection=PORT_MUX_PIN_DIR_OUTPUT
          Pin_K18_25_IN: PortMuxPinName=NHET1[0], SPI4CLK, PortMuxPinFunc=PORT_PIN_MUX_NHET1_0, PortMuxPinRegId=23, PortMuxPinRegPos=8, PortMuxPinNumberPackage1=K18, PortMuxPinNumberPackage2=25, PortMuxPinDirection=PORT_MUX_PIN_DIR_INPUT
          Pin_V2_23: PortMuxPinName=NHET1[01], SPI4NENA, NHET2[8], PortMuxPinFunc=PORT_PIN_MUX_NHET2_8, PortMuxPinRegId=4, PortMuxPinRegPos=16, PortMuxPinNumberPackage1=V2, PortMuxPinNumberPackage2=23, PortMuxPinDirection=PORT_MUX_PIN_DIR_OUTPUT
          Pin_W5_30: PortMuxPinName=NHET1[02], SPI4SIMO, PortMuxPinFunc=PORT_PIN_MUX_NHET1_02, PortMuxPinRegId=5, PortMuxPinRegPos=8, PortMuxPinNumberPackage1=W5, PortMuxPinNumberPackage2=30, PortMuxPinDirection=PORT_MUX_PIN_DIR_OUTPUT
          Pin_W5_30_IN: PortMuxPinName=NHET1[02], SPI4SIMO, PortMuxPinFunc=PORT_PIN_MUX_NHET1_02, PortMuxPinRegId=23, PortMuxPinRegPos=16, PortMuxPinNumberPackage1=W5, PortMuxPinNumberPackage2=30, PortMuxPinDirection=PORT_MUX_PIN_DIR_INPUT
          Pin_U1_24: PortMuxPinName=NHET1[03], SPI4NCS[0], NHET2[10], PortMuxPinFunc=PORT_PIN_MUX_NHET2_10, PortMuxPinRegId=4, PortMuxPinRegPos=24, PortMuxPinNumberPackage1=U1, PortMuxPinNumberPackage2=24, PortMuxPinDirection=PORT_MUX_PIN_DIR_OUTPUT
          Pin_V6_31: PortMuxPinName=NHET1[05], SPI4SOMI, NHET2[12], PortMuxPinFunc=PORT_PIN_MUX_NHET2_12, PortMuxPinRegId=5, PortMuxPinRegPos=16, PortMuxPinNumberPackage1=V6, PortMuxPinNumberPackage2=31, PortMuxPinDirection=PORT_MUX_PIN_DIR_OUTPUT
          Pin_V6_31_IN: PortMuxPinName=NHET1[05], SPI4SOMI, PortMuxPinFunc=PORT_PIN_MUX_NHET1_05, PortMuxPinRegId=23, PortMuxPinRegPos=24, PortMuxPinNumberPackage1=V6, PortMuxPinNumberPackage2=31, PortMuxPinDirection=PORT_MUX_PIN_DIR_INPUT
          Pin_W3_38: PortMuxPinName=NHET1[06], SCIRX, PortMuxPinFunc=PORT_PIN_MUX_NHET1_06, PortMuxPinRegId=7, PortMuxPinRegPos=16, PortMuxPinNumberPackage1=W3, PortMuxPinNumberPackage2=38, PortMuxPinDirection=PORT_MUX_PIN_DIR_OUTPUT
          Pin_T1_33: PortMuxPinName=NHET1[07], Reserved, Reserved, NHET2[14], PortMuxPinFunc=PORT_PIN_MUX_NHET2_14, PortMuxPinRegId=6, PortMuxPinRegPos=0, PortMuxPinNumberPackage1=T1, PortMuxPinNumberPackage2=33, PortMuxPinDirection=PORT_MUX_PIN_DIR_OUTPUT
          Pin_E18_106: PortMuxPinName=NHET1[08], MIBSPI1SIMO[1], MII_TXD[3], PortMuxPinFunc=PORT_PIN_MUX_NHET1_08, PortMuxPinRegId=14, PortMuxPinRegPos=0, PortMuxPinNumberPackage1=E18, PortMuxPinNumberPackage2=106, PortMuxPinDirection=PORT_MUX_PIN_DIR_OUTPUT
          Pin_V7_35: PortMuxPinName=NHET1[09], NHET2[16], PortMuxPinFunc=PORT_PIN_MUX_NHET1_09, PortMuxPinRegId=6, PortMuxPinRegPos=16, PortMuxPinNumberPackage1=V7, PortMuxPinNumberPackage2=35, PortMuxPinDirection=PORT_MUX_PIN_DIR_OUTPUT
          Pin_D19_118: PortMuxPinName=NHET1[10], MII_TX_CLK, Reserved, MII_TX_AVCLK4, PortMuxPinFunc=PORT_PIN_MUX_NHET1_10, PortMuxPinRegId=17, PortMuxPinRegPos=0, PortMuxPinNumberPackage1=D19, PortMuxPinNumberPackage2=118, PortMuxPinDirection=PORT_MUX_PIN_DIR_OUTPUT
          Pin_E3_6: PortMuxPinName=NHET1[11], MIBSPI3NCS[4], NHET2[18], PortMuxPinFunc=PORT_PIN_MUX_NHET2_18, PortMuxPinRegId=1, PortMuxPinRegPos=8, PortMuxPinNumberPackage1=E3, PortMuxPinNumberPackage2=6, PortMuxPinDirection=PORT_MUX_PIN_DIR_OUTPUT
          Pin_B4_124: PortMuxPinName=NHET1[12], MII_CRS, RMII_CRS_DV, PortMuxPinFunc=PORT_PIN_MUX_NHET1_12, PortMuxPinRegId=17, PortMuxPinRegPos=16, PortMuxPinNumberPackage1=B4, PortMuxPinNumberPackage2=124, PortMuxPinDirection=PORT_MUX_PIN_DIR_OUTPUT
          Pin_N2_39: PortMuxPinName=NHET1[13], SCITX, PortMuxPinFunc=PORT_PIN_MUX_NHET1_13, PortMuxPinRegId=8, PortMuxPinRegPos=0, PortMuxPinNumberPackage1=N2, PortMuxPinNumberPackage2=39, PortMuxPinDirection=PORT_MUX_PIN_DIR_OUTPUT
          Pin_N1_41: PortMuxPinName=NHET1[15], MIBSPI1NCS[4], PortMuxPinFunc=PORT_PIN_MUX_NHET1_15, PortMuxPinRegId=8, PortMuxPinRegPos=16, PortMuxPinNumberPackage1=N1, PortMuxPinNumberPackage2=41, PortMuxPinDirection=PORT_MUX_PIN_DIR_OUTPUT
          Pin_P1_91: PortMuxPinName=NHET1[24], MIBSPI1NCS[5], MII_RXD[0], RMII_RXD[0], PortMuxPinFunc=PORT_PIN_MUX_NHET1_24, PortMuxPinRegId=11, PortMuxPinRegPos=24, PortMuxPinNumberPackage1=P1, PortMuxPinNumberPackage2=91, PortMuxPinDirection=PORT_MUX_PIN_DIR_OUTPUT
          Pin_A14_92: PortMuxPinName=NHET1[26], MII_RXD[1], RMII_RXD[1], PortMuxPinFunc=PORT_PIN_MUX_NHET1_26, PortMuxPinRegId=12, PortMuxPinRegPos=0, PortMuxPinNumberPackage1=A14, PortMuxPinNumberPackage2=92, PortMuxPinDirection=PORT_MUX_PIN_DIR_OUTPUT
          Pin_K19_107: PortMuxPinName=NHET1[28], MII_RXCLK, RMII_REFCLK, MII_RX_AVCLK4, PortMuxPinFunc=PORT_PIN_MUX_NHET1_28, PortMuxPinRegId=14, PortMuxPinRegPos=8, PortMuxPinNumberPackage1=K19, PortMuxPinNumberPackage2=107, PortMuxPinDirection=PORT_MUX_PIN_DIR_OUTPUT
          Pin_B11_127: PortMuxPinName=NHET1[30], MII_RX_DV, PortMuxPinFunc=PORT_PIN_MUX_NHET1_30, PortMuxPinRegId=19, PortMuxPinRegPos=8, PortMuxPinNumberPackage1=B11, PortMuxPinNumberPackage2=127, PortMuxPinDirection=PORT_MUX_PIN_DIR_OUTPUT
          Pin_D3_54: PortMuxPinName=SPI2NENA, SPI2NCS[1], PortMuxPinFunc=PORT_PIN_MUX_SPI2NENA, PortMuxPinRegId=29, PortMuxPinRegPos=0, PortMuxPinNumberPackage1=D3, PortMuxPinNumberPackage2=54, PortMuxPinDirection=PORT_MUX_PIN_DIR_OUTPUT
    PortGeneral:
      PortDevErrorDetect = true
      PortSetPinDirectionApi = true
      PortSetPinModeApi = false
      PortVersionInfoApi = false
      PortRefreshPortDirectionApi = false
      PortCfgDoParamChk = true
      PortCfgChkUninit = true
      PortCfgChkParamPin = true
      PortCfgChkParamVinfo = true
      PortCfgChkParamConfig = true
      PortCfgDebugReporting = true
      PortErrorhook = Det_ReportError
      PortDetIncludeFile = Det.h
      PortPackageMapping0 = NA
      PortPackageMapping1 = Pin_337
      PortPackageMapping2 = Pin_144
      PortPackageMapping3 = NA
      PortPackageMapping4 = NA
      PortSpecialRegisterAccessEnabled = true
      PortSpecialRegisterAccessOnlyForWrite = true
      PortSpecialRegisterAccessOnlyForPrivilegedModeRegisters = true
      PortSpecialRegisterAccessNotInInit = false
      PortIrqHandling = SuspendAllInterrupts
  module config Wdg_internal_TMS570LS3x: definition=Wdg, implementation-config-variant=VARIANT-PRE-COMPILE, module-description=Wdg_Impl
    WdgGeneral:
      WdgDevErrorDetect = false
      WdgDemReport = false
      WdgDisableAllowed = false
      WdgVersionInfoApi = false
      WdgInternalTickCounter = true
      WdgUseOsSuspendInterrupt = true
      WdgInitialTimeout = 0.006
      WdgGlobalMemoryAppTaskRef = Ap_0
    WdgModeConfig (WdgSettingsConfig): WdgDefaultMode=WDGIF_SLOW_MODE
      WdgWindowStart: Value=0
      WdgRtiKhz: Value=80000
  module config WdgIf: implementation-config-variant=VARIANT-PRE-COMPILE, module-description=WdgIf_Impl
    Wdg_internal_TMS570LS3x (WdgIfDevice): WdgIfDeviceIndex=0, WdgIfDriverRef=WdgGeneral
    WdgIfGeneral: WdgIfDevErrorDetect=false, WdgIfDemReport=false, WdgIfVersionInfoApi=false, WdgIfInternalTickCounterRef=Wdg_internal_TMS570LS3x
  module config WdgM: implementation-config-variant=VARIANT-PRE-COMPILE, module-description=WdgM_Impl
    WdgM_Runtime (WdgMConfigSet): WdgMInitialMode=WdgMMode
      WdgMMode: WdgMExpiredSupervisionCycleTol=0, WdgMModeId=0, WdgMTicksPerSecond=1E+06, WdgMSupervisionCycle=0.004, WdgMInitialTriggerModeId=0
        7 x WdgMAliveSupervision, all with WdgMMaxMargin=0, WdgMMinMargin=0:
          SE2ms_Alive0: WdgMExpectedAliveIndications=2, WdgMSupervisionReferenceCycle=1, WdgMAliveSupervisionCheckpointRef=TmprlMon_Per1_CP0
          SE4ms_Alive0: WdgMExpectedAliveIndications=1, WdgMSupervisionReferenceCycle=1, WdgMAliveSupervisionCheckpointRef=uDiagLossOfExec_Per3_CP0
          SE10ms_Alive0: WdgMExpectedAliveIndications=2, WdgMSupervisionReferenceCycle=5, WdgMAliveSupervisionCheckpointRef=TuningSelAuth_Per1_CP0
          SE100ms_Alive0: WdgMExpectedAliveIndications=1, WdgMSupervisionReferenceCycle=25, WdgMAliveSupervisionCheckpointRef=CurrParamComp_Per2_CP0
          SE2ms_Alive1: WdgMExpectedAliveIndications=2, WdgMSupervisionReferenceCycle=1, WdgMAliveSupervisionCheckpointRef=VehPwrMd_Per1_CP1
          SE10ms_Alive1: WdgMExpectedAliveIndications=2, WdgMSupervisionReferenceCycle=5, WdgMAliveSupervisionCheckpointRef=BVDiag_Per1_CP1
          SE100ms_Alive1: WdgMExpectedAliveIndications=1, WdgMSupervisionReferenceCycle=25, WdgMAliveSupervisionCheckpointRef=ThrmlDutyCycle_Per1_CP1
        WdgMProgramFlowSupervision: WdgMGlobalCheckpointFinalRef=GlbFinal_CP0, WdgMGlobalCheckpointInitialRef=TmprlMon_Per1_CP0
          5 x WdgMGlobalTransition:
            GT_01: WdgMGlobalTransitionDestRef=StaMd8_Per1_CP0, WdgMGlobalTransitionSourceRef=StaMd_Per1_CP1
            GT_02: WdgMGlobalTransitionDestRef=BatteryVoltage_Per1_CP0, WdgMGlobalTransitionSourceRef=StabilityComp2_Per1_CP1
            GT_06: WdgMGlobalTransitionDestRef=SrlComInput_Per2_CP0, WdgMGlobalTransitionSourceRef=ShtdnMech_Per1_CP1
            GT_08: WdgMGlobalTransitionDestRef=DiagMgr8_Per_CP0, WdgMGlobalTransitionSourceRef=uDiagStaticRegs_Per_CP1
            GT_09: WdgMGlobalTransitionDestRef=CtrlTemp_Per2_CP0, WdgMGlobalTransitionSourceRef=DiagMgr8_Per_CP0
        WdgMTrigger: WdgMWatchdogMode=WDGIF_SLOW_MODE, WdgMTriggerConditionValue=6, WdgMTriggerWindowStart=2, WdgMTriggerModeId=0, WdgMTriggerWatchdogRef=WdgMWatchdog
        9 x WdgMLocalStatusParams, all with WdgMFailedSupervisionRefCycleTol=0, WdgMSupervisedEntityInitialMode=WDGM_LOCAL_STATUS_OK, WdgMFailedDeadlineRefCycleTol=0, WdgMDeadlineReferenceCycle=0, WdgMFailedProgramFlowRefCycleTol=0, WdgMProgramFlowReferenceCycle=0:
          SE2ms_{8..10}_Status: WdgMLocalStatusSupervisedEntityRef=SE2ms_{8..10}
          SE4ms_10_Status: WdgMLocalStatusSupervisedEntityRef=SE4ms_10
          SE10ms_9_Status: WdgMLocalStatusSupervisedEntityRef=SE10ms_9
          SE10ms_10_Status: WdgMLocalStatusSupervisedEntityRef=SE10ms_10
          SE100ms_{8..10}_Status: WdgMLocalStatusSupervisedEntityRef=SE100ms_{8..10}
    WdgMGeneral:
      WdgMDevErrorDetect = false
      WdgMDemReport = false
      WdgMImmediateReset = true
      WdgMOffModeEnabled = false
      WdgMVersionInfoApi = false
      WdgMDefensiveBehavior = true
      WdgMUseRte = true
      WdgMDemSupervisionReport = false
      WdgMFirstCycleAliveCounterReset = true
      WdgMUseOsSuspendInterrupt = true
      WdgMTimebaseSource = WDGM_INTERNAL_HARDWARE_TICK
      WdgMSecondResetPath = false
      WdgMTickOverrunCorrection = true
      WdgMEntityDeactivationEnabled = false
      WdgMStateChangeNotification = false
      WdgMGlobalMemoryAppTaskRef = Ap_0
      9 x WdgMSupervisedEntity, all with WdgMEnableEntityDeactivation=false, WdgMSupportedAutosarAPI=API_4_0:
        SE100ms_9: WdgMSupervisedEntityId=0, WdgMLocalCheckpointFinalRef=ThrmlDutyCycle_Per1_CP1, WdgMLocalCheckpointInitialRef=CtrlTemp_Per2_CP0, WdgMAppTaskRef=Ap_9
          CtrlTemp_Per2_CP0 (WdgMCheckpoint): WdgMCheckpointId=0
          ThrmlDutyCycle_Per1_CP1 (WdgMCheckpoint): WdgMCheckpointId=1
          LT_01 (WdgMLocalTransition): WdgMLocalTransitionDestRef=ThrmlDutyCycle_Per1_CP1, WdgMLocalTransitionSourceRef=CtrlTemp_Per2_CP0
        SE100ms_10: WdgMSupervisedEntityId=1, WdgMLocalCheckpointFinalRef=uDiagStaticRegs_Per_CP1, WdgMLocalCheckpointInitialRef=CurrParamComp_Per2_CP0, WdgMAppTaskRef=Ap_10
          CurrParamComp_Per2_CP0 (WdgMCheckpoint): WdgMCheckpointId=0
          uDiagStaticRegs_Per_CP1 (WdgMCheckpoint): WdgMCheckpointId=1
          LT_01 (WdgMLocalTransition): WdgMLocalTransitionDestRef=uDiagStaticRegs_Per_CP1, WdgMLocalTransitionSourceRef=CurrParamComp_Per2_CP0
        SE100ms_8: WdgMSupervisedEntityId=2, WdgMLocalCheckpointFinalRef=DiagMgr8_Per_CP0, WdgMLocalCheckpointInitialRef=DiagMgr8_Per_CP0, WdgMAppTaskRef=Ap_8
          DiagMgr8_Per_CP0 (WdgMCheckpoint): WdgMCheckpointId=0
        SE10ms_10: WdgMSupervisedEntityId=3, WdgMLocalCheckpointFinalRef=ShtdnMech_Per1_CP1, WdgMLocalCheckpointInitialRef=TuningSelAuth_Per1_CP0, WdgMAppTaskRef=Ap_10
          TuningSelAuth_Per1_CP0 (WdgMCheckpoint): WdgMCheckpointId=0
          ShtdnMech_Per1_CP1 (WdgMCheckpoint): WdgMCheckpointId=1
          LT_01 (WdgMLocalTransition): WdgMLocalTransitionDestRef=ShtdnMech_Per1_CP1, WdgMLocalTransitionSourceRef=TuningSelAuth_Per1_CP0
        SE10ms_9: WdgMSupervisedEntityId=4, WdgMLocalCheckpointFinalRef=BVDiag_Per1_CP1, WdgMLocalCheckpointInitialRef=SrlComInput_Per2_CP0, WdgMAppTaskRef=Ap_9
          SrlComInput_Per2_CP0 (WdgMCheckpoint): WdgMCheckpointId=0
          BVDiag_Per1_CP1 (WdgMCheckpoint): WdgMCheckpointId=1
          LT_01 (WdgMLocalTransition): WdgMLocalTransitionDestRef=BVDiag_Per1_CP1, WdgMLocalTransitionSourceRef=SrlComInput_Per2_CP0
        SE4ms_10: WdgMSupervisedEntityId=5, WdgMLocalCheckpointFinalRef=uDiagLossOfExec_Per3_CP0, WdgMLocalCheckpointInitialRef=uDiagLossOfExec_Per3_CP0, WdgMAppTaskRef=Ap_10
          uDiagLossOfExec_Per3_CP0 (WdgMCheckpoint): WdgMCheckpointId=0
        SE2ms_10: WdgMSupervisedEntityId=6, WdgMLocalCheckpointFinalRef=StaMd_Per1_CP1, WdgMLocalCheckpointInitialRef=TmprlMon_Per1_CP0, WdgMAppTaskRef=Ap_10
          3 x WdgMCheckpoint:
            TmprlMon_Per1_CP0: WdgMCheckpointId=0
            StaMd_Per1_CP1: WdgMCheckpointId=1
            GlbFinal_CP0: WdgMCheckpointId=2
          LT01 (WdgMLocalTransition): WdgMLocalTransitionDestRef=StaMd_Per1_CP1, WdgMLocalTransitionSourceRef=TmprlMon_Per1_CP0
        SE2ms_9: WdgMSupervisedEntityId=7, WdgMLocalCheckpointFinalRef=VehPwrMd_Per1_CP1, WdgMLocalCheckpointInitialRef=BatteryVoltage_Per1_CP0, WdgMAppTaskRef=Ap_9
          BatteryVoltage_Per1_CP0 (WdgMCheckpoint): WdgMCheckpointId=0
          VehPwrMd_Per1_CP1 (WdgMCheckpoint): WdgMCheckpointId=1
          LT_01 (WdgMLocalTransition): WdgMLocalTransitionDestRef=VehPwrMd_Per1_CP1, WdgMLocalTransitionSourceRef=BatteryVoltage_Per1_CP0
        SE2ms_8: WdgMSupervisedEntityId=8, WdgMLocalCheckpointFinalRef=StabilityComp2_Per1_CP1, WdgMLocalCheckpointInitialRef=StaMd8_Per1_CP0, WdgMAppTaskRef=Ap_8
          StaMd8_Per1_CP0 (WdgMCheckpoint): WdgMCheckpointId=0
          StabilityComp2_Per1_CP1 (WdgMCheckpoint): WdgMCheckpointId=1
          LT_01 (WdgMLocalTransition): WdgMLocalTransitionDestRef=StabilityComp2_Per1_CP1, WdgMLocalTransitionSourceRef=StaMd8_Per1_CP0
      WdgMWatchdog: WdgMWatchdogName=Watchdog, WdgIfDeviceRef=Wdg_internal_TMS570LS3x
      WdgMCallerIds: WdgMCallerId=0
  module config CtrlTemp: implementation-config-variant=VARIANT-POST-BUILD
    CtrlTempGeneral: CtrlTempCPEnable=CtrlTemp_Per2_CP0
    CommonPublishedInformation: ArMajorVersion=3, ArMinorVersion=2, ArPatchVersion=0, SwMajorVersion=0, SwMinorVersion=0, SwPatchVersion=0, ModuleId=0, VendorId=0
  module config VehSpdLmt: implementation-config-variant=VARIANT-POST-BUILD
    VehSpdLmtGeneral
    CommonPublishedInformation: ArMajorVersion=3, ArMinorVersion=2, ArPatchVersion=0, SwMajorVersion=0, SwMinorVersion=0, SwPatchVersion=0, ModuleId=0, VendorId=0
  module config ActivePull: implementation-config-variant=VARIANT-POST-BUILD
    ActivePullGeneral
    CommonPublishedInformation: ArMajorVersion=3, ArMinorVersion=2, ArPatchVersion=0, SwMajorVersion=0, SwMinorVersion=0, SwPatchVersion=0, ModuleId=0, VendorId=0
  module config StOpCtrl: implementation-config-variant=VARIANT-POST-BUILD
    StOpCtrlGeneral
    CommonPublishedInformation: ArMajorVersion=3, ArMinorVersion=2, ArPatchVersion=0, SwMajorVersion=0, SwMinorVersion=0, SwPatchVersion=0, ModuleId=0, VendorId=0
  module config OvrVoltMon: implementation-config-variant=VARIANT-POST-BUILD
    OvrVoltMonGeneral
    CommonPublishedInformation: ArMajorVersion=3, ArMinorVersion=2, ArPatchVersion=0, SwMajorVersion=0, SwMinorVersion=0, SwPatchVersion=0, ModuleId=0, VendorId=0
  module config ShtdnMech: implementation-config-variant=VARIANT-POST-BUILD
    ShtdnMechGeneral: ShtdnMechCPEnable=ShtdnMech_Per1_CP1
    CommonPublishedInformation: ArMajorVersion=3, ArMinorVersion=2, ArPatchVersion=0, SwMajorVersion=0, SwMinorVersion=0, SwPatchVersion=0, ModuleId=0, VendorId=0
  module config HiLoadStall: implementation-config-variant=VARIANT-POST-BUILD
    HiLoadStallGeneral
    CommonPublishedInformation: ArMajorVersion=3, ArMinorVersion=2, ArPatchVersion=0, SwMajorVersion=0, SwMinorVersion=0, SwPatchVersion=0, ModuleId=0, VendorId=0
  module config WhlImbRej: implementation-config-variant=VARIANT-POST-BUILD
    WhlImbRejGeneral
    CommonPublishedInformation: ArMajorVersion=3, ArMinorVersion=2, ArPatchVersion=0, SwMajorVersion=0, SwMinorVersion=0, SwPatchVersion=0, ModuleId=0, VendorId=0
  module config WIRInputQual: implementation-config-variant=VARIANT-POST-BUILD
    WIRInputQualGeneral
    CommonPublishedInformation: ArMajorVersion=3, ArMinorVersion=2, ArPatchVersion=0, SwMajorVersion=0, SwMinorVersion=0, SwPatchVersion=0, ModuleId=0, VendorId=0
  module config FrqDepDmpnInrtCmp: implementation-config-variant=VARIANT-POST-BUILD
    FrqDepDmpnInrtCmpGeneral
    CommonPublishedInformation: ArMajorVersion=3, ArMinorVersion=2, ArPatchVersion=0, SwMajorVersion=0, SwMinorVersion=0, SwPatchVersion=0, ModuleId=0, VendorId=0
  module config TrqCanc: implementation-config-variant=VARIANT-POST-BUILD
    TrqCancGeneral
    CommonPublishedInformation: ArMajorVersion=3, ArMinorVersion=2, ArPatchVersion=0, SwMajorVersion=0, SwMinorVersion=0, SwPatchVersion=0, ModuleId=0, VendorId=0
  module config PICurrCntrl: implementation-config-variant=VARIANT-POST-BUILD
    PICurrCntrlGeneral
    CommonPublishedInformation: ArMajorVersion=3, ArMinorVersion=2, ArPatchVersion=0, SwMajorVersion=0, SwMinorVersion=0, SwPatchVersion=0, ModuleId=0, VendorId=0
  module config StabilityComp2: implementation-config-variant=VARIANT-POST-BUILD
    StabilityComp2General: StabilityComp2CPEnable=StabilityComp2_Per1_CP1
    CommonPublishedInformation: ArMajorVersion=3, ArMinorVersion=2, ArPatchVersion=0, SwMajorVersion=0, SwMinorVersion=0, SwPatchVersion=0, ModuleId=0, VendorId=0
  module config TmprlMon2: implementation-config-variant=VARIANT-POST-BUILD
    TmprlMon2General
    CommonPublishedInformation: ArMajorVersion=3, ArMinorVersion=2, ArPatchVersion=0, SwMajorVersion=0, SwMinorVersion=0, SwPatchVersion=0, ModuleId=0, VendorId=0
  module config DigPhsReasDiag: implementation-config-variant=VARIANT-POST-BUILD
    DigPhsReasDiagGeneral: NHETFREQUENCY_HZ=80000000, MAXPWMFREQ_HZ=18000
    CommonPublishedInformation: ArMajorVersion=3, ArMinorVersion=2, ArPatchVersion=0, SwMajorVersion=0, SwMinorVersion=0, SwPatchVersion=0, ModuleId=0, VendorId=0
  module config HighFreqAssist: implementation-config-variant=VARIANT-PRE-COMPILE
    HighFreqAssistGeneral
    CommonPublishedInformation: ArMajorVersion=3, ArMinorVersion=2, ArPatchVersion=0, SwMajorVersion=0, SwMinorVersion=0, SwPatchVersion=0, ModuleId=0, VendorId=0
  module config SignlCondn: implementation-config-variant=VARIANT-POST-BUILD
    SignlCondnGeneral
    CommonPublishedInformation: ArMajorVersion=3, ArMinorVersion=2, ArPatchVersion=0, SwMajorVersion=0, SwMinorVersion=0, SwPatchVersion=0, ModuleId=0, VendorId=0
  module config NvMProxy: implementation-config-variant=VARIANT-PRE-COMPILE
    NvMProxyConfigSet
      15 x NvMProxyBlock, all with ROMDefault_Or_NotificationFunction_Symbol=NULL_PTR:
        ShCurrCal: NvmRamBlockDataAddressSecure=Rte_CmMtrCurr_ShCurrCal, InitBlockHandling=None, InitCheckFailResponse=N/A, NvMRamGlobalShared=false, NvmBlockDescriptorRef=Rte_NvmBlock_CmMtrCurr_ShCurrCal
        TorqueCmdSF: NvmRamBlockDataAddressSecure=Rte_TrqCmdScl_TorqueCmdSF_Uls_f32, InitBlockHandling=None, InitCheckFailResponse=N/A, NvMRamGlobalShared=false, NvmBlockDescriptorRef=Rte_NvmBlock_TrqCmdScl_TorqueCmdSF_Uls_f32
        Polarity: NvmRamBlockDataAddressSecure=Rte_Polarity_Polarity_Cnt_Str, InitBlockHandling=None, InitCheckFailResponse=N/A, NvMRamGlobalShared=false, NvmBlockDescriptorRef=Rte_NvmBlock_Polarity_Polarity_Cnt_Str
        CloseCheckData: NvmRamBlockDataAddressSecure=CloseCheck_Cnt_u32, InitBlockHandling=None, InitCheckFailResponse=N/A, NvMRamGlobalShared=true, NvmBlockDescriptorRef=NVM_BLOCK_STAMD_CLOSECHECK
        TypeHRamBuffer: NvmRamBlockDataAddressSecure=TypeHData_Cnt_u08, InitBlockHandling=None, InitCheckFailResponse=N/A, NvMRamGlobalShared=false, NvmBlockDescriptorRef=NVM_BLOCK_STAMD_TYPEH
        CogTrqCal: NvmRamBlockDataAddressSecure=Rte_Ap_TrqCanc_CogTrqCal, InitBlockHandling=None, InitCheckFailResponse=N/A, NvMRamGlobalShared=false, NvmBlockDescriptorRef=Rte_NvmBlock_Ap_TrqCanc_CogTrqCal
        EOLNomMtrParam: NvmRamBlockDataAddressSecure=Rte_CurrParamComp_EOLNomMtrParam, InitBlockHandling=None, InitCheckFailResponse=N/A, NvMRamGlobalShared=false, NvmBlockDescriptorRef=Rte_NvmBlock_CurrParamComp_EOLNomMtrParam
        DigTrqTrim: NvmRamBlockDataAddressSecure=Rte_Sa_DigHwTrqSENT_DigTrqTrim, InitBlockHandling=CRC16, InitCheckFailResponse=SetNTC_0x0A, NvMRamGlobalShared=false, NvmBlockDescriptorRef=Rte_NvmBlock_Sa_DigHwTrqSENT_DigTrqTrim
        DigMSBEOLData: NvmRamBlockDataAddressSecure=Rte_Sa_DigMSB_DigMSBEOLData, InitBlockHandling=None, InitCheckFailResponse=N/A, NvMRamGlobalShared=false, NvmBlockDescriptorRef=Rte_NvmBlock_Sa_DigMSB_DigMSBEOLData
        DigColPsEOL: NvmRamBlockDataAddressSecure=Rte_DigColPs_DigColPsEOL, InitBlockHandling=None, InitCheckFailResponse=N/A, NvMRamGlobalShared=false, NvmBlockDescriptorRef=Rte_NvmBlock_DigColPs_DigColPsEOL
        CogTrqRplComp: NvmRamBlockDataAddressSecure=Rte_Ap_TrqCanc_CogTrqRplComp, InitBlockHandling=None, InitCheckFailResponse=N/A, NvMRamGlobalShared=false, NvmBlockDescriptorRef=Rte_NvmBlock_Ap_TrqCanc_CogTrqRplComp
        SteerAsstDefeat: NvmRamBlockDataAddressSecure=Rte_Ap_AstLmt_SteerAsstDefeat, InitBlockHandling=None, InitCheckFailResponse=N/A, NvMRamGlobalShared=false, NvmBlockDescriptorRef=Rte_NvmBlock_Ap_AstLmt_SteerAsstDefeat
        TSMitDisableEOL: NvmRamBlockDataAddressSecure=Rte_Ap_TSMit_TSMitDisableEOL, InitBlockHandling=None, InitCheckFailResponse=N/A, NvMRamGlobalShared=false, NvmBlockDescriptorRef=Rte_NvmBlock_Ap_TSMit_TSMitDisableEOL
        TSMitGailLrn: NvmRamBlockDataAddressSecure=Rte_Ap_TSMit_TSMitGainLrn, InitBlockHandling=None, InitCheckFailResponse=N/A, NvMRamGlobalShared=false, NvmBlockDescriptorRef=Rte_NvmBlock_Ap_TSMit_TSMitGainLrn
        VehDynMtrPosReset: NvmRamBlockDataAddressSecure=Rte_VehDyn_MotPosReset, InitBlockHandling=None, InitCheckFailResponse=N/A, NvMRamGlobalShared=false, NvmBlockDescriptorRef=Rte_NvmBlock_VehDyn_MotPosReset
    NvMProxyGeneral: NvMProxyIncludes=Ap_StaMd_Cfg.h, FailureAPI=NxtrDiagMgr10_ReportNTCStatus, NvMProxyDevErrorDetect=false
    CommonPublishedInformation: ArMajorVersion=1, ArMinorVersion=2, ArPatchVersion=0, SwMajorVersion=1, SwMinorVersion=0, SwPatchVersion=0, ModuleId=104, VendorId=0
  module config ApXcp: implementation-config-variant=VARIANT-PRE-COMPILE
    XcpGeneral: ExternalEEPROMAccess=STD_OFF, XcpIncludes=Lnk_Symbols.h, XcpIncludes=NtWrap.h, XcpRteEvents=XcpEventChannel_2ms_DAQ_2
    XcpMemoryAccess
      Ram (InternalMemoryRng): IntMemRngLow=134217728, IntMemRngHigh=134348799
      FLASH (InternalMemoryRng): IntMemRngLow=0, IntMemRngHigh=786431
      EEPROM (ExternalMemoryRng): ExtMemRngLow=0, ExtMemRngHigh=8191
    RamCopy
    TuneOnTheFly: TuneOnTheFlySupport=STD_ON, RamBlockSize=4096, TuneOnTheFlyIncludes=CalConstants.h
      Seg0_Pers: Seg0Enable=STD_ON, MaxPerCopy=1, CalConstNumOfPerSymbol=D_NUMOFPERS_CNT_U16, TuneOnTheFlyPersLkup=STD_OFF
      Seg1_Sets: Seg1Enable=STD_ON, MaxSetCopy=1, CalConstNumOfSetSymbol=D_NUMOFTUNSETS_CNT_U16, TuneOnTheFlySetLkup=STD_OFF
      Seg2_Common: Seg2Enable=STD_OFF
      Seg3_SetAndPer: Seg3Enable=STD_OFF
      Seg4_SetAndPerAndCommon: Seg4Enable=STD_OFF
    CommonPublishedInformation: ArMajorVersion=3, ArMinorVersion=2, ArPatchVersion=0, SwMajorVersion=0, SwMinorVersion=0, SwPatchVersion=0, ModuleId=0, VendorId=0
  module config CustPerSrvcs: implementation-config-variant=VARIANT-PRE-COMPILE
    CustPerSrvcsGeneral
    CommonPublishedInformation: ArMajorVersion=3, ArMinorVersion=2, ArPatchVersion=0, SwMajorVersion=0, SwMinorVersion=0, SwPatchVersion=0, ModuleId=0, VendorId=0
  module config NvMMgr: implementation-config-variant=VARIANT-POST-BUILD
    NvMMgrGeneral: EcuStartupApp=Ap_9, NvMandMemIfApp=Ap_9
    CommonPublishedInformation: ArMajorVersion=3, ArMinorVersion=2, ArPatchVersion=0, SwMajorVersion=0, SwMinorVersion=0, SwPatchVersion=0, ModuleId=0, VendorId=0
  module config BkCpPc: implementation-config-variant=VARIANT-PRE-COMPILE
    BkCpPcGeneral: BkCpPcPwrDiscConfiguration=1
    CommonPublishedInformation: ArMajorVersion=3, ArMinorVersion=2, ArPatchVersion=0, SwMajorVersion=0, SwMinorVersion=0, SwPatchVersion=0, ModuleId=0, VendorId=0
  module config EtDmpFw: implementation-config-variant=VARIANT-PRE-COMPILE
    EtDmpFwGeneral
    CommonPublishedInformation: ArMajorVersion=3, ArMinorVersion=2, ArPatchVersion=0, SwMajorVersion=0, SwMinorVersion=0, SwPatchVersion=0, ModuleId=0, VendorId=0
  module config ReturnFirewall: implementation-config-variant=VARIANT-PRE-COMPILE
    ReturnFirewallGeneral
    CommonPublishedInformation: ArMajorVersion=3, ArMinorVersion=2, ArPatchVersion=0, SwMajorVersion=0, SwMinorVersion=0, SwPatchVersion=0, ModuleId=0, VendorId=0
  module config DigHwTrqSENT: implementation-config-variant=VARIANT-PRE-COMPILE
    DigHwTrqSENTGeneral
    CommonPublishedInformation: ArMajorVersion=3, ArMinorVersion=2, ArPatchVersion=0, SwMajorVersion=0, SwMinorVersion=0, SwPatchVersion=0, ModuleId=0, VendorId=0
  module config DigMSB: implementation-config-variant=VARIANT-PRE-COMPILE
    DigMSBGeneral
    CommonPublishedInformation: ArMajorVersion=3, ArMinorVersion=2, ArPatchVersion=0, SwMajorVersion=0, SwMinorVersion=0, SwPatchVersion=0, ModuleId=0, VendorId=0
  module config DigMSBSigCorr: implementation-config-variant=VARIANT-PRE-COMPILE  # Configuration of the Nexteer DigMSBSigCorr module.
    DigMSBSigCorrGeneral
    CommonPublishedInformation: ArMajorVersion=3, ArMinorVersion=2, ArPatchVersion=0, SwMajorVersion=0, SwMinorVersion=0, SwPatchVersion=0, ModuleId=0, VendorId=0
  module config MtrVel: implementation-config-variant=VARIANT-PRE-COMPILE
    MtrVelGeneral
    CommonPublishedInformation: ArMajorVersion=3, ArMinorVersion=2, ArPatchVersion=0, SwMajorVersion=0, SwMinorVersion=0, SwPatchVersion=0, ModuleId=0, VendorId=0
  module config MtrVel2: implementation-config-variant=VARIANT-PRE-COMPILE
    MtrVel2General
    CommonPublishedInformation: ArMajorVersion=3, ArMinorVersion=2, ArPatchVersion=0, SwMajorVersion=0, SwMinorVersion=0, SwPatchVersion=0, ModuleId=0, VendorId=0
  module config SpiNxt: implementation-config-variant=VARIANT-PRE-COMPILE
    SpiNxtGeneral: SpiNxtUseWith=D_SPINXT_USEWITHDIGMSB, SpiNxtUseDMA=STD_ON
  module config AbsHwPos: implementation-config-variant=VARIANT-PRE-COMPILE
    AbsHwPosGeneral
    CommonPublishedInformation: ArMajorVersion=3, ArMinorVersion=2, ArPatchVersion=0, SwMajorVersion=0, SwMinorVersion=0, SwPatchVersion=0, ModuleId=0, VendorId=0
  module config VehDyn: implementation-config-variant=VARIANT-PRE-COMPILE
    VehDynGeneral
    CommonPublishedInformation: ArMajorVersion=3, ArMinorVersion=2, ArPatchVersion=0, SwMajorVersion=0, SwMinorVersion=0, SwPatchVersion=0, ModuleId=0, VendorId=0
  module config ComplErr: implementation-config-variant=VARIANT-PRE-COMPILE
    ComplErrGeneral
    CommonPublishedInformation: ArMajorVersion=3, ArMinorVersion=2, ArPatchVersion=0, SwMajorVersion=0, SwMinorVersion=0, SwPatchVersion=0, ModuleId=0, VendorId=0
  module config DigColPs: implementation-config-variant=VARIANT-PRE-COMPILE
    DigColPsGeneral
    CommonPublishedInformation: ArMajorVersion=3, ArMinorVersion=2, ArPatchVersion=0, SwMajorVersion=0, SwMinorVersion=0, SwPatchVersion=0, ModuleId=0, VendorId=0
  module config Sweep: implementation-config-variant=VARIANT-PRE-COMPILE
    SweepGeneral
    CommonPublishedInformation: ArMajorVersion=3, ArMinorVersion=2, ArPatchVersion=0, SwMajorVersion=0, SwMinorVersion=0, SwPatchVersion=0, ModuleId=0, VendorId=0
  module config Sweep2: implementation-config-variant=VARIANT-PRE-COMPILE
    Sweep2General
    CommonPublishedInformation: ArMajorVersion=3, ArMinorVersion=2, ArPatchVersion=0, SwMajorVersion=0, SwMinorVersion=0, SwPatchVersion=0, ModuleId=0, VendorId=0
  module config TrqArblim: implementation-config-variant=VARIANT-PRE-COMPILE
    TrqArblimGeneral
    CommonPublishedInformation: ArMajorVersion=3, ArMinorVersion=2, ArPatchVersion=0, SwMajorVersion=0, SwMinorVersion=0, SwPatchVersion=0, ModuleId=0, VendorId=0
  module config TrqOvlSta: implementation-config-variant=VARIANT-PRE-COMPILE
    TrqOvlStaGeneral
    CommonPublishedInformation: ArMajorVersion=3, ArMinorVersion=2, ArPatchVersion=0, SwMajorVersion=0, SwMinorVersion=0, SwPatchVersion=0, ModuleId=0, VendorId=0
  module config HOWDetect: implementation-config-variant=VARIANT-POST-BUILD
    HOWDetectGeneral
    CommonPublishedInformation: ArMajorVersion=3, ArMinorVersion=2, ArPatchVersion=0, SwMajorVersion=0, SwMinorVersion=0, SwPatchVersion=0, ModuleId=0, VendorId=0
  module config PosServo: implementation-config-variant=VARIANT-POST-BUILD
    PosServoGeneral
    CommonPublishedInformation: ArMajorVersion=3, ArMinorVersion=2, ArPatchVersion=0, SwMajorVersion=0, SwMinorVersion=0, SwPatchVersion=0, ModuleId=0, VendorId=0
  module config TrqOsc: implementation-config-variant=VARIANT-POST-BUILD
    TrqOscGeneral
    CommonPublishedInformation: ArMajorVersion=3, ArMinorVersion=2, ArPatchVersion=0, SwMajorVersion=0, SwMinorVersion=0, SwPatchVersion=0, ModuleId=0, VendorId=0
  module config StrtStop: implementation-config-variant=VARIANT-POST-BUILD
    StrtStopGeneral
    CommonPublishedInformation: ArMajorVersion=3, ArMinorVersion=2, ArPatchVersion=0, SwMajorVersion=0, SwMinorVersion=0, SwPatchVersion=0, ModuleId=0, VendorId=0
  module config TSMit: implementation-config-variant=VARIANT-POST-BUILD
    TSMitGeneral
    CommonPublishedInformation: ArMajorVersion=3, ArMinorVersion=2, ArPatchVersion=0, SwMajorVersion=0, SwMinorVersion=0, SwPatchVersion=0, ModuleId=0, VendorId=0
  module config GenPosTraj: implementation-config-variant=VARIANT-POST-BUILD
    GenPosTrajGeneral
    CommonPublishedInformation: ArMajorVersion=3, ArMinorVersion=2, ArPatchVersion=0, SwMajorVersion=0, SwMinorVersion=0, SwPatchVersion=0, ModuleId=0, VendorId=0
