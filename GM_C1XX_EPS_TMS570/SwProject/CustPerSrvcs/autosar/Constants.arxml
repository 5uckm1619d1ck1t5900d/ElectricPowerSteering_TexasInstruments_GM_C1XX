AUTOSAR XML (schema 314)
package /Constant
  constant specification D_ZERO_CNT_U8
    value:
      integer literal D_ZERO_CNT_U8: type=UInt8, value=0
