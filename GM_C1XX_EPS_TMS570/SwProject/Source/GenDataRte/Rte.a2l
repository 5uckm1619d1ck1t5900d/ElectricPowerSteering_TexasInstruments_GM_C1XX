/*
COPYRIGHT
Copyright (c) 2006-2011 by Vector Informatik GmbH. All rights reserved.
This software is copyright protected and proprietary to Vector Informatik GmbH.
Vector Informatik GmbH grants to you only those rights as set out in the license conditions.
License:  License CBD1010124 valid for CBD1010124 Nexteer  Package: BMW MSR SIP BAC3.0 Micro: TI TMS570 TMS570LS30306  Compiler: Code Composer Studio 4.9.0
*/
/begin MEASUREMENT CmMtrCurr.ADCMtrCurr2.Volts_f32 "MICROSAR RTE" FLOAT32_IEEE NO_COMPU_METHOD 0 0 1.175494351e-38 3.402823466e+38 ECU_ADDRESS 0 SYMBOL_LINK "Rte_CDDInterface_ADCMtrCurr2_Volts_f32" 0 DISPLAY_IDENTIFIER CmMtrCurr.ReceiverPorts.ADCMtrCurr2.Volts_f32 /end MEASUREMENT
/begin MEASUREMENT CmMtrCurr.ComOffset.Cnt_u16 "MICROSAR RTE" UWORD NO_COMPU_METHOD 0 0 0 65535 ECU_ADDRESS 0 SYMBOL_LINK "Rte_CmMtrCurr_ComOffset_Cnt_u16" 0 DISPLAY_IDENTIFIER CmMtrCurr.SenderPorts.ComOffset.Cnt_u16 /end MEASUREMENT
/begin MEASUREMENT CmMtrCurr.CorrMtrCurrPosition.Rev_f32 "MICROSAR RTE" FLOAT32_IEEE NO_COMPU_METHOD 0 0 1.175494351e-38 3.402823466e+38 ECU_ADDRESS 0 SYMBOL_LINK "Rte_CDDInterface_CorrMtrCurrPosition_Rev_f32" 0 DISPLAY_IDENTIFIER CmMtrCurr.ReceiverPorts.CorrMtrCurrPosition.Rev_f32 /end MEASUREMENT
/begin MEASUREMENT CmMtrCurr.CurrTempOffset.CurrOffsetY1_Volts_s4p11 "MICROSAR RTE" SWORD NO_COMPU_METHOD 0 0 -32768 32767 MATRIX_DIM 16 1 1 ECU_ADDRESS 0 SYMBOL_LINK "Rte_CmMtrCurr_CurrTempOffset.CurrOffsetY1_Volts_s4p11" 0 DISPLAY_IDENTIFIER CmMtrCurr.PerInstanceMemories.CurrTempOffset.CurrOffsetY1_Volts_s4p11 READ_WRITE /end MEASUREMENT
/begin MEASUREMENT CmMtrCurr.CurrTempOffset.CurrOffsetY2_Volts_s4p11 "MICROSAR RTE" SWORD NO_COMPU_METHOD 0 0 -32768 32767 MATRIX_DIM 16 1 1 ECU_ADDRESS 0 SYMBOL_LINK "Rte_CmMtrCurr_CurrTempOffset.CurrOffsetY2_Volts_s4p11" 0 DISPLAY_IDENTIFIER CmMtrCurr.PerInstanceMemories.CurrTempOffset.CurrOffsetY2_Volts_s4p11 READ_WRITE /end MEASUREMENT
/begin MEASUREMENT CmMtrCurr.CurrTempOffset.CurrTempOffsetX_DegC_s10p5 "MICROSAR RTE" SWORD NO_COMPU_METHOD 0 0 -32768 32767 MATRIX_DIM 16 1 1 ECU_ADDRESS 0 SYMBOL_LINK "Rte_CmMtrCurr_CurrTempOffset.CurrTempOffsetX_DegC_s10p5" 0 DISPLAY_IDENTIFIER CmMtrCurr.PerInstanceMemories.CurrTempOffset.CurrTempOffsetX_DegC_s10p5 READ_WRITE /end MEASUREMENT
/begin MEASUREMENT CmMtrCurr.CurrentGainSvc.Cnt_lgc "MICROSAR RTE" UBYTE RTE_CM_BOOLEAN 0 0 0 255 ECU_ADDRESS 0 SYMBOL_LINK "Rte_CmMtrCurr_CurrentGainSvc_Cnt_lgc" 0 DISPLAY_IDENTIFIER CmMtrCurr.SenderPorts.CurrentGainSvc.Cnt_lgc /end MEASUREMENT
/begin MEASUREMENT CmMtrCurr.FiltCntrlTemp.DegC_f32 "MICROSAR RTE" FLOAT32_IEEE NO_COMPU_METHOD 0 0 1.175494351e-38 3.402823466e+38 ECU_ADDRESS 0 SYMBOL_LINK "Rte_CtrlTemp_FiltMeasTemp_DegC_f32" 0 DISPLAY_IDENTIFIER CmMtrCurr.ReceiverPorts.FiltCntrlTemp.DegC_f32 /end MEASUREMENT
/begin MEASUREMENT CmMtrCurr.MEC.Cnt_enum "MICROSAR RTE" UBYTE RTE_CM_ENUM_ManufModeType 0 0 0 2 ECU_ADDRESS 0 SYMBOL_LINK "Rte_CDDInterface_MEC_Cnt_enum" 0 DISPLAY_IDENTIFIER CmMtrCurr.ReceiverPorts.MEC.Cnt_enum /end MEASUREMENT
/begin MEASUREMENT CmMtrCurr.MtrCurr1TempOffset.Volt_f32 "This signal is intended to communicate any type voltage signal measured by the ecu.  This signal has a lower limit of 0 which reequires users of the signal to provide divide by 0 protection if it is used as a denominator in a calculation.  See Vecu port p" FLOAT32_IEEE NO_COMPU_METHOD 0 0 1.175494351e-38 3.402823466e+38 ECU_ADDRESS 0 SYMBOL_LINK "Rte_CmMtrCurr_MtrCurr1TempOffset_Volt_f32" 0 DISPLAY_IDENTIFIER CmMtrCurr.SenderPorts.MtrCurr1TempOffset.Volt_f32 /end MEASUREMENT
/begin MEASUREMENT CmMtrCurr.MtrCurr2TempOffset.Volt_f32 "This signal is intended to communicate any type voltage signal measured by the ecu.  This signal has a lower limit of 0 which reequires users of the signal to provide divide by 0 protection if it is used as a denominator in a calculation.  See Vecu port p" FLOAT32_IEEE NO_COMPU_METHOD 0 0 1.175494351e-38 3.402823466e+38 ECU_ADDRESS 0 SYMBOL_LINK "Rte_CmMtrCurr_MtrCurr2TempOffset_Volt_f32" 0 DISPLAY_IDENTIFIER CmMtrCurr.SenderPorts.MtrCurr2TempOffset.Volt_f32 /end MEASUREMENT
/begin MEASUREMENT CmMtrCurr.MtrCurrAngle.Rev_f32 "MICROSAR RTE" FLOAT32_IEEE NO_COMPU_METHOD 0 0 1.175494351e-38 3.402823466e+38 ECU_ADDRESS 0 SYMBOL_LINK "Rte_CurrCmd_MtrCurrAngle_Rev_f32" 0 DISPLAY_IDENTIFIER CmMtrCurr.ReceiverPorts.MtrCurrAngle.Rev_f32 /end MEASUREMENT
/begin MEASUREMENT CmMtrCurr.MtrCurrK1.Amp_f32 "MICROSAR RTE" FLOAT32_IEEE NO_COMPU_METHOD 0 0 1.175494351e-38 3.402823466e+38 ECU_ADDRESS 0 SYMBOL_LINK "Rte_CDDInterface_MtrCurrK1_Amp_f32" 0 DISPLAY_IDENTIFIER CmMtrCurr.ReceiverPorts.MtrCurrK1.Amp_f32 /end MEASUREMENT
/begin MEASUREMENT CmMtrCurr.MtrCurrK2.Amp_f32 "MICROSAR RTE" FLOAT32_IEEE NO_COMPU_METHOD 0 0 1.175494351e-38 3.402823466e+38 ECU_ADDRESS 0 SYMBOL_LINK "Rte_CDDInterface_MtrCurrK2_Amp_f32" 0 DISPLAY_IDENTIFIER CmMtrCurr.ReceiverPorts.MtrCurrK2.Amp_f32 /end MEASUREMENT
/begin MEASUREMENT CmMtrCurr.MtrVel.MtrRadpS_f32 "MICROSAR RTE" FLOAT32_IEEE NO_COMPU_METHOD 0 0 1.175494351e-38 3.402823466e+38 ECU_ADDRESS 0 SYMBOL_LINK "Rte_Sa_MtrVel_MotorVelMRF_MtrRadpS_f32" 0 DISPLAY_IDENTIFIER CmMtrCurr.ReceiverPorts.MtrVel.MtrRadpS_f32 /end MEASUREMENT
/begin MEASUREMENT CmMtrCurr.ShCurrCal.EOLMtrCurr1OffsetDiff_Volts_f32 "MICROSAR RTE" FLOAT32_IEEE NO_COMPU_METHOD 0 0 1.175494351e-38 3.402823466e+38 ECU_ADDRESS 0 SYMBOL_LINK "Rte_CmMtrCurr_ShCurrCal.EOLMtrCurr1OffsetDiff_Volts_f32" 0 DISPLAY_IDENTIFIER CmMtrCurr.PerInstanceMemories.ShCurrCal.EOLMtrCurr1OffsetDiff_Volts_f32 READ_WRITE /end MEASUREMENT
/begin MEASUREMENT CmMtrCurr.ShCurrCal.EOLMtrCurr1OffsetLo_Volts_f32 "MICROSAR RTE" FLOAT32_IEEE NO_COMPU_METHOD 0 0 1.175494351e-38 3.402823466e+38 ECU_ADDRESS 0 SYMBOL_LINK "Rte_CmMtrCurr_ShCurrCal.EOLMtrCurr1OffsetLo_Volts_f32" 0 DISPLAY_IDENTIFIER CmMtrCurr.PerInstanceMemories.ShCurrCal.EOLMtrCurr1OffsetLo_Volts_f32 READ_WRITE /end MEASUREMENT
/begin MEASUREMENT CmMtrCurr.ShCurrCal.EOLMtrCurr2OffsetDiff_Volts_f32 "MICROSAR RTE" FLOAT32_IEEE NO_COMPU_METHOD 0 0 1.175494351e-38 3.402823466e+38 ECU_ADDRESS 0 SYMBOL_LINK "Rte_CmMtrCurr_ShCurrCal.EOLMtrCurr2OffsetDiff_Volts_f32" 0 DISPLAY_IDENTIFIER CmMtrCurr.PerInstanceMemories.ShCurrCal.EOLMtrCurr2OffsetDiff_Volts_f32 READ_WRITE /end MEASUREMENT
/begin MEASUREMENT CmMtrCurr.ShCurrCal.EOLMtrCurr2OffsetLo_Volts_f32 "MICROSAR RTE" FLOAT32_IEEE NO_COMPU_METHOD 0 0 1.175494351e-38 3.402823466e+38 ECU_ADDRESS 0 SYMBOL_LINK "Rte_CmMtrCurr_ShCurrCal.EOLMtrCurr2OffsetLo_Volts_f32" 0 DISPLAY_IDENTIFIER CmMtrCurr.PerInstanceMemories.ShCurrCal.EOLMtrCurr2OffsetLo_Volts_f32 READ_WRITE /end MEASUREMENT
/begin MEASUREMENT CmMtrCurr.ShCurrCal.EOLMtrCurrVcalCmd_VoltCnts_f32 "MICROSAR RTE" FLOAT32_IEEE NO_COMPU_METHOD 0 0 1.175494351e-38 3.402823466e+38 ECU_ADDRESS 0 SYMBOL_LINK "Rte_CmMtrCurr_ShCurrCal.EOLMtrCurrVcalCmd_VoltCnts_f32" 0 DISPLAY_IDENTIFIER CmMtrCurr.PerInstanceMemories.ShCurrCal.EOLMtrCurrVcalCmd_VoltCnts_f32 READ_WRITE /end MEASUREMENT
/begin MEASUREMENT CmMtrCurr.ShCurrCal.EOLPhscurr1Gain_AmpspVolt_f32 "MICROSAR RTE" FLOAT32_IEEE NO_COMPU_METHOD 0 0 1.175494351e-38 3.402823466e+38 ECU_ADDRESS 0 SYMBOL_LINK "Rte_CmMtrCurr_ShCurrCal.EOLPhscurr1Gain_AmpspVolt_f32" 0 DISPLAY_IDENTIFIER CmMtrCurr.PerInstanceMemories.ShCurrCal.EOLPhscurr1Gain_AmpspVolt_f32 READ_WRITE /end MEASUREMENT
/begin MEASUREMENT CmMtrCurr.ShCurrCal.EOLPhscurr2Gain_AmpspVolt_f32 "MICROSAR RTE" FLOAT32_IEEE NO_COMPU_METHOD 0 0 1.175494351e-38 3.402823466e+38 ECU_ADDRESS 0 SYMBOL_LINK "Rte_CmMtrCurr_ShCurrCal.EOLPhscurr2Gain_AmpspVolt_f32" 0 DISPLAY_IDENTIFIER CmMtrCurr.PerInstanceMemories.ShCurrCal.EOLPhscurr2Gain_AmpspVolt_f32 READ_WRITE /end MEASUREMENT
/begin MEASUREMENT CmMtrCurr.SrlComSvcDft.Cnt_b32 "MICROSAR RTE" ULONG NO_COMPU_METHOD 0 0 0 4294967295 ECU_ADDRESS 0 SYMBOL_LINK "Rte_CDDInterface_SrlComSvcDft_Cnt_b32" 0 DISPLAY_IDENTIFIER CmMtrCurr.ReceiverPorts.SrlComSvcDft.Cnt_b32 /end MEASUREMENT
/begin MEASUREMENT CmMtrCurr.SystemState.Mode "MICROSAR RTE" UBYTE RTE_CM_ENUM_StaMd_Mode 0 0 0 255 ECU_ADDRESS 0 SYMBOL_LINK "Rte_ModeMachine_StaMd_SystemState_Mode" 0 DISPLAY_IDENTIFIER CmMtrCurr.ModeRequirePorts.SystemState.Mode /end MEASUREMENT
/begin MEASUREMENT CmMtrCurr.Vecu.Volt_f32 "This port prototype is inteded to communicate voltage signals that represent the ecu supplied voltage.  This signal has a lower limit, which is non-zero, to allow users of the signal to use it as a denominator in an expression without requiring a divide b" FLOAT32_IEEE NO_COMPU_METHOD 0 0 1.175494351e-38 3.402823466e+38 ECU_ADDRESS 0 SYMBOL_LINK "Rte_BatteryVoltage_Vecu_Volt_f32" 0 DISPLAY_IDENTIFIER CmMtrCurr.ReceiverPorts.Vecu.Volt_f32 /end MEASUREMENT
/begin MEASUREMENT CmMtrCurr.VehSpd.Kph_f32 "MICROSAR RTE" FLOAT32_IEEE NO_COMPU_METHOD 0 0 1.175494351e-38 3.402823466e+38 ECU_ADDRESS 0 SYMBOL_LINK "Rte_Ap_SignlCondn_VehicleSpeed_Kph_f32" 0 DISPLAY_IDENTIFIER CmMtrCurr.ReceiverPorts.VehSpd.Kph_f32 /end MEASUREMENT
/begin MEASUREMENT CmMtrCurr.VhSpdValid.Cnt_lgc "MICROSAR RTE" UBYTE RTE_CM_BOOLEAN 0 0 0 255 ECU_ADDRESS 0 SYMBOL_LINK "Rte_SrlComInput_VehicleSpeedValid_Cnt_lgc" 0 DISPLAY_IDENTIFIER CmMtrCurr.ReceiverPorts.VhSpdValid.Cnt_lgc /end MEASUREMENT
/begin MEASUREMENT ComplErr.ComplErr.HwDeg_f32 "MICROSAR RTE" FLOAT32_IEEE NO_COMPU_METHOD 0 0 1.175494351e-38 3.402823466e+38 ECU_ADDRESS 0 SYMBOL_LINK "Rte_ComplErr_ComplErr_HwDeg_f32" 0 DISPLAY_IDENTIFIER ComplErr.SenderPorts.ComplErr.HwDeg_f32 /end MEASUREMENT
/begin MEASUREMENT ComplErr.TorqueCmdCRF.MtrNm_f32 "MICROSAR RTE" FLOAT32_IEEE NO_COMPU_METHOD 0 0 1.175494351e-38 3.402823466e+38 ECU_ADDRESS 0 SYMBOL_LINK "Rte_CtrldDisShtdn_CntDisMtrTrqCmdCRF_MtrNm_f32" 0 DISPLAY_IDENTIFIER ComplErr.ReceiverPorts.TorqueCmdCRF.MtrNm_f32 /end MEASUREMENT
/begin MEASUREMENT CtrlTemp.AmbTemp.DegC_f32 "MICROSAR RTE" FLOAT32_IEEE NO_COMPU_METHOD 0 0 1.175494351e-38 3.402823466e+38 ECU_ADDRESS 0 SYMBOL_LINK "Rte_SrlComInput_SrlComAmbTemp_DegC_f32" 0 DISPLAY_IDENTIFIER CtrlTemp.ReceiverPorts.AmbTemp.DegC_f32 /end MEASUREMENT
/begin MEASUREMENT CtrlTemp.DiagStsTempRdPrf.Cnt_lgc "MICROSAR RTE" UBYTE RTE_CM_BOOLEAN 0 0 0 255 ECU_ADDRESS 0 SYMBOL_LINK "Rte_DiagMgr_DiagStsDefTemp_Cnt_lgc" 0 DISPLAY_IDENTIFIER CtrlTemp.ReceiverPorts.DiagStsTempRdPrf.Cnt_lgc /end MEASUREMENT
/begin MEASUREMENT CtrlTemp.FiltMeasTemp.DegC_f32 "MICROSAR RTE" FLOAT32_IEEE NO_COMPU_METHOD 0 0 1.175494351e-38 3.402823466e+38 ECU_ADDRESS 0 SYMBOL_LINK "Rte_CtrlTemp_FiltMeasTemp_DegC_f32" 0 DISPLAY_IDENTIFIER CtrlTemp.SenderPorts.FiltMeasTemp.DegC_f32 /end MEASUREMENT
/begin MEASUREMENT CtrlTemp.TemperatureADC.Volt_f32 "This signal is intended to communicate any type voltage signal measured by the ecu.  This signal has a lower limit of 0 which reequires users of the signal to provide divide by 0 protection if it is used as a denominator in a calculation.  See Vecu port p" FLOAT32_IEEE NO_COMPU_METHOD 0 0 1.175494351e-38 3.402823466e+38 ECU_ADDRESS 0 SYMBOL_LINK "Rte_IoHwAbstractionUsr_TemperatureADC_Volt_f32" 0 DISPLAY_IDENTIFIER CtrlTemp.ReceiverPorts.TemperatureADC.Volt_f32 /end MEASUREMENT
/begin MEASUREMENT CtrldDisShtdn.AssistAssyPolarity.Cnt_s08 "MICROSAR RTE" SBYTE NO_COMPU_METHOD 0 0 -128 127 ECU_ADDRESS 0 SYMBOL_LINK "Rte_Polarity_AssistAssyPolarity_Cnt_s08" 0 DISPLAY_IDENTIFIER CtrldDisShtdn.ReceiverPorts.AssistAssyPolarity.Cnt_s08 /end MEASUREMENT
/begin MEASUREMENT CtrldDisShtdn.CRFMtrVel.MtrRadpS_f32 "MICROSAR RTE" FLOAT32_IEEE NO_COMPU_METHOD 0 0 1.175494351e-38 3.402823466e+38 ECU_ADDRESS 0 SYMBOL_LINK "Rte_Sa_MtrVel_MotorVelCRF_MtrRadpS_f32" 0 DISPLAY_IDENTIFIER CtrldDisShtdn.ReceiverPorts.CRFMtrVel.MtrRadpS_f32 /end MEASUREMENT
/begin MEASUREMENT CtrldDisShtdn.CntDisMtrTrqCmdCRF.MtrNm_f32 "MICROSAR RTE" FLOAT32_IEEE NO_COMPU_METHOD 0 0 1.175494351e-38 3.402823466e+38 ECU_ADDRESS 0 SYMBOL_LINK "Rte_CtrldDisShtdn_CntDisMtrTrqCmdCRF_MtrNm_f32" 0 DISPLAY_IDENTIFIER CtrldDisShtdn.SenderPorts.CntDisMtrTrqCmdCRF.MtrNm_f32 /end MEASUREMENT
/begin MEASUREMENT CtrldDisShtdn.CntDisMtrTrqCmdMRF.MtrNm_f32 "MICROSAR RTE" FLOAT32_IEEE NO_COMPU_METHOD 0 0 1.175494351e-38 3.402823466e+38 ECU_ADDRESS 0 SYMBOL_LINK "Rte_CtrldDisShtdn_CntDisMtrTrqCmdMRF_MtrNm_f32" 0 DISPLAY_IDENTIFIER CtrldDisShtdn.SenderPorts.CntDisMtrTrqCmdMRF.MtrNm_f32 /end MEASUREMENT
/begin MEASUREMENT CtrldDisShtdn.CtrldDmpStsCmp.Cnt_lgc "MICROSAR RTE" UBYTE RTE_CM_BOOLEAN 0 0 0 255 ECU_ADDRESS 0 SYMBOL_LINK "Rte_CtrldDisShtdn_CtrldDmpStsCmp_Cnt_lgc" 0 DISPLAY_IDENTIFIER CtrldDisShtdn.SenderPorts.CtrldDmpStsCmp.Cnt_lgc /end MEASUREMENT
/begin MEASUREMENT CtrldDisShtdn.DiagStsF2Active.Cnt_lgc "MICROSAR RTE" UBYTE RTE_CM_BOOLEAN 0 0 0 255 ECU_ADDRESS 0 SYMBOL_LINK "Rte_DiagMgr_DiagStsCtrldDisRmpPres_Cnt_lgc" 0 DISPLAY_IDENTIFIER CtrldDisShtdn.ReceiverPorts.DiagStsF2Active.Cnt_lgc /end MEASUREMENT
/begin MEASUREMENT CtrldDisShtdn.SumLimTrqCmd.MtrNm_f32 "MICROSAR RTE" FLOAT32_IEEE NO_COMPU_METHOD 0 0 1.175494351e-38 3.402823466e+38 ECU_ADDRESS 0 SYMBOL_LINK "Rte_Ap_Sweep2_OutputMtrTrq_MtrNm_f32" 0 DISPLAY_IDENTIFIER CtrldDisShtdn.ReceiverPorts.SumLimTrqCmd.MtrNm_f32 /end MEASUREMENT
/begin MEASUREMENT CtrldDisShtdn.SysC_CRFMtrTrqCmd.MtrNm_f32 "MICROSAR RTE" FLOAT32_IEEE NO_COMPU_METHOD 0 0 1.175494351e-38 3.402823466e+38 ECU_ADDRESS 0 SYMBOL_LINK "Rte_CtrldDisShtdn_SysC_CRFMtrTrqCmd_MtrNm_f32" 0 DISPLAY_IDENTIFIER CtrldDisShtdn.SenderPorts.SysC_CRFMtrTrqCmd.MtrNm_f32 /end MEASUREMENT
/begin MEASUREMENT CtrldDisShtdn.SysC_MRFMtrTrqCmd.MtrNm_f32 "MICROSAR RTE" FLOAT32_IEEE NO_COMPU_METHOD 0 0 1.175494351e-38 3.402823466e+38 ECU_ADDRESS 0 SYMBOL_LINK "Rte_CtrldDisShtdn_SysC_MRFMtrTrqCmd_MtrNm_f32" 0 DISPLAY_IDENTIFIER CtrldDisShtdn.SenderPorts.SysC_MRFMtrTrqCmd.MtrNm_f32 /end MEASUREMENT
/begin MEASUREMENT CtrldDisShtdn.SystemState.Mode "MICROSAR RTE" UBYTE RTE_CM_ENUM_StaMd_Mode 0 0 0 255 ECU_ADDRESS 0 SYMBOL_LINK "Rte_ModeMachine_StaMd_SystemState_Mode" 0 DISPLAY_IDENTIFIER CtrldDisShtdn.ModeRequirePorts.SystemState.Mode /end MEASUREMENT
/begin MEASUREMENT CurrCmd.CurrentGainSvc.Cnt_lgc "MICROSAR RTE" UBYTE RTE_CM_BOOLEAN 0 0 0 255 ECU_ADDRESS 0 SYMBOL_LINK "Rte_CmMtrCurr_CurrentGainSvc_Cnt_lgc" 0 DISPLAY_IDENTIFIER CurrCmd.ReceiverPorts.CurrentGainSvc.Cnt_lgc /end MEASUREMENT
/begin MEASUREMENT CurrCmd.EstKe.VpRadpS_f32 "MICROSAR RTE" FLOAT32_IEEE NO_COMPU_METHOD 0 0 1.175494351e-38 3.402823466e+38 ECU_ADDRESS 0 SYMBOL_LINK "Rte_CurrParamComp_EstKe_VpRadpS_f32" 0 DISPLAY_IDENTIFIER CurrCmd.ReceiverPorts.EstKe.VpRadpS_f32 /end MEASUREMENT
/begin MEASUREMENT CurrCmd.EstLd.Henry_f32 "MICROSAR RTE" FLOAT32_IEEE NO_COMPU_METHOD 0 0 1.175494351e-38 3.402823466e+38 ECU_ADDRESS 0 SYMBOL_LINK "Rte_CurrParamComp_EstLd_Henry_f32" 0 DISPLAY_IDENTIFIER CurrCmd.ReceiverPorts.EstLd.Henry_f32 /end MEASUREMENT
/begin MEASUREMENT CurrCmd.EstLq.Henry_f32 "MICROSAR RTE" FLOAT32_IEEE NO_COMPU_METHOD 0 0 1.175494351e-38 3.402823466e+38 ECU_ADDRESS 0 SYMBOL_LINK "Rte_CurrParamComp_EstLq_Henry_f32" 0 DISPLAY_IDENTIFIER CurrCmd.ReceiverPorts.EstLq.Henry_f32 /end MEASUREMENT
/begin MEASUREMENT CurrCmd.EstR.Ohm_f32 "MICROSAR RTE" FLOAT32_IEEE NO_COMPU_METHOD 0 0 1.175494351e-38 3.402823466e+38 ECU_ADDRESS 0 SYMBOL_LINK "Rte_CurrParamComp_EstR_Ohm_f32" 0 DISPLAY_IDENTIFIER CurrCmd.ReceiverPorts.EstR.Ohm_f32 /end MEASUREMENT
/begin MEASUREMENT CurrCmd.IvtrLoaMtgtnEn.Cnt_lgc "MICROSAR RTE" UBYTE RTE_CM_BOOLEAN 0 0 0 255 ECU_ADDRESS 0 SYMBOL_LINK "Rte_CurrCmd_IvtrLoaMtgtnEn_Cnt_lgc" 0 DISPLAY_IDENTIFIER CurrCmd.ReceiverPorts.IvtrLoaMtgtnEn.Cnt_lgc /end MEASUREMENT
/begin MEASUREMENT CurrCmd.MRFMtrVel.MtrRadpS_f32 "MICROSAR RTE" FLOAT32_IEEE NO_COMPU_METHOD 0 0 1.175494351e-38 3.402823466e+38 ECU_ADDRESS 0 SYMBOL_LINK "Rte_Sa_MtrVel_MotorVelMRF_MtrRadpS_f32" 0 DISPLAY_IDENTIFIER CurrCmd.ReceiverPorts.MRFMtrVel.MtrRadpS_f32 /end MEASUREMENT
/begin MEASUREMENT CurrCmd.MRFTrqCmdScl.MtrNm_f32 "MICROSAR RTE" FLOAT32_IEEE NO_COMPU_METHOD 0 0 1.175494351e-38 3.402823466e+38 ECU_ADDRESS 0 SYMBOL_LINK "Rte_TrqCmdScl_MRFMtrTrqCmdScl_MtrNm_f32" 0 DISPLAY_IDENTIFIER CurrCmd.ReceiverPorts.MRFTrqCmdScl.MtrNm_f32 /end MEASUREMENT
/begin MEASUREMENT CurrCmd.MotCurrLoaMtgtnEn.Cnt_lgc "MICROSAR RTE" UBYTE RTE_CM_BOOLEAN 0 0 0 255 ECU_ADDRESS 0 SYMBOL_LINK "Rte_CurrCmd_MotCurrLoaMtgtnEn_Cnt_lgc" 0 DISPLAY_IDENTIFIER CurrCmd.ReceiverPorts.MotCurrLoaMtgtnEn.Cnt_lgc /end MEASUREMENT
/begin MEASUREMENT CurrCmd.MtrCurrAngle.Rev_f32 "MICROSAR RTE" FLOAT32_IEEE NO_COMPU_METHOD 0 0 1.175494351e-38 3.402823466e+38 ECU_ADDRESS 0 SYMBOL_LINK "Rte_CurrCmd_MtrCurrAngle_Rev_f32" 0 DISPLAY_IDENTIFIER CurrCmd.SenderPorts.MtrCurrAngle.Rev_f32 /end MEASUREMENT
/begin MEASUREMENT CurrCmd.MtrCurrDaxRef.Amp_f32 "MICROSAR RTE" FLOAT32_IEEE NO_COMPU_METHOD 0 0 1.175494351e-38 3.402823466e+38 ECU_ADDRESS 0 SYMBOL_LINK "Rte_CurrCmd_MtrCurrDaxRef_Amp_f32" 0 DISPLAY_IDENTIFIER CurrCmd.SenderPorts.MtrCurrDaxRef.Amp_f32 /end MEASUREMENT
/begin MEASUREMENT CurrCmd.MtrCurrQaxRef.Amp_f32 "MICROSAR RTE" FLOAT32_IEEE NO_COMPU_METHOD 0 0 1.175494351e-38 3.402823466e+38 ECU_ADDRESS 0 SYMBOL_LINK "Rte_CurrCmd_MtrCurrQaxRef_Amp_f32" 0 DISPLAY_IDENTIFIER CurrCmd.SenderPorts.MtrCurrQaxRef.Amp_f32 /end MEASUREMENT
/begin MEASUREMENT CurrCmd.MtrQuad.Cnt_u08 "MICROSAR RTE" UBYTE NO_COMPU_METHOD 0 0 0 255 ECU_ADDRESS 0 SYMBOL_LINK "Rte_QuadDet_MtrQuad_Cnt_u08" 0 DISPLAY_IDENTIFIER CurrCmd.ReceiverPorts.MtrQuad.Cnt_u08 /end MEASUREMENT
/begin MEASUREMENT CurrCmd.Vecu.Volt_f32 "This port prototype is inteded to communicate voltage signals that represent the ecu supplied voltage.  This signal has a lower limit, which is non-zero, to allow users of the signal to use it as a denominator in an expression without requiring a divide b" FLOAT32_IEEE NO_COMPU_METHOD 0 0 1.175494351e-38 3.402823466e+38 ECU_ADDRESS 0 SYMBOL_LINK "Rte_BatteryVoltage_Vecu_Volt_f32" 0 DISPLAY_IDENTIFIER CurrCmd.ReceiverPorts.Vecu.Volt_f32 /end MEASUREMENT
/begin MEASUREMENT CurrCmd.VehSpd.Kph_f32 "MICROSAR RTE" FLOAT32_IEEE NO_COMPU_METHOD 0 0 1.175494351e-38 3.402823466e+38 ECU_ADDRESS 0 SYMBOL_LINK "Rte_Ap_SignlCondn_VehicleSpeed_Kph_f32" 0 DISPLAY_IDENTIFIER CurrCmd.ReceiverPorts.VehSpd.Kph_f32 /end MEASUREMENT
/begin MEASUREMENT CurrParamComp.CuTempEst.DegC_f32 "MICROSAR RTE" FLOAT32_IEEE NO_COMPU_METHOD 0 0 1.175494351e-38 3.402823466e+38 ECU_ADDRESS 0 SYMBOL_LINK "Rte_Ap_MtrTempEst_CuTempEst_DegC_f32" 0 DISPLAY_IDENTIFIER CurrParamComp.ReceiverPorts.CuTempEst.DegC_f32 /end MEASUREMENT
/begin MEASUREMENT CurrParamComp.EOLNomMtrParam.NomKe_VpRadpS_f32 "MICROSAR RTE" FLOAT32_IEEE NO_COMPU_METHOD 0 0 1.175494351e-38 3.402823466e+38 ECU_ADDRESS 0 SYMBOL_LINK "Rte_CurrParamComp_EOLNomMtrParam.NomKe_VpRadpS_f32" 0 DISPLAY_IDENTIFIER CurrParamComp.PerInstanceMemories.EOLNomMtrParam.NomKe_VpRadpS_f32 READ_WRITE /end MEASUREMENT
/begin MEASUREMENT CurrParamComp.EOLNomMtrParam.NomRmtr_Ohm_f32 "MICROSAR RTE" FLOAT32_IEEE NO_COMPU_METHOD 0 0 1.175494351e-38 3.402823466e+38 ECU_ADDRESS 0 SYMBOL_LINK "Rte_CurrParamComp_EOLNomMtrParam.NomRmtr_Ohm_f32" 0 DISPLAY_IDENTIFIER CurrParamComp.PerInstanceMemories.EOLNomMtrParam.NomRmtr_Ohm_f32 READ_WRITE /end MEASUREMENT
/begin MEASUREMENT CurrParamComp.EstKe.VpRadpS_f32 "MICROSAR RTE" FLOAT32_IEEE NO_COMPU_METHOD 0 0 1.175494351e-38 3.402823466e+38 ECU_ADDRESS 0 SYMBOL_LINK "Rte_CurrParamComp_EstKe_VpRadpS_f32" 0 DISPLAY_IDENTIFIER CurrParamComp.SenderPorts.EstKe.VpRadpS_f32 /end MEASUREMENT
/begin MEASUREMENT CurrParamComp.EstLd.Henry_f32 "MICROSAR RTE" FLOAT32_IEEE NO_COMPU_METHOD 0 0 1.175494351e-38 3.402823466e+38 ECU_ADDRESS 0 SYMBOL_LINK "Rte_CurrParamComp_EstLd_Henry_f32" 0 DISPLAY_IDENTIFIER CurrParamComp.SenderPorts.EstLd.Henry_f32 /end MEASUREMENT
/begin MEASUREMENT CurrParamComp.EstLq.Henry_f32 "MICROSAR RTE" FLOAT32_IEEE NO_COMPU_METHOD 0 0 1.175494351e-38 3.402823466e+38 ECU_ADDRESS 0 SYMBOL_LINK "Rte_CurrParamComp_EstLq_Henry_f32" 0 DISPLAY_IDENTIFIER CurrParamComp.SenderPorts.EstLq.Henry_f32 /end MEASUREMENT
/begin MEASUREMENT CurrParamComp.EstR.Ohm_f32 "MICROSAR RTE" FLOAT32_IEEE NO_COMPU_METHOD 0 0 1.175494351e-38 3.402823466e+38 ECU_ADDRESS 0 SYMBOL_LINK "Rte_CurrParamComp_EstR_Ohm_f32" 0 DISPLAY_IDENTIFIER CurrParamComp.SenderPorts.EstR.Ohm_f32 /end MEASUREMENT
/begin MEASUREMENT CurrParamComp.MagTempEst.DegC_f32 "MICROSAR RTE" FLOAT32_IEEE NO_COMPU_METHOD 0 0 1.175494351e-38 3.402823466e+38 ECU_ADDRESS 0 SYMBOL_LINK "Rte_Ap_MtrTempEst_MagTempEst_DegC_f32" 0 DISPLAY_IDENTIFIER CurrParamComp.ReceiverPorts.MagTempEst.DegC_f32 /end MEASUREMENT
/begin MEASUREMENT CurrParamComp.MtrCurrDaxRef.Amp_f32 "MICROSAR RTE" FLOAT32_IEEE NO_COMPU_METHOD 0 0 1.175494351e-38 3.402823466e+38 ECU_ADDRESS 0 SYMBOL_LINK "Rte_CurrCmd_MtrCurrDaxRef_Amp_f32" 0 DISPLAY_IDENTIFIER CurrParamComp.ReceiverPorts.MtrCurrDaxRef.Amp_f32 /end MEASUREMENT
/begin MEASUREMENT CurrParamComp.MtrCurrQaxRef.Amp_f32 "MICROSAR RTE" FLOAT32_IEEE NO_COMPU_METHOD 0 0 1.175494351e-38 3.402823466e+38 ECU_ADDRESS 0 SYMBOL_LINK "Rte_CurrCmd_MtrCurrQaxRef_Amp_f32" 0 DISPLAY_IDENTIFIER CurrParamComp.ReceiverPorts.MtrCurrQaxRef.Amp_f32 /end MEASUREMENT
/begin MEASUREMENT CurrParamComp.SiTempEst.DegC_f32 "MICROSAR RTE" FLOAT32_IEEE NO_COMPU_METHOD 0 0 1.175494351e-38 3.402823466e+38 ECU_ADDRESS 0 SYMBOL_LINK "Rte_Ap_MtrTempEst_SiTempEst_DegC_f32" 0 DISPLAY_IDENTIFIER CurrParamComp.ReceiverPorts.SiTempEst.DegC_f32 /end MEASUREMENT
/begin MEASUREMENT CustPerSrvcs.SystemState.Mode "MICROSAR RTE" UBYTE RTE_CM_ENUM_StaMd_Mode 0 0 0 255 ECU_ADDRESS 0 SYMBOL_LINK "Rte_ModeMachine_Ap_StaMd9_SystemState9_Mode" 0 DISPLAY_IDENTIFIER CustPerSrvcs.ModeRequirePorts.SystemState.Mode /end MEASUREMENT
/begin MEASUREMENT CustPerSrvcs.ThermalLimitFlagCntr.Cnt_u08 "MICROSAR RTE" UBYTE NO_COMPU_METHOD 0 0 0 255 ECU_ADDRESS 0 SYMBOL_LINK "Rte_CustPerSrvcs_ThermalLimitFlagCntr_Cnt_u08" 0 DISPLAY_IDENTIFIER CustPerSrvcs.SenderPorts.ThermalLimitFlagCntr.Cnt_u08 /end MEASUREMENT
/begin MEASUREMENT Damping.AssistCmd.MtrNm_f32 "MICROSAR RTE" FLOAT32_IEEE NO_COMPU_METHOD 0 0 1.175494351e-38 3.402823466e+38 ECU_ADDRESS 0 SYMBOL_LINK "Rte_StabilityComp_AssistCmd_MtrNm_f32" 0 DISPLAY_IDENTIFIER Damping.ReceiverPorts.AssistCmd.MtrNm_f32 /end MEASUREMENT
/begin MEASUREMENT Damping.AssistMechTempEst.DegC_f32 "MICROSAR RTE" FLOAT32_IEEE NO_COMPU_METHOD 0 0 1.175494351e-38 3.402823466e+38 ECU_ADDRESS 0 SYMBOL_LINK "Rte_Ap_MtrTempEst_AssistMechTempEst_DegC_f32" 0 DISPLAY_IDENTIFIER Damping.ReceiverPorts.AssistMechTempEst.DegC_f32 /end MEASUREMENT
/begin MEASUREMENT Damping.CustomDamp.MtrNm_f32 "MICROSAR RTE" FLOAT32_IEEE NO_COMPU_METHOD 0 0 1.175494351e-38 3.402823466e+38 ECU_ADDRESS 0 SYMBOL_LINK "Rte_Damping_CustomDamp_MtrNm_f32" 0 DISPLAY_IDENTIFIER Damping.ReceiverPorts.CustomDamp.MtrNm_f32 /end MEASUREMENT
/begin MEASUREMENT Damping.DampingCmd.MtrNm_f32 "MICROSAR RTE" FLOAT32_IEEE NO_COMPU_METHOD 0 0 1.175494351e-38 3.402823466e+38 ECU_ADDRESS 0 SYMBOL_LINK "Rte_Damping_DampingCmd_MtrNm_f32" 0 DISPLAY_IDENTIFIER Damping.SenderPorts.DampingCmd.MtrNm_f32 /end MEASUREMENT
/begin MEASUREMENT Damping.DampingDDFactor.Uls_f32 "MICROSAR RTE" FLOAT32_IEEE NO_COMPU_METHOD 0 0 1.175494351e-38 3.402823466e+38 ECU_ADDRESS 0 SYMBOL_LINK "Rte_Ap_TrqArblim_DampingDDFactor_Uls_f32" 0 DISPLAY_IDENTIFIER Damping.ReceiverPorts.DampingDDFactor.Uls_f32 /end MEASUREMENT
/begin MEASUREMENT Damping.DefeatDampingSvc.Cnt_lgc "MICROSAR RTE" UBYTE RTE_CM_BOOLEAN 0 0 0 255 ECU_ADDRESS 0 SYMBOL_LINK "Rte_CDDInterface_DampingSrlComSvcDft_Cnt_lgc" 0 DISPLAY_IDENTIFIER Damping.ReceiverPorts.DefeatDampingSvc.Cnt_lgc /end MEASUREMENT
/begin MEASUREMENT Damping.HwTorque.HwNm_f32 "MICROSAR RTE" FLOAT32_IEEE NO_COMPU_METHOD 0 0 1.175494351e-38 3.402823466e+38 ECU_ADDRESS 0 SYMBOL_LINK "Rte_Ap_Sweep_OutputHwTrq_HwNm_f32" 0 DISPLAY_IDENTIFIER Damping.ReceiverPorts.HwTorque.HwNm_f32 /end MEASUREMENT
/begin MEASUREMENT Damping.MotorVelCRF.MtrRadpS_f32 "MICROSAR RTE" FLOAT32_IEEE NO_COMPU_METHOD 0 0 1.175494351e-38 3.402823466e+38 ECU_ADDRESS 0 SYMBOL_LINK "Rte_Sa_MtrVel_MotorVelCRF_MtrRadpS_f32" 0 DISPLAY_IDENTIFIER Damping.ReceiverPorts.MotorVelCRF.MtrRadpS_f32 /end MEASUREMENT
/begin MEASUREMENT Damping.VehicleSpeed.Kph_f32 "MICROSAR RTE" FLOAT32_IEEE NO_COMPU_METHOD 0 0 1.175494351e-38 3.402823466e+38 ECU_ADDRESS 0 SYMBOL_LINK "Rte_Ap_SignlCondn_VehicleSpeed_Kph_f32" 0 DISPLAY_IDENTIFIER Damping.ReceiverPorts.VehicleSpeed.Kph_f32 /end MEASUREMENT
/begin MEASUREMENT DemIf.BusOffCE.Cnt_lgc "MICROSAR RTE" UBYTE RTE_CM_BOOLEAN 0 0 0 255 ECU_ADDRESS 0 SYMBOL_LINK "Rte_SrlComOutput_BusOffCE_Cnt_lgc" 0 DISPLAY_IDENTIFIER DemIf.ReceiverPorts.BusOffCE.Cnt_lgc /end MEASUREMENT
/begin MEASUREMENT DemIf.BusOffHS.Cnt_lgc "MICROSAR RTE" UBYTE RTE_CM_BOOLEAN 0 0 0 255 ECU_ADDRESS 0 SYMBOL_LINK "Rte_SrlComOutput_BusOffHS_Cnt_lgc" 0 DISPLAY_IDENTIFIER DemIf.ReceiverPorts.BusOffHS.Cnt_lgc /end MEASUREMENT
/begin MEASUREMENT DemIf.DisableCEBusNormComm.Cnt_lgc "MICROSAR RTE" UBYTE RTE_CM_BOOLEAN 0 0 0 255 ECU_ADDRESS 0 SYMBOL_LINK "Rte_CDDInterface_DisableCEBusNormComm_Cnt_lgc" 0 DISPLAY_IDENTIFIER DemIf.ReceiverPorts.DisableCEBusNormComm.Cnt_lgc /end MEASUREMENT
/begin MEASUREMENT DemIf.DisableHSBusNormComm.Cnt_lgc "MICROSAR RTE" UBYTE RTE_CM_BOOLEAN 0 0 0 255 ECU_ADDRESS 0 SYMBOL_LINK "Rte_CDDInterface_DisableHSBusNormComm_Cnt_lgc" 0 DISPLAY_IDENTIFIER DemIf.ReceiverPorts.DisableHSBusNormComm.Cnt_lgc /end MEASUREMENT
/begin MEASUREMENT DemIf.EngRunAtvForCTCInhibit.Cnt_lgc "MICROSAR RTE" UBYTE RTE_CM_BOOLEAN 0 0 0 255 ECU_ADDRESS 0 SYMBOL_LINK "Rte_SrlComInput_EngRunAtvForCTCInhibit_Cnt_lgc" 0 DISPLAY_IDENTIFIER DemIf.ReceiverPorts.EngRunAtvForCTCInhibit.Cnt_lgc /end MEASUREMENT
/begin MEASUREMENT DemIf.SPMForCTCInhibit.Cnt_lgc "MICROSAR RTE" UBYTE RTE_CM_BOOLEAN 0 0 0 255 ECU_ADDRESS 0 SYMBOL_LINK "Rte_SrlComInput_SPMForCTCInhibit_Cnt_lgc" 0 DISPLAY_IDENTIFIER DemIf.ReceiverPorts.SPMForCTCInhibit.Cnt_lgc /end MEASUREMENT
/begin MEASUREMENT DemIf.SrlComEngOn.Cnt_lgc "MICROSAR RTE" UBYTE RTE_CM_BOOLEAN 0 0 0 255 ECU_ADDRESS 0 SYMBOL_LINK "Rte_SrlComInput_SrlComEngOn_Cnt_lgc" 0 DISPLAY_IDENTIFIER DemIf.ReceiverPorts.SrlComEngOn.Cnt_lgc /end MEASUREMENT
/begin MEASUREMENT DemIf.SrlComSysPwrMd.Cnt_enum "MICROSAR RTE" UBYTE RTE_CM_ENUM_SysPwrMd 0 0 0 3 ECU_ADDRESS 0 SYMBOL_LINK "Rte_SrlComInput_SrlComSysPwrMd_Cnt_enum" 0 DISPLAY_IDENTIFIER DemIf.ReceiverPorts.SrlComSysPwrMd.Cnt_enum /end MEASUREMENT
/begin MEASUREMENT DemIf.Vecu.Volt_f32 "This port prototype is inteded to communicate voltage signals that represent the ecu supplied voltage.  This signal has a lower limit, which is non-zero, to allow users of the signal to use it as a denominator in an expression without requiring a divide b" FLOAT32_IEEE NO_COMPU_METHOD 0 0 1.175494351e-38 3.402823466e+38 ECU_ADDRESS 0 SYMBOL_LINK "Rte_BatteryVoltage_Vecu_Volt_f32" 0 DISPLAY_IDENTIFIER DemIf.ReceiverPorts.Vecu.Volt_f32 /end MEASUREMENT
/begin MEASUREMENT DiagMgr.DiagRampRate.XpmS_f32 "MICROSAR RTE" FLOAT32_IEEE NO_COMPU_METHOD 0 0 1.175494351e-38 3.402823466e+38 ECU_ADDRESS 0 SYMBOL_LINK "Rte_DiagMgr_DiagRampRate_XpmS_f32" 0 DISPLAY_IDENTIFIER DiagMgr.SenderPorts.DiagRampRate.XpmS_f32 /end MEASUREMENT
/begin MEASUREMENT DiagMgr.DiagRampValue.Uls_f32 "MICROSAR RTE" FLOAT32_IEEE NO_COMPU_METHOD 0 0 1.175494351e-38 3.402823466e+38 ECU_ADDRESS 0 SYMBOL_LINK "Rte_DiagMgr_DiagRampValue_Uls_f32" 0 DISPLAY_IDENTIFIER DiagMgr.SenderPorts.DiagRampValue.Uls_f32 /end MEASUREMENT
/begin MEASUREMENT DiagMgr.DiagRmpToZeroActive.Cnt_lgc "MICROSAR RTE" UBYTE RTE_CM_BOOLEAN 0 0 0 255 ECU_ADDRESS 0 SYMBOL_LINK "Rte_DiagMgr_DiagRmpToZeroActive_Cnt_lgc" 0 DISPLAY_IDENTIFIER DiagMgr.SenderPorts.DiagRmpToZeroActive.Cnt_lgc /end MEASUREMENT
/begin MEASUREMENT DiagMgr.DiagStsCtrldDisRmpPres.Cnt_lgc "MICROSAR RTE" UBYTE RTE_CM_BOOLEAN 0 0 0 255 ECU_ADDRESS 0 SYMBOL_LINK "Rte_DiagMgr_DiagStsCtrldDisRmpPres_Cnt_lgc" 0 DISPLAY_IDENTIFIER DiagMgr.SenderPorts.DiagStsCtrldDisRmpPres.Cnt_lgc /end MEASUREMENT
/begin MEASUREMENT DiagMgr.DiagStsDefTemp.Cnt_lgc "MICROSAR RTE" UBYTE RTE_CM_BOOLEAN 0 0 0 255 ECU_ADDRESS 0 SYMBOL_LINK "Rte_DiagMgr_DiagStsDefTemp_Cnt_lgc" 0 DISPLAY_IDENTIFIER DiagMgr.SenderPorts.DiagStsDefTemp.Cnt_lgc /end MEASUREMENT
/begin MEASUREMENT DiagMgr.DiagStsDefVehSpd.Cnt_lgc "MICROSAR RTE" UBYTE RTE_CM_BOOLEAN 0 0 0 255 ECU_ADDRESS 0 SYMBOL_LINK "Rte_DiagMgr_DiagStsDefVehSpd_Cnt_lgc" 0 DISPLAY_IDENTIFIER DiagMgr.SenderPorts.DiagStsDefVehSpd.Cnt_lgc /end MEASUREMENT
/begin MEASUREMENT DiagMgr.DiagStsHWASbSystmFltPres.Cnt_lgc "MICROSAR RTE" UBYTE RTE_CM_BOOLEAN 0 0 0 255 ECU_ADDRESS 0 SYMBOL_LINK "Rte_DiagMgr_DiagStsHWASbSystmFltPres_Cnt_lgc" 0 DISPLAY_IDENTIFIER DiagMgr.SenderPorts.DiagStsHWASbSystmFltPres.Cnt_lgc /end MEASUREMENT
/begin MEASUREMENT DiagMgr.DiagStsNonRecRmpToZeroFltPres.Cnt_lgc "MICROSAR RTE" UBYTE RTE_CM_BOOLEAN 0 0 0 255 ECU_ADDRESS 0 SYMBOL_LINK "Rte_DiagMgr_DiagStsNonRecRmpToZeroFltPres_Cnt_lgc" 0 DISPLAY_IDENTIFIER DiagMgr.SenderPorts.DiagStsNonRecRmpToZeroFltPres.Cnt_lgc /end MEASUREMENT
/begin MEASUREMENT DiagMgr.DiagStsRecRmpToZeroFltPres.Cnt_lgc "MICROSAR RTE" UBYTE RTE_CM_BOOLEAN 0 0 0 255 ECU_ADDRESS 0 SYMBOL_LINK "Rte_DiagMgr_DiagStsRecRmpToZeroFltPres_Cnt_lgc" 0 DISPLAY_IDENTIFIER DiagMgr.SenderPorts.DiagStsRecRmpToZeroFltPres.Cnt_lgc /end MEASUREMENT
/begin MEASUREMENT DiagMgr.DiagStsScomHWANotValid.Cnt_lgc "MICROSAR RTE" UBYTE RTE_CM_BOOLEAN 0 0 0 255 ECU_ADDRESS 0 SYMBOL_LINK "Rte_DiagMgr_DiagStsScomHWANotValid_Cnt_lgc" 0 DISPLAY_IDENTIFIER DiagMgr.SenderPorts.DiagStsScomHWANotValid.Cnt_lgc /end MEASUREMENT
/begin MEASUREMENT DiagMgr.DiagStsWIRDisable.Cnt_lgc "MICROSAR RTE" UBYTE RTE_CM_BOOLEAN 0 0 0 255 ECU_ADDRESS 0 SYMBOL_LINK "Rte_DiagMgr_DiagStsWIRDisable_Cnt_lgc" 0 DISPLAY_IDENTIFIER DiagMgr.SenderPorts.DiagStsWIRDisable.Cnt_lgc /end MEASUREMENT
/begin MEASUREMENT DiagMgr.HwTrq.HwNm_f32 "MICROSAR RTE" FLOAT32_IEEE NO_COMPU_METHOD 0 0 1.175494351e-38 3.402823466e+38 ECU_ADDRESS 0 SYMBOL_LINK "Rte_Ap_Sweep_OutputHwTrq_HwNm_f32" 0 DISPLAY_IDENTIFIER DiagMgr.ReceiverPorts.HwTrq.HwNm_f32 /end MEASUREMENT
/begin MEASUREMENT DiagMgr.IgnCnt.Cnt_u16 "MICROSAR RTE" UWORD NO_COMPU_METHOD 0 0 0 65535 ECU_ADDRESS 0 SYMBOL_LINK "Rte_CDDInterface_IgnCnt_Cnt_u16" 0 DISPLAY_IDENTIFIER DiagMgr.ReceiverPorts.IgnCnt.Cnt_u16 /end MEASUREMENT
/begin MEASUREMENT DiagMgr.MEC.Cnt_enum "MICROSAR RTE" UBYTE RTE_CM_ENUM_ManufModeType 0 0 0 2 ECU_ADDRESS 0 SYMBOL_LINK "Rte_CDDInterface_MEC_Cnt_enum" 0 DISPLAY_IDENTIFIER DiagMgr.ReceiverPorts.MEC.Cnt_enum /end MEASUREMENT
/begin MEASUREMENT DiagMgr.MfgDiagInhibit.Cnt_lgc "MICROSAR RTE" UBYTE RTE_CM_BOOLEAN 0 0 0 255 ECU_ADDRESS 0 SYMBOL_LINK "Rte_CDDInterface_MfgDiagInhibit_Cnt_lgc" 0 DISPLAY_IDENTIFIER DiagMgr.ReceiverPorts.MfgDiagInhibit.Cnt_lgc /end MEASUREMENT
/begin MEASUREMENT DiagMgr.MtrTrq.MtrNm_f32 "MICROSAR RTE" FLOAT32_IEEE NO_COMPU_METHOD 0 0 1.175494351e-38 3.402823466e+38 ECU_ADDRESS 0 SYMBOL_LINK "Rte_CtrldDisShtdn_CntDisMtrTrqCmdMRF_MtrNm_f32" 0 DISPLAY_IDENTIFIER DiagMgr.ReceiverPorts.MtrTrq.MtrNm_f32 /end MEASUREMENT
/begin MEASUREMENT DiagMgr.SystemState.Mode "MICROSAR RTE" UBYTE RTE_CM_ENUM_StaMd_Mode 0 0 0 255 ECU_ADDRESS 0 SYMBOL_LINK "Rte_ModeMachine_StaMd_SystemState_Mode" 0 DISPLAY_IDENTIFIER DiagMgr.ModeRequirePorts.SystemState.Mode /end MEASUREMENT
/begin MEASUREMENT DiagMgr.VehSpd.Kph_f32 "MICROSAR RTE" FLOAT32_IEEE NO_COMPU_METHOD 0 0 1.175494351e-38 3.402823466e+38 ECU_ADDRESS 0 SYMBOL_LINK "Rte_Ap_SignlCondn_VehicleSpeed_Kph_f32" 0 DISPLAY_IDENTIFIER DiagMgr.ReceiverPorts.VehSpd.Kph_f32 /end MEASUREMENT
/begin MEASUREMENT DigColPs.DigColPsEOL.ColTrim_Deg_f32 "MICROSAR RTE" FLOAT32_IEEE NO_COMPU_METHOD 0 0 1.175494351e-38 3.402823466e+38 ECU_ADDRESS 0 SYMBOL_LINK "Rte_DigColPs_DigColPsEOL.ColTrim_Deg_f32" 0 DISPLAY_IDENTIFIER DigColPs.PerInstanceMemories.DigColPsEOL.ColTrim_Deg_f32 READ_WRITE /end MEASUREMENT
/begin MEASUREMENT DigColPs.DigColPsEOL.R_ColTrim_Cnt_u32 "MICROSAR RTE" ULONG NO_COMPU_METHOD 0 0 0 4294967295 ECU_ADDRESS 0 SYMBOL_LINK "Rte_DigColPs_DigColPsEOL.R_ColTrim_Cnt_u32" 0 DISPLAY_IDENTIFIER DigColPs.PerInstanceMemories.DigColPsEOL.R_ColTrim_Cnt_u32 READ_WRITE /end MEASUREMENT
/begin MEASUREMENT DigColPs.DigColPsEOL.R_SpurTrim_Cnt_u32 "MICROSAR RTE" ULONG NO_COMPU_METHOD 0 0 0 4294967295 ECU_ADDRESS 0 SYMBOL_LINK "Rte_DigColPs_DigColPsEOL.R_SpurTrim_Cnt_u32" 0 DISPLAY_IDENTIFIER DigColPs.PerInstanceMemories.DigColPsEOL.R_SpurTrim_Cnt_u32 READ_WRITE /end MEASUREMENT
/begin MEASUREMENT DigColPs.DigColPsEOL.R_TrimCom_Cnt_u16 "MICROSAR RTE" UWORD NO_COMPU_METHOD 0 0 0 65535 ECU_ADDRESS 0 SYMBOL_LINK "Rte_DigColPs_DigColPsEOL.R_TrimCom_Cnt_u16" 0 DISPLAY_IDENTIFIER DigColPs.PerInstanceMemories.DigColPsEOL.R_TrimCom_Cnt_u16 READ_WRITE /end MEASUREMENT
/begin MEASUREMENT DigColPs.DigColPsEOL.SpurTrim_Deg_f32 "MICROSAR RTE" FLOAT32_IEEE NO_COMPU_METHOD 0 0 1.175494351e-38 3.402823466e+38 ECU_ADDRESS 0 SYMBOL_LINK "Rte_DigColPs_DigColPsEOL.SpurTrim_Deg_f32" 0 DISPLAY_IDENTIFIER DigColPs.PerInstanceMemories.DigColPsEOL.SpurTrim_Deg_f32 READ_WRITE /end MEASUREMENT
/begin MEASUREMENT DigColPs.DigColPsEOL.TrimComp_Cnt_u16 "MICROSAR RTE" UWORD NO_COMPU_METHOD 0 0 0 65535 ECU_ADDRESS 0 SYMBOL_LINK "Rte_DigColPs_DigColPsEOL.TrimComp_Cnt_u16" 0 DISPLAY_IDENTIFIER DigColPs.PerInstanceMemories.DigColPsEOL.TrimComp_Cnt_u16 READ_WRITE /end MEASUREMENT
/begin MEASUREMENT DigColPs.I2CHwAbsPos.HwDeg_f32 "MICROSAR RTE" FLOAT32_IEEE NO_COMPU_METHOD 0 0 1.175494351e-38 3.402823466e+38 ECU_ADDRESS 0 SYMBOL_LINK "Rte_DigColPs_I2CHwAbsPos_HwDeg_f32" 0 DISPLAY_IDENTIFIER DigColPs.SenderPorts.I2CHwAbsPos.HwDeg_f32 /end MEASUREMENT
/begin MEASUREMENT DigColPs.I2CHwAbsPosValid.Cnt_lgc "MICROSAR RTE" UBYTE RTE_CM_BOOLEAN 0 0 0 255 ECU_ADDRESS 0 SYMBOL_LINK "Rte_DigColPs_I2CHwAbsPosValid_Cnt_lgc" 0 DISPLAY_IDENTIFIER DigColPs.SenderPorts.I2CHwAbsPosValid.Cnt_lgc /end MEASUREMENT
/begin MEASUREMENT DigColPs.MecState.Cnt_enum "MICROSAR RTE" UBYTE RTE_CM_ENUM_ManufModeType 0 0 0 2 ECU_ADDRESS 0 SYMBOL_LINK "Rte_CDDInterface_MEC_Cnt_enum" 0 DISPLAY_IDENTIFIER DigColPs.ReceiverPorts.MecState.Cnt_enum /end MEASUREMENT
/begin MEASUREMENT DigColPs.TrimComp.Cnt_lgc "MICROSAR RTE" UBYTE RTE_CM_BOOLEAN 0 0 0 255 ECU_ADDRESS 0 SYMBOL_LINK "Rte_DigColPs_TrimComp_Cnt_lgc" 0 DISPLAY_IDENTIFIER DigColPs.SenderPorts.TrimComp.Cnt_lgc /end MEASUREMENT
/begin MEASUREMENT DigPhsReasDiag.ExpectedOnTimeA.Cnt_u32 "MICROSAR RTE" ULONG NO_COMPU_METHOD 0 0 0 4294967295 ECU_ADDRESS 0 SYMBOL_LINK "Rte_CDDInterface_ExpectedOnTimeA_Cnt_u32" 0 DISPLAY_IDENTIFIER DigPhsReasDiag.ReceiverPorts.ExpectedOnTimeA.Cnt_u32 /end MEASUREMENT
/begin MEASUREMENT DigPhsReasDiag.ExpectedOnTimeB.Cnt_u32 "MICROSAR RTE" ULONG NO_COMPU_METHOD 0 0 0 4294967295 ECU_ADDRESS 0 SYMBOL_LINK "Rte_CDDInterface_ExpectedOnTimeB_Cnt_u32" 0 DISPLAY_IDENTIFIER DigPhsReasDiag.ReceiverPorts.ExpectedOnTimeB.Cnt_u32 /end MEASUREMENT
/begin MEASUREMENT DigPhsReasDiag.ExpectedOnTimeC.Cnt_u32 "MICROSAR RTE" ULONG NO_COMPU_METHOD 0 0 0 4294967295 ECU_ADDRESS 0 SYMBOL_LINK "Rte_CDDInterface_ExpectedOnTimeC_Cnt_u32" 0 DISPLAY_IDENTIFIER DigPhsReasDiag.ReceiverPorts.ExpectedOnTimeC.Cnt_u32 /end MEASUREMENT
/begin MEASUREMENT DigPhsReasDiag.GateDriveResetActive.Cnt_lgc "MICROSAR RTE" UBYTE RTE_CM_BOOLEAN 0 0 0 255 ECU_ADDRESS 0 SYMBOL_LINK "Rte_MtrDrvDiag_GateDriveResetActive_Cnt_lgc" 0 DISPLAY_IDENTIFIER DigPhsReasDiag.ReceiverPorts.GateDriveResetActive.Cnt_lgc /end MEASUREMENT
/begin MEASUREMENT DigPhsReasDiag.LRPRCorrectedMtrPosCaptured.Rev_f32 "MICROSAR RTE" FLOAT32_IEEE NO_COMPU_METHOD 0 0 1.175494351e-38 3.402823466e+38 ECU_ADDRESS 0 SYMBOL_LINK "Rte_DigPhsReasDiag_LRPRCorrectedMtrPosCaptured_Rev_f32" 0 DISPLAY_IDENTIFIER DigPhsReasDiag.ReceiverPorts.LRPRCorrectedMtrPosCaptured.Rev_f32 /end MEASUREMENT
/begin MEASUREMENT DigPhsReasDiag.LRPRModulationIndexCaptured.Uls_f32 "MICROSAR RTE" FLOAT32_IEEE NO_COMPU_METHOD 0 0 1.175494351e-38 3.402823466e+38 ECU_ADDRESS 0 SYMBOL_LINK "Rte_CDDInterface_ModIdxFinal_Uls_f32" 0 DISPLAY_IDENTIFIER DigPhsReasDiag.ReceiverPorts.LRPRModulationIndexCaptured.Uls_f32 /end MEASUREMENT
/begin MEASUREMENT DigPhsReasDiag.LRPRPhaseadvanceCaptured.Cnt_s16 "MICROSAR RTE" SWORD NO_COMPU_METHOD 0 0 -32768 32767 ECU_ADDRESS 0 SYMBOL_LINK "Rte_CDDInterface_LRPRPhaseadvanceCaptured_Cnt_s16" 0 DISPLAY_IDENTIFIER DigPhsReasDiag.ReceiverPorts.LRPRPhaseadvanceCaptured.Cnt_s16 /end MEASUREMENT
/begin MEASUREMENT DigPhsReasDiag.MeasuredOnTimeA.Cnt_u32 "MICROSAR RTE" ULONG NO_COMPU_METHOD 0 0 0 4294967295 ECU_ADDRESS 0 SYMBOL_LINK "Rte_CDDInterface_MeasuredOnTimeA_Cnt_u32" 0 DISPLAY_IDENTIFIER DigPhsReasDiag.ReceiverPorts.MeasuredOnTimeA.Cnt_u32 /end MEASUREMENT
/begin MEASUREMENT DigPhsReasDiag.MeasuredOnTimeB.Cnt_u32 "MICROSAR RTE" ULONG NO_COMPU_METHOD 0 0 0 4294967295 ECU_ADDRESS 0 SYMBOL_LINK "Rte_CDDInterface_MeasuredOnTimeB_Cnt_u32" 0 DISPLAY_IDENTIFIER DigPhsReasDiag.ReceiverPorts.MeasuredOnTimeB.Cnt_u32 /end MEASUREMENT
/begin MEASUREMENT DigPhsReasDiag.MeasuredOnTimeC.Cnt_u32 "MICROSAR RTE" ULONG NO_COMPU_METHOD 0 0 0 4294967295 ECU_ADDRESS 0 SYMBOL_LINK "Rte_CDDInterface_MeasuredOnTimeC_Cnt_u32" 0 DISPLAY_IDENTIFIER DigPhsReasDiag.ReceiverPorts.MeasuredOnTimeC.Cnt_u32 /end MEASUREMENT
/begin MEASUREMENT DigPhsReasDiag.MotorVelMRFUnfiltered.MtrRadpS_f32 "MICROSAR RTE" FLOAT32_IEEE NO_COMPU_METHOD 0 0 1.175494351e-38 3.402823466e+38 ECU_ADDRESS 0 SYMBOL_LINK "Rte_Sa_MtrVel_MotorVelMRF_MtrRadpS_f32" 0 DISPLAY_IDENTIFIER DigPhsReasDiag.ReceiverPorts.MotorVelMRFUnfiltered.MtrRadpS_f32 /end MEASUREMENT
/begin MEASUREMENT DigPhsReasDiag.MtrElecMechPolarity.Cnt_s08 "MICROSAR RTE" SBYTE NO_COMPU_METHOD 0 0 -128 127 ECU_ADDRESS 0 SYMBOL_LINK "Rte_Polarity_MtrElecMechPolarity_Cnt_s08" 0 DISPLAY_IDENTIFIER DigPhsReasDiag.ReceiverPorts.MtrElecMechPolarity.Cnt_s08 /end MEASUREMENT
/begin MEASUREMENT DigPhsReasDiag.PDActivateTest.Cnt_lgc "MICROSAR RTE" UBYTE RTE_CM_BOOLEAN 0 0 0 255 ECU_ADDRESS 0 SYMBOL_LINK "Rte_DigPhsReasDiag_PDActivateTest_Cnt_lgc" 0 DISPLAY_IDENTIFIER DigPhsReasDiag.ReceiverPorts.PDActivateTest.Cnt_lgc /end MEASUREMENT
/begin MEASUREMENT DigPhsReasDiag.SystemState.Mode "MICROSAR RTE" UBYTE RTE_CM_ENUM_StaMd_Mode 0 0 0 255 ECU_ADDRESS 0 SYMBOL_LINK "Rte_ModeMachine_StaMd_SystemState_Mode" 0 DISPLAY_IDENTIFIER DigPhsReasDiag.ModeRequirePorts.SystemState.Mode /end MEASUREMENT
/begin MEASUREMENT EOTActuatorMng.AssistEOTDamping.MtrNm_f32 "MICROSAR RTE" FLOAT32_IEEE NO_COMPU_METHOD 0 0 1.175494351e-38 3.402823466e+38 ECU_ADDRESS 0 SYMBOL_LINK "Rte_EOTActuatorMng_AssistEOTDamping_MtrNm_f32" 0 DISPLAY_IDENTIFIER EOTActuatorMng.SenderPorts.AssistEOTDamping.MtrNm_f32 /end MEASUREMENT
/begin MEASUREMENT EOTActuatorMng.AssistEOTGain.Uls_f32 "MICROSAR RTE" FLOAT32_IEEE NO_COMPU_METHOD 0 0 1.175494351e-38 3.402823466e+38 ECU_ADDRESS 0 SYMBOL_LINK "Rte_EOTActuatorMng_AssistEOTGain_Uls_f32" 0 DISPLAY_IDENTIFIER EOTActuatorMng.SenderPorts.AssistEOTGain.Uls_f32 /end MEASUREMENT
/begin MEASUREMENT EOTActuatorMng.AssistEOTLimit.MtrNm_f32 "MICROSAR RTE" FLOAT32_IEEE NO_COMPU_METHOD 0 0 1.175494351e-38 3.402823466e+38 ECU_ADDRESS 0 SYMBOL_LINK "Rte_EOTActuatorMng_AssistEOTLimit_MtrNm_f32" 0 DISPLAY_IDENTIFIER EOTActuatorMng.SenderPorts.AssistEOTLimit.MtrNm_f32 /end MEASUREMENT
/begin MEASUREMENT EOTActuatorMng.CcwEOT.HwDeg_f32 "MICROSAR RTE" FLOAT32_IEEE NO_COMPU_METHOD 0 0 1.175494351e-38 3.402823466e+38 ECU_ADDRESS 0 SYMBOL_LINK "Rte_Ap_LrnEOT_CCWPosition_HwDeg_f32" 0 DISPLAY_IDENTIFIER EOTActuatorMng.ReceiverPorts.CcwEOT.HwDeg_f32 /end MEASUREMENT
/begin MEASUREMENT EOTActuatorMng.CcwFound.Cnt_lgc "MICROSAR RTE" UBYTE RTE_CM_BOOLEAN 0 0 0 255 ECU_ADDRESS 0 SYMBOL_LINK "Rte_Ap_LrnEOT_CCWFound_Cnt_lgc" 0 DISPLAY_IDENTIFIER EOTActuatorMng.ReceiverPorts.CcwFound.Cnt_lgc /end MEASUREMENT
/begin MEASUREMENT EOTActuatorMng.CwEOT.HwDeg_f32 "MICROSAR RTE" FLOAT32_IEEE NO_COMPU_METHOD 0 0 1.175494351e-38 3.402823466e+38 ECU_ADDRESS 0 SYMBOL_LINK "Rte_Ap_LrnEOT_CWPosition_HwDeg_f32" 0 DISPLAY_IDENTIFIER EOTActuatorMng.ReceiverPorts.CwEOT.HwDeg_f32 /end MEASUREMENT
/begin MEASUREMENT EOTActuatorMng.CwFound.Cnt_lgc "MICROSAR RTE" UBYTE RTE_CM_BOOLEAN 0 0 0 255 ECU_ADDRESS 0 SYMBOL_LINK "Rte_Ap_LrnEOT_CWFound_Cnt_lgc" 0 DISPLAY_IDENTIFIER EOTActuatorMng.ReceiverPorts.CwFound.Cnt_lgc /end MEASUREMENT
/begin MEASUREMENT EOTActuatorMng.EOTDisable.Cnt_lgc "MICROSAR RTE" UBYTE RTE_CM_BOOLEAN 0 0 0 255 ECU_ADDRESS 0 SYMBOL_LINK "Rte_CDDInterface_EOTImpactSrlComSvcDft_Cnt_lgc" 0 DISPLAY_IDENTIFIER EOTActuatorMng.ReceiverPorts.EOTDisable.Cnt_lgc /end MEASUREMENT
/begin MEASUREMENT EOTActuatorMng.HandWheelAuth.Uls_f32 "MICROSAR RTE" FLOAT32_IEEE NO_COMPU_METHOD 0 0 1.175494351e-38 3.402823466e+38 ECU_ADDRESS 0 SYMBOL_LINK "Rte_AbsHwPos_HandwheelAuthority_Uls_f32" 0 DISPLAY_IDENTIFIER EOTActuatorMng.ReceiverPorts.HandWheelAuth.Uls_f32 /end MEASUREMENT
/begin MEASUREMENT EOTActuatorMng.HandWheelPos.HwDeg_f32 "MICROSAR RTE" FLOAT32_IEEE NO_COMPU_METHOD 0 0 1.175494351e-38 3.402823466e+38 ECU_ADDRESS 0 SYMBOL_LINK "Rte_AbsHwPos_HandwheelPosition_HwDeg_f32" 0 DISPLAY_IDENTIFIER EOTActuatorMng.ReceiverPorts.HandWheelPos.HwDeg_f32 /end MEASUREMENT
/begin MEASUREMENT EOTActuatorMng.HwTorque.HwNm_f32 "MICROSAR RTE" FLOAT32_IEEE NO_COMPU_METHOD 0 0 1.175494351e-38 3.402823466e+38 ECU_ADDRESS 0 SYMBOL_LINK "Rte_Ap_Sweep_OutputHwTrq_HwNm_f32" 0 DISPLAY_IDENTIFIER EOTActuatorMng.ReceiverPorts.HwTorque.HwNm_f32 /end MEASUREMENT
/begin MEASUREMENT EOTActuatorMng.MotorVel.MtrRadpS_f32 "MICROSAR RTE" FLOAT32_IEEE NO_COMPU_METHOD 0 0 1.175494351e-38 3.402823466e+38 ECU_ADDRESS 0 SYMBOL_LINK "Rte_Sa_MtrVel_MotorVelCRF_MtrRadpS_f32" 0 DISPLAY_IDENTIFIER EOTActuatorMng.ReceiverPorts.MotorVel.MtrRadpS_f32 /end MEASUREMENT
/begin MEASUREMENT EOTActuatorMng.PreLimitTorque.MtrNm_f32 "MICROSAR RTE" FLOAT32_IEEE NO_COMPU_METHOD 0 0 1.175494351e-38 3.402823466e+38 ECU_ADDRESS 0 SYMBOL_LINK "Rte_Ap_AstLmt_PreLimitTorque_MtrNm_f32" 0 DISPLAY_IDENTIFIER EOTActuatorMng.ReceiverPorts.PreLimitTorque.MtrNm_f32 /end MEASUREMENT
/begin MEASUREMENT EOTActuatorMng.VehicleSpeed.Kph_f32 "MICROSAR RTE" FLOAT32_IEEE NO_COMPU_METHOD 0 0 1.175494351e-38 3.402823466e+38 ECU_ADDRESS 0 SYMBOL_LINK "Rte_Ap_SignlCondn_VehicleSpeed_Kph_f32" 0 DISPLAY_IDENTIFIER EOTActuatorMng.ReceiverPorts.VehicleSpeed.Kph_f32 /end MEASUREMENT
/begin MEASUREMENT FltInjection.MotorVelCRF.MtrRadpS_f32 "MICROSAR RTE" FLOAT32_IEEE NO_COMPU_METHOD 0 0 1.175494351e-38 3.402823466e+38 ECU_ADDRESS 0 SYMBOL_LINK "Rte_Sa_MtrVel_MotorVelCRF_MtrRadpS_f32" 0 DISPLAY_IDENTIFIER FltInjection.ReceiverPorts.MotorVelCRF.MtrRadpS_f32 /end MEASUREMENT
/begin MEASUREMENT FrqDepDmpnInrtCmp.BaseAssistCmd.MtrNm_f32 "MICROSAR RTE" FLOAT32_IEEE NO_COMPU_METHOD 0 0 1.175494351e-38 3.402823466e+38 ECU_ADDRESS 0 SYMBOL_LINK "Rte_Assist_BaseAssistCmd_MtrNm_f32" 0 DISPLAY_IDENTIFIER FrqDepDmpnInrtCmp.ReceiverPorts.BaseAssistCmd.MtrNm_f32 /end MEASUREMENT
/begin MEASUREMENT FrqDepDmpnInrtCmp.CRFMotorVel.MtrRadpS_f32 "MICROSAR RTE" FLOAT32_IEEE NO_COMPU_METHOD 0 0 1.175494351e-38 3.402823466e+38 ECU_ADDRESS 0 SYMBOL_LINK "Rte_Sa_MtrVel_MotorVelCRF_MtrRadpS_f32" 0 DISPLAY_IDENTIFIER FrqDepDmpnInrtCmp.ReceiverPorts.CRFMotorVel.MtrRadpS_f32 /end MEASUREMENT
/begin MEASUREMENT FrqDepDmpnInrtCmp.FreqDepDmpSrlComSvcDft.Cnt_lgc "MICROSAR RTE" UBYTE RTE_CM_BOOLEAN 0 0 0 255 ECU_ADDRESS 0 SYMBOL_LINK "Rte_CDDInterface_FreqDepDmpSrlComSvcDft_Cnt_lgc" 0 DISPLAY_IDENTIFIER FrqDepDmpnInrtCmp.ReceiverPorts.FreqDepDmpSrlComSvcDft.Cnt_lgc /end MEASUREMENT
/begin MEASUREMENT FrqDepDmpnInrtCmp.FrqDepDmpnInrtCmp.MtrNm_f32 "MICROSAR RTE" FLOAT32_IEEE NO_COMPU_METHOD 0 0 1.175494351e-38 3.402823466e+38 ECU_ADDRESS 0 SYMBOL_LINK "Rte_FrqDepDmpnInrtCmp_FrqDepDmpnInrtCmp_MtrNm_f32" 0 DISPLAY_IDENTIFIER FrqDepDmpnInrtCmp.SenderPorts.FrqDepDmpnInrtCmp.MtrNm_f32 /end MEASUREMENT
/begin MEASUREMENT FrqDepDmpnInrtCmp.HwTorque.HwNm_f32 "MICROSAR RTE" FLOAT32_IEEE NO_COMPU_METHOD 0 0 1.175494351e-38 3.402823466e+38 ECU_ADDRESS 0 SYMBOL_LINK "Rte_Ap_Sweep_OutputHwTrq_HwNm_f32" 0 DISPLAY_IDENTIFIER FrqDepDmpnInrtCmp.ReceiverPorts.HwTorque.HwNm_f32 /end MEASUREMENT
/begin MEASUREMENT FrqDepDmpnInrtCmp.SystemState.Mode "MICROSAR RTE" UBYTE RTE_CM_ENUM_StaMd_Mode 0 0 0 255 ECU_ADDRESS 0 SYMBOL_LINK "Rte_ModeMachine_StaMd_SystemState_Mode" 0 DISPLAY_IDENTIFIER FrqDepDmpnInrtCmp.ModeRequirePorts.SystemState.Mode /end MEASUREMENT
/begin MEASUREMENT FrqDepDmpnInrtCmp.VehicleLonAccel.KphpS_f32 "MICROSAR RTE" FLOAT32_IEEE NO_COMPU_METHOD 0 0 1.175494351e-38 3.402823466e+38 ECU_ADDRESS 0 SYMBOL_LINK "Rte_Ap_SignlCondn_Vehicle_LonAccel_KphpS_f32" 0 DISPLAY_IDENTIFIER FrqDepDmpnInrtCmp.ReceiverPorts.VehicleLonAccel.KphpS_f32 /end MEASUREMENT
/begin MEASUREMENT FrqDepDmpnInrtCmp.VehicleSpeed.Kph_f32 "MICROSAR RTE" FLOAT32_IEEE NO_COMPU_METHOD 0 0 1.175494351e-38 3.402823466e+38 ECU_ADDRESS 0 SYMBOL_LINK "Rte_Ap_SignlCondn_VehicleSpeed_Kph_f32" 0 DISPLAY_IDENTIFIER FrqDepDmpnInrtCmp.ReceiverPorts.VehicleSpeed.Kph_f32 /end MEASUREMENT
/begin MEASUREMENT FrqDepDmpnInrtCmp.WIRCmdAmpBlnd.MtrNm_f32 "MICROSAR RTE" FLOAT32_IEEE NO_COMPU_METHOD 0 0 1.175494351e-38 3.402823466e+38 ECU_ADDRESS 0 SYMBOL_LINK "Rte_Ap_WhlImbRej_WIRCmdAmpBlnd_MtrNm_f32" 0 DISPLAY_IDENTIFIER FrqDepDmpnInrtCmp.ReceiverPorts.WIRCmdAmpBlnd.MtrNm_f32 /end MEASUREMENT
/begin MEASUREMENT HiLoadStall.AssistStallLimit.MtrNm_f32 "MICROSAR RTE" FLOAT32_IEEE NO_COMPU_METHOD 0 0 1.175494351e-38 3.402823466e+38 ECU_ADDRESS 0 SYMBOL_LINK "Rte_HiLoadStall_AssistStallLimit_MtrNm_f32" 0 DISPLAY_IDENTIFIER HiLoadStall.SenderPorts.AssistStallLimit.MtrNm_f32 /end MEASUREMENT
/begin MEASUREMENT HiLoadStall.DftStallLimit.Cnt_lgc "MICROSAR RTE" UBYTE RTE_CM_BOOLEAN 0 0 0 255 ECU_ADDRESS 0 SYMBOL_LINK "Rte_CDDInterface_EOTThermalSrlComSvcDft_Cnt_lgc" 0 DISPLAY_IDENTIFIER HiLoadStall.ReceiverPorts.DftStallLimit.Cnt_lgc /end MEASUREMENT
/begin MEASUREMENT HiLoadStall.MtrVelCRF.MtrRadpS_f32 "MICROSAR RTE" FLOAT32_IEEE NO_COMPU_METHOD 0 0 1.175494351e-38 3.402823466e+38 ECU_ADDRESS 0 SYMBOL_LINK "Rte_Sa_MtrVel_MotorVelCRF_MtrRadpS_f32" 0 DISPLAY_IDENTIFIER HiLoadStall.ReceiverPorts.MtrVelCRF.MtrRadpS_f32 /end MEASUREMENT
/begin MEASUREMENT HiLoadStall.PreLimitForStall.MtrNm_f32 "MICROSAR RTE" FLOAT32_IEEE NO_COMPU_METHOD 0 0 1.175494351e-38 3.402823466e+38 ECU_ADDRESS 0 SYMBOL_LINK "Rte_Ap_AstLmt_PreLimitForStall_MtrNm_f32" 0 DISPLAY_IDENTIFIER HiLoadStall.ReceiverPorts.PreLimitForStall.MtrNm_f32 /end MEASUREMENT
/begin MEASUREMENT HighFreqAssist.HighFreqAssist.MtrNm_f32 "MICROSAR RTE" FLOAT32_IEEE NO_COMPU_METHOD 0 0 1.175494351e-38 3.402823466e+38 ECU_ADDRESS 0 SYMBOL_LINK "Rte_HighFreqAssist_HighFreqAssist_MtrNm_f32" 0 DISPLAY_IDENTIFIER HighFreqAssist.SenderPorts.HighFreqAssist.MtrNm_f32 /end MEASUREMENT
/begin MEASUREMENT HighFreqAssist.HwTorque.HwNm_f32 "MICROSAR RTE" FLOAT32_IEEE NO_COMPU_METHOD 0 0 1.175494351e-38 3.402823466e+38 ECU_ADDRESS 0 SYMBOL_LINK "Rte_Ap_Sweep_OutputHwTrq_HwNm_f32" 0 DISPLAY_IDENTIFIER HighFreqAssist.ReceiverPorts.HwTorque.HwNm_f32 /end MEASUREMENT
/begin MEASUREMENT HighFreqAssist.VehicleSpeed.Kph_f32 "MICROSAR RTE" FLOAT32_IEEE NO_COMPU_METHOD 0 0 1.175494351e-38 3.402823466e+38 ECU_ADDRESS 0 SYMBOL_LINK "Rte_Ap_SignlCondn_VehicleSpeed_Kph_f32" 0 DISPLAY_IDENTIFIER HighFreqAssist.ReceiverPorts.VehicleSpeed.Kph_f32 /end MEASUREMENT
/begin MEASUREMENT HighFreqAssist.WIRCmdAmpBlnd.MtrNm_f32 "MICROSAR RTE" FLOAT32_IEEE NO_COMPU_METHOD 0 0 1.175494351e-38 3.402823466e+38 ECU_ADDRESS 0 SYMBOL_LINK "Rte_Ap_WhlImbRej_WIRCmdAmpBlnd_MtrNm_f32" 0 DISPLAY_IDENTIFIER HighFreqAssist.ReceiverPorts.WIRCmdAmpBlnd.MtrNm_f32 /end MEASUREMENT
/begin MEASUREMENT HystComp.AssistMechTempEst.DegC_f32 "MICROSAR RTE" FLOAT32_IEEE NO_COMPU_METHOD 0 0 1.175494351e-38 3.402823466e+38 ECU_ADDRESS 0 SYMBOL_LINK "Rte_Ap_MtrTempEst_AssistMechTempEst_DegC_f32" 0 DISPLAY_IDENTIFIER HystComp.ReceiverPorts.AssistMechTempEst.DegC_f32 /end MEASUREMENT
/begin MEASUREMENT HystComp.BaseAssistCmd.MtrNm_f32 "MICROSAR RTE" FLOAT32_IEEE NO_COMPU_METHOD 0 0 1.175494351e-38 3.402823466e+38 ECU_ADDRESS 0 SYMBOL_LINK "Rte_Assist_BaseAssistCmd_MtrNm_f32" 0 DISPLAY_IDENTIFIER HystComp.ReceiverPorts.BaseAssistCmd.MtrNm_f32 /end MEASUREMENT
/begin MEASUREMENT HystComp.DefeatHystService.Cnt_lgc "MICROSAR RTE" UBYTE RTE_CM_BOOLEAN 0 0 0 255 ECU_ADDRESS 0 SYMBOL_LINK "Rte_CDDInterface_HystCompSrlComSvcDft_Cnt_lgc" 0 DISPLAY_IDENTIFIER HystComp.ReceiverPorts.DefeatHystService.Cnt_lgc /end MEASUREMENT
/begin MEASUREMENT HystComp.FricOffset.HwNm_f32 "MICROSAR RTE" FLOAT32_IEEE NO_COMPU_METHOD 0 0 1.175494351e-38 3.402823466e+38 ECU_ADDRESS 0 SYMBOL_LINK "Rte_Ap_AvgFricLrn_FricOffset_HwNm_f32" 0 DISPLAY_IDENTIFIER HystComp.ReceiverPorts.FricOffset.HwNm_f32 /end MEASUREMENT
/begin MEASUREMENT HystComp.HwTorque.HwNm_f32 "MICROSAR RTE" FLOAT32_IEEE NO_COMPU_METHOD 0 0 1.175494351e-38 3.402823466e+38 ECU_ADDRESS 0 SYMBOL_LINK "Rte_Ap_Sweep_OutputHwTrq_HwNm_f32" 0 DISPLAY_IDENTIFIER HystComp.ReceiverPorts.HwTorque.HwNm_f32 /end MEASUREMENT
/begin MEASUREMENT HystComp.HysteresisComp.MtrNm_f32 "MICROSAR RTE" FLOAT32_IEEE NO_COMPU_METHOD 0 0 1.175494351e-38 3.402823466e+38 ECU_ADDRESS 0 SYMBOL_LINK "Rte_HystComp_HysteresisComp_MtrNm_f32" 0 DISPLAY_IDENTIFIER HystComp.SenderPorts.HysteresisComp.MtrNm_f32 /end MEASUREMENT
/begin MEASUREMENT HystComp.VehicleSpeed.Kph_f32 "MICROSAR RTE" FLOAT32_IEEE NO_COMPU_METHOD 0 0 1.175494351e-38 3.402823466e+38 ECU_ADDRESS 0 SYMBOL_LINK "Rte_Ap_SignlCondn_VehicleSpeed_Kph_f32" 0 DISPLAY_IDENTIFIER HystComp.ReceiverPorts.VehicleSpeed.Kph_f32 /end MEASUREMENT
/begin MEASUREMENT HystComp.WIRCmdAmpBlnd.MtrNm_f32 "MICROSAR RTE" FLOAT32_IEEE NO_COMPU_METHOD 0 0 1.175494351e-38 3.402823466e+38 ECU_ADDRESS 0 SYMBOL_LINK "Rte_Ap_WhlImbRej_WIRCmdAmpBlnd_MtrNm_f32" 0 DISPLAY_IDENTIFIER HystComp.ReceiverPorts.WIRCmdAmpBlnd.MtrNm_f32 /end MEASUREMENT
/begin MEASUREMENT IoHwAbstractionUsr.Batt.Volt_f32 "This signal is intended to communicate any type voltage signal measured by the ecu.  This signal has a lower limit of 0 which reequires users of the signal to provide divide by 0 protection if it is used as a denominator in a calculation.  See Vecu port p" FLOAT32_IEEE NO_COMPU_METHOD 0 0 1.175494351e-38 3.402823466e+38 ECU_ADDRESS 0 SYMBOL_LINK "Rte_IoHwAbstractionUsr_Batt_Volt_f32" 0 DISPLAY_IDENTIFIER IoHwAbstractionUsr.SenderPorts.Batt.Volt_f32 /end MEASUREMENT
/begin MEASUREMENT IoHwAbstractionUsr.BattSwitched.Volt_f32 "This signal is intended to communicate any type voltage signal measured by the ecu.  This signal has a lower limit of 0 which reequires users of the signal to provide divide by 0 protection if it is used as a denominator in a calculation.  See Vecu port p" FLOAT32_IEEE NO_COMPU_METHOD 0 0 1.175494351e-38 3.402823466e+38 ECU_ADDRESS 0 SYMBOL_LINK "Rte_IoHwAbstractionUsr_BattSwitched_Volt_f32" 0 DISPLAY_IDENTIFIER IoHwAbstractionUsr.SenderPorts.BattSwitched.Volt_f32 /end MEASUREMENT
/begin MEASUREMENT IoHwAbstractionUsr.SysCVSwitch.Volt_f32 "This signal is intended to communicate any type voltage signal measured by the ecu.  This signal has a lower limit of 0 which reequires users of the signal to provide divide by 0 protection if it is used as a denominator in a calculation.  See Vecu port p" FLOAT32_IEEE NO_COMPU_METHOD 0 0 1.175494351e-38 3.402823466e+38 ECU_ADDRESS 0 SYMBOL_LINK "Rte_IoHwAbstractionUsr_SysCVSwitch_Volt_f32" 0 DISPLAY_IDENTIFIER IoHwAbstractionUsr.SenderPorts.SysCVSwitch.Volt_f32 /end MEASUREMENT
/begin MEASUREMENT IoHwAbstractionUsr.SysCVSwitchADC.Cnt_u16 "MICROSAR RTE" UWORD NO_COMPU_METHOD 0 0 0 65535 ECU_ADDRESS 0 SYMBOL_LINK "Rte_CDDInterface_SysCVSwitchADC_Cnt_u16" 0 DISPLAY_IDENTIFIER IoHwAbstractionUsr.ReceiverPorts.SysCVSwitchADC.Cnt_u16 /end MEASUREMENT
/begin MEASUREMENT IoHwAbstractionUsr.TemperatureADC.Volt_f32 "This signal is intended to communicate any type voltage signal measured by the ecu.  This signal has a lower limit of 0 which reequires users of the signal to provide divide by 0 protection if it is used as a denominator in a calculation.  See Vecu port p" FLOAT32_IEEE NO_COMPU_METHOD 0 0 1.175494351e-38 3.402823466e+38 ECU_ADDRESS 0 SYMBOL_LINK "Rte_IoHwAbstractionUsr_TemperatureADC_Volt_f32" 0 DISPLAY_IDENTIFIER IoHwAbstractionUsr.SenderPorts.TemperatureADC.Volt_f32 /end MEASUREMENT
/begin MEASUREMENT MtrDrvDiag.FETFaultPhase.Cnt_enum "MICROSAR RTE" UBYTE RTE_CM_ENUM_FETPHASETYPE_ENUM 0 0 0 255 ECU_ADDRESS 0 SYMBOL_LINK "Rte_MtrDrvDiag_FETFaultPhase_Cnt_enum" 0 DISPLAY_IDENTIFIER MtrDrvDiag.SenderPorts.FETFaultPhase.Cnt_enum /end MEASUREMENT
/begin MEASUREMENT MtrDrvDiag.FETFaultType.Cnt_enum "MICROSAR RTE" UBYTE RTE_CM_ENUM_FETFAULTTYPE_ENUM 0 0 0 255 ECU_ADDRESS 0 SYMBOL_LINK "Rte_MtrDrvDiag_FETFaultType_Cnt_enum" 0 DISPLAY_IDENTIFIER MtrDrvDiag.SenderPorts.FETFaultType.Cnt_enum /end MEASUREMENT
/begin MEASUREMENT MtrDrvDiag.GateDriveResetActive.Cnt_lgc "MICROSAR RTE" UBYTE RTE_CM_BOOLEAN 0 0 0 255 ECU_ADDRESS 0 SYMBOL_LINK "Rte_MtrDrvDiag_GateDriveResetActive_Cnt_lgc" 0 DISPLAY_IDENTIFIER MtrDrvDiag.SenderPorts.GateDriveResetActive.Cnt_lgc /end MEASUREMENT
/begin MEASUREMENT MtrDrvDiag.MtrDrvrInitComplete.Cnt_lgc "MICROSAR RTE" UBYTE RTE_CM_BOOLEAN 0 0 0 255 ECU_ADDRESS 0 SYMBOL_LINK "Rte_MtrDrvDiag_MtrDrvrInitComplete_Cnt_lgc" 0 DISPLAY_IDENTIFIER MtrDrvDiag.SenderPorts.MtrDrvrInitComplete.Cnt_lgc /end MEASUREMENT
/begin MEASUREMENT MtrDrvDiag.MtrDrvrInitStart.Cnt_lgc "MICROSAR RTE" UBYTE RTE_CM_BOOLEAN 0 0 0 255 ECU_ADDRESS 0 SYMBOL_LINK "Rte_Ap_HwPwUp_MtrDrvrInitStart_Cnt_lgc" 0 DISPLAY_IDENTIFIER MtrDrvDiag.ReceiverPorts.MtrDrvrInitStart.Cnt_lgc /end MEASUREMENT
/begin MEASUREMENT MtrDrvDiag.SystemState.Mode "MICROSAR RTE" UBYTE RTE_CM_ENUM_StaMd_Mode 0 0 0 255 ECU_ADDRESS 0 SYMBOL_LINK "Rte_ModeMachine_StaMd_SystemState_Mode" 0 DISPLAY_IDENTIFIER MtrDrvDiag.ModeRequirePorts.SystemState.Mode /end MEASUREMENT
/begin MEASUREMENT PeakCurrEst.EstPkCurr.AmpSq_f32 "MICROSAR RTE" FLOAT32_IEEE NO_COMPU_METHOD 0 0 1.175494351e-38 3.402823466e+38 ECU_ADDRESS 0 SYMBOL_LINK "Rte_PeakCurrEst_EstPkCurr_AmpSq_f32" 0 DISPLAY_IDENTIFIER PeakCurrEst.SenderPorts.EstPkCurr.AmpSq_f32 /end MEASUREMENT
/begin MEASUREMENT PeakCurrEst.FiltEstPkCurr.AmpSq_f32 "MICROSAR RTE" FLOAT32_IEEE NO_COMPU_METHOD 0 0 1.175494351e-38 3.402823466e+38 ECU_ADDRESS 0 SYMBOL_LINK "Rte_PeakCurrEst_FiltEstPkCurr_AmpSq_f32" 0 DISPLAY_IDENTIFIER PeakCurrEst.SenderPorts.FiltEstPkCurr.AmpSq_f32 /end MEASUREMENT
/begin MEASUREMENT PeakCurrEst.IvtrLoaMtgtnEn.Cnt_lgc "MICROSAR RTE" UBYTE RTE_CM_BOOLEAN 0 0 0 255 ECU_ADDRESS 0 SYMBOL_LINK "Rte_PeakCurrEst_IvtrLoaMtgtnEn_Cnt_lgc" 0 DISPLAY_IDENTIFIER PeakCurrEst.ReceiverPorts.IvtrLoaMtgtnEn.Cnt_lgc /end MEASUREMENT
/begin MEASUREMENT PeakCurrEst.MotCurrLoaMtgtnEn.Cnt_lgc "MICROSAR RTE" UBYTE RTE_CM_BOOLEAN 0 0 0 255 ECU_ADDRESS 0 SYMBOL_LINK "Rte_PeakCurrEst_MotCurrLoaMtgtnEn_Cnt_lgc" 0 DISPLAY_IDENTIFIER PeakCurrEst.ReceiverPorts.MotCurrLoaMtgtnEn.Cnt_lgc /end MEASUREMENT
/begin MEASUREMENT PeakCurrEst.MtrCurrDax.Amp_f32 "MICROSAR RTE" FLOAT32_IEEE NO_COMPU_METHOD 0 0 1.175494351e-38 3.402823466e+38 ECU_ADDRESS 0 SYMBOL_LINK "Rte_CDDInterface_MtrCurrDax_Amp_f32" 0 DISPLAY_IDENTIFIER PeakCurrEst.ReceiverPorts.MtrCurrDax.Amp_f32 /end MEASUREMENT
/begin MEASUREMENT PeakCurrEst.MtrCurrDaxRef.Amp_f32 "MICROSAR RTE" FLOAT32_IEEE NO_COMPU_METHOD 0 0 1.175494351e-38 3.402823466e+38 ECU_ADDRESS 0 SYMBOL_LINK "Rte_CurrCmd_MtrCurrDaxRef_Amp_f32" 0 DISPLAY_IDENTIFIER PeakCurrEst.ReceiverPorts.MtrCurrDaxRef.Amp_f32 /end MEASUREMENT
/begin MEASUREMENT PeakCurrEst.MtrCurrQax.Amp_f32 "MICROSAR RTE" FLOAT32_IEEE NO_COMPU_METHOD 0 0 1.175494351e-38 3.402823466e+38 ECU_ADDRESS 0 SYMBOL_LINK "Rte_CDDInterface_MtrCurrQax_Amp_f32" 0 DISPLAY_IDENTIFIER PeakCurrEst.ReceiverPorts.MtrCurrQax.Amp_f32 /end MEASUREMENT
/begin MEASUREMENT PeakCurrEst.MtrCurrQaxRef.Amp_f32 "MICROSAR RTE" FLOAT32_IEEE NO_COMPU_METHOD 0 0 1.175494351e-38 3.402823466e+38 ECU_ADDRESS 0 SYMBOL_LINK "Rte_CurrCmd_MtrCurrQaxRef_Amp_f32" 0 DISPLAY_IDENTIFIER PeakCurrEst.ReceiverPorts.MtrCurrQaxRef.Amp_f32 /end MEASUREMENT
/begin MEASUREMENT PeakCurrEst.SystemState.Mode "MICROSAR RTE" UBYTE RTE_CM_ENUM_StaMd_Mode 0 0 0 255 ECU_ADDRESS 0 SYMBOL_LINK "Rte_ModeMachine_StaMd_SystemState_Mode" 0 DISPLAY_IDENTIFIER PeakCurrEst.ModeRequirePorts.SystemState.Mode /end MEASUREMENT
/begin MEASUREMENT Polarity.AssistAssyPolarity.Cnt_s08 "MICROSAR RTE" SBYTE NO_COMPU_METHOD 0 0 -128 127 ECU_ADDRESS 0 SYMBOL_LINK "Rte_Polarity_AssistAssyPolarity_Cnt_s08" 0 DISPLAY_IDENTIFIER Polarity.SenderPorts.AssistAssyPolarity.Cnt_s08 /end MEASUREMENT
/begin MEASUREMENT Polarity.DiagAssistAssyPolarity.Cnt_s08 "MICROSAR RTE" SBYTE NO_COMPU_METHOD 0 0 -128 127 ECU_ADDRESS 0 SYMBOL_LINK "Rte_Polarity_AssistAssyPolarity_Cnt_s08" 0 DISPLAY_IDENTIFIER Polarity.ReceiverPorts.DiagAssistAssyPolarity.Cnt_s08 /end MEASUREMENT
/begin MEASUREMENT Polarity.DiagHwPosPolarity.Cnt_s08 "MICROSAR RTE" SBYTE NO_COMPU_METHOD 0 0 -128 127 ECU_ADDRESS 0 SYMBOL_LINK "Rte_Polarity_HwPosPolarity_Cnt_s08" 0 DISPLAY_IDENTIFIER Polarity.ReceiverPorts.DiagHwPosPolarity.Cnt_s08 /end MEASUREMENT
/begin MEASUREMENT Polarity.DiagHwTrqPolarity.Cnt_s08 "MICROSAR RTE" SBYTE NO_COMPU_METHOD 0 0 -128 127 ECU_ADDRESS 0 SYMBOL_LINK "Rte_Polarity_HwTrqPolarity_Cnt_s08" 0 DISPLAY_IDENTIFIER Polarity.ReceiverPorts.DiagHwTrqPolarity.Cnt_s08 /end MEASUREMENT
/begin MEASUREMENT Polarity.DiagMtrElecMechPolarity.Cnt_s08 "MICROSAR RTE" SBYTE NO_COMPU_METHOD 0 0 -128 127 ECU_ADDRESS 0 SYMBOL_LINK "Rte_Polarity_MtrElecMechPolarity_Cnt_s08" 0 DISPLAY_IDENTIFIER Polarity.ReceiverPorts.DiagMtrElecMechPolarity.Cnt_s08 /end MEASUREMENT
/begin MEASUREMENT Polarity.DiagMtrPosPolarity.Cnt_s08 "MICROSAR RTE" SBYTE NO_COMPU_METHOD 0 0 -128 127 ECU_ADDRESS 0 SYMBOL_LINK "Rte_Polarity_MtrPosPolarity_Cnt_s08" 0 DISPLAY_IDENTIFIER Polarity.ReceiverPorts.DiagMtrPosPolarity.Cnt_s08 /end MEASUREMENT
/begin MEASUREMENT Polarity.DiagMtrVelPolarity.Cnt_s08 "MICROSAR RTE" SBYTE NO_COMPU_METHOD 0 0 -128 127 ECU_ADDRESS 0 SYMBOL_LINK "Rte_Polarity_MtrVelPolarity_Cnt_s08" 0 DISPLAY_IDENTIFIER Polarity.ReceiverPorts.DiagMtrVelPolarity.Cnt_s08 /end MEASUREMENT
/begin MEASUREMENT Polarity.HwPosPolarity.Cnt_s08 "MICROSAR RTE" SBYTE NO_COMPU_METHOD 0 0 -128 127 ECU_ADDRESS 0 SYMBOL_LINK "Rte_Polarity_HwPosPolarity_Cnt_s08" 0 DISPLAY_IDENTIFIER Polarity.SenderPorts.HwPosPolarity.Cnt_s08 /end MEASUREMENT
/begin MEASUREMENT Polarity.HwTrqPolarity.Cnt_s08 "MICROSAR RTE" SBYTE NO_COMPU_METHOD 0 0 -128 127 ECU_ADDRESS 0 SYMBOL_LINK "Rte_Polarity_HwTrqPolarity_Cnt_s08" 0 DISPLAY_IDENTIFIER Polarity.SenderPorts.HwTrqPolarity.Cnt_s08 /end MEASUREMENT
/begin MEASUREMENT Polarity.MtrElecMechPolarity.Cnt_s08 "MICROSAR RTE" SBYTE NO_COMPU_METHOD 0 0 -128 127 ECU_ADDRESS 0 SYMBOL_LINK "Rte_Polarity_MtrElecMechPolarity_Cnt_s08" 0 DISPLAY_IDENTIFIER Polarity.SenderPorts.MtrElecMechPolarity.Cnt_s08 /end MEASUREMENT
/begin MEASUREMENT Polarity.MtrPosPolarity.Cnt_s08 "MICROSAR RTE" SBYTE NO_COMPU_METHOD 0 0 -128 127 ECU_ADDRESS 0 SYMBOL_LINK "Rte_Polarity_MtrPosPolarity_Cnt_s08" 0 DISPLAY_IDENTIFIER Polarity.SenderPorts.MtrPosPolarity.Cnt_s08 /end MEASUREMENT
/begin MEASUREMENT Polarity.MtrVelPolarity.Cnt_s08 "MICROSAR RTE" SBYTE NO_COMPU_METHOD 0 0 -128 127 ECU_ADDRESS 0 SYMBOL_LINK "Rte_Polarity_MtrVelPolarity_Cnt_s08" 0 DISPLAY_IDENTIFIER Polarity.SenderPorts.MtrVelPolarity.Cnt_s08 /end MEASUREMENT
/begin MEASUREMENT Polarity.Polarity_Cnt_Str.Polarity_Cnt_b08 "MICROSAR RTE" UBYTE NO_COMPU_METHOD 0 0 0 255 ECU_ADDRESS 0 SYMBOL_LINK "Rte_Polarity_Polarity_Cnt_Str.Polarity_Cnt_b08" 0 DISPLAY_IDENTIFIER Polarity.PerInstanceMemories.Polarity_Cnt_Str.Polarity_Cnt_b08 READ_WRITE /end MEASUREMENT
/begin MEASUREMENT Polarity.Polarity_Cnt_Str.R_Polarity_Cnt_b08 "MICROSAR RTE" UBYTE NO_COMPU_METHOD 0 0 0 255 ECU_ADDRESS 0 SYMBOL_LINK "Rte_Polarity_Polarity_Cnt_Str.R_Polarity_Cnt_b08" 0 DISPLAY_IDENTIFIER Polarity.PerInstanceMemories.Polarity_Cnt_Str.R_Polarity_Cnt_b08 READ_WRITE /end MEASUREMENT
/begin MEASUREMENT Polarity.SysC_MtrElecMechPolarity.Cnt_s32 "MICROSAR RTE" SLONG NO_COMPU_METHOD 0 0 -2147483648 2147483647 ECU_ADDRESS 0 SYMBOL_LINK "Rte_Polarity_SysC_MtrElecMechPolarity_Cnt_s32" 0 DISPLAY_IDENTIFIER Polarity.SenderPorts.SysC_MtrElecMechPolarity.Cnt_s32 /end MEASUREMENT
/begin MEASUREMENT QuadDet.InstMtrDir.Cnt_s08 "MICROSAR RTE" SBYTE NO_COMPU_METHOD 0 0 -128 127 ECU_ADDRESS 0 SYMBOL_LINK "Rte_QuadDet_InstMtrDir_Cnt_s08" 0 DISPLAY_IDENTIFIER QuadDet.SenderPorts.InstMtrDir.Cnt_s08 /end MEASUREMENT
/begin MEASUREMENT QuadDet.MRFCumMtrPos.Deg_f32 "MICROSAR RTE" FLOAT32_IEEE NO_COMPU_METHOD 0 0 1.175494351e-38 3.402823466e+38 ECU_ADDRESS 0 SYMBOL_LINK "Rte_Sa_DigMSB_CumMechMtrPosMRF_Deg_f32" 0 DISPLAY_IDENTIFIER QuadDet.ReceiverPorts.MRFCumMtrPos.Deg_f32 /end MEASUREMENT
/begin MEASUREMENT QuadDet.MRFMtrTrqCmdScl.MtrNm_f32 "MICROSAR RTE" FLOAT32_IEEE NO_COMPU_METHOD 0 0 1.175494351e-38 3.402823466e+38 ECU_ADDRESS 0 SYMBOL_LINK "Rte_TrqCmdScl_MRFMtrTrqCmdScl_MtrNm_f32" 0 DISPLAY_IDENTIFIER QuadDet.ReceiverPorts.MRFMtrTrqCmdScl.MtrNm_f32 /end MEASUREMENT
/begin MEASUREMENT QuadDet.MtrQuad.Cnt_u08 "MICROSAR RTE" UBYTE NO_COMPU_METHOD 0 0 0 255 ECU_ADDRESS 0 SYMBOL_LINK "Rte_QuadDet_MtrQuad_Cnt_u08" 0 DISPLAY_IDENTIFIER QuadDet.SenderPorts.MtrQuad.Cnt_u08 /end MEASUREMENT
/begin MEASUREMENT Return.AssistMechTempEst.DegC_f32 "MICROSAR RTE" FLOAT32_IEEE NO_COMPU_METHOD 0 0 1.175494351e-38 3.402823466e+38 ECU_ADDRESS 0 SYMBOL_LINK "Rte_Ap_MtrTempEst_AssistMechTempEst_DegC_f32" 0 DISPLAY_IDENTIFIER Return.ReceiverPorts.AssistMechTempEst.DegC_f32 /end MEASUREMENT
/begin MEASUREMENT Return.DefeatReturnSvc.Cnt_lgc "MICROSAR RTE" UBYTE RTE_CM_BOOLEAN 0 0 0 255 ECU_ADDRESS 0 SYMBOL_LINK "Rte_CDDInterface_ReturnSrlComSvcDft_Cnt_lgc" 0 DISPLAY_IDENTIFIER Return.ReceiverPorts.DefeatReturnSvc.Cnt_lgc /end MEASUREMENT
/begin MEASUREMENT Return.DiagStsHwPosDis.Cnt_lgc "MICROSAR RTE" UBYTE RTE_CM_BOOLEAN 0 0 0 255 ECU_ADDRESS 0 SYMBOL_LINK "Rte_DiagMgr_DiagStsHWASbSystmFltPres_Cnt_lgc" 0 DISPLAY_IDENTIFIER Return.ReceiverPorts.DiagStsHwPosDis.Cnt_lgc /end MEASUREMENT
/begin MEASUREMENT Return.HandwheelAuthority.Uls_f32 "MICROSAR RTE" FLOAT32_IEEE NO_COMPU_METHOD 0 0 1.175494351e-38 3.402823466e+38 ECU_ADDRESS 0 SYMBOL_LINK "Rte_AbsHwPos_HandwheelAuthority_Uls_f32" 0 DISPLAY_IDENTIFIER Return.ReceiverPorts.HandwheelAuthority.Uls_f32 /end MEASUREMENT
/begin MEASUREMENT Return.HandwheelPosition.HwDeg_f32 "MICROSAR RTE" FLOAT32_IEEE NO_COMPU_METHOD 0 0 1.175494351e-38 3.402823466e+38 ECU_ADDRESS 0 SYMBOL_LINK "Rte_AbsHwPos_HandwheelPosition_HwDeg_f32" 0 DISPLAY_IDENTIFIER Return.ReceiverPorts.HandwheelPosition.HwDeg_f32 /end MEASUREMENT
/begin MEASUREMENT Return.HandwheelVel.HwRadpS_f32 "MICROSAR RTE" FLOAT32_IEEE NO_COMPU_METHOD 0 0 1.175494351e-38 3.402823466e+38 ECU_ADDRESS 0 SYMBOL_LINK "Rte_Sa_MtrVel_HandwheelVel_HwRadpS_f32" 0 DISPLAY_IDENTIFIER Return.ReceiverPorts.HandwheelVel.HwRadpS_f32 /end MEASUREMENT
/begin MEASUREMENT Return.HwTorque.HwNm_f32 "MICROSAR RTE" FLOAT32_IEEE NO_COMPU_METHOD 0 0 1.175494351e-38 3.402823466e+38 ECU_ADDRESS 0 SYMBOL_LINK "Rte_Ap_Sweep_OutputHwTrq_HwNm_f32" 0 DISPLAY_IDENTIFIER Return.ReceiverPorts.HwTorque.HwNm_f32 /end MEASUREMENT
/begin MEASUREMENT Return.PAReturnSclFct.Uls_f32 "MICROSAR RTE" FLOAT32_IEEE NO_COMPU_METHOD 0 0 1.175494351e-38 3.402823466e+38 ECU_ADDRESS 0 SYMBOL_LINK "Rte_Ap_PosServo_PosSrvoReturnSclFct_Uls_f32" 0 DISPLAY_IDENTIFIER Return.ReceiverPorts.PAReturnSclFct.Uls_f32 /end MEASUREMENT
/begin MEASUREMENT Return.ReturnCmd.MtrNm_f32 "MICROSAR RTE" FLOAT32_IEEE NO_COMPU_METHOD 0 0 1.175494351e-38 3.402823466e+38 ECU_ADDRESS 0 SYMBOL_LINK "Rte_Return_ReturnCmd_MtrNm_f32" 0 DISPLAY_IDENTIFIER Return.SenderPorts.ReturnCmd.MtrNm_f32 /end MEASUREMENT
/begin MEASUREMENT Return.ReturnDDFactor.Uls_f32 "MICROSAR RTE" FLOAT32_IEEE NO_COMPU_METHOD 0 0 1.175494351e-38 3.402823466e+38 ECU_ADDRESS 0 SYMBOL_LINK "Rte_Ap_TrqArblim_ReturnDDFactor_Uls_f32" 0 DISPLAY_IDENTIFIER Return.ReceiverPorts.ReturnDDFactor.Uls_f32 /end MEASUREMENT
/begin MEASUREMENT Return.ReturnOffset.HwDeg_f32 "MICROSAR RTE" FLOAT32_IEEE NO_COMPU_METHOD 0 0 1.175494351e-38 3.402823466e+38 ECU_ADDRESS 0 SYMBOL_LINK "Rte_Return_ReturnOffset_HwDeg_f32" 0 DISPLAY_IDENTIFIER Return.ReceiverPorts.ReturnOffset.HwDeg_f32 /end MEASUREMENT
/begin MEASUREMENT Return.VehicleSpeed.Kph_f32 "MICROSAR RTE" FLOAT32_IEEE NO_COMPU_METHOD 0 0 1.175494351e-38 3.402823466e+38 ECU_ADDRESS 0 SYMBOL_LINK "Rte_Ap_SignlCondn_VehicleSpeed_Kph_f32" 0 DISPLAY_IDENTIFIER Return.ReceiverPorts.VehicleSpeed.Kph_f32 /end MEASUREMENT
/begin MEASUREMENT ReturnFirewall.Defeat_Return_Svc.Cnt_lgc "MICROSAR RTE" UBYTE RTE_CM_BOOLEAN 0 0 0 255 ECU_ADDRESS 0 SYMBOL_LINK "Rte_CDDInterface_ReturnSrlComSvcDft_Cnt_lgc" 0 DISPLAY_IDENTIFIER ReturnFirewall.ReceiverPorts.Defeat_Return_Svc.Cnt_lgc /end MEASUREMENT
/begin MEASUREMENT ReturnFirewall.HandwheelPosition.HwDeg_f32 "MICROSAR RTE" FLOAT32_IEEE NO_COMPU_METHOD 0 0 1.175494351e-38 3.402823466e+38 ECU_ADDRESS 0 SYMBOL_LINK "Rte_AbsHwPos_HandwheelPosition_HwDeg_f32" 0 DISPLAY_IDENTIFIER ReturnFirewall.ReceiverPorts.HandwheelPosition.HwDeg_f32 /end MEASUREMENT
/begin MEASUREMENT ReturnFirewall.LimitedReturn.MtrNm_f32 "MICROSAR RTE" FLOAT32_IEEE NO_COMPU_METHOD 0 0 1.175494351e-38 3.402823466e+38 ECU_ADDRESS 0 SYMBOL_LINK "Rte_ReturnFirewall_LimitedReturn_MtrNm_f32" 0 DISPLAY_IDENTIFIER ReturnFirewall.SenderPorts.LimitedReturn.MtrNm_f32 /end MEASUREMENT
/begin MEASUREMENT ReturnFirewall.MEC_Counter.Cnt_enum "MICROSAR RTE" UBYTE RTE_CM_ENUM_ManufModeType 0 0 0 2 ECU_ADDRESS 0 SYMBOL_LINK "Rte_CDDInterface_MEC_Cnt_enum" 0 DISPLAY_IDENTIFIER ReturnFirewall.ReceiverPorts.MEC_Counter.Cnt_enum /end MEASUREMENT
/begin MEASUREMENT ReturnFirewall.ReturnCmd.MtrNm_f32 "MICROSAR RTE" FLOAT32_IEEE NO_COMPU_METHOD 0 0 1.175494351e-38 3.402823466e+38 ECU_ADDRESS 0 SYMBOL_LINK "Rte_Return_ReturnCmd_MtrNm_f32" 0 DISPLAY_IDENTIFIER ReturnFirewall.ReceiverPorts.ReturnCmd.MtrNm_f32 /end MEASUREMENT
/begin MEASUREMENT ReturnFirewall.VehicleSpeed.Kph_f32 "MICROSAR RTE" FLOAT32_IEEE NO_COMPU_METHOD 0 0 1.175494351e-38 3.402823466e+38 ECU_ADDRESS 0 SYMBOL_LINK "Rte_Ap_SignlCondn_VehicleSpeed_Kph_f32" 0 DISPLAY_IDENTIFIER ReturnFirewall.ReceiverPorts.VehicleSpeed.Kph_f32 /end MEASUREMENT
/begin MEASUREMENT RteErrata.SystemState.Mode "MICROSAR RTE" UBYTE RTE_CM_ENUM_StaMd_Mode 0 0 0 255 ECU_ADDRESS 0 SYMBOL_LINK "Rte_ModeMachine_StaMd_SystemState_Mode" 0 DISPLAY_IDENTIFIER RteErrata.ModeRequirePorts.SystemState.Mode /end MEASUREMENT
/begin MEASUREMENT RteErrata8.SystemState.Mode "MICROSAR RTE" UBYTE RTE_CM_ENUM_StaMd_Mode 0 0 0 255 ECU_ADDRESS 0 SYMBOL_LINK "Rte_ModeMachine_Ap_StaMd8_SystemState8_Mode" 0 DISPLAY_IDENTIFIER RteErrata8.ModeRequirePorts.SystemState.Mode /end MEASUREMENT
/begin GROUP CmMtrCurr.ADCMtrCurr2.Volts_f32 "MICROSAR RTE" /begin SUB_GROUP /end SUB_GROUP /begin FUNCTION_LIST /end FUNCTION_LIST /begin REF_CHARACTERISTIC /end REF_CHARACTERISTIC /begin REF_MEASUREMENT CmMtrCurr.ADCMtrCurr2.Volts_f32 /end REF_MEASUREMENT /end GROUP
/begin GROUP CmMtrCurr.ComOffset.Cnt_u16 "MICROSAR RTE" /begin SUB_GROUP /end SUB_GROUP /begin FUNCTION_LIST /end FUNCTION_LIST /begin REF_CHARACTERISTIC /end REF_CHARACTERISTIC /begin REF_MEASUREMENT CmMtrCurr.ComOffset.Cnt_u16 /end REF_MEASUREMENT /end GROUP
/begin GROUP CmMtrCurr.CorrMtrCurrPosition.Rev_f32 "MICROSAR RTE" /begin SUB_GROUP /end SUB_GROUP /begin FUNCTION_LIST /end FUNCTION_LIST /begin REF_CHARACTERISTIC /end REF_CHARACTERISTIC /begin REF_MEASUREMENT CmMtrCurr.CorrMtrCurrPosition.Rev_f32 /end REF_MEASUREMENT /end GROUP
/begin GROUP CmMtrCurr.CurrTempOffset "MICROSAR RTE" /begin SUB_GROUP /end SUB_GROUP /begin FUNCTION_LIST /end FUNCTION_LIST /begin REF_CHARACTERISTIC /end REF_CHARACTERISTIC
 /begin REF_MEASUREMENT CmMtrCurr.CurrTempOffset.CurrOffsetY1_Volts_s4p11 CmMtrCurr.CurrTempOffset.CurrOffsetY2_Volts_s4p11 CmMtrCurr.CurrTempOffset.CurrTempOffsetX_DegC_s10p5 /end REF_MEASUREMENT
/end GROUP
/begin GROUP CmMtrCurr.CurrentGainSvc.Cnt_lgc "MICROSAR RTE" /begin SUB_GROUP /end SUB_GROUP /begin FUNCTION_LIST /end FUNCTION_LIST /begin REF_CHARACTERISTIC /end REF_CHARACTERISTIC /begin REF_MEASUREMENT CmMtrCurr.CurrentGainSvc.Cnt_lgc /end REF_MEASUREMENT /end GROUP
/begin GROUP CmMtrCurr.FiltCntrlTemp.DegC_f32 "MICROSAR RTE" /begin SUB_GROUP /end SUB_GROUP /begin FUNCTION_LIST /end FUNCTION_LIST /begin REF_CHARACTERISTIC /end REF_CHARACTERISTIC /begin REF_MEASUREMENT CmMtrCurr.FiltCntrlTemp.DegC_f32 /end REF_MEASUREMENT /end GROUP
/begin GROUP CmMtrCurr.MEC.Cnt_enum "MICROSAR RTE" /begin SUB_GROUP /end SUB_GROUP /begin FUNCTION_LIST /end FUNCTION_LIST /begin REF_CHARACTERISTIC /end REF_CHARACTERISTIC /begin REF_MEASUREMENT CmMtrCurr.MEC.Cnt_enum /end REF_MEASUREMENT /end GROUP
/begin GROUP CmMtrCurr.ModeRequirePorts "MICROSAR RTE" /begin SUB_GROUP CmMtrCurr.SystemState.Mode /end SUB_GROUP /begin FUNCTION_LIST /end FUNCTION_LIST /begin REF_CHARACTERISTIC /end REF_CHARACTERISTIC /begin REF_MEASUREMENT /end REF_MEASUREMENT /end GROUP
/begin GROUP CmMtrCurr.MtrCurr1TempOffset.Volt_f32 "MICROSAR RTE" /begin SUB_GROUP /end SUB_GROUP /begin FUNCTION_LIST /end FUNCTION_LIST /begin REF_CHARACTERISTIC /end REF_CHARACTERISTIC /begin REF_MEASUREMENT CmMtrCurr.MtrCurr1TempOffset.Volt_f32 /end REF_MEASUREMENT /end GROUP
/begin GROUP CmMtrCurr.MtrCurr2TempOffset.Volt_f32 "MICROSAR RTE" /begin SUB_GROUP /end SUB_GROUP /begin FUNCTION_LIST /end FUNCTION_LIST /begin REF_CHARACTERISTIC /end REF_CHARACTERISTIC /begin REF_MEASUREMENT CmMtrCurr.MtrCurr2TempOffset.Volt_f32 /end REF_MEASUREMENT /end GROUP
/begin GROUP CmMtrCurr.MtrCurrAngle.Rev_f32 "MICROSAR RTE" /begin SUB_GROUP /end SUB_GROUP /begin FUNCTION_LIST /end FUNCTION_LIST /begin REF_CHARACTERISTIC /end REF_CHARACTERISTIC /begin REF_MEASUREMENT CmMtrCurr.MtrCurrAngle.Rev_f32 /end REF_MEASUREMENT /end GROUP
/begin GROUP CmMtrCurr.MtrCurrK1.Amp_f32 "MICROSAR RTE" /begin SUB_GROUP /end SUB_GROUP /begin FUNCTION_LIST /end FUNCTION_LIST /begin REF_CHARACTERISTIC /end REF_CHARACTERISTIC /begin REF_MEASUREMENT CmMtrCurr.MtrCurrK1.Amp_f32 /end REF_MEASUREMENT /end GROUP
/begin GROUP CmMtrCurr.MtrCurrK2.Amp_f32 "MICROSAR RTE" /begin SUB_GROUP /end SUB_GROUP /begin FUNCTION_LIST /end FUNCTION_LIST /begin REF_CHARACTERISTIC /end REF_CHARACTERISTIC /begin REF_MEASUREMENT CmMtrCurr.MtrCurrK2.Amp_f32 /end REF_MEASUREMENT /end GROUP
/begin GROUP CmMtrCurr.MtrVel.MtrRadpS_f32 "MICROSAR RTE" /begin SUB_GROUP /end SUB_GROUP /begin FUNCTION_LIST /end FUNCTION_LIST /begin REF_CHARACTERISTIC /end REF_CHARACTERISTIC /begin REF_MEASUREMENT CmMtrCurr.MtrVel.MtrRadpS_f32 /end REF_MEASUREMENT /end GROUP
/begin GROUP CmMtrCurr.PerInstanceMemories "MICROSAR RTE" /begin SUB_GROUP CmMtrCurr.CurrTempOffset CmMtrCurr.ShCurrCal /end SUB_GROUP /begin FUNCTION_LIST /end FUNCTION_LIST /begin REF_CHARACTERISTIC /end REF_CHARACTERISTIC /begin REF_MEASUREMENT /end REF_MEASUREMENT /end GROUP
/begin GROUP CmMtrCurr.ReceiverPorts "MICROSAR RTE"
 /begin SUB_GROUP CmMtrCurr.ADCMtrCurr1.Volts_f32 CmMtrCurr.ADCMtrCurr2.Volts_f32 CmMtrCurr.CorrMtrCurrPosition.Rev_f32 CmMtrCurr.FiltCntrlTemp.DegC_f32 CmMtrCurr.MEC.Cnt_enum CmMtrCurr.MtrCurrAngle.Rev_f32 CmMtrCurr.MtrCurrK1.Amp_f32 CmMtrCurr.MtrCurrK2.Amp_f32 CmMtrCurr.MtrVel.MtrRadpS_f32 CmMtrCurr.SrlComSvcDft.Cnt_b32 CmMtrCurr.Vecu.Volt_f32 CmMtrCurr.VehSpd.Kph_f32 CmMtrCurr.VhSpdValid.Cnt_lgc /end SUB_GROUP
 /begin FUNCTION_LIST /end FUNCTION_LIST
 /begin REF_CHARACTERISTIC /end REF_CHARACTERISTIC
 /begin REF_MEASUREMENT /end REF_MEASUREMENT
/end GROUP
/begin GROUP CmMtrCurr.SenderPorts "MICROSAR RTE"
 /begin SUB_GROUP CmMtrCurr.ComOffset.Cnt_u16 CmMtrCurr.CurrentGainSvc.Cnt_lgc CmMtrCurr.MtrCurr1TempOffset.Volt_f32 CmMtrCurr.MtrCurr2TempOffset.Volt_f32 /end SUB_GROUP
 /begin FUNCTION_LIST /end FUNCTION_LIST
 /begin REF_CHARACTERISTIC /end REF_CHARACTERISTIC
 /begin REF_MEASUREMENT /end REF_MEASUREMENT
/end GROUP
/begin GROUP CmMtrCurr.ShCurrCal "MICROSAR RTE" /begin SUB_GROUP /end SUB_GROUP /begin FUNCTION_LIST /end FUNCTION_LIST /begin REF_CHARACTERISTIC /end REF_CHARACTERISTIC
 /begin REF_MEASUREMENT CmMtrCurr.ShCurrCal.EOLMtrCurr1OffsetDiff_Volts_f32 CmMtrCurr.ShCurrCal.EOLMtrCurr1OffsetLo_Volts_f32 CmMtrCurr.ShCurrCal.EOLMtrCurr2OffsetDiff_Volts_f32 CmMtrCurr.ShCurrCal.EOLMtrCurr2OffsetLo_Volts_f32 CmMtrCurr.ShCurrCal.EOLMtrCurrVcalCmd_VoltCnts_f32 CmMtrCurr.ShCurrCal.EOLPhscurr1Gain_AmpspVolt_f32 CmMtrCurr.ShCurrCal.EOLPhscurr2Gain_AmpspVolt_f32 /end REF_MEASUREMENT
/end GROUP
/begin GROUP CmMtrCurr.SrlComSvcDft.Cnt_b32 "MICROSAR RTE" /begin SUB_GROUP /end SUB_GROUP /begin FUNCTION_LIST /end FUNCTION_LIST /begin REF_CHARACTERISTIC /end REF_CHARACTERISTIC /begin REF_MEASUREMENT CmMtrCurr.SrlComSvcDft.Cnt_b32 /end REF_MEASUREMENT /end GROUP
/begin GROUP CmMtrCurr.SystemState.Mode "MICROSAR RTE" /begin SUB_GROUP /end SUB_GROUP /begin FUNCTION_LIST /end FUNCTION_LIST /begin REF_CHARACTERISTIC /end REF_CHARACTERISTIC /begin REF_MEASUREMENT CmMtrCurr.SystemState.Mode /end REF_MEASUREMENT /end GROUP
/begin GROUP CmMtrCurr.Vecu.Volt_f32 "MICROSAR RTE" /begin SUB_GROUP /end SUB_GROUP /begin FUNCTION_LIST /end FUNCTION_LIST /begin REF_CHARACTERISTIC /end REF_CHARACTERISTIC /begin REF_MEASUREMENT CmMtrCurr.Vecu.Volt_f32 /end REF_MEASUREMENT /end GROUP
/begin GROUP CmMtrCurr.VehSpd.Kph_f32 "MICROSAR RTE" /begin SUB_GROUP /end SUB_GROUP /begin FUNCTION_LIST /end FUNCTION_LIST /begin REF_CHARACTERISTIC /end REF_CHARACTERISTIC /begin REF_MEASUREMENT CmMtrCurr.VehSpd.Kph_f32 /end REF_MEASUREMENT /end GROUP
/begin GROUP CmMtrCurr.VhSpdValid.Cnt_lgc "MICROSAR RTE" /begin SUB_GROUP /end SUB_GROUP /begin FUNCTION_LIST /end FUNCTION_LIST /begin REF_CHARACTERISTIC /end REF_CHARACTERISTIC /begin REF_MEASUREMENT CmMtrCurr.VhSpdValid.Cnt_lgc /end REF_MEASUREMENT /end GROUP
/begin GROUP ComplErr "MICROSAR RTE" /begin SUB_GROUP ComplErr.ReceiverPorts ComplErr.SenderPorts /end SUB_GROUP /begin FUNCTION_LIST /end FUNCTION_LIST /begin REF_CHARACTERISTIC /end REF_CHARACTERISTIC /begin REF_MEASUREMENT /end REF_MEASUREMENT /end GROUP
/begin GROUP ComplErr.ComplErr.HwDeg_f32 "MICROSAR RTE" /begin SUB_GROUP /end SUB_GROUP /begin FUNCTION_LIST /end FUNCTION_LIST /begin REF_CHARACTERISTIC /end REF_CHARACTERISTIC /begin REF_MEASUREMENT ComplErr.ComplErr.HwDeg_f32 /end REF_MEASUREMENT /end GROUP
/begin GROUP ComplErr.ReceiverPorts "MICROSAR RTE" /begin SUB_GROUP ComplErr.TorqueCmdCRF.MtrNm_f32 /end SUB_GROUP /begin FUNCTION_LIST /end FUNCTION_LIST /begin REF_CHARACTERISTIC /end REF_CHARACTERISTIC /begin REF_MEASUREMENT /end REF_MEASUREMENT /end GROUP
/begin GROUP ComplErr.SenderPorts "MICROSAR RTE" /begin SUB_GROUP ComplErr.ComplErr.HwDeg_f32 /end SUB_GROUP /begin FUNCTION_LIST /end FUNCTION_LIST /begin REF_CHARACTERISTIC /end REF_CHARACTERISTIC /begin REF_MEASUREMENT /end REF_MEASUREMENT /end GROUP
/begin GROUP ComplErr.TorqueCmdCRF.MtrNm_f32 "MICROSAR RTE" /begin SUB_GROUP /end SUB_GROUP /begin FUNCTION_LIST /end FUNCTION_LIST /begin REF_CHARACTERISTIC /end REF_CHARACTERISTIC /begin REF_MEASUREMENT ComplErr.TorqueCmdCRF.MtrNm_f32 /end REF_MEASUREMENT /end GROUP
/begin GROUP CtrlTemp "MICROSAR RTE" /begin SUB_GROUP CtrlTemp.ReceiverPorts CtrlTemp.SenderPorts /end SUB_GROUP /begin FUNCTION_LIST /end FUNCTION_LIST /begin REF_CHARACTERISTIC /end REF_CHARACTERISTIC /begin REF_MEASUREMENT /end REF_MEASUREMENT /end GROUP
/begin GROUP CtrlTemp.AmbTemp.DegC_f32 "MICROSAR RTE" /begin SUB_GROUP /end SUB_GROUP /begin FUNCTION_LIST /end FUNCTION_LIST /begin REF_CHARACTERISTIC /end REF_CHARACTERISTIC /begin REF_MEASUREMENT CtrlTemp.AmbTemp.DegC_f32 /end REF_MEASUREMENT /end GROUP
/begin GROUP CtrlTemp.DiagStsTempRdPrf.Cnt_lgc "MICROSAR RTE" /begin SUB_GROUP /end SUB_GROUP /begin FUNCTION_LIST /end FUNCTION_LIST /begin REF_CHARACTERISTIC /end REF_CHARACTERISTIC /begin REF_MEASUREMENT CtrlTemp.DiagStsTempRdPrf.Cnt_lgc /end REF_MEASUREMENT /end GROUP
/begin GROUP CtrlTemp.FiltMeasTemp.DegC_f32 "MICROSAR RTE" /begin SUB_GROUP /end SUB_GROUP /begin FUNCTION_LIST /end FUNCTION_LIST /begin REF_CHARACTERISTIC /end REF_CHARACTERISTIC /begin REF_MEASUREMENT CtrlTemp.FiltMeasTemp.DegC_f32 /end REF_MEASUREMENT /end GROUP
/begin GROUP CtrlTemp.ReceiverPorts "MICROSAR RTE"
 /begin SUB_GROUP CtrlTemp.AmbTemp.DegC_f32 CtrlTemp.DiagStsTempRdPrf.Cnt_lgc CtrlTemp.TemperatureADC.Volt_f32 /end SUB_GROUP
 /begin FUNCTION_LIST /end FUNCTION_LIST
 /begin REF_CHARACTERISTIC /end REF_CHARACTERISTIC
 /begin REF_MEASUREMENT /end REF_MEASUREMENT
/end GROUP
/begin GROUP CtrlTemp.SenderPorts "MICROSAR RTE" /begin SUB_GROUP CtrlTemp.FiltMeasTemp.DegC_f32 /end SUB_GROUP /begin FUNCTION_LIST /end FUNCTION_LIST /begin REF_CHARACTERISTIC /end REF_CHARACTERISTIC /begin REF_MEASUREMENT /end REF_MEASUREMENT /end GROUP
/begin GROUP CtrlTemp.TemperatureADC.Volt_f32 "MICROSAR RTE" /begin SUB_GROUP /end SUB_GROUP /begin FUNCTION_LIST /end FUNCTION_LIST /begin REF_CHARACTERISTIC /end REF_CHARACTERISTIC /begin REF_MEASUREMENT CtrlTemp.TemperatureADC.Volt_f32 /end REF_MEASUREMENT /end GROUP
/begin GROUP CtrldDisShtdn "MICROSAR RTE"
 /begin SUB_GROUP CtrldDisShtdn.ModeRequirePorts CtrldDisShtdn.ReceiverPorts CtrldDisShtdn.SenderPorts /end SUB_GROUP
 /begin FUNCTION_LIST /end FUNCTION_LIST
 /begin REF_CHARACTERISTIC /end REF_CHARACTERISTIC
 /begin REF_MEASUREMENT /end REF_MEASUREMENT
/end GROUP
/begin GROUP CtrldDisShtdn.AssistAssyPolarity.Cnt_s08 "MICROSAR RTE" /begin SUB_GROUP /end SUB_GROUP /begin FUNCTION_LIST /end FUNCTION_LIST /begin REF_CHARACTERISTIC /end REF_CHARACTERISTIC /begin REF_MEASUREMENT CtrldDisShtdn.AssistAssyPolarity.Cnt_s08 /end REF_MEASUREMENT /end GROUP
/begin GROUP CtrldDisShtdn.CRFMtrVel.MtrRadpS_f32 "MICROSAR RTE" /begin SUB_GROUP /end SUB_GROUP /begin FUNCTION_LIST /end FUNCTION_LIST /begin REF_CHARACTERISTIC /end REF_CHARACTERISTIC /begin REF_MEASUREMENT CtrldDisShtdn.CRFMtrVel.MtrRadpS_f32 /end REF_MEASUREMENT /end GROUP
/begin GROUP CtrldDisShtdn.CntDisMtrTrqCmdCRF.MtrNm_f32 "MICROSAR RTE" /begin SUB_GROUP /end SUB_GROUP /begin FUNCTION_LIST /end FUNCTION_LIST /begin REF_CHARACTERISTIC /end REF_CHARACTERISTIC /begin REF_MEASUREMENT CtrldDisShtdn.CntDisMtrTrqCmdCRF.MtrNm_f32 /end REF_MEASUREMENT /end GROUP
/begin GROUP CtrldDisShtdn.CntDisMtrTrqCmdMRF.MtrNm_f32 "MICROSAR RTE" /begin SUB_GROUP /end SUB_GROUP /begin FUNCTION_LIST /end FUNCTION_LIST /begin REF_CHARACTERISTIC /end REF_CHARACTERISTIC /begin REF_MEASUREMENT CtrldDisShtdn.CntDisMtrTrqCmdMRF.MtrNm_f32 /end REF_MEASUREMENT /end GROUP
/begin GROUP CtrldDisShtdn.CtrldDmpStsCmp.Cnt_lgc "MICROSAR RTE" /begin SUB_GROUP /end SUB_GROUP /begin FUNCTION_LIST /end FUNCTION_LIST /begin REF_CHARACTERISTIC /end REF_CHARACTERISTIC /begin REF_MEASUREMENT CtrldDisShtdn.CtrldDmpStsCmp.Cnt_lgc /end REF_MEASUREMENT /end GROUP
/begin GROUP CtrldDisShtdn.DiagStsF2Active.Cnt_lgc "MICROSAR RTE" /begin SUB_GROUP /end SUB_GROUP /begin FUNCTION_LIST /end FUNCTION_LIST /begin REF_CHARACTERISTIC /end REF_CHARACTERISTIC /begin REF_MEASUREMENT CtrldDisShtdn.DiagStsF2Active.Cnt_lgc /end REF_MEASUREMENT /end GROUP
/begin GROUP CtrldDisShtdn.ModeRequirePorts "MICROSAR RTE" /begin SUB_GROUP CtrldDisShtdn.SystemState.Mode /end SUB_GROUP /begin FUNCTION_LIST /end FUNCTION_LIST /begin REF_CHARACTERISTIC /end REF_CHARACTERISTIC /begin REF_MEASUREMENT /end REF_MEASUREMENT /end GROUP
/begin GROUP CtrldDisShtdn.ReceiverPorts "MICROSAR RTE"
 /begin SUB_GROUP CtrldDisShtdn.AssistAssyPolarity.Cnt_s08 CtrldDisShtdn.CRFMtrVel.MtrRadpS_f32 CtrldDisShtdn.DiagStsF2Active.Cnt_lgc CtrldDisShtdn.SumLimTrqCmd.MtrNm_f32 /end SUB_GROUP
 /begin FUNCTION_LIST /end FUNCTION_LIST
 /begin REF_CHARACTERISTIC /end REF_CHARACTERISTIC
 /begin REF_MEASUREMENT /end REF_MEASUREMENT
/end GROUP
/begin GROUP CtrldDisShtdn.SenderPorts "MICROSAR RTE"
 /begin SUB_GROUP CtrldDisShtdn.CntDisMtrTrqCmdCRF.MtrNm_f32 CtrldDisShtdn.CntDisMtrTrqCmdMRF.MtrNm_f32 CtrldDisShtdn.CtrldDmpStsCmp.Cnt_lgc CtrldDisShtdn.SysC_CRFMtrTrqCmd.MtrNm_f32 CtrldDisShtdn.SysC_MRFMtrTrqCmd.MtrNm_f32 /end SUB_GROUP
 /begin FUNCTION_LIST /end FUNCTION_LIST
 /begin REF_CHARACTERISTIC /end REF_CHARACTERISTIC
 /begin REF_MEASUREMENT /end REF_MEASUREMENT
/end GROUP
/begin GROUP CtrldDisShtdn.SumLimTrqCmd.MtrNm_f32 "MICROSAR RTE" /begin SUB_GROUP /end SUB_GROUP /begin FUNCTION_LIST /end FUNCTION_LIST /begin REF_CHARACTERISTIC /end REF_CHARACTERISTIC /begin REF_MEASUREMENT CtrldDisShtdn.SumLimTrqCmd.MtrNm_f32 /end REF_MEASUREMENT /end GROUP
/begin GROUP CtrldDisShtdn.SysC_CRFMtrTrqCmd.MtrNm_f32 "MICROSAR RTE" /begin SUB_GROUP /end SUB_GROUP /begin FUNCTION_LIST /end FUNCTION_LIST /begin REF_CHARACTERISTIC /end REF_CHARACTERISTIC /begin REF_MEASUREMENT CtrldDisShtdn.SysC_CRFMtrTrqCmd.MtrNm_f32 /end REF_MEASUREMENT /end GROUP
/begin GROUP CtrldDisShtdn.SysC_MRFMtrTrqCmd.MtrNm_f32 "MICROSAR RTE" /begin SUB_GROUP /end SUB_GROUP /begin FUNCTION_LIST /end FUNCTION_LIST /begin REF_CHARACTERISTIC /end REF_CHARACTERISTIC /begin REF_MEASUREMENT CtrldDisShtdn.SysC_MRFMtrTrqCmd.MtrNm_f32 /end REF_MEASUREMENT /end GROUP
/begin GROUP CtrldDisShtdn.SystemState.Mode "MICROSAR RTE" /begin SUB_GROUP /end SUB_GROUP /begin FUNCTION_LIST /end FUNCTION_LIST /begin REF_CHARACTERISTIC /end REF_CHARACTERISTIC /begin REF_MEASUREMENT CtrldDisShtdn.SystemState.Mode /end REF_MEASUREMENT /end GROUP
/begin GROUP CurrCmd "MICROSAR RTE" /begin SUB_GROUP CurrCmd.ReceiverPorts CurrCmd.SenderPorts /end SUB_GROUP /begin FUNCTION_LIST /end FUNCTION_LIST /begin REF_CHARACTERISTIC /end REF_CHARACTERISTIC /begin REF_MEASUREMENT /end REF_MEASUREMENT /end GROUP
/begin GROUP CurrCmd.CurrentGainSvc.Cnt_lgc "MICROSAR RTE" /begin SUB_GROUP /end SUB_GROUP /begin FUNCTION_LIST /end FUNCTION_LIST /begin REF_CHARACTERISTIC /end REF_CHARACTERISTIC /begin REF_MEASUREMENT CurrCmd.CurrentGainSvc.Cnt_lgc /end REF_MEASUREMENT /end GROUP
/begin GROUP CurrCmd.EstKe.VpRadpS_f32 "MICROSAR RTE" /begin SUB_GROUP /end SUB_GROUP /begin FUNCTION_LIST /end FUNCTION_LIST /begin REF_CHARACTERISTIC /end REF_CHARACTERISTIC /begin REF_MEASUREMENT CurrCmd.EstKe.VpRadpS_f32 /end REF_MEASUREMENT /end GROUP
/begin GROUP CurrCmd.EstLd.Henry_f32 "MICROSAR RTE" /begin SUB_GROUP /end SUB_GROUP /begin FUNCTION_LIST /end FUNCTION_LIST /begin REF_CHARACTERISTIC /end REF_CHARACTERISTIC /begin REF_MEASUREMENT CurrCmd.EstLd.Henry_f32 /end REF_MEASUREMENT /end GROUP
/begin GROUP CurrCmd.EstLq.Henry_f32 "MICROSAR RTE" /begin SUB_GROUP /end SUB_GROUP /begin FUNCTION_LIST /end FUNCTION_LIST /begin REF_CHARACTERISTIC /end REF_CHARACTERISTIC /begin REF_MEASUREMENT CurrCmd.EstLq.Henry_f32 /end REF_MEASUREMENT /end GROUP
/begin GROUP CurrCmd.EstR.Ohm_f32 "MICROSAR RTE" /begin SUB_GROUP /end SUB_GROUP /begin FUNCTION_LIST /end FUNCTION_LIST /begin REF_CHARACTERISTIC /end REF_CHARACTERISTIC /begin REF_MEASUREMENT CurrCmd.EstR.Ohm_f32 /end REF_MEASUREMENT /end GROUP
/begin GROUP CurrCmd.IvtrLoaMtgtnEn.Cnt_lgc "MICROSAR RTE" /begin SUB_GROUP /end SUB_GROUP /begin FUNCTION_LIST /end FUNCTION_LIST /begin REF_CHARACTERISTIC /end REF_CHARACTERISTIC /begin REF_MEASUREMENT CurrCmd.IvtrLoaMtgtnEn.Cnt_lgc /end REF_MEASUREMENT /end GROUP
/begin GROUP CurrCmd.MRFMtrVel.MtrRadpS_f32 "MICROSAR RTE" /begin SUB_GROUP /end SUB_GROUP /begin FUNCTION_LIST /end FUNCTION_LIST /begin REF_CHARACTERISTIC /end REF_CHARACTERISTIC /begin REF_MEASUREMENT CurrCmd.MRFMtrVel.MtrRadpS_f32 /end REF_MEASUREMENT /end GROUP
/begin GROUP CurrCmd.MRFTrqCmdScl.MtrNm_f32 "MICROSAR RTE" /begin SUB_GROUP /end SUB_GROUP /begin FUNCTION_LIST /end FUNCTION_LIST /begin REF_CHARACTERISTIC /end REF_CHARACTERISTIC /begin REF_MEASUREMENT CurrCmd.MRFTrqCmdScl.MtrNm_f32 /end REF_MEASUREMENT /end GROUP
/begin GROUP CurrCmd.MotCurrLoaMtgtnEn.Cnt_lgc "MICROSAR RTE" /begin SUB_GROUP /end SUB_GROUP /begin FUNCTION_LIST /end FUNCTION_LIST /begin REF_CHARACTERISTIC /end REF_CHARACTERISTIC /begin REF_MEASUREMENT CurrCmd.MotCurrLoaMtgtnEn.Cnt_lgc /end REF_MEASUREMENT /end GROUP
/begin GROUP CurrCmd.MtrCurrAngle.Rev_f32 "MICROSAR RTE" /begin SUB_GROUP /end SUB_GROUP /begin FUNCTION_LIST /end FUNCTION_LIST /begin REF_CHARACTERISTIC /end REF_CHARACTERISTIC /begin REF_MEASUREMENT CurrCmd.MtrCurrAngle.Rev_f32 /end REF_MEASUREMENT /end GROUP
/begin GROUP CurrCmd.MtrCurrDaxRef.Amp_f32 "MICROSAR RTE" /begin SUB_GROUP /end SUB_GROUP /begin FUNCTION_LIST /end FUNCTION_LIST /begin REF_CHARACTERISTIC /end REF_CHARACTERISTIC /begin REF_MEASUREMENT CurrCmd.MtrCurrDaxRef.Amp_f32 /end REF_MEASUREMENT /end GROUP
/begin GROUP CurrCmd.MtrCurrQaxRef.Amp_f32 "MICROSAR RTE" /begin SUB_GROUP /end SUB_GROUP /begin FUNCTION_LIST /end FUNCTION_LIST /begin REF_CHARACTERISTIC /end REF_CHARACTERISTIC /begin REF_MEASUREMENT CurrCmd.MtrCurrQaxRef.Amp_f32 /end REF_MEASUREMENT /end GROUP
/begin GROUP CurrCmd.MtrQuad.Cnt_u08 "MICROSAR RTE" /begin SUB_GROUP /end SUB_GROUP /begin FUNCTION_LIST /end FUNCTION_LIST /begin REF_CHARACTERISTIC /end REF_CHARACTERISTIC /begin REF_MEASUREMENT CurrCmd.MtrQuad.Cnt_u08 /end REF_MEASUREMENT /end GROUP
/begin GROUP CurrCmd.ReceiverPorts "MICROSAR RTE"
 /begin SUB_GROUP CurrCmd.CurrentGainSvc.Cnt_lgc CurrCmd.EstKe.VpRadpS_f32 CurrCmd.EstLd.Henry_f32 CurrCmd.EstLq.Henry_f32 CurrCmd.EstR.Ohm_f32 CurrCmd.IvtrLoaMtgtnEn.Cnt_lgc CurrCmd.MRFMtrVel.MtrRadpS_f32 CurrCmd.MRFTrqCmdScl.MtrNm_f32 CurrCmd.MotCurrLoaMtgtnEn.Cnt_lgc CurrCmd.MtrQuad.Cnt_u08 CurrCmd.Vecu.Volt_f32 CurrCmd.VehSpd.Kph_f32 /end SUB_GROUP
 /begin FUNCTION_LIST /end FUNCTION_LIST
 /begin REF_CHARACTERISTIC /end REF_CHARACTERISTIC
 /begin REF_MEASUREMENT /end REF_MEASUREMENT
/end GROUP
/begin GROUP CurrCmd.SenderPorts "MICROSAR RTE"
 /begin SUB_GROUP CurrCmd.MtrCurrAngle.Rev_f32 CurrCmd.MtrCurrDaxRef.Amp_f32 CurrCmd.MtrCurrQaxRef.Amp_f32 /end SUB_GROUP
 /begin FUNCTION_LIST /end FUNCTION_LIST
 /begin REF_CHARACTERISTIC /end REF_CHARACTERISTIC
 /begin REF_MEASUREMENT /end REF_MEASUREMENT
/end GROUP
/begin GROUP CurrCmd.Vecu.Volt_f32 "MICROSAR RTE" /begin SUB_GROUP /end SUB_GROUP /begin FUNCTION_LIST /end FUNCTION_LIST /begin REF_CHARACTERISTIC /end REF_CHARACTERISTIC /begin REF_MEASUREMENT CurrCmd.Vecu.Volt_f32 /end REF_MEASUREMENT /end GROUP
/begin GROUP CurrCmd.VehSpd.Kph_f32 "MICROSAR RTE" /begin SUB_GROUP /end SUB_GROUP /begin FUNCTION_LIST /end FUNCTION_LIST /begin REF_CHARACTERISTIC /end REF_CHARACTERISTIC /begin REF_MEASUREMENT CurrCmd.VehSpd.Kph_f32 /end REF_MEASUREMENT /end GROUP
/begin GROUP CurrParamComp "MICROSAR RTE"
 /begin SUB_GROUP CurrParamComp.PerInstanceMemories CurrParamComp.ReceiverPorts CurrParamComp.SenderPorts /end SUB_GROUP
 /begin FUNCTION_LIST /end FUNCTION_LIST
 /begin REF_CHARACTERISTIC /end REF_CHARACTERISTIC
 /begin REF_MEASUREMENT /end REF_MEASUREMENT
/end GROUP
/begin GROUP CurrParamComp.CuTempEst.DegC_f32 "MICROSAR RTE" /begin SUB_GROUP /end SUB_GROUP /begin FUNCTION_LIST /end FUNCTION_LIST /begin REF_CHARACTERISTIC /end REF_CHARACTERISTIC /begin REF_MEASUREMENT CurrParamComp.CuTempEst.DegC_f32 /end REF_MEASUREMENT /end GROUP
/begin GROUP CurrParamComp.EOLNomMtrParam "MICROSAR RTE" /begin SUB_GROUP /end SUB_GROUP /begin FUNCTION_LIST /end FUNCTION_LIST /begin REF_CHARACTERISTIC /end REF_CHARACTERISTIC
 /begin REF_MEASUREMENT CurrParamComp.EOLNomMtrParam.NomKe_VpRadpS_f32 CurrParamComp.EOLNomMtrParam.NomRmtr_Ohm_f32 /end REF_MEASUREMENT
/end GROUP
/begin GROUP CurrParamComp.EstKe.VpRadpS_f32 "MICROSAR RTE" /begin SUB_GROUP /end SUB_GROUP /begin FUNCTION_LIST /end FUNCTION_LIST /begin REF_CHARACTERISTIC /end REF_CHARACTERISTIC /begin REF_MEASUREMENT CurrParamComp.EstKe.VpRadpS_f32 /end REF_MEASUREMENT /end GROUP
/begin GROUP CurrParamComp.EstLd.Henry_f32 "MICROSAR RTE" /begin SUB_GROUP /end SUB_GROUP /begin FUNCTION_LIST /end FUNCTION_LIST /begin REF_CHARACTERISTIC /end REF_CHARACTERISTIC /begin REF_MEASUREMENT CurrParamComp.EstLd.Henry_f32 /end REF_MEASUREMENT /end GROUP
/begin GROUP CurrParamComp.EstLq.Henry_f32 "MICROSAR RTE" /begin SUB_GROUP /end SUB_GROUP /begin FUNCTION_LIST /end FUNCTION_LIST /begin REF_CHARACTERISTIC /end REF_CHARACTERISTIC /begin REF_MEASUREMENT CurrParamComp.EstLq.Henry_f32 /end REF_MEASUREMENT /end GROUP
/begin GROUP CurrParamComp.EstR.Ohm_f32 "MICROSAR RTE" /begin SUB_GROUP /end SUB_GROUP /begin FUNCTION_LIST /end FUNCTION_LIST /begin REF_CHARACTERISTIC /end REF_CHARACTERISTIC /begin REF_MEASUREMENT CurrParamComp.EstR.Ohm_f32 /end REF_MEASUREMENT /end GROUP
/begin GROUP CurrParamComp.MagTempEst.DegC_f32 "MICROSAR RTE" /begin SUB_GROUP /end SUB_GROUP /begin FUNCTION_LIST /end FUNCTION_LIST /begin REF_CHARACTERISTIC /end REF_CHARACTERISTIC /begin REF_MEASUREMENT CurrParamComp.MagTempEst.DegC_f32 /end REF_MEASUREMENT /end GROUP
/begin GROUP CurrParamComp.MtrCurrDaxRef.Amp_f32 "MICROSAR RTE" /begin SUB_GROUP /end SUB_GROUP /begin FUNCTION_LIST /end FUNCTION_LIST /begin REF_CHARACTERISTIC /end REF_CHARACTERISTIC /begin REF_MEASUREMENT CurrParamComp.MtrCurrDaxRef.Amp_f32 /end REF_MEASUREMENT /end GROUP
/begin GROUP CurrParamComp.MtrCurrQaxRef.Amp_f32 "MICROSAR RTE" /begin SUB_GROUP /end SUB_GROUP /begin FUNCTION_LIST /end FUNCTION_LIST /begin REF_CHARACTERISTIC /end REF_CHARACTERISTIC /begin REF_MEASUREMENT CurrParamComp.MtrCurrQaxRef.Amp_f32 /end REF_MEASUREMENT /end GROUP
/begin GROUP CurrParamComp.PerInstanceMemories "MICROSAR RTE" /begin SUB_GROUP CurrParamComp.EOLNomMtrParam /end SUB_GROUP /begin FUNCTION_LIST /end FUNCTION_LIST /begin REF_CHARACTERISTIC /end REF_CHARACTERISTIC /begin REF_MEASUREMENT /end REF_MEASUREMENT /end GROUP
/begin GROUP CurrParamComp.ReceiverPorts "MICROSAR RTE"
 /begin SUB_GROUP CurrParamComp.CuTempEst.DegC_f32 CurrParamComp.MagTempEst.DegC_f32 CurrParamComp.MtrCurrDaxRef.Amp_f32 CurrParamComp.MtrCurrQaxRef.Amp_f32 CurrParamComp.SiTempEst.DegC_f32 /end SUB_GROUP
 /begin FUNCTION_LIST /end FUNCTION_LIST
 /begin REF_CHARACTERISTIC /end REF_CHARACTERISTIC
 /begin REF_MEASUREMENT /end REF_MEASUREMENT
/end GROUP
/begin GROUP CurrParamComp.SenderPorts "MICROSAR RTE"
 /begin SUB_GROUP CurrParamComp.EstKe.VpRadpS_f32 CurrParamComp.EstLd.Henry_f32 CurrParamComp.EstLq.Henry_f32 CurrParamComp.EstR.Ohm_f32 /end SUB_GROUP
 /begin FUNCTION_LIST /end FUNCTION_LIST
 /begin REF_CHARACTERISTIC /end REF_CHARACTERISTIC
 /begin REF_MEASUREMENT /end REF_MEASUREMENT
/end GROUP
/begin GROUP CurrParamComp.SiTempEst.DegC_f32 "MICROSAR RTE" /begin SUB_GROUP /end SUB_GROUP /begin FUNCTION_LIST /end FUNCTION_LIST /begin REF_CHARACTERISTIC /end REF_CHARACTERISTIC /begin REF_MEASUREMENT CurrParamComp.SiTempEst.DegC_f32 /end REF_MEASUREMENT /end GROUP
/begin GROUP CustPerSrvcs "MICROSAR RTE" /begin SUB_GROUP CustPerSrvcs.ModeRequirePorts CustPerSrvcs.SenderPorts /end SUB_GROUP /begin FUNCTION_LIST /end FUNCTION_LIST /begin REF_CHARACTERISTIC /end REF_CHARACTERISTIC /begin REF_MEASUREMENT /end REF_MEASUREMENT /end GROUP
/begin GROUP CustPerSrvcs.ModeRequirePorts "MICROSAR RTE" /begin SUB_GROUP CustPerSrvcs.SystemState.Mode /end SUB_GROUP /begin FUNCTION_LIST /end FUNCTION_LIST /begin REF_CHARACTERISTIC /end REF_CHARACTERISTIC /begin REF_MEASUREMENT /end REF_MEASUREMENT /end GROUP
/begin GROUP CustPerSrvcs.SenderPorts "MICROSAR RTE" /begin SUB_GROUP CustPerSrvcs.ThermalLimitFlagCntr.Cnt_u08 /end SUB_GROUP /begin FUNCTION_LIST /end FUNCTION_LIST /begin REF_CHARACTERISTIC /end REF_CHARACTERISTIC /begin REF_MEASUREMENT /end REF_MEASUREMENT /end GROUP
/begin GROUP CustPerSrvcs.SystemState.Mode "MICROSAR RTE" /begin SUB_GROUP /end SUB_GROUP /begin FUNCTION_LIST /end FUNCTION_LIST /begin REF_CHARACTERISTIC /end REF_CHARACTERISTIC /begin REF_MEASUREMENT CustPerSrvcs.SystemState.Mode /end REF_MEASUREMENT /end GROUP
/begin GROUP CustPerSrvcs.ThermalLimitFlagCntr.Cnt_u08 "MICROSAR RTE" /begin SUB_GROUP /end SUB_GROUP /begin FUNCTION_LIST /end FUNCTION_LIST /begin REF_CHARACTERISTIC /end REF_CHARACTERISTIC /begin REF_MEASUREMENT CustPerSrvcs.ThermalLimitFlagCntr.Cnt_u08 /end REF_MEASUREMENT /end GROUP
/begin GROUP Damping "MICROSAR RTE" /begin SUB_GROUP Damping.ReceiverPorts Damping.SenderPorts /end SUB_GROUP /begin FUNCTION_LIST /end FUNCTION_LIST /begin REF_CHARACTERISTIC /end REF_CHARACTERISTIC /begin REF_MEASUREMENT /end REF_MEASUREMENT /end GROUP
/begin GROUP Damping.AssistCmd.MtrNm_f32 "MICROSAR RTE" /begin SUB_GROUP /end SUB_GROUP /begin FUNCTION_LIST /end FUNCTION_LIST /begin REF_CHARACTERISTIC /end REF_CHARACTERISTIC /begin REF_MEASUREMENT Damping.AssistCmd.MtrNm_f32 /end REF_MEASUREMENT /end GROUP
/begin GROUP Damping.AssistMechTempEst.DegC_f32 "MICROSAR RTE" /begin SUB_GROUP /end SUB_GROUP /begin FUNCTION_LIST /end FUNCTION_LIST /begin REF_CHARACTERISTIC /end REF_CHARACTERISTIC /begin REF_MEASUREMENT Damping.AssistMechTempEst.DegC_f32 /end REF_MEASUREMENT /end GROUP
/begin GROUP Damping.CustomDamp.MtrNm_f32 "MICROSAR RTE" /begin SUB_GROUP /end SUB_GROUP /begin FUNCTION_LIST /end FUNCTION_LIST /begin REF_CHARACTERISTIC /end REF_CHARACTERISTIC /begin REF_MEASUREMENT Damping.CustomDamp.MtrNm_f32 /end REF_MEASUREMENT /end GROUP
/begin GROUP Damping.DampingCmd.MtrNm_f32 "MICROSAR RTE" /begin SUB_GROUP /end SUB_GROUP /begin FUNCTION_LIST /end FUNCTION_LIST /begin REF_CHARACTERISTIC /end REF_CHARACTERISTIC /begin REF_MEASUREMENT Damping.DampingCmd.MtrNm_f32 /end REF_MEASUREMENT /end GROUP
/begin GROUP Damping.DampingDDFactor.Uls_f32 "MICROSAR RTE" /begin SUB_GROUP /end SUB_GROUP /begin FUNCTION_LIST /end FUNCTION_LIST /begin REF_CHARACTERISTIC /end REF_CHARACTERISTIC /begin REF_MEASUREMENT Damping.DampingDDFactor.Uls_f32 /end REF_MEASUREMENT /end GROUP
/begin GROUP Damping.DefeatDampingSvc.Cnt_lgc "MICROSAR RTE" /begin SUB_GROUP /end SUB_GROUP /begin FUNCTION_LIST /end FUNCTION_LIST /begin REF_CHARACTERISTIC /end REF_CHARACTERISTIC /begin REF_MEASUREMENT Damping.DefeatDampingSvc.Cnt_lgc /end REF_MEASUREMENT /end GROUP
/begin GROUP Damping.HwTorque.HwNm_f32 "MICROSAR RTE" /begin SUB_GROUP /end SUB_GROUP /begin FUNCTION_LIST /end FUNCTION_LIST /begin REF_CHARACTERISTIC /end REF_CHARACTERISTIC /begin REF_MEASUREMENT Damping.HwTorque.HwNm_f32 /end REF_MEASUREMENT /end GROUP
/begin GROUP Damping.MotorVelCRF.MtrRadpS_f32 "MICROSAR RTE" /begin SUB_GROUP /end SUB_GROUP /begin FUNCTION_LIST /end FUNCTION_LIST /begin REF_CHARACTERISTIC /end REF_CHARACTERISTIC /begin REF_MEASUREMENT Damping.MotorVelCRF.MtrRadpS_f32 /end REF_MEASUREMENT /end GROUP
/begin GROUP Damping.ReceiverPorts "MICROSAR RTE"
 /begin SUB_GROUP Damping.AssistCmd.MtrNm_f32 Damping.AssistMechTempEst.DegC_f32 Damping.CustomDamp.MtrNm_f32 Damping.DampingDDFactor.Uls_f32 Damping.DefeatDampingSvc.Cnt_lgc Damping.HwTorque.HwNm_f32 Damping.MotorVelCRF.MtrRadpS_f32 Damping.VehicleSpeed.Kph_f32 /end SUB_GROUP
 /begin FUNCTION_LIST /end FUNCTION_LIST
 /begin REF_CHARACTERISTIC /end REF_CHARACTERISTIC
 /begin REF_MEASUREMENT /end REF_MEASUREMENT
/end GROUP
/begin GROUP Damping.SenderPorts "MICROSAR RTE" /begin SUB_GROUP Damping.DampingCmd.MtrNm_f32 /end SUB_GROUP /begin FUNCTION_LIST /end FUNCTION_LIST /begin REF_CHARACTERISTIC /end REF_CHARACTERISTIC /begin REF_MEASUREMENT /end REF_MEASUREMENT /end GROUP
/begin GROUP Damping.VehicleSpeed.Kph_f32 "MICROSAR RTE" /begin SUB_GROUP /end SUB_GROUP /begin FUNCTION_LIST /end FUNCTION_LIST /begin REF_CHARACTERISTIC /end REF_CHARACTERISTIC /begin REF_MEASUREMENT Damping.VehicleSpeed.Kph_f32 /end REF_MEASUREMENT /end GROUP
/begin GROUP DemIf "MICROSAR RTE" /begin SUB_GROUP DemIf.ReceiverPorts /end SUB_GROUP /begin FUNCTION_LIST /end FUNCTION_LIST /begin REF_CHARACTERISTIC /end REF_CHARACTERISTIC /begin REF_MEASUREMENT /end REF_MEASUREMENT /end GROUP
/begin GROUP DemIf.BusOffCE.Cnt_lgc "MICROSAR RTE" /begin SUB_GROUP /end SUB_GROUP /begin FUNCTION_LIST /end FUNCTION_LIST /begin REF_CHARACTERISTIC /end REF_CHARACTERISTIC /begin REF_MEASUREMENT DemIf.BusOffCE.Cnt_lgc /end REF_MEASUREMENT /end GROUP
/begin GROUP DemIf.BusOffHS.Cnt_lgc "MICROSAR RTE" /begin SUB_GROUP /end SUB_GROUP /begin FUNCTION_LIST /end FUNCTION_LIST /begin REF_CHARACTERISTIC /end REF_CHARACTERISTIC /begin REF_MEASUREMENT DemIf.BusOffHS.Cnt_lgc /end REF_MEASUREMENT /end GROUP
/begin GROUP DemIf.DisableCEBusNormComm.Cnt_lgc "MICROSAR RTE" /begin SUB_GROUP /end SUB_GROUP /begin FUNCTION_LIST /end FUNCTION_LIST /begin REF_CHARACTERISTIC /end REF_CHARACTERISTIC /begin REF_MEASUREMENT DemIf.DisableCEBusNormComm.Cnt_lgc /end REF_MEASUREMENT /end GROUP
/begin GROUP DemIf.DisableHSBusNormComm.Cnt_lgc "MICROSAR RTE" /begin SUB_GROUP /end SUB_GROUP /begin FUNCTION_LIST /end FUNCTION_LIST /begin REF_CHARACTERISTIC /end REF_CHARACTERISTIC /begin REF_MEASUREMENT DemIf.DisableHSBusNormComm.Cnt_lgc /end REF_MEASUREMENT /end GROUP
/begin GROUP DemIf.EngRunAtvForCTCInhibit.Cnt_lgc "MICROSAR RTE" /begin SUB_GROUP /end SUB_GROUP /begin FUNCTION_LIST /end FUNCTION_LIST /begin REF_CHARACTERISTIC /end REF_CHARACTERISTIC /begin REF_MEASUREMENT DemIf.EngRunAtvForCTCInhibit.Cnt_lgc /end REF_MEASUREMENT /end GROUP
/begin GROUP DemIf.ReceiverPorts "MICROSAR RTE"
 /begin SUB_GROUP DemIf.BusOffCE.Cnt_lgc DemIf.BusOffHS.Cnt_lgc DemIf.DisableCEBusNormComm.Cnt_lgc DemIf.DisableHSBusNormComm.Cnt_lgc DemIf.EngRunAtvForCTCInhibit.Cnt_lgc DemIf.SPMForCTCInhibit.Cnt_lgc DemIf.SrlComEngOn.Cnt_lgc DemIf.SrlComSysPwrMd.Cnt_enum DemIf.Vecu.Volt_f32 /end SUB_GROUP
 /begin FUNCTION_LIST /end FUNCTION_LIST
 /begin REF_CHARACTERISTIC /end REF_CHARACTERISTIC
 /begin REF_MEASUREMENT /end REF_MEASUREMENT
/end GROUP
/begin GROUP DemIf.SPMForCTCInhibit.Cnt_lgc "MICROSAR RTE" /begin SUB_GROUP /end SUB_GROUP /begin FUNCTION_LIST /end FUNCTION_LIST /begin REF_CHARACTERISTIC /end REF_CHARACTERISTIC /begin REF_MEASUREMENT DemIf.SPMForCTCInhibit.Cnt_lgc /end REF_MEASUREMENT /end GROUP
/begin GROUP DemIf.SrlComEngOn.Cnt_lgc "MICROSAR RTE" /begin SUB_GROUP /end SUB_GROUP /begin FUNCTION_LIST /end FUNCTION_LIST /begin REF_CHARACTERISTIC /end REF_CHARACTERISTIC /begin REF_MEASUREMENT DemIf.SrlComEngOn.Cnt_lgc /end REF_MEASUREMENT /end GROUP
/begin GROUP DemIf.SrlComSysPwrMd.Cnt_enum "MICROSAR RTE" /begin SUB_GROUP /end SUB_GROUP /begin FUNCTION_LIST /end FUNCTION_LIST /begin REF_CHARACTERISTIC /end REF_CHARACTERISTIC /begin REF_MEASUREMENT DemIf.SrlComSysPwrMd.Cnt_enum /end REF_MEASUREMENT /end GROUP
/begin GROUP DemIf.Vecu.Volt_f32 "MICROSAR RTE" /begin SUB_GROUP /end SUB_GROUP /begin FUNCTION_LIST /end FUNCTION_LIST /begin REF_CHARACTERISTIC /end REF_CHARACTERISTIC /begin REF_MEASUREMENT DemIf.Vecu.Volt_f32 /end REF_MEASUREMENT /end GROUP
/begin GROUP DiagMgr "MICROSAR RTE"
 /begin SUB_GROUP DiagMgr.ModeRequirePorts DiagMgr.ReceiverPorts DiagMgr.SenderPorts /end SUB_GROUP
 /begin FUNCTION_LIST /end FUNCTION_LIST
 /begin REF_CHARACTERISTIC /end REF_CHARACTERISTIC
 /begin REF_MEASUREMENT /end REF_MEASUREMENT
/end GROUP
/begin GROUP DiagMgr.DiagRampRate.XpmS_f32 "MICROSAR RTE" /begin SUB_GROUP /end SUB_GROUP /begin FUNCTION_LIST /end FUNCTION_LIST /begin REF_CHARACTERISTIC /end REF_CHARACTERISTIC /begin REF_MEASUREMENT DiagMgr.DiagRampRate.XpmS_f32 /end REF_MEASUREMENT /end GROUP
/begin GROUP DiagMgr.DiagRampValue.Uls_f32 "MICROSAR RTE" /begin SUB_GROUP /end SUB_GROUP /begin FUNCTION_LIST /end FUNCTION_LIST /begin REF_CHARACTERISTIC /end REF_CHARACTERISTIC /begin REF_MEASUREMENT DiagMgr.DiagRampValue.Uls_f32 /end REF_MEASUREMENT /end GROUP
/begin GROUP DiagMgr.DiagRmpToZeroActive.Cnt_lgc "MICROSAR RTE" /begin SUB_GROUP /end SUB_GROUP /begin FUNCTION_LIST /end FUNCTION_LIST /begin REF_CHARACTERISTIC /end REF_CHARACTERISTIC /begin REF_MEASUREMENT DiagMgr.DiagRmpToZeroActive.Cnt_lgc /end REF_MEASUREMENT /end GROUP
/begin GROUP DiagMgr.DiagStsCtrldDisRmpPres.Cnt_lgc "MICROSAR RTE" /begin SUB_GROUP /end SUB_GROUP /begin FUNCTION_LIST /end FUNCTION_LIST /begin REF_CHARACTERISTIC /end REF_CHARACTERISTIC /begin REF_MEASUREMENT DiagMgr.DiagStsCtrldDisRmpPres.Cnt_lgc /end REF_MEASUREMENT /end GROUP
/begin GROUP DiagMgr.DiagStsDefTemp.Cnt_lgc "MICROSAR RTE" /begin SUB_GROUP /end SUB_GROUP /begin FUNCTION_LIST /end FUNCTION_LIST /begin REF_CHARACTERISTIC /end REF_CHARACTERISTIC /begin REF_MEASUREMENT DiagMgr.DiagStsDefTemp.Cnt_lgc /end REF_MEASUREMENT /end GROUP
/begin GROUP DiagMgr.DiagStsDefVehSpd.Cnt_lgc "MICROSAR RTE" /begin SUB_GROUP /end SUB_GROUP /begin FUNCTION_LIST /end FUNCTION_LIST /begin REF_CHARACTERISTIC /end REF_CHARACTERISTIC /begin REF_MEASUREMENT DiagMgr.DiagStsDefVehSpd.Cnt_lgc /end REF_MEASUREMENT /end GROUP
/begin GROUP DiagMgr.DiagStsHWASbSystmFltPres.Cnt_lgc "MICROSAR RTE" /begin SUB_GROUP /end SUB_GROUP /begin FUNCTION_LIST /end FUNCTION_LIST /begin REF_CHARACTERISTIC /end REF_CHARACTERISTIC /begin REF_MEASUREMENT DiagMgr.DiagStsHWASbSystmFltPres.Cnt_lgc /end REF_MEASUREMENT /end GROUP
/begin GROUP DiagMgr.DiagStsNonRecRmpToZeroFltPres.Cnt_lgc "MICROSAR RTE" /begin SUB_GROUP /end SUB_GROUP /begin FUNCTION_LIST /end FUNCTION_LIST /begin REF_CHARACTERISTIC /end REF_CHARACTERISTIC /begin REF_MEASUREMENT DiagMgr.DiagStsNonRecRmpToZeroFltPres.Cnt_lgc /end REF_MEASUREMENT /end GROUP
/begin GROUP DiagMgr.DiagStsRecRmpToZeroFltPres.Cnt_lgc "MICROSAR RTE" /begin SUB_GROUP /end SUB_GROUP /begin FUNCTION_LIST /end FUNCTION_LIST /begin REF_CHARACTERISTIC /end REF_CHARACTERISTIC /begin REF_MEASUREMENT DiagMgr.DiagStsRecRmpToZeroFltPres.Cnt_lgc /end REF_MEASUREMENT /end GROUP
/begin GROUP DiagMgr.DiagStsScomHWANotValid.Cnt_lgc "MICROSAR RTE" /begin SUB_GROUP /end SUB_GROUP /begin FUNCTION_LIST /end FUNCTION_LIST /begin REF_CHARACTERISTIC /end REF_CHARACTERISTIC /begin REF_MEASUREMENT DiagMgr.DiagStsScomHWANotValid.Cnt_lgc /end REF_MEASUREMENT /end GROUP
/begin GROUP DiagMgr.DiagStsWIRDisable.Cnt_lgc "MICROSAR RTE" /begin SUB_GROUP /end SUB_GROUP /begin FUNCTION_LIST /end FUNCTION_LIST /begin REF_CHARACTERISTIC /end REF_CHARACTERISTIC /begin REF_MEASUREMENT DiagMgr.DiagStsWIRDisable.Cnt_lgc /end REF_MEASUREMENT /end GROUP
/begin GROUP DiagMgr.HwTrq.HwNm_f32 "MICROSAR RTE" /begin SUB_GROUP /end SUB_GROUP /begin FUNCTION_LIST /end FUNCTION_LIST /begin REF_CHARACTERISTIC /end REF_CHARACTERISTIC /begin REF_MEASUREMENT DiagMgr.HwTrq.HwNm_f32 /end REF_MEASUREMENT /end GROUP
/begin GROUP DiagMgr.IgnCnt.Cnt_u16 "MICROSAR RTE" /begin SUB_GROUP /end SUB_GROUP /begin FUNCTION_LIST /end FUNCTION_LIST /begin REF_CHARACTERISTIC /end REF_CHARACTERISTIC /begin REF_MEASUREMENT DiagMgr.IgnCnt.Cnt_u16 /end REF_MEASUREMENT /end GROUP
/begin GROUP DiagMgr.MEC.Cnt_enum "MICROSAR RTE" /begin SUB_GROUP /end SUB_GROUP /begin FUNCTION_LIST /end FUNCTION_LIST /begin REF_CHARACTERISTIC /end REF_CHARACTERISTIC /begin REF_MEASUREMENT DiagMgr.MEC.Cnt_enum /end REF_MEASUREMENT /end GROUP
/begin GROUP DiagMgr.MfgDiagInhibit.Cnt_lgc "MICROSAR RTE" /begin SUB_GROUP /end SUB_GROUP /begin FUNCTION_LIST /end FUNCTION_LIST /begin REF_CHARACTERISTIC /end REF_CHARACTERISTIC /begin REF_MEASUREMENT DiagMgr.MfgDiagInhibit.Cnt_lgc /end REF_MEASUREMENT /end GROUP
/begin GROUP DiagMgr.ModeRequirePorts "MICROSAR RTE" /begin SUB_GROUP DiagMgr.SystemState.Mode /end SUB_GROUP /begin FUNCTION_LIST /end FUNCTION_LIST /begin REF_CHARACTERISTIC /end REF_CHARACTERISTIC /begin REF_MEASUREMENT /end REF_MEASUREMENT /end GROUP
/begin GROUP DiagMgr.MtrTrq.MtrNm_f32 "MICROSAR RTE" /begin SUB_GROUP /end SUB_GROUP /begin FUNCTION_LIST /end FUNCTION_LIST /begin REF_CHARACTERISTIC /end REF_CHARACTERISTIC /begin REF_MEASUREMENT DiagMgr.MtrTrq.MtrNm_f32 /end REF_MEASUREMENT /end GROUP
/begin GROUP DiagMgr.ReceiverPorts "MICROSAR RTE"
 /begin SUB_GROUP DiagMgr.HwTrq.HwNm_f32 DiagMgr.IgnCnt.Cnt_u16 DiagMgr.MEC.Cnt_enum DiagMgr.MfgDiagInhibit.Cnt_lgc DiagMgr.MtrTrq.MtrNm_f32 DiagMgr.VehSpd.Kph_f32 /end SUB_GROUP
 /begin FUNCTION_LIST /end FUNCTION_LIST
 /begin REF_CHARACTERISTIC /end REF_CHARACTERISTIC
 /begin REF_MEASUREMENT /end REF_MEASUREMENT
/end GROUP
/begin GROUP DiagMgr.SenderPorts "MICROSAR RTE"
 /begin SUB_GROUP DiagMgr.DiagRampRate.XpmS_f32 DiagMgr.DiagRampValue.Uls_f32 DiagMgr.DiagRmpToZeroActive.Cnt_lgc DiagMgr.DiagStsCtrldDisRmpPres.Cnt_lgc DiagMgr.DiagStsDefTemp.Cnt_lgc DiagMgr.DiagStsDefVehSpd.Cnt_lgc DiagMgr.DiagStsHWASbSystmFltPres.Cnt_lgc DiagMgr.DiagStsNonRecRmpToZeroFltPres.Cnt_lgc DiagMgr.DiagStsRecRmpToZeroFltPres.Cnt_lgc DiagMgr.DiagStsScomHWANotValid.Cnt_lgc DiagMgr.DiagStsWIRDisable.Cnt_lgc /end SUB_GROUP
 /begin FUNCTION_LIST /end FUNCTION_LIST
 /begin REF_CHARACTERISTIC /end REF_CHARACTERISTIC
 /begin REF_MEASUREMENT /end REF_MEASUREMENT
/end GROUP
/begin GROUP DiagMgr.SystemState.Mode "MICROSAR RTE" /begin SUB_GROUP /end SUB_GROUP /begin FUNCTION_LIST /end FUNCTION_LIST /begin REF_CHARACTERISTIC /end REF_CHARACTERISTIC /begin REF_MEASUREMENT DiagMgr.SystemState.Mode /end REF_MEASUREMENT /end GROUP
/begin GROUP DiagMgr.VehSpd.Kph_f32 "MICROSAR RTE" /begin SUB_GROUP /end SUB_GROUP /begin FUNCTION_LIST /end FUNCTION_LIST /begin REF_CHARACTERISTIC /end REF_CHARACTERISTIC /begin REF_MEASUREMENT DiagMgr.VehSpd.Kph_f32 /end REF_MEASUREMENT /end GROUP
/begin GROUP DigColPs "MICROSAR RTE"
 /begin SUB_GROUP DigColPs.PerInstanceMemories DigColPs.ReceiverPorts DigColPs.SenderPorts /end SUB_GROUP
 /begin FUNCTION_LIST /end FUNCTION_LIST
 /begin REF_CHARACTERISTIC /end REF_CHARACTERISTIC
 /begin REF_MEASUREMENT /end REF_MEASUREMENT
/end GROUP
/begin GROUP DigColPs.DigColPsEOL "MICROSAR RTE" /begin SUB_GROUP /end SUB_GROUP /begin FUNCTION_LIST /end FUNCTION_LIST /begin REF_CHARACTERISTIC /end REF_CHARACTERISTIC
 /begin REF_MEASUREMENT DigColPs.DigColPsEOL.ColTrim_Deg_f32 DigColPs.DigColPsEOL.R_ColTrim_Cnt_u32 DigColPs.DigColPsEOL.R_SpurTrim_Cnt_u32 DigColPs.DigColPsEOL.R_TrimCom_Cnt_u16 DigColPs.DigColPsEOL.SpurTrim_Deg_f32 DigColPs.DigColPsEOL.TrimComp_Cnt_u16 /end REF_MEASUREMENT
/end GROUP
/begin GROUP DigColPs.I2CHwAbsPos.HwDeg_f32 "MICROSAR RTE" /begin SUB_GROUP /end SUB_GROUP /begin FUNCTION_LIST /end FUNCTION_LIST /begin REF_CHARACTERISTIC /end REF_CHARACTERISTIC /begin REF_MEASUREMENT DigColPs.I2CHwAbsPos.HwDeg_f32 /end REF_MEASUREMENT /end GROUP
/begin GROUP DigColPs.I2CHwAbsPosValid.Cnt_lgc "MICROSAR RTE" /begin SUB_GROUP /end SUB_GROUP /begin FUNCTION_LIST /end FUNCTION_LIST /begin REF_CHARACTERISTIC /end REF_CHARACTERISTIC /begin REF_MEASUREMENT DigColPs.I2CHwAbsPosValid.Cnt_lgc /end REF_MEASUREMENT /end GROUP
/begin GROUP DigColPs.MecState.Cnt_enum "MICROSAR RTE" /begin SUB_GROUP /end SUB_GROUP /begin FUNCTION_LIST /end FUNCTION_LIST /begin REF_CHARACTERISTIC /end REF_CHARACTERISTIC /begin REF_MEASUREMENT DigColPs.MecState.Cnt_enum /end REF_MEASUREMENT /end GROUP
/begin GROUP DigColPs.PerInstanceMemories "MICROSAR RTE" /begin SUB_GROUP DigColPs.DigColPsEOL /end SUB_GROUP /begin FUNCTION_LIST /end FUNCTION_LIST /begin REF_CHARACTERISTIC /end REF_CHARACTERISTIC /begin REF_MEASUREMENT /end REF_MEASUREMENT /end GROUP
/begin GROUP DigColPs.ReceiverPorts "MICROSAR RTE" /begin SUB_GROUP DigColPs.MecState.Cnt_enum /end SUB_GROUP /begin FUNCTION_LIST /end FUNCTION_LIST /begin REF_CHARACTERISTIC /end REF_CHARACTERISTIC /begin REF_MEASUREMENT /end REF_MEASUREMENT /end GROUP
/begin GROUP DigColPs.SenderPorts "MICROSAR RTE"
 /begin SUB_GROUP DigColPs.I2CHwAbsPos.HwDeg_f32 DigColPs.I2CHwAbsPosValid.Cnt_lgc DigColPs.TrimComp.Cnt_lgc /end SUB_GROUP
 /begin FUNCTION_LIST /end FUNCTION_LIST
 /begin REF_CHARACTERISTIC /end REF_CHARACTERISTIC
 /begin REF_MEASUREMENT /end REF_MEASUREMENT
/end GROUP
/begin GROUP DigColPs.TrimComp.Cnt_lgc "MICROSAR RTE" /begin SUB_GROUP /end SUB_GROUP /begin FUNCTION_LIST /end FUNCTION_LIST /begin REF_CHARACTERISTIC /end REF_CHARACTERISTIC /begin REF_MEASUREMENT DigColPs.TrimComp.Cnt_lgc /end REF_MEASUREMENT /end GROUP
/begin GROUP DigPhsReasDiag "MICROSAR RTE"
 /begin SUB_GROUP DigPhsReasDiag.ModeRequirePorts DigPhsReasDiag.ReceiverPorts /end SUB_GROUP
 /begin FUNCTION_LIST /end FUNCTION_LIST
 /begin REF_CHARACTERISTIC /end REF_CHARACTERISTIC
 /begin REF_MEASUREMENT /end REF_MEASUREMENT
/end GROUP
/begin GROUP DigPhsReasDiag.ExpectedOnTimeA.Cnt_u32 "MICROSAR RTE" /begin SUB_GROUP /end SUB_GROUP /begin FUNCTION_LIST /end FUNCTION_LIST /begin REF_CHARACTERISTIC /end REF_CHARACTERISTIC /begin REF_MEASUREMENT DigPhsReasDiag.ExpectedOnTimeA.Cnt_u32 /end REF_MEASUREMENT /end GROUP
/begin GROUP DigPhsReasDiag.ExpectedOnTimeB.Cnt_u32 "MICROSAR RTE" /begin SUB_GROUP /end SUB_GROUP /begin FUNCTION_LIST /end FUNCTION_LIST /begin REF_CHARACTERISTIC /end REF_CHARACTERISTIC /begin REF_MEASUREMENT DigPhsReasDiag.ExpectedOnTimeB.Cnt_u32 /end REF_MEASUREMENT /end GROUP
/begin GROUP DigPhsReasDiag.ExpectedOnTimeC.Cnt_u32 "MICROSAR RTE" /begin SUB_GROUP /end SUB_GROUP /begin FUNCTION_LIST /end FUNCTION_LIST /begin REF_CHARACTERISTIC /end REF_CHARACTERISTIC /begin REF_MEASUREMENT DigPhsReasDiag.ExpectedOnTimeC.Cnt_u32 /end REF_MEASUREMENT /end GROUP
/begin GROUP DigPhsReasDiag.GateDriveResetActive.Cnt_lgc "MICROSAR RTE" /begin SUB_GROUP /end SUB_GROUP /begin FUNCTION_LIST /end FUNCTION_LIST /begin REF_CHARACTERISTIC /end REF_CHARACTERISTIC /begin REF_MEASUREMENT DigPhsReasDiag.GateDriveResetActive.Cnt_lgc /end REF_MEASUREMENT /end GROUP
/begin GROUP DigPhsReasDiag.LRPRCorrectedMtrPosCaptured.Rev_f32 "MICROSAR RTE" /begin SUB_GROUP /end SUB_GROUP /begin FUNCTION_LIST /end FUNCTION_LIST /begin REF_CHARACTERISTIC /end REF_CHARACTERISTIC /begin REF_MEASUREMENT DigPhsReasDiag.LRPRCorrectedMtrPosCaptured.Rev_f32 /end REF_MEASUREMENT /end GROUP
/begin GROUP DigPhsReasDiag.LRPRModulationIndexCaptured.Uls_f32 "MICROSAR RTE" /begin SUB_GROUP /end SUB_GROUP /begin FUNCTION_LIST /end FUNCTION_LIST /begin REF_CHARACTERISTIC /end REF_CHARACTERISTIC /begin REF_MEASUREMENT DigPhsReasDiag.LRPRModulationIndexCaptured.Uls_f32 /end REF_MEASUREMENT /end GROUP
/begin GROUP DigPhsReasDiag.LRPRPhaseadvanceCaptured.Cnt_s16 "MICROSAR RTE" /begin SUB_GROUP /end SUB_GROUP /begin FUNCTION_LIST /end FUNCTION_LIST /begin REF_CHARACTERISTIC /end REF_CHARACTERISTIC /begin REF_MEASUREMENT DigPhsReasDiag.LRPRPhaseadvanceCaptured.Cnt_s16 /end REF_MEASUREMENT /end GROUP
/begin GROUP DigPhsReasDiag.MeasuredOnTimeA.Cnt_u32 "MICROSAR RTE" /begin SUB_GROUP /end SUB_GROUP /begin FUNCTION_LIST /end FUNCTION_LIST /begin REF_CHARACTERISTIC /end REF_CHARACTERISTIC /begin REF_MEASUREMENT DigPhsReasDiag.MeasuredOnTimeA.Cnt_u32 /end REF_MEASUREMENT /end GROUP
/begin GROUP DigPhsReasDiag.MeasuredOnTimeB.Cnt_u32 "MICROSAR RTE" /begin SUB_GROUP /end SUB_GROUP /begin FUNCTION_LIST /end FUNCTION_LIST /begin REF_CHARACTERISTIC /end REF_CHARACTERISTIC /begin REF_MEASUREMENT DigPhsReasDiag.MeasuredOnTimeB.Cnt_u32 /end REF_MEASUREMENT /end GROUP
/begin GROUP DigPhsReasDiag.MeasuredOnTimeC.Cnt_u32 "MICROSAR RTE" /begin SUB_GROUP /end SUB_GROUP /begin FUNCTION_LIST /end FUNCTION_LIST /begin REF_CHARACTERISTIC /end REF_CHARACTERISTIC /begin REF_MEASUREMENT DigPhsReasDiag.MeasuredOnTimeC.Cnt_u32 /end REF_MEASUREMENT /end GROUP
/begin GROUP DigPhsReasDiag.ModeRequirePorts "MICROSAR RTE" /begin SUB_GROUP DigPhsReasDiag.SystemState.Mode /end SUB_GROUP /begin FUNCTION_LIST /end FUNCTION_LIST /begin REF_CHARACTERISTIC /end REF_CHARACTERISTIC /begin REF_MEASUREMENT /end REF_MEASUREMENT /end GROUP
/begin GROUP DigPhsReasDiag.MotorVelMRFUnfiltered.MtrRadpS_f32 "MICROSAR RTE" /begin SUB_GROUP /end SUB_GROUP /begin FUNCTION_LIST /end FUNCTION_LIST /begin REF_CHARACTERISTIC /end REF_CHARACTERISTIC /begin REF_MEASUREMENT DigPhsReasDiag.MotorVelMRFUnfiltered.MtrRadpS_f32 /end REF_MEASUREMENT /end GROUP
/begin GROUP DigPhsReasDiag.MtrElecMechPolarity.Cnt_s08 "MICROSAR RTE" /begin SUB_GROUP /end SUB_GROUP /begin FUNCTION_LIST /end FUNCTION_LIST /begin REF_CHARACTERISTIC /end REF_CHARACTERISTIC /begin REF_MEASUREMENT DigPhsReasDiag.MtrElecMechPolarity.Cnt_s08 /end REF_MEASUREMENT /end GROUP
/begin GROUP DigPhsReasDiag.PDActivateTest.Cnt_lgc "MICROSAR RTE" /begin SUB_GROUP /end SUB_GROUP /begin FUNCTION_LIST /end FUNCTION_LIST /begin REF_CHARACTERISTIC /end REF_CHARACTERISTIC /begin REF_MEASUREMENT DigPhsReasDiag.PDActivateTest.Cnt_lgc /end REF_MEASUREMENT /end GROUP
/begin GROUP DigPhsReasDiag.ReceiverPorts "MICROSAR RTE"
 /begin SUB_GROUP DigPhsReasDiag.ExpectedOnTimeA.Cnt_u32 DigPhsReasDiag.ExpectedOnTimeB.Cnt_u32 DigPhsReasDiag.ExpectedOnTimeC.Cnt_u32 DigPhsReasDiag.GateDriveResetActive.Cnt_lgc DigPhsReasDiag.LRPRCorrectedMtrPosCaptured.Rev_f32 DigPhsReasDiag.LRPRModulationIndexCaptured.Uls_f32 DigPhsReasDiag.LRPRPhaseadvanceCaptured.Cnt_s16 DigPhsReasDiag.MeasuredOnTimeA.Cnt_u32 DigPhsReasDiag.MeasuredOnTimeB.Cnt_u32 DigPhsReasDiag.MeasuredOnTimeC.Cnt_u32 DigPhsReasDiag.MotorVelMRFUnfiltered.MtrRadpS_f32 DigPhsReasDiag.MtrElecMechPolarity.Cnt_s08 DigPhsReasDiag.PDActivateTest.Cnt_lgc /end SUB_GROUP
 /begin FUNCTION_LIST /end FUNCTION_LIST
 /begin REF_CHARACTERISTIC /end REF_CHARACTERISTIC
 /begin REF_MEASUREMENT /end REF_MEASUREMENT
/end GROUP
/begin GROUP DigPhsReasDiag.SystemState.Mode "MICROSAR RTE" /begin SUB_GROUP /end SUB_GROUP /begin FUNCTION_LIST /end FUNCTION_LIST /begin REF_CHARACTERISTIC /end REF_CHARACTERISTIC /begin REF_MEASUREMENT DigPhsReasDiag.SystemState.Mode /end REF_MEASUREMENT /end GROUP
/begin GROUP EOTActuatorMng "MICROSAR RTE" /begin SUB_GROUP EOTActuatorMng.ReceiverPorts EOTActuatorMng.SenderPorts /end SUB_GROUP /begin FUNCTION_LIST /end FUNCTION_LIST /begin REF_CHARACTERISTIC /end REF_CHARACTERISTIC /begin REF_MEASUREMENT /end REF_MEASUREMENT /end GROUP
/begin GROUP EOTActuatorMng.AssistEOTDamping.MtrNm_f32 "MICROSAR RTE" /begin SUB_GROUP /end SUB_GROUP /begin FUNCTION_LIST /end FUNCTION_LIST /begin REF_CHARACTERISTIC /end REF_CHARACTERISTIC /begin REF_MEASUREMENT EOTActuatorMng.AssistEOTDamping.MtrNm_f32 /end REF_MEASUREMENT /end GROUP
/begin GROUP EOTActuatorMng.AssistEOTGain.Uls_f32 "MICROSAR RTE" /begin SUB_GROUP /end SUB_GROUP /begin FUNCTION_LIST /end FUNCTION_LIST /begin REF_CHARACTERISTIC /end REF_CHARACTERISTIC /begin REF_MEASUREMENT EOTActuatorMng.AssistEOTGain.Uls_f32 /end REF_MEASUREMENT /end GROUP
/begin GROUP EOTActuatorMng.AssistEOTLimit.MtrNm_f32 "MICROSAR RTE" /begin SUB_GROUP /end SUB_GROUP /begin FUNCTION_LIST /end FUNCTION_LIST /begin REF_CHARACTERISTIC /end REF_CHARACTERISTIC /begin REF_MEASUREMENT EOTActuatorMng.AssistEOTLimit.MtrNm_f32 /end REF_MEASUREMENT /end GROUP
/begin GROUP EOTActuatorMng.CcwEOT.HwDeg_f32 "MICROSAR RTE" /begin SUB_GROUP /end SUB_GROUP /begin FUNCTION_LIST /end FUNCTION_LIST /begin REF_CHARACTERISTIC /end REF_CHARACTERISTIC /begin REF_MEASUREMENT EOTActuatorMng.CcwEOT.HwDeg_f32 /end REF_MEASUREMENT /end GROUP
/begin GROUP EOTActuatorMng.CcwFound.Cnt_lgc "MICROSAR RTE" /begin SUB_GROUP /end SUB_GROUP /begin FUNCTION_LIST /end FUNCTION_LIST /begin REF_CHARACTERISTIC /end REF_CHARACTERISTIC /begin REF_MEASUREMENT EOTActuatorMng.CcwFound.Cnt_lgc /end REF_MEASUREMENT /end GROUP
/begin GROUP EOTActuatorMng.CwEOT.HwDeg_f32 "MICROSAR RTE" /begin SUB_GROUP /end SUB_GROUP /begin FUNCTION_LIST /end FUNCTION_LIST /begin REF_CHARACTERISTIC /end REF_CHARACTERISTIC /begin REF_MEASUREMENT EOTActuatorMng.CwEOT.HwDeg_f32 /end REF_MEASUREMENT /end GROUP
/begin GROUP EOTActuatorMng.CwFound.Cnt_lgc "MICROSAR RTE" /begin SUB_GROUP /end SUB_GROUP /begin FUNCTION_LIST /end FUNCTION_LIST /begin REF_CHARACTERISTIC /end REF_CHARACTERISTIC /begin REF_MEASUREMENT EOTActuatorMng.CwFound.Cnt_lgc /end REF_MEASUREMENT /end GROUP
/begin GROUP EOTActuatorMng.EOTDisable.Cnt_lgc "MICROSAR RTE" /begin SUB_GROUP /end SUB_GROUP /begin FUNCTION_LIST /end FUNCTION_LIST /begin REF_CHARACTERISTIC /end REF_CHARACTERISTIC /begin REF_MEASUREMENT EOTActuatorMng.EOTDisable.Cnt_lgc /end REF_MEASUREMENT /end GROUP
/begin GROUP EOTActuatorMng.HandWheelAuth.Uls_f32 "MICROSAR RTE" /begin SUB_GROUP /end SUB_GROUP /begin FUNCTION_LIST /end FUNCTION_LIST /begin REF_CHARACTERISTIC /end REF_CHARACTERISTIC /begin REF_MEASUREMENT EOTActuatorMng.HandWheelAuth.Uls_f32 /end REF_MEASUREMENT /end GROUP
/begin GROUP EOTActuatorMng.HandWheelPos.HwDeg_f32 "MICROSAR RTE" /begin SUB_GROUP /end SUB_GROUP /begin FUNCTION_LIST /end FUNCTION_LIST /begin REF_CHARACTERISTIC /end REF_CHARACTERISTIC /begin REF_MEASUREMENT EOTActuatorMng.HandWheelPos.HwDeg_f32 /end REF_MEASUREMENT /end GROUP
/begin GROUP EOTActuatorMng.HwTorque.HwNm_f32 "MICROSAR RTE" /begin SUB_GROUP /end SUB_GROUP /begin FUNCTION_LIST /end FUNCTION_LIST /begin REF_CHARACTERISTIC /end REF_CHARACTERISTIC /begin REF_MEASUREMENT EOTActuatorMng.HwTorque.HwNm_f32 /end REF_MEASUREMENT /end GROUP
/begin GROUP EOTActuatorMng.MotorVel.MtrRadpS_f32 "MICROSAR RTE" /begin SUB_GROUP /end SUB_GROUP /begin FUNCTION_LIST /end FUNCTION_LIST /begin REF_CHARACTERISTIC /end REF_CHARACTERISTIC /begin REF_MEASUREMENT EOTActuatorMng.MotorVel.MtrRadpS_f32 /end REF_MEASUREMENT /end GROUP
/begin GROUP EOTActuatorMng.PreLimitTorque.MtrNm_f32 "MICROSAR RTE" /begin SUB_GROUP /end SUB_GROUP /begin FUNCTION_LIST /end FUNCTION_LIST /begin REF_CHARACTERISTIC /end REF_CHARACTERISTIC /begin REF_MEASUREMENT EOTActuatorMng.PreLimitTorque.MtrNm_f32 /end REF_MEASUREMENT /end GROUP
/begin GROUP EOTActuatorMng.ReceiverPorts "MICROSAR RTE"
 /begin SUB_GROUP EOTActuatorMng.CcwEOT.HwDeg_f32 EOTActuatorMng.CcwFound.Cnt_lgc EOTActuatorMng.CwEOT.HwDeg_f32 EOTActuatorMng.CwFound.Cnt_lgc EOTActuatorMng.EOTDisable.Cnt_lgc EOTActuatorMng.HandWheelAuth.Uls_f32 EOTActuatorMng.HandWheelPos.HwDeg_f32 EOTActuatorMng.HwTorque.HwNm_f32 EOTActuatorMng.MotorVel.MtrRadpS_f32 EOTActuatorMng.PreLimitTorque.MtrNm_f32 EOTActuatorMng.VehicleSpeed.Kph_f32 /end SUB_GROUP
 /begin FUNCTION_LIST /end FUNCTION_LIST
 /begin REF_CHARACTERISTIC /end REF_CHARACTERISTIC
 /begin REF_MEASUREMENT /end REF_MEASUREMENT
/end GROUP
/begin GROUP EOTActuatorMng.SenderPorts "MICROSAR RTE"
 /begin SUB_GROUP EOTActuatorMng.AssistEOTDamping.MtrNm_f32 EOTActuatorMng.AssistEOTGain.Uls_f32 EOTActuatorMng.AssistEOTLimit.MtrNm_f32 /end SUB_GROUP
 /begin FUNCTION_LIST /end FUNCTION_LIST
 /begin REF_CHARACTERISTIC /end REF_CHARACTERISTIC
 /begin REF_MEASUREMENT /end REF_MEASUREMENT
/end GROUP
/begin GROUP EOTActuatorMng.VehicleSpeed.Kph_f32 "MICROSAR RTE" /begin SUB_GROUP /end SUB_GROUP /begin FUNCTION_LIST /end FUNCTION_LIST /begin REF_CHARACTERISTIC /end REF_CHARACTERISTIC /begin REF_MEASUREMENT EOTActuatorMng.VehicleSpeed.Kph_f32 /end REF_MEASUREMENT /end GROUP
/begin GROUP FltInjection "MICROSAR RTE" /begin SUB_GROUP FltInjection.ReceiverPorts /end SUB_GROUP /begin FUNCTION_LIST /end FUNCTION_LIST /begin REF_CHARACTERISTIC /end REF_CHARACTERISTIC /begin REF_MEASUREMENT /end REF_MEASUREMENT /end GROUP
/begin GROUP FltInjection.MotorVelCRF.MtrRadpS_f32 "MICROSAR RTE" /begin SUB_GROUP /end SUB_GROUP /begin FUNCTION_LIST /end FUNCTION_LIST /begin REF_CHARACTERISTIC /end REF_CHARACTERISTIC /begin REF_MEASUREMENT FltInjection.MotorVelCRF.MtrRadpS_f32 /end REF_MEASUREMENT /end GROUP
/begin GROUP FltInjection.ReceiverPorts "MICROSAR RTE" /begin SUB_GROUP FltInjection.MotorVelCRF.MtrRadpS_f32 /end SUB_GROUP /begin FUNCTION_LIST /end FUNCTION_LIST /begin REF_CHARACTERISTIC /end REF_CHARACTERISTIC /begin REF_MEASUREMENT /end REF_MEASUREMENT /end GROUP
/begin GROUP FrqDepDmpnInrtCmp "MICROSAR RTE"
 /begin SUB_GROUP FrqDepDmpnInrtCmp.ModeRequirePorts FrqDepDmpnInrtCmp.ReceiverPorts FrqDepDmpnInrtCmp.SenderPorts /end SUB_GROUP
 /begin FUNCTION_LIST /end FUNCTION_LIST
 /begin REF_CHARACTERISTIC /end REF_CHARACTERISTIC
 /begin REF_MEASUREMENT /end REF_MEASUREMENT
/end GROUP
/begin GROUP FrqDepDmpnInrtCmp.BaseAssistCmd.MtrNm_f32 "MICROSAR RTE" /begin SUB_GROUP /end SUB_GROUP /begin FUNCTION_LIST /end FUNCTION_LIST /begin REF_CHARACTERISTIC /end REF_CHARACTERISTIC /begin REF_MEASUREMENT FrqDepDmpnInrtCmp.BaseAssistCmd.MtrNm_f32 /end REF_MEASUREMENT /end GROUP
/begin GROUP FrqDepDmpnInrtCmp.CRFMotorVel.MtrRadpS_f32 "MICROSAR RTE" /begin SUB_GROUP /end SUB_GROUP /begin FUNCTION_LIST /end FUNCTION_LIST /begin REF_CHARACTERISTIC /end REF_CHARACTERISTIC /begin REF_MEASUREMENT FrqDepDmpnInrtCmp.CRFMotorVel.MtrRadpS_f32 /end REF_MEASUREMENT /end GROUP
/begin GROUP FrqDepDmpnInrtCmp.FreqDepDmpSrlComSvcDft.Cnt_lgc "MICROSAR RTE" /begin SUB_GROUP /end SUB_GROUP /begin FUNCTION_LIST /end FUNCTION_LIST /begin REF_CHARACTERISTIC /end REF_CHARACTERISTIC /begin REF_MEASUREMENT FrqDepDmpnInrtCmp.FreqDepDmpSrlComSvcDft.Cnt_lgc /end REF_MEASUREMENT /end GROUP
/begin GROUP FrqDepDmpnInrtCmp.FrqDepDmpnInrtCmp.MtrNm_f32 "MICROSAR RTE" /begin SUB_GROUP /end SUB_GROUP /begin FUNCTION_LIST /end FUNCTION_LIST /begin REF_CHARACTERISTIC /end REF_CHARACTERISTIC /begin REF_MEASUREMENT FrqDepDmpnInrtCmp.FrqDepDmpnInrtCmp.MtrNm_f32 /end REF_MEASUREMENT /end GROUP
/begin GROUP FrqDepDmpnInrtCmp.HwTorque.HwNm_f32 "MICROSAR RTE" /begin SUB_GROUP /end SUB_GROUP /begin FUNCTION_LIST /end FUNCTION_LIST /begin REF_CHARACTERISTIC /end REF_CHARACTERISTIC /begin REF_MEASUREMENT FrqDepDmpnInrtCmp.HwTorque.HwNm_f32 /end REF_MEASUREMENT /end GROUP
/begin GROUP FrqDepDmpnInrtCmp.ModeRequirePorts "MICROSAR RTE" /begin SUB_GROUP FrqDepDmpnInrtCmp.SystemState.Mode /end SUB_GROUP /begin FUNCTION_LIST /end FUNCTION_LIST /begin REF_CHARACTERISTIC /end REF_CHARACTERISTIC /begin REF_MEASUREMENT /end REF_MEASUREMENT /end GROUP
/begin GROUP FrqDepDmpnInrtCmp.ReceiverPorts "MICROSAR RTE"
 /begin SUB_GROUP FrqDepDmpnInrtCmp.BaseAssistCmd.MtrNm_f32 FrqDepDmpnInrtCmp.CRFMotorVel.MtrRadpS_f32 FrqDepDmpnInrtCmp.FreqDepDmpSrlComSvcDft.Cnt_lgc FrqDepDmpnInrtCmp.HwTorque.HwNm_f32 FrqDepDmpnInrtCmp.VehicleLonAccel.KphpS_f32 FrqDepDmpnInrtCmp.VehicleSpeed.Kph_f32 FrqDepDmpnInrtCmp.WIRCmdAmpBlnd.MtrNm_f32 /end SUB_GROUP
 /begin FUNCTION_LIST /end FUNCTION_LIST
 /begin REF_CHARACTERISTIC /end REF_CHARACTERISTIC
 /begin REF_MEASUREMENT /end REF_MEASUREMENT
/end GROUP
/begin GROUP FrqDepDmpnInrtCmp.SenderPorts "MICROSAR RTE" /begin SUB_GROUP FrqDepDmpnInrtCmp.FrqDepDmpnInrtCmp.MtrNm_f32 /end SUB_GROUP /begin FUNCTION_LIST /end FUNCTION_LIST /begin REF_CHARACTERISTIC /end REF_CHARACTERISTIC /begin REF_MEASUREMENT /end REF_MEASUREMENT /end GROUP
/begin GROUP FrqDepDmpnInrtCmp.SystemState.Mode "MICROSAR RTE" /begin SUB_GROUP /end SUB_GROUP /begin FUNCTION_LIST /end FUNCTION_LIST /begin REF_CHARACTERISTIC /end REF_CHARACTERISTIC /begin REF_MEASUREMENT FrqDepDmpnInrtCmp.SystemState.Mode /end REF_MEASUREMENT /end GROUP
/begin GROUP FrqDepDmpnInrtCmp.VehicleLonAccel.KphpS_f32 "MICROSAR RTE" /begin SUB_GROUP /end SUB_GROUP /begin FUNCTION_LIST /end FUNCTION_LIST /begin REF_CHARACTERISTIC /end REF_CHARACTERISTIC /begin REF_MEASUREMENT FrqDepDmpnInrtCmp.VehicleLonAccel.KphpS_f32 /end REF_MEASUREMENT /end GROUP
/begin GROUP FrqDepDmpnInrtCmp.VehicleSpeed.Kph_f32 "MICROSAR RTE" /begin SUB_GROUP /end SUB_GROUP /begin FUNCTION_LIST /end FUNCTION_LIST /begin REF_CHARACTERISTIC /end REF_CHARACTERISTIC /begin REF_MEASUREMENT FrqDepDmpnInrtCmp.VehicleSpeed.Kph_f32 /end REF_MEASUREMENT /end GROUP
/begin GROUP FrqDepDmpnInrtCmp.WIRCmdAmpBlnd.MtrNm_f32 "MICROSAR RTE" /begin SUB_GROUP /end SUB_GROUP /begin FUNCTION_LIST /end FUNCTION_LIST /begin REF_CHARACTERISTIC /end REF_CHARACTERISTIC /begin REF_MEASUREMENT FrqDepDmpnInrtCmp.WIRCmdAmpBlnd.MtrNm_f32 /end REF_MEASUREMENT /end GROUP
/begin GROUP HiLoadStall "MICROSAR RTE" /begin SUB_GROUP HiLoadStall.ReceiverPorts HiLoadStall.SenderPorts /end SUB_GROUP /begin FUNCTION_LIST /end FUNCTION_LIST /begin REF_CHARACTERISTIC /end REF_CHARACTERISTIC /begin REF_MEASUREMENT /end REF_MEASUREMENT /end GROUP
/begin GROUP HiLoadStall.AssistStallLimit.MtrNm_f32 "MICROSAR RTE" /begin SUB_GROUP /end SUB_GROUP /begin FUNCTION_LIST /end FUNCTION_LIST /begin REF_CHARACTERISTIC /end REF_CHARACTERISTIC /begin REF_MEASUREMENT HiLoadStall.AssistStallLimit.MtrNm_f32 /end REF_MEASUREMENT /end GROUP
/begin GROUP HiLoadStall.DftStallLimit.Cnt_lgc "MICROSAR RTE" /begin SUB_GROUP /end SUB_GROUP /begin FUNCTION_LIST /end FUNCTION_LIST /begin REF_CHARACTERISTIC /end REF_CHARACTERISTIC /begin REF_MEASUREMENT HiLoadStall.DftStallLimit.Cnt_lgc /end REF_MEASUREMENT /end GROUP
/begin GROUP HiLoadStall.MtrVelCRF.MtrRadpS_f32 "MICROSAR RTE" /begin SUB_GROUP /end SUB_GROUP /begin FUNCTION_LIST /end FUNCTION_LIST /begin REF_CHARACTERISTIC /end REF_CHARACTERISTIC /begin REF_MEASUREMENT HiLoadStall.MtrVelCRF.MtrRadpS_f32 /end REF_MEASUREMENT /end GROUP
/begin GROUP HiLoadStall.PreLimitForStall.MtrNm_f32 "MICROSAR RTE" /begin SUB_GROUP /end SUB_GROUP /begin FUNCTION_LIST /end FUNCTION_LIST /begin REF_CHARACTERISTIC /end REF_CHARACTERISTIC /begin REF_MEASUREMENT HiLoadStall.PreLimitForStall.MtrNm_f32 /end REF_MEASUREMENT /end GROUP
/begin GROUP HiLoadStall.ReceiverPorts "MICROSAR RTE"
 /begin SUB_GROUP HiLoadStall.DftStallLimit.Cnt_lgc HiLoadStall.MtrVelCRF.MtrRadpS_f32 HiLoadStall.PreLimitForStall.MtrNm_f32 /end SUB_GROUP
 /begin FUNCTION_LIST /end FUNCTION_LIST
 /begin REF_CHARACTERISTIC /end REF_CHARACTERISTIC
 /begin REF_MEASUREMENT /end REF_MEASUREMENT
/end GROUP
/begin GROUP HiLoadStall.SenderPorts "MICROSAR RTE" /begin SUB_GROUP HiLoadStall.AssistStallLimit.MtrNm_f32 /end SUB_GROUP /begin FUNCTION_LIST /end FUNCTION_LIST /begin REF_CHARACTERISTIC /end REF_CHARACTERISTIC /begin REF_MEASUREMENT /end REF_MEASUREMENT /end GROUP
/begin GROUP HighFreqAssist "MICROSAR RTE" /begin SUB_GROUP HighFreqAssist.ReceiverPorts HighFreqAssist.SenderPorts /end SUB_GROUP /begin FUNCTION_LIST /end FUNCTION_LIST /begin REF_CHARACTERISTIC /end REF_CHARACTERISTIC /begin REF_MEASUREMENT /end REF_MEASUREMENT /end GROUP
/begin GROUP HighFreqAssist.HighFreqAssist.MtrNm_f32 "MICROSAR RTE" /begin SUB_GROUP /end SUB_GROUP /begin FUNCTION_LIST /end FUNCTION_LIST /begin REF_CHARACTERISTIC /end REF_CHARACTERISTIC /begin REF_MEASUREMENT HighFreqAssist.HighFreqAssist.MtrNm_f32 /end REF_MEASUREMENT /end GROUP
/begin GROUP HighFreqAssist.HwTorque.HwNm_f32 "MICROSAR RTE" /begin SUB_GROUP /end SUB_GROUP /begin FUNCTION_LIST /end FUNCTION_LIST /begin REF_CHARACTERISTIC /end REF_CHARACTERISTIC /begin REF_MEASUREMENT HighFreqAssist.HwTorque.HwNm_f32 /end REF_MEASUREMENT /end GROUP
/begin GROUP HighFreqAssist.ReceiverPorts "MICROSAR RTE"
 /begin SUB_GROUP HighFreqAssist.HwTorque.HwNm_f32 HighFreqAssist.VehicleSpeed.Kph_f32 HighFreqAssist.WIRCmdAmpBlnd.MtrNm_f32 /end SUB_GROUP
 /begin FUNCTION_LIST /end FUNCTION_LIST
 /begin REF_CHARACTERISTIC /end REF_CHARACTERISTIC
 /begin REF_MEASUREMENT /end REF_MEASUREMENT
/end GROUP
/begin GROUP HighFreqAssist.SenderPorts "MICROSAR RTE" /begin SUB_GROUP HighFreqAssist.HighFreqAssist.MtrNm_f32 /end SUB_GROUP /begin FUNCTION_LIST /end FUNCTION_LIST /begin REF_CHARACTERISTIC /end REF_CHARACTERISTIC /begin REF_MEASUREMENT /end REF_MEASUREMENT /end GROUP
/begin GROUP HighFreqAssist.VehicleSpeed.Kph_f32 "MICROSAR RTE" /begin SUB_GROUP /end SUB_GROUP /begin FUNCTION_LIST /end FUNCTION_LIST /begin REF_CHARACTERISTIC /end REF_CHARACTERISTIC /begin REF_MEASUREMENT HighFreqAssist.VehicleSpeed.Kph_f32 /end REF_MEASUREMENT /end GROUP
/begin GROUP HighFreqAssist.WIRCmdAmpBlnd.MtrNm_f32 "MICROSAR RTE" /begin SUB_GROUP /end SUB_GROUP /begin FUNCTION_LIST /end FUNCTION_LIST /begin REF_CHARACTERISTIC /end REF_CHARACTERISTIC /begin REF_MEASUREMENT HighFreqAssist.WIRCmdAmpBlnd.MtrNm_f32 /end REF_MEASUREMENT /end GROUP
/begin GROUP HystComp "MICROSAR RTE" /begin SUB_GROUP HystComp.ReceiverPorts HystComp.SenderPorts /end SUB_GROUP /begin FUNCTION_LIST /end FUNCTION_LIST /begin REF_CHARACTERISTIC /end REF_CHARACTERISTIC /begin REF_MEASUREMENT /end REF_MEASUREMENT /end GROUP
/begin GROUP HystComp.AssistMechTempEst.DegC_f32 "MICROSAR RTE" /begin SUB_GROUP /end SUB_GROUP /begin FUNCTION_LIST /end FUNCTION_LIST /begin REF_CHARACTERISTIC /end REF_CHARACTERISTIC /begin REF_MEASUREMENT HystComp.AssistMechTempEst.DegC_f32 /end REF_MEASUREMENT /end GROUP
/begin GROUP HystComp.BaseAssistCmd.MtrNm_f32 "MICROSAR RTE" /begin SUB_GROUP /end SUB_GROUP /begin FUNCTION_LIST /end FUNCTION_LIST /begin REF_CHARACTERISTIC /end REF_CHARACTERISTIC /begin REF_MEASUREMENT HystComp.BaseAssistCmd.MtrNm_f32 /end REF_MEASUREMENT /end GROUP
/begin GROUP HystComp.DefeatHystService.Cnt_lgc "MICROSAR RTE" /begin SUB_GROUP /end SUB_GROUP /begin FUNCTION_LIST /end FUNCTION_LIST /begin REF_CHARACTERISTIC /end REF_CHARACTERISTIC /begin REF_MEASUREMENT HystComp.DefeatHystService.Cnt_lgc /end REF_MEASUREMENT /end GROUP
/begin GROUP HystComp.FricOffset.HwNm_f32 "MICROSAR RTE" /begin SUB_GROUP /end SUB_GROUP /begin FUNCTION_LIST /end FUNCTION_LIST /begin REF_CHARACTERISTIC /end REF_CHARACTERISTIC /begin REF_MEASUREMENT HystComp.FricOffset.HwNm_f32 /end REF_MEASUREMENT /end GROUP
/begin GROUP HystComp.HwTorque.HwNm_f32 "MICROSAR RTE" /begin SUB_GROUP /end SUB_GROUP /begin FUNCTION_LIST /end FUNCTION_LIST /begin REF_CHARACTERISTIC /end REF_CHARACTERISTIC /begin REF_MEASUREMENT HystComp.HwTorque.HwNm_f32 /end REF_MEASUREMENT /end GROUP
/begin GROUP HystComp.HysteresisComp.MtrNm_f32 "MICROSAR RTE" /begin SUB_GROUP /end SUB_GROUP /begin FUNCTION_LIST /end FUNCTION_LIST /begin REF_CHARACTERISTIC /end REF_CHARACTERISTIC /begin REF_MEASUREMENT HystComp.HysteresisComp.MtrNm_f32 /end REF_MEASUREMENT /end GROUP
/begin GROUP HystComp.ReceiverPorts "MICROSAR RTE"
 /begin SUB_GROUP HystComp.AssistMechTempEst.DegC_f32 HystComp.BaseAssistCmd.MtrNm_f32 HystComp.DefeatHystService.Cnt_lgc HystComp.FricOffset.HwNm_f32 HystComp.HwTorque.HwNm_f32 HystComp.VehicleSpeed.Kph_f32 HystComp.WIRCmdAmpBlnd.MtrNm_f32 /end SUB_GROUP
 /begin FUNCTION_LIST /end FUNCTION_LIST
 /begin REF_CHARACTERISTIC /end REF_CHARACTERISTIC
 /begin REF_MEASUREMENT /end REF_MEASUREMENT
/end GROUP
/begin GROUP HystComp.SenderPorts "MICROSAR RTE" /begin SUB_GROUP HystComp.HysteresisComp.MtrNm_f32 /end SUB_GROUP /begin FUNCTION_LIST /end FUNCTION_LIST /begin REF_CHARACTERISTIC /end REF_CHARACTERISTIC /begin REF_MEASUREMENT /end REF_MEASUREMENT /end GROUP
/begin GROUP HystComp.VehicleSpeed.Kph_f32 "MICROSAR RTE" /begin SUB_GROUP /end SUB_GROUP /begin FUNCTION_LIST /end FUNCTION_LIST /begin REF_CHARACTERISTIC /end REF_CHARACTERISTIC /begin REF_MEASUREMENT HystComp.VehicleSpeed.Kph_f32 /end REF_MEASUREMENT /end GROUP
/begin GROUP HystComp.WIRCmdAmpBlnd.MtrNm_f32 "MICROSAR RTE" /begin SUB_GROUP /end SUB_GROUP /begin FUNCTION_LIST /end FUNCTION_LIST /begin REF_CHARACTERISTIC /end REF_CHARACTERISTIC /begin REF_MEASUREMENT HystComp.WIRCmdAmpBlnd.MtrNm_f32 /end REF_MEASUREMENT /end GROUP
/begin GROUP IoHwAbstractionUsr "MICROSAR RTE"
 /begin SUB_GROUP IoHwAbstractionUsr.ReceiverPorts IoHwAbstractionUsr.SenderPorts /end SUB_GROUP
 /begin FUNCTION_LIST /end FUNCTION_LIST
 /begin REF_CHARACTERISTIC /end REF_CHARACTERISTIC
 /begin REF_MEASUREMENT /end REF_MEASUREMENT
/end GROUP
/begin GROUP IoHwAbstractionUsr.Batt.Volt_f32 "MICROSAR RTE" /begin SUB_GROUP /end SUB_GROUP /begin FUNCTION_LIST /end FUNCTION_LIST /begin REF_CHARACTERISTIC /end REF_CHARACTERISTIC /begin REF_MEASUREMENT IoHwAbstractionUsr.Batt.Volt_f32 /end REF_MEASUREMENT /end GROUP
/begin GROUP IoHwAbstractionUsr.BattSwitched.Volt_f32 "MICROSAR RTE" /begin SUB_GROUP /end SUB_GROUP /begin FUNCTION_LIST /end FUNCTION_LIST /begin REF_CHARACTERISTIC /end REF_CHARACTERISTIC /begin REF_MEASUREMENT IoHwAbstractionUsr.BattSwitched.Volt_f32 /end REF_MEASUREMENT /end GROUP
/begin GROUP IoHwAbstractionUsr.ReceiverPorts "MICROSAR RTE" /begin SUB_GROUP IoHwAbstractionUsr.SysCVSwitchADC.Cnt_u16 /end SUB_GROUP /begin FUNCTION_LIST /end FUNCTION_LIST /begin REF_CHARACTERISTIC /end REF_CHARACTERISTIC /begin REF_MEASUREMENT /end REF_MEASUREMENT /end GROUP
/begin GROUP IoHwAbstractionUsr.SenderPorts "MICROSAR RTE"
 /begin SUB_GROUP IoHwAbstractionUsr.Batt.Volt_f32 IoHwAbstractionUsr.BattSwitched.Volt_f32 IoHwAbstractionUsr.SysCVSwitch.Volt_f32 IoHwAbstractionUsr.TemperatureADC.Volt_f32 /end SUB_GROUP
 /begin FUNCTION_LIST /end FUNCTION_LIST
 /begin REF_CHARACTERISTIC /end REF_CHARACTERISTIC
 /begin REF_MEASUREMENT /end REF_MEASUREMENT
/end GROUP
/begin GROUP IoHwAbstractionUsr.SysCVSwitch.Volt_f32 "MICROSAR RTE" /begin SUB_GROUP /end SUB_GROUP /begin FUNCTION_LIST /end FUNCTION_LIST /begin REF_CHARACTERISTIC /end REF_CHARACTERISTIC /begin REF_MEASUREMENT IoHwAbstractionUsr.SysCVSwitch.Volt_f32 /end REF_MEASUREMENT /end GROUP
/begin GROUP IoHwAbstractionUsr.SysCVSwitchADC.Cnt_u16 "MICROSAR RTE" /begin SUB_GROUP /end SUB_GROUP /begin FUNCTION_LIST /end FUNCTION_LIST /begin REF_CHARACTERISTIC /end REF_CHARACTERISTIC /begin REF_MEASUREMENT IoHwAbstractionUsr.SysCVSwitchADC.Cnt_u16 /end REF_MEASUREMENT /end GROUP
/begin GROUP IoHwAbstractionUsr.TemperatureADC.Volt_f32 "MICROSAR RTE" /begin SUB_GROUP /end SUB_GROUP /begin FUNCTION_LIST /end FUNCTION_LIST /begin REF_CHARACTERISTIC /end REF_CHARACTERISTIC /begin REF_MEASUREMENT IoHwAbstractionUsr.TemperatureADC.Volt_f32 /end REF_MEASUREMENT /end GROUP
/begin GROUP MtrDrvDiag "MICROSAR RTE"
 /begin SUB_GROUP MtrDrvDiag.ModeRequirePorts MtrDrvDiag.ReceiverPorts MtrDrvDiag.SenderPorts /end SUB_GROUP
 /begin FUNCTION_LIST /end FUNCTION_LIST
 /begin REF_CHARACTERISTIC /end REF_CHARACTERISTIC
 /begin REF_MEASUREMENT /end REF_MEASUREMENT
/end GROUP
/begin GROUP MtrDrvDiag.FETFaultPhase.Cnt_enum "MICROSAR RTE" /begin SUB_GROUP /end SUB_GROUP /begin FUNCTION_LIST /end FUNCTION_LIST /begin REF_CHARACTERISTIC /end REF_CHARACTERISTIC /begin REF_MEASUREMENT MtrDrvDiag.FETFaultPhase.Cnt_enum /end REF_MEASUREMENT /end GROUP
/begin GROUP MtrDrvDiag.FETFaultType.Cnt_enum "MICROSAR RTE" /begin SUB_GROUP /end SUB_GROUP /begin FUNCTION_LIST /end FUNCTION_LIST /begin REF_CHARACTERISTIC /end REF_CHARACTERISTIC /begin REF_MEASUREMENT MtrDrvDiag.FETFaultType.Cnt_enum /end REF_MEASUREMENT /end GROUP
/begin GROUP MtrDrvDiag.GateDriveResetActive.Cnt_lgc "MICROSAR RTE" /begin SUB_GROUP /end SUB_GROUP /begin FUNCTION_LIST /end FUNCTION_LIST /begin REF_CHARACTERISTIC /end REF_CHARACTERISTIC /begin REF_MEASUREMENT MtrDrvDiag.GateDriveResetActive.Cnt_lgc /end REF_MEASUREMENT /end GROUP
/begin GROUP MtrDrvDiag.ModeRequirePorts "MICROSAR RTE" /begin SUB_GROUP MtrDrvDiag.SystemState.Mode /end SUB_GROUP /begin FUNCTION_LIST /end FUNCTION_LIST /begin REF_CHARACTERISTIC /end REF_CHARACTERISTIC /begin REF_MEASUREMENT /end REF_MEASUREMENT /end GROUP
/begin GROUP MtrDrvDiag.MtrDrvrInitComplete.Cnt_lgc "MICROSAR RTE" /begin SUB_GROUP /end SUB_GROUP /begin FUNCTION_LIST /end FUNCTION_LIST /begin REF_CHARACTERISTIC /end REF_CHARACTERISTIC /begin REF_MEASUREMENT MtrDrvDiag.MtrDrvrInitComplete.Cnt_lgc /end REF_MEASUREMENT /end GROUP
/begin GROUP MtrDrvDiag.MtrDrvrInitStart.Cnt_lgc "MICROSAR RTE" /begin SUB_GROUP /end SUB_GROUP /begin FUNCTION_LIST /end FUNCTION_LIST /begin REF_CHARACTERISTIC /end REF_CHARACTERISTIC /begin REF_MEASUREMENT MtrDrvDiag.MtrDrvrInitStart.Cnt_lgc /end REF_MEASUREMENT /end GROUP
/begin GROUP MtrDrvDiag.ReceiverPorts "MICROSAR RTE" /begin SUB_GROUP MtrDrvDiag.MtrDrvrInitStart.Cnt_lgc /end SUB_GROUP /begin FUNCTION_LIST /end FUNCTION_LIST /begin REF_CHARACTERISTIC /end REF_CHARACTERISTIC /begin REF_MEASUREMENT /end REF_MEASUREMENT /end GROUP
/begin GROUP MtrDrvDiag.SenderPorts "MICROSAR RTE"
 /begin SUB_GROUP MtrDrvDiag.FETFaultPhase.Cnt_enum MtrDrvDiag.FETFaultType.Cnt_enum MtrDrvDiag.GateDriveResetActive.Cnt_lgc MtrDrvDiag.MtrDrvrInitComplete.Cnt_lgc /end SUB_GROUP
 /begin FUNCTION_LIST /end FUNCTION_LIST
 /begin REF_CHARACTERISTIC /end REF_CHARACTERISTIC
 /begin REF_MEASUREMENT /end REF_MEASUREMENT
/end GROUP
/begin GROUP MtrDrvDiag.SystemState.Mode "MICROSAR RTE" /begin SUB_GROUP /end SUB_GROUP /begin FUNCTION_LIST /end FUNCTION_LIST /begin REF_CHARACTERISTIC /end REF_CHARACTERISTIC /begin REF_MEASUREMENT MtrDrvDiag.SystemState.Mode /end REF_MEASUREMENT /end GROUP
/begin GROUP PeakCurrEst "MICROSAR RTE"
 /begin SUB_GROUP PeakCurrEst.ModeRequirePorts PeakCurrEst.ReceiverPorts PeakCurrEst.SenderPorts /end SUB_GROUP
 /begin FUNCTION_LIST /end FUNCTION_LIST
 /begin REF_CHARACTERISTIC /end REF_CHARACTERISTIC
 /begin REF_MEASUREMENT /end REF_MEASUREMENT
/end GROUP
/begin GROUP PeakCurrEst.EstPkCurr.AmpSq_f32 "MICROSAR RTE" /begin SUB_GROUP /end SUB_GROUP /begin FUNCTION_LIST /end FUNCTION_LIST /begin REF_CHARACTERISTIC /end REF_CHARACTERISTIC /begin REF_MEASUREMENT PeakCurrEst.EstPkCurr.AmpSq_f32 /end REF_MEASUREMENT /end GROUP
/begin GROUP PeakCurrEst.FiltEstPkCurr.AmpSq_f32 "MICROSAR RTE" /begin SUB_GROUP /end SUB_GROUP /begin FUNCTION_LIST /end FUNCTION_LIST /begin REF_CHARACTERISTIC /end REF_CHARACTERISTIC /begin REF_MEASUREMENT PeakCurrEst.FiltEstPkCurr.AmpSq_f32 /end REF_MEASUREMENT /end GROUP
/begin GROUP PeakCurrEst.IvtrLoaMtgtnEn.Cnt_lgc "MICROSAR RTE" /begin SUB_GROUP /end SUB_GROUP /begin FUNCTION_LIST /end FUNCTION_LIST /begin REF_CHARACTERISTIC /end REF_CHARACTERISTIC /begin REF_MEASUREMENT PeakCurrEst.IvtrLoaMtgtnEn.Cnt_lgc /end REF_MEASUREMENT /end GROUP
/begin GROUP PeakCurrEst.ModeRequirePorts "MICROSAR RTE" /begin SUB_GROUP PeakCurrEst.SystemState.Mode /end SUB_GROUP /begin FUNCTION_LIST /end FUNCTION_LIST /begin REF_CHARACTERISTIC /end REF_CHARACTERISTIC /begin REF_MEASUREMENT /end REF_MEASUREMENT /end GROUP
/begin GROUP PeakCurrEst.MotCurrLoaMtgtnEn.Cnt_lgc "MICROSAR RTE" /begin SUB_GROUP /end SUB_GROUP /begin FUNCTION_LIST /end FUNCTION_LIST /begin REF_CHARACTERISTIC /end REF_CHARACTERISTIC /begin REF_MEASUREMENT PeakCurrEst.MotCurrLoaMtgtnEn.Cnt_lgc /end REF_MEASUREMENT /end GROUP
/begin GROUP PeakCurrEst.MtrCurrDax.Amp_f32 "MICROSAR RTE" /begin SUB_GROUP /end SUB_GROUP /begin FUNCTION_LIST /end FUNCTION_LIST /begin REF_CHARACTERISTIC /end REF_CHARACTERISTIC /begin REF_MEASUREMENT PeakCurrEst.MtrCurrDax.Amp_f32 /end REF_MEASUREMENT /end GROUP
/begin GROUP PeakCurrEst.MtrCurrDaxRef.Amp_f32 "MICROSAR RTE" /begin SUB_GROUP /end SUB_GROUP /begin FUNCTION_LIST /end FUNCTION_LIST /begin REF_CHARACTERISTIC /end REF_CHARACTERISTIC /begin REF_MEASUREMENT PeakCurrEst.MtrCurrDaxRef.Amp_f32 /end REF_MEASUREMENT /end GROUP
/begin GROUP PeakCurrEst.MtrCurrQax.Amp_f32 "MICROSAR RTE" /begin SUB_GROUP /end SUB_GROUP /begin FUNCTION_LIST /end FUNCTION_LIST /begin REF_CHARACTERISTIC /end REF_CHARACTERISTIC /begin REF_MEASUREMENT PeakCurrEst.MtrCurrQax.Amp_f32 /end REF_MEASUREMENT /end GROUP
/begin GROUP PeakCurrEst.MtrCurrQaxRef.Amp_f32 "MICROSAR RTE" /begin SUB_GROUP /end SUB_GROUP /begin FUNCTION_LIST /end FUNCTION_LIST /begin REF_CHARACTERISTIC /end REF_CHARACTERISTIC /begin REF_MEASUREMENT PeakCurrEst.MtrCurrQaxRef.Amp_f32 /end REF_MEASUREMENT /end GROUP
/begin GROUP PeakCurrEst.ReceiverPorts "MICROSAR RTE"
 /begin SUB_GROUP PeakCurrEst.IvtrLoaMtgtnEn.Cnt_lgc PeakCurrEst.MotCurrLoaMtgtnEn.Cnt_lgc PeakCurrEst.MtrCurrDax.Amp_f32 PeakCurrEst.MtrCurrDaxRef.Amp_f32 PeakCurrEst.MtrCurrQax.Amp_f32 PeakCurrEst.MtrCurrQaxRef.Amp_f32 /end SUB_GROUP
 /begin FUNCTION_LIST /end FUNCTION_LIST
 /begin REF_CHARACTERISTIC /end REF_CHARACTERISTIC
 /begin REF_MEASUREMENT /end REF_MEASUREMENT
/end GROUP
/begin GROUP PeakCurrEst.SenderPorts "MICROSAR RTE"
 /begin SUB_GROUP PeakCurrEst.EstPkCurr.AmpSq_f32 PeakCurrEst.FiltEstPkCurr.AmpSq_f32 /end SUB_GROUP
 /begin FUNCTION_LIST /end FUNCTION_LIST
 /begin REF_CHARACTERISTIC /end REF_CHARACTERISTIC
 /begin REF_MEASUREMENT /end REF_MEASUREMENT
/end GROUP
/begin GROUP PeakCurrEst.SystemState.Mode "MICROSAR RTE" /begin SUB_GROUP /end SUB_GROUP /begin FUNCTION_LIST /end FUNCTION_LIST /begin REF_CHARACTERISTIC /end REF_CHARACTERISTIC /begin REF_MEASUREMENT PeakCurrEst.SystemState.Mode /end REF_MEASUREMENT /end GROUP
/begin GROUP Polarity "MICROSAR RTE"
 /begin SUB_GROUP Polarity.PerInstanceMemories Polarity.ReceiverPorts Polarity.SenderPorts /end SUB_GROUP
 /begin FUNCTION_LIST /end FUNCTION_LIST
 /begin REF_CHARACTERISTIC /end REF_CHARACTERISTIC
 /begin REF_MEASUREMENT /end REF_MEASUREMENT
/end GROUP
/begin GROUP Polarity.AssistAssyPolarity.Cnt_s08 "MICROSAR RTE" /begin SUB_GROUP /end SUB_GROUP /begin FUNCTION_LIST /end FUNCTION_LIST /begin REF_CHARACTERISTIC /end REF_CHARACTERISTIC /begin REF_MEASUREMENT Polarity.AssistAssyPolarity.Cnt_s08 /end REF_MEASUREMENT /end GROUP
/begin GROUP Polarity.DiagAssistAssyPolarity.Cnt_s08 "MICROSAR RTE" /begin SUB_GROUP /end SUB_GROUP /begin FUNCTION_LIST /end FUNCTION_LIST /begin REF_CHARACTERISTIC /end REF_CHARACTERISTIC /begin REF_MEASUREMENT Polarity.DiagAssistAssyPolarity.Cnt_s08 /end REF_MEASUREMENT /end GROUP
/begin GROUP Polarity.DiagHwPosPolarity.Cnt_s08 "MICROSAR RTE" /begin SUB_GROUP /end SUB_GROUP /begin FUNCTION_LIST /end FUNCTION_LIST /begin REF_CHARACTERISTIC /end REF_CHARACTERISTIC /begin REF_MEASUREMENT Polarity.DiagHwPosPolarity.Cnt_s08 /end REF_MEASUREMENT /end GROUP
/begin GROUP Polarity.DiagHwTrqPolarity.Cnt_s08 "MICROSAR RTE" /begin SUB_GROUP /end SUB_GROUP /begin FUNCTION_LIST /end FUNCTION_LIST /begin REF_CHARACTERISTIC /end REF_CHARACTERISTIC /begin REF_MEASUREMENT Polarity.DiagHwTrqPolarity.Cnt_s08 /end REF_MEASUREMENT /end GROUP
/begin GROUP Polarity.DiagMtrElecMechPolarity.Cnt_s08 "MICROSAR RTE" /begin SUB_GROUP /end SUB_GROUP /begin FUNCTION_LIST /end FUNCTION_LIST /begin REF_CHARACTERISTIC /end REF_CHARACTERISTIC /begin REF_MEASUREMENT Polarity.DiagMtrElecMechPolarity.Cnt_s08 /end REF_MEASUREMENT /end GROUP
/begin GROUP Polarity.DiagMtrPosPolarity.Cnt_s08 "MICROSAR RTE" /begin SUB_GROUP /end SUB_GROUP /begin FUNCTION_LIST /end FUNCTION_LIST /begin REF_CHARACTERISTIC /end REF_CHARACTERISTIC /begin REF_MEASUREMENT Polarity.DiagMtrPosPolarity.Cnt_s08 /end REF_MEASUREMENT /end GROUP
/begin GROUP Polarity.DiagMtrVelPolarity.Cnt_s08 "MICROSAR RTE" /begin SUB_GROUP /end SUB_GROUP /begin FUNCTION_LIST /end FUNCTION_LIST /begin REF_CHARACTERISTIC /end REF_CHARACTERISTIC /begin REF_MEASUREMENT Polarity.DiagMtrVelPolarity.Cnt_s08 /end REF_MEASUREMENT /end GROUP
/begin GROUP Polarity.HwPosPolarity.Cnt_s08 "MICROSAR RTE" /begin SUB_GROUP /end SUB_GROUP /begin FUNCTION_LIST /end FUNCTION_LIST /begin REF_CHARACTERISTIC /end REF_CHARACTERISTIC /begin REF_MEASUREMENT Polarity.HwPosPolarity.Cnt_s08 /end REF_MEASUREMENT /end GROUP
/begin GROUP Polarity.HwTrqPolarity.Cnt_s08 "MICROSAR RTE" /begin SUB_GROUP /end SUB_GROUP /begin FUNCTION_LIST /end FUNCTION_LIST /begin REF_CHARACTERISTIC /end REF_CHARACTERISTIC /begin REF_MEASUREMENT Polarity.HwTrqPolarity.Cnt_s08 /end REF_MEASUREMENT /end GROUP
/begin GROUP Polarity.MtrElecMechPolarity.Cnt_s08 "MICROSAR RTE" /begin SUB_GROUP /end SUB_GROUP /begin FUNCTION_LIST /end FUNCTION_LIST /begin REF_CHARACTERISTIC /end REF_CHARACTERISTIC /begin REF_MEASUREMENT Polarity.MtrElecMechPolarity.Cnt_s08 /end REF_MEASUREMENT /end GROUP
/begin GROUP Polarity.MtrPosPolarity.Cnt_s08 "MICROSAR RTE" /begin SUB_GROUP /end SUB_GROUP /begin FUNCTION_LIST /end FUNCTION_LIST /begin REF_CHARACTERISTIC /end REF_CHARACTERISTIC /begin REF_MEASUREMENT Polarity.MtrPosPolarity.Cnt_s08 /end REF_MEASUREMENT /end GROUP
/begin GROUP Polarity.MtrVelPolarity.Cnt_s08 "MICROSAR RTE" /begin SUB_GROUP /end SUB_GROUP /begin FUNCTION_LIST /end FUNCTION_LIST /begin REF_CHARACTERISTIC /end REF_CHARACTERISTIC /begin REF_MEASUREMENT Polarity.MtrVelPolarity.Cnt_s08 /end REF_MEASUREMENT /end GROUP
/begin GROUP Polarity.PerInstanceMemories "MICROSAR RTE" /begin SUB_GROUP Polarity.Polarity_Cnt_Str /end SUB_GROUP /begin FUNCTION_LIST /end FUNCTION_LIST /begin REF_CHARACTERISTIC /end REF_CHARACTERISTIC /begin REF_MEASUREMENT /end REF_MEASUREMENT /end GROUP
/begin GROUP Polarity.Polarity_Cnt_Str "MICROSAR RTE" /begin SUB_GROUP /end SUB_GROUP /begin FUNCTION_LIST /end FUNCTION_LIST /begin REF_CHARACTERISTIC /end REF_CHARACTERISTIC
 /begin REF_MEASUREMENT Polarity.Polarity_Cnt_Str.Polarity_Cnt_b08 Polarity.Polarity_Cnt_Str.R_Polarity_Cnt_b08 /end REF_MEASUREMENT
/end GROUP
/begin GROUP Polarity.ReceiverPorts "MICROSAR RTE"
 /begin SUB_GROUP Polarity.DiagAssistAssyPolarity.Cnt_s08 Polarity.DiagHwPosPolarity.Cnt_s08 Polarity.DiagHwTrqPolarity.Cnt_s08 Polarity.DiagMtrElecMechPolarity.Cnt_s08 Polarity.DiagMtrPosPolarity.Cnt_s08 Polarity.DiagMtrVelPolarity.Cnt_s08 /end SUB_GROUP
 /begin FUNCTION_LIST /end FUNCTION_LIST
 /begin REF_CHARACTERISTIC /end REF_CHARACTERISTIC
 /begin REF_MEASUREMENT /end REF_MEASUREMENT
/end GROUP
/begin GROUP Polarity.SenderPorts "MICROSAR RTE"
 /begin SUB_GROUP Polarity.AssistAssyPolarity.Cnt_s08 Polarity.HwPosPolarity.Cnt_s08 Polarity.HwTrqPolarity.Cnt_s08 Polarity.MtrElecMechPolarity.Cnt_s08 Polarity.MtrPosPolarity.Cnt_s08 Polarity.MtrVelPolarity.Cnt_s08 Polarity.SysC_MtrElecMechPolarity.Cnt_s32 /end SUB_GROUP
 /begin FUNCTION_LIST /end FUNCTION_LIST
 /begin REF_CHARACTERISTIC /end REF_CHARACTERISTIC
 /begin REF_MEASUREMENT /end REF_MEASUREMENT
/end GROUP
/begin GROUP Polarity.SysC_MtrElecMechPolarity.Cnt_s32 "MICROSAR RTE" /begin SUB_GROUP /end SUB_GROUP /begin FUNCTION_LIST /end FUNCTION_LIST /begin REF_CHARACTERISTIC /end REF_CHARACTERISTIC /begin REF_MEASUREMENT Polarity.SysC_MtrElecMechPolarity.Cnt_s32 /end REF_MEASUREMENT /end GROUP
/begin GROUP QuadDet "MICROSAR RTE" /begin SUB_GROUP QuadDet.ReceiverPorts QuadDet.SenderPorts /end SUB_GROUP /begin FUNCTION_LIST /end FUNCTION_LIST /begin REF_CHARACTERISTIC /end REF_CHARACTERISTIC /begin REF_MEASUREMENT /end REF_MEASUREMENT /end GROUP
/begin GROUP QuadDet.InstMtrDir.Cnt_s08 "MICROSAR RTE" /begin SUB_GROUP /end SUB_GROUP /begin FUNCTION_LIST /end FUNCTION_LIST /begin REF_CHARACTERISTIC /end REF_CHARACTERISTIC /begin REF_MEASUREMENT QuadDet.InstMtrDir.Cnt_s08 /end REF_MEASUREMENT /end GROUP
/begin GROUP QuadDet.MRFCumMtrPos.Deg_f32 "MICROSAR RTE" /begin SUB_GROUP /end SUB_GROUP /begin FUNCTION_LIST /end FUNCTION_LIST /begin REF_CHARACTERISTIC /end REF_CHARACTERISTIC /begin REF_MEASUREMENT QuadDet.MRFCumMtrPos.Deg_f32 /end REF_MEASUREMENT /end GROUP
/begin GROUP QuadDet.MRFMtrTrqCmdScl.MtrNm_f32 "MICROSAR RTE" /begin SUB_GROUP /end SUB_GROUP /begin FUNCTION_LIST /end FUNCTION_LIST /begin REF_CHARACTERISTIC /end REF_CHARACTERISTIC /begin REF_MEASUREMENT QuadDet.MRFMtrTrqCmdScl.MtrNm_f32 /end REF_MEASUREMENT /end GROUP
/begin GROUP QuadDet.MtrQuad.Cnt_u08 "MICROSAR RTE" /begin SUB_GROUP /end SUB_GROUP /begin FUNCTION_LIST /end FUNCTION_LIST /begin REF_CHARACTERISTIC /end REF_CHARACTERISTIC /begin REF_MEASUREMENT QuadDet.MtrQuad.Cnt_u08 /end REF_MEASUREMENT /end GROUP
/begin GROUP QuadDet.ReceiverPorts "MICROSAR RTE"
 /begin SUB_GROUP QuadDet.MRFCumMtrPos.Deg_f32 QuadDet.MRFMtrTrqCmdScl.MtrNm_f32 /end SUB_GROUP
 /begin FUNCTION_LIST /end FUNCTION_LIST
 /begin REF_CHARACTERISTIC /end REF_CHARACTERISTIC
 /begin REF_MEASUREMENT /end REF_MEASUREMENT
/end GROUP
/begin GROUP QuadDet.SenderPorts "MICROSAR RTE" /begin SUB_GROUP QuadDet.InstMtrDir.Cnt_s08 QuadDet.MtrQuad.Cnt_u08 /end SUB_GROUP /begin FUNCTION_LIST /end FUNCTION_LIST /begin REF_CHARACTERISTIC /end REF_CHARACTERISTIC /begin REF_MEASUREMENT /end REF_MEASUREMENT /end GROUP
/begin GROUP RTE "MICROSAR RTE" /begin SUB_GROUP SWCs /end SUB_GROUP /begin FUNCTION_LIST /end FUNCTION_LIST /begin REF_CHARACTERISTIC /end REF_CHARACTERISTIC /begin REF_MEASUREMENT /end REF_MEASUREMENT /end GROUP
/begin GROUP Return "MICROSAR RTE" /begin SUB_GROUP Return.ReceiverPorts Return.SenderPorts /end SUB_GROUP /begin FUNCTION_LIST /end FUNCTION_LIST /begin REF_CHARACTERISTIC /end REF_CHARACTERISTIC /begin REF_MEASUREMENT /end REF_MEASUREMENT /end GROUP
/begin GROUP Return.AssistMechTempEst.DegC_f32 "MICROSAR RTE" /begin SUB_GROUP /end SUB_GROUP /begin FUNCTION_LIST /end FUNCTION_LIST /begin REF_CHARACTERISTIC /end REF_CHARACTERISTIC /begin REF_MEASUREMENT Return.AssistMechTempEst.DegC_f32 /end REF_MEASUREMENT /end GROUP
/begin GROUP Return.DefeatReturnSvc.Cnt_lgc "MICROSAR RTE" /begin SUB_GROUP /end SUB_GROUP /begin FUNCTION_LIST /end FUNCTION_LIST /begin REF_CHARACTERISTIC /end REF_CHARACTERISTIC /begin REF_MEASUREMENT Return.DefeatReturnSvc.Cnt_lgc /end REF_MEASUREMENT /end GROUP
/begin GROUP Return.DiagStsHwPosDis.Cnt_lgc "MICROSAR RTE" /begin SUB_GROUP /end SUB_GROUP /begin FUNCTION_LIST /end FUNCTION_LIST /begin REF_CHARACTERISTIC /end REF_CHARACTERISTIC /begin REF_MEASUREMENT Return.DiagStsHwPosDis.Cnt_lgc /end REF_MEASUREMENT /end GROUP
/begin GROUP Return.HandwheelAuthority.Uls_f32 "MICROSAR RTE" /begin SUB_GROUP /end SUB_GROUP /begin FUNCTION_LIST /end FUNCTION_LIST /begin REF_CHARACTERISTIC /end REF_CHARACTERISTIC /begin REF_MEASUREMENT Return.HandwheelAuthority.Uls_f32 /end REF_MEASUREMENT /end GROUP
/begin GROUP Return.HandwheelPosition.HwDeg_f32 "MICROSAR RTE" /begin SUB_GROUP /end SUB_GROUP /begin FUNCTION_LIST /end FUNCTION_LIST /begin REF_CHARACTERISTIC /end REF_CHARACTERISTIC /begin REF_MEASUREMENT Return.HandwheelPosition.HwDeg_f32 /end REF_MEASUREMENT /end GROUP
/begin GROUP Return.HandwheelVel.HwRadpS_f32 "MICROSAR RTE" /begin SUB_GROUP /end SUB_GROUP /begin FUNCTION_LIST /end FUNCTION_LIST /begin REF_CHARACTERISTIC /end REF_CHARACTERISTIC /begin REF_MEASUREMENT Return.HandwheelVel.HwRadpS_f32 /end REF_MEASUREMENT /end GROUP
/begin GROUP Return.HwTorque.HwNm_f32 "MICROSAR RTE" /begin SUB_GROUP /end SUB_GROUP /begin FUNCTION_LIST /end FUNCTION_LIST /begin REF_CHARACTERISTIC /end REF_CHARACTERISTIC /begin REF_MEASUREMENT Return.HwTorque.HwNm_f32 /end REF_MEASUREMENT /end GROUP
/begin GROUP Return.PAReturnSclFct.Uls_f32 "MICROSAR RTE" /begin SUB_GROUP /end SUB_GROUP /begin FUNCTION_LIST /end FUNCTION_LIST /begin REF_CHARACTERISTIC /end REF_CHARACTERISTIC /begin REF_MEASUREMENT Return.PAReturnSclFct.Uls_f32 /end REF_MEASUREMENT /end GROUP
/begin GROUP Return.ReceiverPorts "MICROSAR RTE"
 /begin SUB_GROUP Return.AssistMechTempEst.DegC_f32 Return.DefeatReturnSvc.Cnt_lgc Return.DiagStsHwPosDis.Cnt_lgc Return.HandwheelAuthority.Uls_f32 Return.HandwheelPosition.HwDeg_f32 Return.HandwheelVel.HwRadpS_f32 Return.HwTorque.HwNm_f32 Return.PAReturnSclFct.Uls_f32 Return.ReturnDDFactor.Uls_f32 Return.ReturnOffset.HwDeg_f32 Return.VehicleSpeed.Kph_f32 /end SUB_GROUP
 /begin FUNCTION_LIST /end FUNCTION_LIST
 /begin REF_CHARACTERISTIC /end REF_CHARACTERISTIC
 /begin REF_MEASUREMENT /end REF_MEASUREMENT
/end GROUP
/begin GROUP Return.ReturnCmd.MtrNm_f32 "MICROSAR RTE" /begin SUB_GROUP /end SUB_GROUP /begin FUNCTION_LIST /end FUNCTION_LIST /begin REF_CHARACTERISTIC /end REF_CHARACTERISTIC /begin REF_MEASUREMENT Return.ReturnCmd.MtrNm_f32 /end REF_MEASUREMENT /end GROUP
/begin GROUP Return.ReturnDDFactor.Uls_f32 "MICROSAR RTE" /begin SUB_GROUP /end SUB_GROUP /begin FUNCTION_LIST /end FUNCTION_LIST /begin REF_CHARACTERISTIC /end REF_CHARACTERISTIC /begin REF_MEASUREMENT Return.ReturnDDFactor.Uls_f32 /end REF_MEASUREMENT /end GROUP
/begin GROUP Return.ReturnOffset.HwDeg_f32 "MICROSAR RTE" /begin SUB_GROUP /end SUB_GROUP /begin FUNCTION_LIST /end FUNCTION_LIST /begin REF_CHARACTERISTIC /end REF_CHARACTERISTIC /begin REF_MEASUREMENT Return.ReturnOffset.HwDeg_f32 /end REF_MEASUREMENT /end GROUP
/begin GROUP Return.SenderPorts "MICROSAR RTE" /begin SUB_GROUP Return.ReturnCmd.MtrNm_f32 /end SUB_GROUP /begin FUNCTION_LIST /end FUNCTION_LIST /begin REF_CHARACTERISTIC /end REF_CHARACTERISTIC /begin REF_MEASUREMENT /end REF_MEASUREMENT /end GROUP
/begin GROUP Return.VehicleSpeed.Kph_f32 "MICROSAR RTE" /begin SUB_GROUP /end SUB_GROUP /begin FUNCTION_LIST /end FUNCTION_LIST /begin REF_CHARACTERISTIC /end REF_CHARACTERISTIC /begin REF_MEASUREMENT Return.VehicleSpeed.Kph_f32 /end REF_MEASUREMENT /end GROUP
/begin GROUP ReturnFirewall "MICROSAR RTE" /begin SUB_GROUP ReturnFirewall.ReceiverPorts ReturnFirewall.SenderPorts /end SUB_GROUP /begin FUNCTION_LIST /end FUNCTION_LIST /begin REF_CHARACTERISTIC /end REF_CHARACTERISTIC /begin REF_MEASUREMENT /end REF_MEASUREMENT /end GROUP
/begin GROUP ReturnFirewall.Defeat_Return_Svc.Cnt_lgc "MICROSAR RTE" /begin SUB_GROUP /end SUB_GROUP /begin FUNCTION_LIST /end FUNCTION_LIST /begin REF_CHARACTERISTIC /end REF_CHARACTERISTIC /begin REF_MEASUREMENT ReturnFirewall.Defeat_Return_Svc.Cnt_lgc /end REF_MEASUREMENT /end GROUP
/begin GROUP ReturnFirewall.HandwheelPosition.HwDeg_f32 "MICROSAR RTE" /begin SUB_GROUP /end SUB_GROUP /begin FUNCTION_LIST /end FUNCTION_LIST /begin REF_CHARACTERISTIC /end REF_CHARACTERISTIC /begin REF_MEASUREMENT ReturnFirewall.HandwheelPosition.HwDeg_f32 /end REF_MEASUREMENT /end GROUP
/begin GROUP ReturnFirewall.LimitedReturn.MtrNm_f32 "MICROSAR RTE" /begin SUB_GROUP /end SUB_GROUP /begin FUNCTION_LIST /end FUNCTION_LIST /begin REF_CHARACTERISTIC /end REF_CHARACTERISTIC /begin REF_MEASUREMENT ReturnFirewall.LimitedReturn.MtrNm_f32 /end REF_MEASUREMENT /end GROUP
/begin GROUP ReturnFirewall.MEC_Counter.Cnt_enum "MICROSAR RTE" /begin SUB_GROUP /end SUB_GROUP /begin FUNCTION_LIST /end FUNCTION_LIST /begin REF_CHARACTERISTIC /end REF_CHARACTERISTIC /begin REF_MEASUREMENT ReturnFirewall.MEC_Counter.Cnt_enum /end REF_MEASUREMENT /end GROUP
/begin GROUP ReturnFirewall.ReceiverPorts "MICROSAR RTE"
 /begin SUB_GROUP ReturnFirewall.Defeat_Return_Svc.Cnt_lgc ReturnFirewall.HandwheelPosition.HwDeg_f32 ReturnFirewall.MEC_Counter.Cnt_enum ReturnFirewall.ReturnCmd.MtrNm_f32 ReturnFirewall.VehicleSpeed.Kph_f32 /end SUB_GROUP
 /begin FUNCTION_LIST /end FUNCTION_LIST
 /begin REF_CHARACTERISTIC /end REF_CHARACTERISTIC
 /begin REF_MEASUREMENT /end REF_MEASUREMENT
/end GROUP
/begin GROUP ReturnFirewall.ReturnCmd.MtrNm_f32 "MICROSAR RTE" /begin SUB_GROUP /end SUB_GROUP /begin FUNCTION_LIST /end FUNCTION_LIST /begin REF_CHARACTERISTIC /end REF_CHARACTERISTIC /begin REF_MEASUREMENT ReturnFirewall.ReturnCmd.MtrNm_f32 /end REF_MEASUREMENT /end GROUP
/begin GROUP ReturnFirewall.SenderPorts "MICROSAR RTE" /begin SUB_GROUP ReturnFirewall.LimitedReturn.MtrNm_f32 /end SUB_GROUP /begin FUNCTION_LIST /end FUNCTION_LIST /begin REF_CHARACTERISTIC /end REF_CHARACTERISTIC /begin REF_MEASUREMENT /end REF_MEASUREMENT /end GROUP
/begin GROUP ReturnFirewall.VehicleSpeed.Kph_f32 "MICROSAR RTE" /begin SUB_GROUP /end SUB_GROUP /begin FUNCTION_LIST /end FUNCTION_LIST /begin REF_CHARACTERISTIC /end REF_CHARACTERISTIC /begin REF_MEASUREMENT ReturnFirewall.VehicleSpeed.Kph_f32 /end REF_MEASUREMENT /end GROUP
/begin GROUP RteErrata "MICROSAR RTE" /begin SUB_GROUP RteErrata.ModeRequirePorts /end SUB_GROUP /begin FUNCTION_LIST /end FUNCTION_LIST /begin REF_CHARACTERISTIC /end REF_CHARACTERISTIC /begin REF_MEASUREMENT /end REF_MEASUREMENT /end GROUP
/begin GROUP RteErrata.ModeRequirePorts "MICROSAR RTE" /begin SUB_GROUP RteErrata.SystemState.Mode /end SUB_GROUP /begin FUNCTION_LIST /end FUNCTION_LIST /begin REF_CHARACTERISTIC /end REF_CHARACTERISTIC /begin REF_MEASUREMENT /end REF_MEASUREMENT /end GROUP
/begin GROUP RteErrata.SystemState.Mode "MICROSAR RTE" /begin SUB_GROUP /end SUB_GROUP /begin FUNCTION_LIST /end FUNCTION_LIST /begin REF_CHARACTERISTIC /end REF_CHARACTERISTIC /begin REF_MEASUREMENT RteErrata.SystemState.Mode /end REF_MEASUREMENT /end GROUP
/begin GROUP RteErrata8 "MICROSAR RTE" /begin SUB_GROUP RteErrata8.ModeRequirePorts /end SUB_GROUP /begin FUNCTION_LIST /end FUNCTION_LIST /begin REF_CHARACTERISTIC /end REF_CHARACTERISTIC /begin REF_MEASUREMENT /end REF_MEASUREMENT /end GROUP
/begin GROUP RteErrata8.ModeRequirePorts "MICROSAR RTE" /begin SUB_GROUP RteErrata8.SystemState.Mode /end SUB_GROUP /begin FUNCTION_LIST /end FUNCTION_LIST /begin REF_CHARACTERISTIC /end REF_CHARACTERISTIC /begin REF_MEASUREMENT /end REF_MEASUREMENT /end GROUP
/begin GROUP RteErrata8.SystemState.Mode "MICROSAR RTE" /begin SUB_GROUP /end SUB_GROUP /begin FUNCTION_LIST /end FUNCTION_LIST /begin REF_CHARACTERISTIC /end REF_CHARACTERISTIC /begin REF_MEASUREMENT RteErrata8.SystemState.Mode /end REF_MEASUREMENT /end GROUP
/begin RECORD_LAYOUT RTE_RL_SWORD FNC_VALUES 1 SWORD ROW_DIR DIRECT /end RECORD_LAYOUT
/begin RECORD_LAYOUT RTE_RL_SLONG FNC_VALUES 1 SLONG ROW_DIR DIRECT /end RECORD_LAYOUT
/begin RECORD_LAYOUT RTE_RL_FLOAT32_IEEE FNC_VALUES 1 FLOAT32_IEEE ROW_DIR DIRECT /end RECORD_LAYOUT
/**********************************************************************************************************************
* COMPU_METHOD / COMPU_VTAB_RANGE
*********************************************************************************************************************/
/begin COMPU_METHOD RTE_CM_BOOLEAN "" TAB_VERB "%3.1" "" COMPU_TAB_REF RTE_CM_BOOLEAN /end COMPU_METHOD
/begin COMPU_VTAB_RANGE RTE_CM_BOOLEAN "" 2 0 0 "false" 1 255 "true" /end COMPU_VTAB_RANGE
/begin COMPU_METHOD RTE_CM_ENUM_ManufModeType "" TAB_VERB "%.1" "" COMPU_TAB_REF RTE_CM_ENUM_ManufModeType /end COMPU_METHOD
/begin COMPU_VTAB_RANGE RTE_CM_ENUM_ManufModeType "" 3 0 0 "ProductionMode" 1 1 "ManufacturingMode" 2 2 "EngineeringMode" /end COMPU_VTAB_RANGE
/begin COMPU_METHOD RTE_CM_ENUM_StaMd_Mode "" TAB_VERB "%.1" "" COMPU_TAB_REF RTE_CM_ENUM_StaMd_Mode /end COMPU_METHOD
/begin COMPU_VTAB_RANGE RTE_CM_ENUM_StaMd_Mode "" 5 0 0 "RTE_MODE_StaMd_Mode_DISABLE" 1 1 "RTE_MODE_StaMd_Mode_OFF" 2 2 "RTE_MODE_StaMd_Mode_OPERATE" 3 3 "RTE_MODE_StaMd_Mode_WARMINIT" 4 4 "RTE_TRANSITION_StaMd_Mode" /end COMPU_VTAB_RANGE
/begin COMPU_METHOD RTE_CM_ENUM_SysPwrMd "" TAB_VERB "%.1" "" COMPU_TAB_REF RTE_CM_ENUM_SysPwrMd /end COMPU_METHOD
/begin COMPU_VTAB_RANGE RTE_CM_ENUM_SysPwrMd "" 4 0 0 "Off" 1 1 "Accessory" 2 2 "Run" 3 3 "CrankRequest" /end COMPU_VTAB_RANGE
/begin COMPU_METHOD RTE_CM_ENUM_FETPHASETYPE_ENUM "" TAB_VERB "%.1" "" COMPU_TAB_REF RTE_CM_ENUM_FETPHASETYPE_ENUM /end COMPU_METHOD
/begin COMPU_VTAB_RANGE RTE_CM_ENUM_FETPHASETYPE_ENUM "" 4 0 0 "NOPHASE" 1 1 "PHASEA" 2 2 "PHASEB" 3 3 "PHASEC" /end COMPU_VTAB_RANGE
/begin COMPU_METHOD RTE_CM_ENUM_FETFAULTTYPE_ENUM "" TAB_VERB "%.1" "" COMPU_TAB_REF RTE_CM_ENUM_FETFAULTTYPE_ENUM /end COMPU_METHOD
/begin COMPU_VTAB_RANGE RTE_CM_ENUM_FETFAULTTYPE_ENUM "" 3 0 0 "NOFAULT" 1 1 "LOWER" 2 2 "UPPER" /end COMPU_VTAB_RANGE
