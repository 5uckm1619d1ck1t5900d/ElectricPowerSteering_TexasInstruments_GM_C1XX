/**********************************************************************************************************************
* COPYRIGHT
* Copyright (c) 2006-2011 by Vector Informatik GmbH. All rights reserved.
* This software is copyright protected and proprietary to Vector Informatik GmbH.
* Vector Informatik GmbH grants to you only those rights as set out in the license conditions.
* All other rights remain with Vector Informatik GmbH.
* FILE DESCRIPTION
* File: Rte.a2l
* Workspace: C:/02_EA3Int/BEV/wip_fz9hxm/GM_C1XX_EPS_TMS570/Tools/AsrProject/Config/DCF/EPS.dcf
* ECU-Project: EPS
* Generated at: Wed Jun 22 17:08:31 2016
* Generator: MICROSAR RTE Generator Version 2.19.1
* License: License CBD1010124 valid for CBD1010124 Nexteer Package: BMW MSR SIP BAC3.0 Micro: TI TMS570 TMS570LS30306 Compiler: Code Composer Studio 4.9.0
* Description: MICROSAR RTE A2L file
*********************************************************************************************************************/
/**********************************************************************************************************************
* MEASUREMENT
*********************************************************************************************************************/
/begin MEASUREMENT AbsHwPos.AlignedCumMechMtrPosCRF.Deg_f32 "MICROSAR RTE" FLOAT32_IEEE NO_COMPU_METHOD 0 0 1.175494351e-38 3.402823466e+38 ECU_ADDRESS 0 SYMBOL_LINK "Rte_Sa_DigMSB_AlignedCumMechMtrPosCRF_Deg_f32" 0 DISPLAY_IDENTIFIER AbsHwPos.ReceiverPorts.AlignedCumMechMtrPosCRF.Deg_f32 /end MEASUREMENT
/begin MEASUREMENT AbsHwPos.ComplError.HwDeg_f32 "MICROSAR RTE" FLOAT32_IEEE NO_COMPU_METHOD 0 0 1.175494351e-38 3.402823466e+38 ECU_ADDRESS 0 SYMBOL_LINK "Rte_ComplErr_ComplErr_HwDeg_f32" 0 DISPLAY_IDENTIFIER AbsHwPos.ReceiverPorts.ComplError.HwDeg_f32 /end MEASUREMENT
/begin MEASUREMENT AbsHwPos.CumMechMtrPosCRF.Deg_f32 "MICROSAR RTE" FLOAT32_IEEE NO_COMPU_METHOD 0 0 1.175494351e-38 3.402823466e+38 ECU_ADDRESS 0 SYMBOL_LINK "Rte_Sa_DigMSB_CumMechMtrPosCRF_Deg_f32" 0 DISPLAY_IDENTIFIER AbsHwPos.ReceiverPorts.CumMechMtrPosCRF.Deg_f32 /end MEASUREMENT
/begin MEASUREMENT AbsHwPos.DiagStatusHwPosReducedPerf.Cnt_lgc "MICROSAR RTE" UBYTE RTE_CM_BOOLEAN 0 0 0 255 ECU_ADDRESS 0 SYMBOL_LINK "Rte_DiagMgr_DiagStsHWASbSystmFltPres_Cnt_lgc" 0 DISPLAY_IDENTIFIER AbsHwPos.ReceiverPorts.DiagStatusHwPosReducedPerf.Cnt_lgc /end MEASUREMENT
/begin MEASUREMENT AbsHwPos.EOLVehCntrOffset.EOLHwPosTrimPerformed_Cnt_u16 "MICROSAR RTE" UWORD NO_COMPU_METHOD 0 0 0 65535 ECU_ADDRESS 0 SYMBOL_LINK "Rte_AbsHwPos_EOLVehCntrOffset.EOLHwPosTrimPerformed_Cnt_u16" 0 DISPLAY_IDENTIFIER AbsHwPos.PerInstanceMemories.EOLVehCntrOffset.EOLHwPosTrimPerformed_Cnt_u16 READ_WRITE /end MEASUREMENT
/begin MEASUREMENT AbsHwPos.EOLVehCntrOffset.EOLVehCntrOffset_HwDeg_f32 "MICROSAR RTE" FLOAT32_IEEE NO_COMPU_METHOD 0 0 1.175494351e-38 3.402823466e+38 ECU_ADDRESS 0 SYMBOL_LINK "Rte_AbsHwPos_EOLVehCntrOffset.EOLVehCntrOffset_HwDeg_f32" 0 DISPLAY_IDENTIFIER AbsHwPos.PerInstanceMemories.EOLVehCntrOffset.EOLVehCntrOffset_HwDeg_f32 READ_WRITE /end MEASUREMENT
/begin MEASUREMENT AbsHwPos.HandwheelAuthority.Uls_f32 "MICROSAR RTE" FLOAT32_IEEE NO_COMPU_METHOD 0 0 1.175494351e-38 3.402823466e+38 ECU_ADDRESS 0 SYMBOL_LINK "Rte_AbsHwPos_HandwheelAuthority_Uls_f32" 0 DISPLAY_IDENTIFIER AbsHwPos.SenderPorts.HandwheelAuthority.Uls_f32 /end MEASUREMENT
/begin MEASUREMENT AbsHwPos.HandwheelPosition.HwDeg_f32 "MICROSAR RTE" FLOAT32_IEEE NO_COMPU_METHOD 0 0 1.175494351e-38 3.402823466e+38 ECU_ADDRESS 0 SYMBOL_LINK "Rte_AbsHwPos_HandwheelPosition_HwDeg_f32" 0 DISPLAY_IDENTIFIER AbsHwPos.SenderPorts.HandwheelPosition.HwDeg_f32 /end MEASUREMENT
/begin MEASUREMENT AbsHwPos.HwPosSource.Cnt_u16 "MICROSAR RTE" UWORD NO_COMPU_METHOD 0 0 0 65535 ECU_ADDRESS 0 SYMBOL_LINK "Rte_AbsHwPos_HwPosSource_Cnt_u16" 0 DISPLAY_IDENTIFIER AbsHwPos.SenderPorts.HwPosSource.Cnt_u16 /end MEASUREMENT
/begin MEASUREMENT AbsHwPos.I2CHwAbsPos.HwDeg_f32 "MICROSAR RTE" FLOAT32_IEEE NO_COMPU_METHOD 0 0 1.175494351e-38 3.402823466e+38 ECU_ADDRESS 0 SYMBOL_LINK "Rte_DigColPs_I2CHwAbsPos_HwDeg_f32" 0 DISPLAY_IDENTIFIER AbsHwPos.ReceiverPorts.I2CHwAbsPos.HwDeg_f32 /end MEASUREMENT
/begin MEASUREMENT AbsHwPos.I2CHwAbsPosValid.Cnt_lgc "MICROSAR RTE" UBYTE RTE_CM_BOOLEAN 0 0 0 255 ECU_ADDRESS 0 SYMBOL_LINK "Rte_DigColPs_I2CHwAbsPosValid_Cnt_lgc" 0 DISPLAY_IDENTIFIER AbsHwPos.ReceiverPorts.I2CHwAbsPosValid.Cnt_lgc /end MEASUREMENT
/begin MEASUREMENT AbsHwPos.ManufMode.Cnt_enum "MICROSAR RTE" UBYTE RTE_CM_ENUM_ManufModeType 0 0 0 2 ECU_ADDRESS 0 SYMBOL_LINK "Rte_CDDInterface_MEC_Cnt_enum" 0 DISPLAY_IDENTIFIER AbsHwPos.ReceiverPorts.ManufMode.Cnt_enum /end MEASUREMENT
/begin MEASUREMENT AbsHwPos.RelHwPos.HwDeg_f32 "MICROSAR RTE" FLOAT32_IEEE NO_COMPU_METHOD 0 0 1.175494351e-38 3.402823466e+38 ECU_ADDRESS 0 SYMBOL_LINK "Rte_AbsHwPos_RelHwPos_HwDeg_f32" 0 DISPLAY_IDENTIFIER AbsHwPos.SenderPorts.RelHwPos.HwDeg_f32 /end MEASUREMENT
/begin MEASUREMENT AbsHwPos.SrlComHwPos.HwDeg_f32 "MICROSAR RTE" FLOAT32_IEEE NO_COMPU_METHOD 0 0 1.175494351e-38 3.402823466e+38 ECU_ADDRESS 0 SYMBOL_LINK "Rte_AbsHwPos_SrlComHwPos_HwDeg_f32" 0 DISPLAY_IDENTIFIER AbsHwPos.SenderPorts.SrlComHwPos.HwDeg_f32 /end MEASUREMENT
/begin MEASUREMENT AbsHwPos.SrlComHwPosStatus.Cnt_u16 "MICROSAR RTE" UWORD NO_COMPU_METHOD 0 0 0 65535 ECU_ADDRESS 0 SYMBOL_LINK "Rte_AbsHwPos_SrlComHwPosStatus_Cnt_u16" 0 DISPLAY_IDENTIFIER AbsHwPos.SenderPorts.SrlComHwPosStatus.Cnt_u16 /end MEASUREMENT
/begin MEASUREMENT AbsHwPos.TurnsCntrValidity.Cnt_u08 "MICROSAR RTE" UBYTE NO_COMPU_METHOD 0 0 0 255 ECU_ADDRESS 0 SYMBOL_LINK "Rte_Sa_DigMSB_AlignedCumMechMtrPosStatus_Cnt_u08" 0 DISPLAY_IDENTIFIER AbsHwPos.ReceiverPorts.TurnsCntrValidity.Cnt_u08 /end MEASUREMENT
/begin MEASUREMENT AbsHwPos.VdAuthority.Uls_f32 "MICROSAR RTE" FLOAT32_IEEE NO_COMPU_METHOD 0 0 1.175494351e-38 3.402823466e+38 ECU_ADDRESS 0 SYMBOL_LINK "Rte_VehDyn_SensorlessAuthority_Uls_f32" 0 DISPLAY_IDENTIFIER AbsHwPos.ReceiverPorts.VdAuthority.Uls_f32 /end MEASUREMENT
/begin MEASUREMENT AbsHwPos.VdHwPos.HwDeg_f32 "MICROSAR RTE" FLOAT32_IEEE NO_COMPU_METHOD 0 0 1.175494351e-38 3.402823466e+38 ECU_ADDRESS 0 SYMBOL_LINK "Rte_VehDyn_SensorlessHwPos_HwDeg_f32" 0 DISPLAY_IDENTIFIER AbsHwPos.ReceiverPorts.VdHwPos.HwDeg_f32 /end MEASUREMENT
/begin MEASUREMENT Ap_ActivePull.DisableLearning.Cnt_lgc "MICROSAR RTE" UBYTE RTE_CM_BOOLEAN 0 0 0 255 ECU_ADDRESS 0 SYMBOL_LINK "Rte_CDDInterface_PullCompLrnSrlComSvcDft_Cnt_lgc" 0 DISPLAY_IDENTIFIER Ap_ActivePull.ReceiverPorts.DisableLearning.Cnt_lgc /end MEASUREMENT
/begin MEASUREMENT Ap_ActivePull.DisableOutput.Cnt_lgc "MICROSAR RTE" UBYTE RTE_CM_BOOLEAN 0 0 0 255 ECU_ADDRESS 0 SYMBOL_LINK "Rte_CDDInterface_PullCompSrlComSvcDft_Cnt_lgc" 0 DISPLAY_IDENTIFIER Ap_ActivePull.ReceiverPorts.DisableOutput.Cnt_lgc /end MEASUREMENT
/begin MEASUREMENT Ap_ActivePull.HandwheelAuthority.Uls_f32 "MICROSAR RTE" FLOAT32_IEEE NO_COMPU_METHOD 0 0 1.175494351e-38 3.402823466e+38 ECU_ADDRESS 0 SYMBOL_LINK "Rte_AbsHwPos_HandwheelAuthority_Uls_f32" 0 DISPLAY_IDENTIFIER Ap_ActivePull.ReceiverPorts.HandwheelAuthority.Uls_f32 /end MEASUREMENT
/begin MEASUREMENT Ap_ActivePull.HandwheelPosition.HwDeg_f32 "MICROSAR RTE" FLOAT32_IEEE NO_COMPU_METHOD 0 0 1.175494351e-38 3.402823466e+38 ECU_ADDRESS 0 SYMBOL_LINK "Rte_AbsHwPos_HandwheelPosition_HwDeg_f32" 0 DISPLAY_IDENTIFIER Ap_ActivePull.ReceiverPorts.HandwheelPosition.HwDeg_f32 /end MEASUREMENT
/begin MEASUREMENT Ap_ActivePull.HandwheelVelocity.HwRadpS_f32 "MICROSAR RTE" FLOAT32_IEEE NO_COMPU_METHOD 0 0 1.175494351e-38 3.402823466e+38 ECU_ADDRESS 0 SYMBOL_LINK "Rte_Sa_MtrVel_HandwheelVel_HwRadpS_f32" 0 DISPLAY_IDENTIFIER Ap_ActivePull.ReceiverPorts.HandwheelVelocity.HwRadpS_f32 /end MEASUREMENT
/begin MEASUREMENT Ap_ActivePull.HwTorque.HwNm_f32 "MICROSAR RTE" FLOAT32_IEEE NO_COMPU_METHOD 0 0 1.175494351e-38 3.402823466e+38 ECU_ADDRESS 0 SYMBOL_LINK "Rte_Ap_Sweep_OutputHwTrq_HwNm_f32" 0 DISPLAY_IDENTIFIER Ap_ActivePull.ReceiverPorts.HwTorque.HwNm_f32 /end MEASUREMENT
/begin MEASUREMENT Ap_ActivePull.PullCompCmd.MtrNm_f32 "MICROSAR RTE" FLOAT32_IEEE NO_COMPU_METHOD 0 0 1.175494351e-38 3.402823466e+38 ECU_ADDRESS 0 SYMBOL_LINK "Rte_Ap_ActivePull_PullCompCmd_MtrNm_f32" 0 DISPLAY_IDENTIFIER Ap_ActivePull.SenderPorts.PullCompCmd.MtrNm_f32 /end MEASUREMENT
/begin MEASUREMENT Ap_ActivePull.SrlComYawRate.DegpS_f32 "MICROSAR RTE" FLOAT32_IEEE NO_COMPU_METHOD 0 0 1.175494351e-38 3.402823466e+38 ECU_ADDRESS 0 SYMBOL_LINK "Rte_SrlComInput_SrlComYawRate_DegpS_f32" 0 DISPLAY_IDENTIFIER Ap_ActivePull.ReceiverPorts.SrlComYawRate.DegpS_f32 /end MEASUREMENT
/begin MEASUREMENT Ap_ActivePull.SystemState.Mode "MICROSAR RTE" UBYTE RTE_CM_ENUM_StaMd_Mode 0 0 0 255 ECU_ADDRESS 0 SYMBOL_LINK "Rte_ModeMachine_Ap_StaMd9_SystemState9_Mode" 0 DISPLAY_IDENTIFIER Ap_ActivePull.ModeRequirePorts.SystemState.Mode /end MEASUREMENT
/begin MEASUREMENT Ap_ActivePull.VehicleSpeed.Kph_f32 "MICROSAR RTE" FLOAT32_IEEE NO_COMPU_METHOD 0 0 1.175494351e-38 3.402823466e+38 ECU_ADDRESS 0 SYMBOL_LINK "Rte_Ap_SignlCondn_VehicleSpeed_Kph_f32" 0 DISPLAY_IDENTIFIER Ap_ActivePull.ReceiverPorts.VehicleSpeed.Kph_f32 /end MEASUREMENT
/begin MEASUREMENT Ap_ActivePull.VehicleSpeedValid.Cnt_lgc "MICROSAR RTE" UBYTE RTE_CM_BOOLEAN 0 0 0 255 ECU_ADDRESS 0 SYMBOL_LINK "Rte_SrlComInput_VehicleSpeedValid_Cnt_lgc" 0 DISPLAY_IDENTIFIER Ap_ActivePull.ReceiverPorts.VehicleSpeedValid.Cnt_lgc /end MEASUREMENT
/begin MEASUREMENT Ap_AssistFirewall.AsstFirewallActive.Uls_f32 "MICROSAR RTE" FLOAT32_IEEE NO_COMPU_METHOD 0 0 1.175494351e-38 3.402823466e+38 ECU_ADDRESS 0 SYMBOL_LINK "Rte_Ap_AssistFirewall_AsstFirewallActive_Uls_f32" 0 DISPLAY_IDENTIFIER Ap_AssistFirewall.SenderPorts.AsstFirewallActive.Uls_f32 /end MEASUREMENT
/begin MEASUREMENT Ap_AssistFirewall.BaseAssistCmd.MtrNm_f32 "MICROSAR RTE" FLOAT32_IEEE NO_COMPU_METHOD 0 0 1.175494351e-38 3.402823466e+38 ECU_ADDRESS 0 SYMBOL_LINK "Rte_Assist_BaseAssistCmd_MtrNm_f32" 0 DISPLAY_IDENTIFIER Ap_AssistFirewall.ReceiverPorts.BaseAssistCmd.MtrNm_f32 /end MEASUREMENT
/begin MEASUREMENT Ap_AssistFirewall.CombinedAssist.MtrNm_f32 "MICROSAR RTE" FLOAT32_IEEE NO_COMPU_METHOD 0 0 1.175494351e-38 3.402823466e+38 ECU_ADDRESS 0 SYMBOL_LINK "Rte_Ap_AssistFirewall_CombinedAssist_MtrNm_f32" 0 DISPLAY_IDENTIFIER Ap_AssistFirewall.SenderPorts.CombinedAssist.MtrNm_f32 /end MEASUREMENT
/begin MEASUREMENT Ap_AssistFirewall.Defeat_AsstTbl_Service.Cnt_lgc "MICROSAR RTE" UBYTE RTE_CM_BOOLEAN 0 0 0 255 ECU_ADDRESS 0 SYMBOL_LINK "Rte_CDDInterface_DftAsstTbl_Cnt_lgc" 0 DISPLAY_IDENTIFIER Ap_AssistFirewall.ReceiverPorts.Defeat_AsstTbl_Service.Cnt_lgc /end MEASUREMENT
/begin MEASUREMENT Ap_AssistFirewall.HighFreqAssist.MtrNm_f32 "MICROSAR RTE" FLOAT32_IEEE NO_COMPU_METHOD 0 0 1.175494351e-38 3.402823466e+38 ECU_ADDRESS 0 SYMBOL_LINK "Rte_HighFreqAssist_HighFreqAssist_MtrNm_f32" 0 DISPLAY_IDENTIFIER Ap_AssistFirewall.ReceiverPorts.HighFreqAssist.MtrNm_f32 /end MEASUREMENT
/begin MEASUREMENT Ap_AssistFirewall.HwTorque.HwNm_f32 "MICROSAR RTE" FLOAT32_IEEE NO_COMPU_METHOD 0 0 1.175494351e-38 3.402823466e+38 ECU_ADDRESS 0 SYMBOL_LINK "Rte_Ap_Sweep_OutputHwTrq_HwNm_f32" 0 DISPLAY_IDENTIFIER Ap_AssistFirewall.ReceiverPorts.HwTorque.HwNm_f32 /end MEASUREMENT
/begin MEASUREMENT Ap_AssistFirewall.HysteresisComp.MtrNm_f32 "MICROSAR RTE" FLOAT32_IEEE NO_COMPU_METHOD 0 0 1.175494351e-38 3.402823466e+38 ECU_ADDRESS 0 SYMBOL_LINK "Rte_HystComp_HysteresisComp_MtrNm_f32" 0 DISPLAY_IDENTIFIER Ap_AssistFirewall.ReceiverPorts.HysteresisComp.MtrNm_f32 /end MEASUREMENT
/begin MEASUREMENT Ap_AssistFirewall.MEC_Counter.Cnt_enum "MICROSAR RTE" UBYTE RTE_CM_ENUM_ManufModeType 0 0 0 2 ECU_ADDRESS 0 SYMBOL_LINK "Rte_CDDInterface_MEC_Cnt_enum" 0 DISPLAY_IDENTIFIER Ap_AssistFirewall.ReceiverPorts.MEC_Counter.Cnt_enum /end MEASUREMENT
/begin MEASUREMENT Ap_AssistFirewall.VehicleSpeed.Kph_f32 "MICROSAR RTE" FLOAT32_IEEE NO_COMPU_METHOD 0 0 1.175494351e-38 3.402823466e+38 ECU_ADDRESS 0 SYMBOL_LINK "Rte_Ap_SignlCondn_VehicleSpeed_Kph_f32" 0 DISPLAY_IDENTIFIER Ap_AssistFirewall.ReceiverPorts.VehicleSpeed.Kph_f32 /end MEASUREMENT
/begin MEASUREMENT Ap_AstLmt.AssistCmd.MtrNm_f32 "MICROSAR RTE" FLOAT32_IEEE NO_COMPU_METHOD 0 0 1.175494351e-38 3.402823466e+38 ECU_ADDRESS 0 SYMBOL_LINK "Rte_StabilityComp_AssistCmd_MtrNm_f32" 0 DISPLAY_IDENTIFIER Ap_AstLmt.ReceiverPorts.AssistCmd.MtrNm_f32 /end MEASUREMENT
/begin MEASUREMENT Ap_AstLmt.AssistEOTDamping.MtrNm_f32 "MICROSAR RTE" FLOAT32_IEEE NO_COMPU_METHOD 0 0 1.175494351e-38 3.402823466e+38 ECU_ADDRESS 0 SYMBOL_LINK "Rte_Ap_EtDmpFw_EOTDampingLtd_MtrNm_f32" 0 DISPLAY_IDENTIFIER Ap_AstLmt.ReceiverPorts.AssistEOTDamping.MtrNm_f32 /end MEASUREMENT
/begin MEASUREMENT Ap_AstLmt.AssistEOTGain.Uls_f32 "MICROSAR RTE" FLOAT32_IEEE NO_COMPU_METHOD 0 0 1.175494351e-38 3.402823466e+38 ECU_ADDRESS 0 SYMBOL_LINK "Rte_Ap_LmtCod_EOTGainLtd_Uls_f32" 0 DISPLAY_IDENTIFIER Ap_AstLmt.ReceiverPorts.AssistEOTGain.Uls_f32 /end MEASUREMENT
/begin MEASUREMENT Ap_AstLmt.AssistEOTLimit.MtrNm_f32 "MICROSAR RTE" FLOAT32_IEEE NO_COMPU_METHOD 0 0 1.175494351e-38 3.402823466e+38 ECU_ADDRESS 0 SYMBOL_LINK "Rte_Ap_LmtCod_EOTLimitLtd_MtrNm_f32" 0 DISPLAY_IDENTIFIER Ap_AstLmt.ReceiverPorts.AssistEOTLimit.MtrNm_f32 /end MEASUREMENT
/begin MEASUREMENT Ap_AstLmt.AssistStallLimit.MtrNm_f32 "MICROSAR RTE" FLOAT32_IEEE NO_COMPU_METHOD 0 0 1.175494351e-38 3.402823466e+38 ECU_ADDRESS 0 SYMBOL_LINK "Rte_Ap_LmtCod_StallLimitLtd_MtrNm_f32" 0 DISPLAY_IDENTIFIER Ap_AstLmt.ReceiverPorts.AssistStallLimit.MtrNm_f32 /end MEASUREMENT
/begin MEASUREMENT Ap_AstLmt.AssistVehSpdLimit.MtrNm_f32 "MICROSAR RTE" FLOAT32_IEEE NO_COMPU_METHOD 0 0 1.175494351e-38 3.402823466e+38 ECU_ADDRESS 0 SYMBOL_LINK "Rte_Ap_LmtCod_VehSpdLimitLtd_MtrNm_f32" 0 DISPLAY_IDENTIFIER Ap_AstLmt.ReceiverPorts.AssistVehSpdLimit.MtrNm_f32 /end MEASUREMENT
/begin MEASUREMENT Ap_AstLmt.CombinedDamping.MtrNm_f32 "MICROSAR RTE" FLOAT32_IEEE NO_COMPU_METHOD 0 0 1.175494351e-38 3.402823466e+38 ECU_ADDRESS 0 SYMBOL_LINK "Rte_Ap_DampingFirewall_CombinedDamping_MtrNm_f32" 0 DISPLAY_IDENTIFIER Ap_AstLmt.ReceiverPorts.CombinedDamping.MtrNm_f32 /end MEASUREMENT
/begin MEASUREMENT Ap_AstLmt.DefeatLimitService.Cnt_lgc "MICROSAR RTE" UBYTE RTE_CM_BOOLEAN 0 0 0 255 ECU_ADDRESS 0 SYMBOL_LINK "Rte_CDDInterface_LimitSrlComSvcDft_Cnt_lgc" 0 DISPLAY_IDENTIFIER Ap_AstLmt.ReceiverPorts.DefeatLimitService.Cnt_lgc /end MEASUREMENT
/begin MEASUREMENT Ap_AstLmt.LimitPercentFiltered.Uls_f32 "MICROSAR RTE" FLOAT32_IEEE NO_COMPU_METHOD 0 0 1.175494351e-38 3.402823466e+38 ECU_ADDRESS 0 SYMBOL_LINK "Rte_Ap_AstLmt_LimitPercentFiltered_Uls_f32" 0 DISPLAY_IDENTIFIER Ap_AstLmt.SenderPorts.LimitPercentFiltered.Uls_f32 /end MEASUREMENT
/begin MEASUREMENT Ap_AstLmt.LimitedReturn.MtrNm_f32 "MICROSAR RTE" FLOAT32_IEEE NO_COMPU_METHOD 0 0 1.175494351e-38 3.402823466e+38 ECU_ADDRESS 0 SYMBOL_LINK "Rte_ReturnFirewall_LimitedReturn_MtrNm_f32" 0 DISPLAY_IDENTIFIER Ap_AstLmt.ReceiverPorts.LimitedReturn.MtrNm_f32 /end MEASUREMENT
/begin MEASUREMENT Ap_AstLmt.LrnPnCtrCCDisable.Cnt_lgc "MICROSAR RTE" UBYTE RTE_CM_BOOLEAN 0 0 0 255 ECU_ADDRESS 0 SYMBOL_LINK "Rte_Ap_AstLmt_LrnPnCtrCCDisable_Cnt_lgc" 0 DISPLAY_IDENTIFIER Ap_AstLmt.ReceiverPorts.LrnPnCtrCCDisable.Cnt_lgc /end MEASUREMENT
/begin MEASUREMENT Ap_AstLmt.LrnPnCtrEnable.Cnt_lgc "MICROSAR RTE" UBYTE RTE_CM_BOOLEAN 0 0 0 255 ECU_ADDRESS 0 SYMBOL_LINK "Rte_Ap_AstLmt_LrnPnCtrEnable_Cnt_lgc" 0 DISPLAY_IDENTIFIER Ap_AstLmt.ReceiverPorts.LrnPnCtrEnable.Cnt_lgc /end MEASUREMENT
/begin MEASUREMENT Ap_AstLmt.LrnPnCtrTCmd.MtrNm_f32 "MICROSAR RTE" FLOAT32_IEEE NO_COMPU_METHOD 0 0 1.175494351e-38 3.402823466e+38 ECU_ADDRESS 0 SYMBOL_LINK "Rte_Ap_AstLmt_LrnPnCtrTCmd_MtrNm_f32" 0 DISPLAY_IDENTIFIER Ap_AstLmt.ReceiverPorts.LrnPnCtrTCmd.MtrNm_f32 /end MEASUREMENT
/begin MEASUREMENT Ap_AstLmt.OpTrqOvr.MtrNm_f32 "MICROSAR RTE" FLOAT32_IEEE NO_COMPU_METHOD 0 0 1.175494351e-38 3.402823466e+38 ECU_ADDRESS 0 SYMBOL_LINK "Rte_Ap_TrqArblim_OpTrqOv_MtrNm_f32" 0 DISPLAY_IDENTIFIER Ap_AstLmt.ReceiverPorts.OpTrqOvr.MtrNm_f32 /end MEASUREMENT
/begin MEASUREMENT Ap_AstLmt.OutputRampMult.Uls_f32 "MICROSAR RTE" FLOAT32_IEEE NO_COMPU_METHOD 0 0 1.175494351e-38 3.402823466e+38 ECU_ADDRESS 0 SYMBOL_LINK "Rte_Ap_LmtCod_OutputRampMultLtd_Uls_f32" 0 DISPLAY_IDENTIFIER Ap_AstLmt.ReceiverPorts.OutputRampMult.Uls_f32 /end MEASUREMENT
/begin MEASUREMENT Ap_AstLmt.PosServCCDisable.Cnt_lgc "MICROSAR RTE" UBYTE RTE_CM_BOOLEAN 0 0 0 255 ECU_ADDRESS 0 SYMBOL_LINK "Rte_Ap_AstLmt_PosServCCDisable_Cnt_lgc" 0 DISPLAY_IDENTIFIER Ap_AstLmt.ReceiverPorts.PosServCCDisable.Cnt_lgc /end MEASUREMENT
/begin MEASUREMENT Ap_AstLmt.PowerLimitPerc.Uls_f32 "MICROSAR RTE" FLOAT32_IEEE NO_COMPU_METHOD 0 0 1.175494351e-38 3.402823466e+38 ECU_ADDRESS 0 SYMBOL_LINK "Rte_Ap_PwrLmtFuncCr_FltTrqLmt_Uls_f32" 0 DISPLAY_IDENTIFIER Ap_AstLmt.ReceiverPorts.PowerLimitPerc.Uls_f32 /end MEASUREMENT
/begin MEASUREMENT Ap_AstLmt.PreLimitForStall.MtrNm_f32 "MICROSAR RTE" FLOAT32_IEEE NO_COMPU_METHOD 0 0 1.175494351e-38 3.402823466e+38 ECU_ADDRESS 0 SYMBOL_LINK "Rte_Ap_AstLmt_PreLimitForStall_MtrNm_f32" 0 DISPLAY_IDENTIFIER Ap_AstLmt.SenderPorts.PreLimitForStall.MtrNm_f32 /end MEASUREMENT
/begin MEASUREMENT Ap_AstLmt.PreLimitTorque.MtrNm_f32 "MICROSAR RTE" FLOAT32_IEEE NO_COMPU_METHOD 0 0 1.175494351e-38 3.402823466e+38 ECU_ADDRESS 0 SYMBOL_LINK "Rte_Ap_AstLmt_PreLimitTorque_MtrNm_f32" 0 DISPLAY_IDENTIFIER Ap_AstLmt.SenderPorts.PreLimitTorque.MtrNm_f32 /end MEASUREMENT
/begin MEASUREMENT Ap_AstLmt.PrkAssistCmd.MtrNm_f32 "MICROSAR RTE" FLOAT32_IEEE NO_COMPU_METHOD 0 0 1.175494351e-38 3.402823466e+38 ECU_ADDRESS 0 SYMBOL_LINK "Rte_Ap_AstLmt_PrkAssistCmd_MtrNm_f32" 0 DISPLAY_IDENTIFIER Ap_AstLmt.ReceiverPorts.PrkAssistCmd.MtrNm_f32 /end MEASUREMENT
/begin MEASUREMENT Ap_AstLmt.PullCompCmd.MtrNm_f32 "MICROSAR RTE" FLOAT32_IEEE NO_COMPU_METHOD 0 0 1.175494351e-38 3.402823466e+38 ECU_ADDRESS 0 SYMBOL_LINK "Rte_Ap_ActivePull_PullCompCmd_MtrNm_f32" 0 DISPLAY_IDENTIFIER Ap_AstLmt.ReceiverPorts.PullCompCmd.MtrNm_f32 /end MEASUREMENT
/begin MEASUREMENT Ap_AstLmt.SteerAsstDefeat "MICROSAR RTE" UBYTE RTE_CM_BOOLEAN 0 0 0 255 ECU_ADDRESS 0 SYMBOL_LINK "Rte_Ap_AstLmt_SteerAsstDefeat" 0 DISPLAY_IDENTIFIER Ap_AstLmt.PerInstanceMemories.SteerAsstDefeat READ_WRITE /end MEASUREMENT
/begin MEASUREMENT Ap_AstLmt.SumLimTrqCmd.MtrNm_f32 "MICROSAR RTE" FLOAT32_IEEE NO_COMPU_METHOD 0 0 1.175494351e-38 3.402823466e+38 ECU_ADDRESS 0 SYMBOL_LINK "Rte_Ap_AstLmt_SumLimTrqCmd_MtrNm_f32" 0 DISPLAY_IDENTIFIER Ap_AstLmt.SenderPorts.SumLimTrqCmd.MtrNm_f32 /end MEASUREMENT
/begin MEASUREMENT Ap_AstLmt.TSMitCommand.MtrNm_f32 "MICROSAR RTE" FLOAT32_IEEE NO_COMPU_METHOD 0 0 1.175494351e-38 3.402823466e+38 ECU_ADDRESS 0 SYMBOL_LINK "Rte_Ap_TSMit_TSMitCommand_MtrNm_f32" 0 DISPLAY_IDENTIFIER Ap_AstLmt.ReceiverPorts.TSMitCommand.MtrNm_f32 /end MEASUREMENT
/begin MEASUREMENT Ap_AstLmt.ThermalLimit.MtrNm_f32 "MICROSAR RTE" FLOAT32_IEEE NO_COMPU_METHOD 0 0 1.175494351e-38 3.402823466e+38 ECU_ADDRESS 0 SYMBOL_LINK "Rte_Ap_LmtCod_ThermalLimitLtd_MtrNm_f32" 0 DISPLAY_IDENTIFIER Ap_AstLmt.ReceiverPorts.ThermalLimit.MtrNm_f32 /end MEASUREMENT
/begin MEASUREMENT Ap_AstLmt.ThermalLimitPerc.Uls_f32 "MICROSAR RTE" FLOAT32_IEEE NO_COMPU_METHOD 0 0 1.175494351e-38 3.402823466e+38 ECU_ADDRESS 0 SYMBOL_LINK "Rte_Ap_ThrmlDutyCycle_ThermLimitPerc_Uls_f32" 0 DISPLAY_IDENTIFIER Ap_AstLmt.ReceiverPorts.ThermalLimitPerc.Uls_f32 /end MEASUREMENT
/begin MEASUREMENT Ap_AstLmt.TrqLimitMin.MtrNm_f32 "MICROSAR RTE" FLOAT32_IEEE NO_COMPU_METHOD 0 0 1.175494351e-38 3.402823466e+38 ECU_ADDRESS 0 SYMBOL_LINK "Rte_Ap_AstLmt_TrqLimitMin_MtrNm_f32" 0 DISPLAY_IDENTIFIER Ap_AstLmt.SenderPorts.TrqLimitMin.MtrNm_f32 /end MEASUREMENT
/begin MEASUREMENT Ap_AstLmt.VehSpd.Kph_f32 "MICROSAR RTE" FLOAT32_IEEE NO_COMPU_METHOD 0 0 1.175494351e-38 3.402823466e+38 ECU_ADDRESS 0 SYMBOL_LINK "Rte_Ap_SignlCondn_VehicleSpeed_Kph_f32" 0 DISPLAY_IDENTIFIER Ap_AstLmt.ReceiverPorts.VehSpd.Kph_f32 /end MEASUREMENT
/begin MEASUREMENT Ap_AstLmt.WheelImbalanceCmd.MtrNm_f32 "MICROSAR RTE" FLOAT32_IEEE NO_COMPU_METHOD 0 0 1.175494351e-38 3.402823466e+38 ECU_ADDRESS 0 SYMBOL_LINK "Rte_Ap_WhlImbRej_WhlImbRejCmd_MtrNm_f32" 0 DISPLAY_IDENTIFIER Ap_AstLmt.ReceiverPorts.WheelImbalanceCmd.MtrNm_f32 /end MEASUREMENT
/begin MEASUREMENT Ap_AvgFricLrn.AvgFricLrnData.EOLFric_HwNm_f32 "MICROSAR RTE" FLOAT32_IEEE NO_COMPU_METHOD 0 0 1.175494351e-38 3.402823466e+38 ECU_ADDRESS 0 SYMBOL_LINK "Rte_Ap_AvgFricLrn_AvgFricLrnData.EOLFric_HwNm_f32" 0 DISPLAY_IDENTIFIER Ap_AvgFricLrn.PerInstanceMemories.AvgFricLrnData.EOLFric_HwNm_f32 READ_WRITE /end MEASUREMENT
/begin MEASUREMENT Ap_AvgFricLrn.AvgFricLrnData.EnableFricLearning_Cnt_lgc "MICROSAR RTE" UBYTE RTE_CM_BOOLEAN 0 0 0 255 ECU_ADDRESS 0 SYMBOL_LINK "Rte_Ap_AvgFricLrn_AvgFricLrnData.EnableFricLearning_Cnt_lgc" 0 DISPLAY_IDENTIFIER Ap_AvgFricLrn.PerInstanceMemories.AvgFricLrnData.EnableFricLearning_Cnt_lgc READ_WRITE /end MEASUREMENT
/begin MEASUREMENT Ap_AvgFricLrn.AvgFricLrnData.EnableFricOffsetOutput_Cnt_lgc "MICROSAR RTE" UBYTE RTE_CM_BOOLEAN 0 0 0 255 ECU_ADDRESS 0 SYMBOL_LINK "Rte_Ap_AvgFricLrn_AvgFricLrnData.EnableFricOffsetOutput_Cnt_lgc" 0 DISPLAY_IDENTIFIER Ap_AvgFricLrn.PerInstanceMemories.AvgFricLrnData.EnableFricOffsetOutput_Cnt_lgc READ_WRITE /end MEASUREMENT
/begin MEASUREMENT Ap_AvgFricLrn.AvgFricLrnData.FricOffset_HwNm_f32 "MICROSAR RTE" FLOAT32_IEEE NO_COMPU_METHOD 0 0 1.175494351e-38 3.402823466e+38 ECU_ADDRESS 0 SYMBOL_LINK "Rte_Ap_AvgFricLrn_AvgFricLrnData.FricOffset_HwNm_f32" 0 DISPLAY_IDENTIFIER Ap_AvgFricLrn.PerInstanceMemories.AvgFricLrnData.FricOffset_HwNm_f32 READ_WRITE /end MEASUREMENT
/begin MEASUREMENT Ap_AvgFricLrn.AvgFricLrnData.OpMode_Cnt_enum "MICROSAR RTE" UBYTE NO_COMPU_METHOD 0 0 0 255 ECU_ADDRESS 0 SYMBOL_LINK "Rte_Ap_AvgFricLrn_AvgFricLrnData.OpMode_Cnt_enum" 0 DISPLAY_IDENTIFIER Ap_AvgFricLrn.PerInstanceMemories.AvgFricLrnData.OpMode_Cnt_enum READ_WRITE /end MEASUREMENT
/begin MEASUREMENT Ap_AvgFricLrn.AvgFricLrnData.RangeCounter_Cnt_u16 "MICROSAR RTE" UWORD NO_COMPU_METHOD 0 0 0 65535 MATRIX_DIM 8 3 1 ECU_ADDRESS 0 SYMBOL_LINK "Rte_Ap_AvgFricLrn_AvgFricLrnData.RangeCounter_Cnt_u16" 0 DISPLAY_IDENTIFIER Ap_AvgFricLrn.PerInstanceMemories.AvgFricLrnData.RangeCounter_Cnt_u16 READ_WRITE /end MEASUREMENT
/begin MEASUREMENT Ap_AvgFricLrn.AvgFricLrnData.Theta_HwNm_f32 "MICROSAR RTE" FLOAT32_IEEE NO_COMPU_METHOD 0 0 1.175494351e-38 3.402823466e+38 MATRIX_DIM 8 4 1 ECU_ADDRESS 0 SYMBOL_LINK "Rte_Ap_AvgFricLrn_AvgFricLrnData.Theta_HwNm_f32" 0 DISPLAY_IDENTIFIER Ap_AvgFricLrn.PerInstanceMemories.AvgFricLrnData.Theta_HwNm_f32 READ_WRITE /end MEASUREMENT
/begin MEASUREMENT Ap_AvgFricLrn.AvgFricLrnData.VehLearnedFric_HwNm_f32 "MICROSAR RTE" FLOAT32_IEEE NO_COMPU_METHOD 0 0 1.175494351e-38 3.402823466e+38 MATRIX_DIM 4 1 1 ECU_ADDRESS 0 SYMBOL_LINK "Rte_Ap_AvgFricLrn_AvgFricLrnData.VehLearnedFric_HwNm_f32" 0 DISPLAY_IDENTIFIER Ap_AvgFricLrn.PerInstanceMemories.AvgFricLrnData.VehLearnedFric_HwNm_f32 READ_WRITE /end MEASUREMENT
/begin MEASUREMENT Ap_AvgFricLrn.CRFMtrTrq.MtrNm_f32 "MICROSAR RTE" FLOAT32_IEEE NO_COMPU_METHOD 0 0 1.175494351e-38 3.402823466e+38 ECU_ADDRESS 0 SYMBOL_LINK "Rte_CtrldDisShtdn_CntDisMtrTrqCmdCRF_MtrNm_f32" 0 DISPLAY_IDENTIFIER Ap_AvgFricLrn.ReceiverPorts.CRFMtrTrq.MtrNm_f32 /end MEASUREMENT
/begin MEASUREMENT Ap_AvgFricLrn.DefeatFricLearning.Cnt_lgc "MICROSAR RTE" UBYTE RTE_CM_BOOLEAN 0 0 0 255 ECU_ADDRESS 0 SYMBOL_LINK "Rte_CDDInterface_FricLrnSrlComSvcDft_Cnt_lgc" 0 DISPLAY_IDENTIFIER Ap_AvgFricLrn.ReceiverPorts.DefeatFricLearning.Cnt_lgc /end MEASUREMENT
/begin MEASUREMENT Ap_AvgFricLrn.EstFric.HwNm_f32 "MICROSAR RTE" FLOAT32_IEEE NO_COMPU_METHOD 0 0 1.175494351e-38 3.402823466e+38 ECU_ADDRESS 0 SYMBOL_LINK "Rte_Ap_AvgFricLrn_EstFric_HwNm_f32" 0 DISPLAY_IDENTIFIER Ap_AvgFricLrn.SenderPorts.EstFric.HwNm_f32 /end MEASUREMENT
/begin MEASUREMENT Ap_AvgFricLrn.FricOffset.HwNm_f32 "MICROSAR RTE" FLOAT32_IEEE NO_COMPU_METHOD 0 0 1.175494351e-38 3.402823466e+38 ECU_ADDRESS 0 SYMBOL_LINK "Rte_Ap_AvgFricLrn_FricOffset_HwNm_f32" 0 DISPLAY_IDENTIFIER Ap_AvgFricLrn.SenderPorts.FricOffset.HwNm_f32 /end MEASUREMENT
/begin MEASUREMENT Ap_AvgFricLrn.HwAng.HwDeg_f32 "MICROSAR RTE" FLOAT32_IEEE NO_COMPU_METHOD 0 0 1.175494351e-38 3.402823466e+38 ECU_ADDRESS 0 SYMBOL_LINK "Rte_AbsHwPos_HandwheelPosition_HwDeg_f32" 0 DISPLAY_IDENTIFIER Ap_AvgFricLrn.ReceiverPorts.HwAng.HwDeg_f32 /end MEASUREMENT
/begin MEASUREMENT Ap_AvgFricLrn.HwPosAuthority.Uls_f32 "MICROSAR RTE" FLOAT32_IEEE NO_COMPU_METHOD 0 0 1.175494351e-38 3.402823466e+38 ECU_ADDRESS 0 SYMBOL_LINK "Rte_AbsHwPos_HandwheelAuthority_Uls_f32" 0 DISPLAY_IDENTIFIER Ap_AvgFricLrn.ReceiverPorts.HwPosAuthority.Uls_f32 /end MEASUREMENT
/begin MEASUREMENT Ap_AvgFricLrn.HwTrq.HwNm_f32 "MICROSAR RTE" FLOAT32_IEEE NO_COMPU_METHOD 0 0 1.175494351e-38 3.402823466e+38 ECU_ADDRESS 0 SYMBOL_LINK "Rte_Ap_Sweep_OutputHwTrq_HwNm_f32" 0 DISPLAY_IDENTIFIER Ap_AvgFricLrn.ReceiverPorts.HwTrq.HwNm_f32 /end MEASUREMENT
/begin MEASUREMENT Ap_AvgFricLrn.HwVel.HwRadpS_f32 "MICROSAR RTE" FLOAT32_IEEE NO_COMPU_METHOD 0 0 1.175494351e-38 3.402823466e+38 ECU_ADDRESS 0 SYMBOL_LINK "Rte_Sa_MtrVel_HandwheelVel_HwRadpS_f32" 0 DISPLAY_IDENTIFIER Ap_AvgFricLrn.ReceiverPorts.HwVel.HwRadpS_f32 /end MEASUREMENT
/begin MEASUREMENT Ap_AvgFricLrn.LatAcc.g_f32 "MICROSAR RTE" FLOAT32_IEEE NO_COMPU_METHOD 0 0 1.175494351e-38 3.402823466e+38 ECU_ADDRESS 0 SYMBOL_LINK "Rte_SrlComInput_SrlComLatAccel_g_f32" 0 DISPLAY_IDENTIFIER Ap_AvgFricLrn.ReceiverPorts.LatAcc.g_f32 /end MEASUREMENT
/begin MEASUREMENT Ap_AvgFricLrn.SatEstFric.HwNm_f32 "MICROSAR RTE" FLOAT32_IEEE NO_COMPU_METHOD 0 0 1.175494351e-38 3.402823466e+38 ECU_ADDRESS 0 SYMBOL_LINK "Rte_Ap_AvgFricLrn_SatEstFric_HwNm_f32" 0 DISPLAY_IDENTIFIER Ap_AvgFricLrn.SenderPorts.SatEstFric.HwNm_f32 /end MEASUREMENT
/begin MEASUREMENT Ap_AvgFricLrn.SystemState.Mode "MICROSAR RTE" UBYTE RTE_CM_ENUM_StaMd_Mode 0 0 0 255 ECU_ADDRESS 0 SYMBOL_LINK "Rte_ModeMachine_Ap_StaMd9_SystemState9_Mode" 0 DISPLAY_IDENTIFIER Ap_AvgFricLrn.ModeRequirePorts.SystemState.Mode /end MEASUREMENT
/begin MEASUREMENT Ap_AvgFricLrn.Temperature.DegC_f32 "MICROSAR RTE" FLOAT32_IEEE NO_COMPU_METHOD 0 0 1.175494351e-38 3.402823466e+38 ECU_ADDRESS 0 SYMBOL_LINK "Rte_Ap_MtrTempEst_AssistMechTempEst_DegC_f32" 0 DISPLAY_IDENTIFIER Ap_AvgFricLrn.ReceiverPorts.Temperature.DegC_f32 /end MEASUREMENT
/begin MEASUREMENT Ap_AvgFricLrn.VehSpd.Kph_f32 "MICROSAR RTE" FLOAT32_IEEE NO_COMPU_METHOD 0 0 1.175494351e-38 3.402823466e+38 ECU_ADDRESS 0 SYMBOL_LINK "Rte_Ap_SignlCondn_VehicleSpeed_Kph_f32" 0 DISPLAY_IDENTIFIER Ap_AvgFricLrn.ReceiverPorts.VehSpd.Kph_f32 /end MEASUREMENT
/begin MEASUREMENT Ap_AvgFricLrn.VehicleSpeedValid.Cnt_lgc "MICROSAR RTE" UBYTE RTE_CM_BOOLEAN 0 0 0 255 ECU_ADDRESS 0 SYMBOL_LINK "Rte_SrlComInput_VehicleSpeedValid_Cnt_lgc" 0 DISPLAY_IDENTIFIER Ap_AvgFricLrn.ReceiverPorts.VehicleSpeedValid.Cnt_lgc /end MEASUREMENT
/begin MEASUREMENT Ap_BVDiag.Batt.Volt_f32 "This signal is intended to communicate any type voltage signal measured by the ecu.  This signal has a lower limit of 0 which reequires users of the signal to provide divide by 0 protection if it is used as a denominator in a calculation.  See Vecu port p" FLOAT32_IEEE NO_COMPU_METHOD 0 0 1.175494351e-38 3.402823466e+38 ECU_ADDRESS 0 SYMBOL_LINK "Rte_IoHwAbstractionUsr_Batt_Volt_f32" 0 DISPLAY_IDENTIFIER Ap_BVDiag.ReceiverPorts.Batt.Volt_f32 /end MEASUREMENT
/begin MEASUREMENT Ap_DampingFirewall.AsstFirewallActive.Uls_f32 "MICROSAR RTE" FLOAT32_IEEE NO_COMPU_METHOD 0 0 1.175494351e-38 3.402823466e+38 ECU_ADDRESS 0 SYMBOL_LINK "Rte_Ap_AssistFirewall_AsstFirewallActive_Uls_f32" 0 DISPLAY_IDENTIFIER Ap_DampingFirewall.ReceiverPorts.AsstFirewallActive.Uls_f32 /end MEASUREMENT
/begin MEASUREMENT Ap_DampingFirewall.BaseAssistCmd.MtrNm_f32 "MICROSAR RTE" FLOAT32_IEEE NO_COMPU_METHOD 0 0 1.175494351e-38 3.402823466e+38 ECU_ADDRESS 0 SYMBOL_LINK "Rte_Assist_BaseAssistCmd_MtrNm_f32" 0 DISPLAY_IDENTIFIER Ap_DampingFirewall.ReceiverPorts.BaseAssistCmd.MtrNm_f32 /end MEASUREMENT
/begin MEASUREMENT Ap_DampingFirewall.CombinedDamping.MtrNm_f32 "MICROSAR RTE" FLOAT32_IEEE NO_COMPU_METHOD 0 0 1.175494351e-38 3.402823466e+38 ECU_ADDRESS 0 SYMBOL_LINK "Rte_Ap_DampingFirewall_CombinedDamping_MtrNm_f32" 0 DISPLAY_IDENTIFIER Ap_DampingFirewall.SenderPorts.CombinedDamping.MtrNm_f32 /end MEASUREMENT
/begin MEASUREMENT Ap_DampingFirewall.DampingCmd.MtrNm_f32 "MICROSAR RTE" FLOAT32_IEEE NO_COMPU_METHOD 0 0 1.175494351e-38 3.402823466e+38 ECU_ADDRESS 0 SYMBOL_LINK "Rte_Damping_DampingCmd_MtrNm_f32" 0 DISPLAY_IDENTIFIER Ap_DampingFirewall.ReceiverPorts.DampingCmd.MtrNm_f32 /end MEASUREMENT
/begin MEASUREMENT Ap_DampingFirewall.Defeat_Damping_Svc.Cnt_lgc "MICROSAR RTE" UBYTE RTE_CM_BOOLEAN 0 0 0 255 ECU_ADDRESS 0 SYMBOL_LINK "Rte_CDDInterface_DampingSrlComSvcDft_Cnt_lgc" 0 DISPLAY_IDENTIFIER Ap_DampingFirewall.ReceiverPorts.Defeat_Damping_Svc.Cnt_lgc /end MEASUREMENT
/begin MEASUREMENT Ap_DampingFirewall.FreqDepDmpSrlComSvcDft.Cnt_lgc "MICROSAR RTE" UBYTE RTE_CM_BOOLEAN 0 0 0 255 ECU_ADDRESS 0 SYMBOL_LINK "Rte_CDDInterface_FreqDepDmpSrlComSvcDft_Cnt_lgc" 0 DISPLAY_IDENTIFIER Ap_DampingFirewall.ReceiverPorts.FreqDepDmpSrlComSvcDft.Cnt_lgc /end MEASUREMENT
/begin MEASUREMENT Ap_DampingFirewall.HwTorque.HwNm_f32 "MICROSAR RTE" FLOAT32_IEEE NO_COMPU_METHOD 0 0 1.175494351e-38 3.402823466e+38 ECU_ADDRESS 0 SYMBOL_LINK "Rte_Ap_Sweep_OutputHwTrq_HwNm_f32" 0 DISPLAY_IDENTIFIER Ap_DampingFirewall.ReceiverPorts.HwTorque.HwNm_f32 /end MEASUREMENT
/begin MEASUREMENT Ap_DampingFirewall.InertiaComp.MtrNm_f32 "MICROSAR RTE" FLOAT32_IEEE NO_COMPU_METHOD 0 0 1.175494351e-38 3.402823466e+38 ECU_ADDRESS 0 SYMBOL_LINK "Rte_FrqDepDmpnInrtCmp_FrqDepDmpnInrtCmp_MtrNm_f32" 0 DISPLAY_IDENTIFIER Ap_DampingFirewall.ReceiverPorts.InertiaComp.MtrNm_f32 /end MEASUREMENT
/begin MEASUREMENT Ap_DampingFirewall.MEC_Counter.Cnt_enum "MICROSAR RTE" UBYTE RTE_CM_ENUM_ManufModeType 0 0 0 2 ECU_ADDRESS 0 SYMBOL_LINK "Rte_CDDInterface_MEC_Cnt_enum" 0 DISPLAY_IDENTIFIER Ap_DampingFirewall.ReceiverPorts.MEC_Counter.Cnt_enum /end MEASUREMENT
/begin MEASUREMENT Ap_DampingFirewall.MtrVelCRF.MtrRadpS_f32 "MICROSAR RTE" FLOAT32_IEEE NO_COMPU_METHOD 0 0 1.175494351e-38 3.402823466e+38 ECU_ADDRESS 0 SYMBOL_LINK "Rte_Sa_MtrVel_MotorVelCRF_MtrRadpS_f32" 0 DISPLAY_IDENTIFIER Ap_DampingFirewall.ReceiverPorts.MtrVelCRF.MtrRadpS_f32 /end MEASUREMENT
/begin MEASUREMENT Ap_DampingFirewall.SystemState.Mode "MICROSAR RTE" UBYTE RTE_CM_ENUM_StaMd_Mode 0 0 0 255 ECU_ADDRESS 0 SYMBOL_LINK "Rte_ModeMachine_StaMd_SystemState_Mode" 0 DISPLAY_IDENTIFIER Ap_DampingFirewall.ModeRequirePorts.SystemState.Mode /end MEASUREMENT
/begin MEASUREMENT Ap_DampingFirewall.VehicleLonAccel.KphpS_f32 "MICROSAR RTE" FLOAT32_IEEE NO_COMPU_METHOD 0 0 1.175494351e-38 3.402823466e+38 ECU_ADDRESS 0 SYMBOL_LINK "Rte_Ap_SignlCondn_Vehicle_LonAccel_KphpS_f32" 0 DISPLAY_IDENTIFIER Ap_DampingFirewall.ReceiverPorts.VehicleLonAccel.KphpS_f32 /end MEASUREMENT
/begin MEASUREMENT Ap_DampingFirewall.VehicleSpeed.Kph_f32 "MICROSAR RTE" FLOAT32_IEEE NO_COMPU_METHOD 0 0 1.175494351e-38 3.402823466e+38 ECU_ADDRESS 0 SYMBOL_LINK "Rte_Ap_SignlCondn_VehicleSpeed_Kph_f32" 0 DISPLAY_IDENTIFIER Ap_DampingFirewall.ReceiverPorts.VehicleSpeed.Kph_f32 /end MEASUREMENT
/begin MEASUREMENT Ap_DampingFirewall.WIRCmdAmpBlnd.MtrNm_f32 "MICROSAR RTE" FLOAT32_IEEE NO_COMPU_METHOD 0 0 1.175494351e-38 3.402823466e+38 ECU_ADDRESS 0 SYMBOL_LINK "Rte_Ap_WhlImbRej_WIRCmdAmpBlnd_MtrNm_f32" 0 DISPLAY_IDENTIFIER Ap_DampingFirewall.ReceiverPorts.WIRCmdAmpBlnd.MtrNm_f32 /end MEASUREMENT
/begin MEASUREMENT Ap_DiagMgr8.HwTrq.HwNm_f32 "MICROSAR RTE" FLOAT32_IEEE NO_COMPU_METHOD 0 0 1.175494351e-38 3.402823466e+38 ECU_ADDRESS 0 SYMBOL_LINK "Rte_Ap_Sweep_OutputHwTrq_HwNm_f32" 0 DISPLAY_IDENTIFIER Ap_DiagMgr8.ReceiverPorts.HwTrq.HwNm_f32 /end MEASUREMENT
/begin MEASUREMENT Ap_DiagMgr8.IgnCnt.Cnt_u16 "MICROSAR RTE" UWORD NO_COMPU_METHOD 0 0 0 65535 ECU_ADDRESS 0 SYMBOL_LINK "Rte_CDDInterface_IgnCnt_Cnt_u16" 0 DISPLAY_IDENTIFIER Ap_DiagMgr8.ReceiverPorts.IgnCnt.Cnt_u16 /end MEASUREMENT
/begin MEASUREMENT Ap_DiagMgr8.MEC.Cnt_enum "MICROSAR RTE" UBYTE RTE_CM_ENUM_ManufModeType 0 0 0 2 ECU_ADDRESS 0 SYMBOL_LINK "Rte_CDDInterface_MEC_Cnt_enum" 0 DISPLAY_IDENTIFIER Ap_DiagMgr8.ReceiverPorts.MEC.Cnt_enum /end MEASUREMENT
/begin MEASUREMENT Ap_DiagMgr8.MfgDiagInhibit.Cnt_lgc "MICROSAR RTE" UBYTE RTE_CM_BOOLEAN 0 0 0 255 ECU_ADDRESS 0 SYMBOL_LINK "Rte_CDDInterface_MfgDiagInhibit_Cnt_lgc" 0 DISPLAY_IDENTIFIER Ap_DiagMgr8.ReceiverPorts.MfgDiagInhibit.Cnt_lgc /end MEASUREMENT
/begin MEASUREMENT Ap_DiagMgr8.MtrTrq.MtrNm_f32 "MICROSAR RTE" FLOAT32_IEEE NO_COMPU_METHOD 0 0 1.175494351e-38 3.402823466e+38 ECU_ADDRESS 0 SYMBOL_LINK "Rte_Ap_PwrLmtFuncCr_MRFMtrTrqCmd_MtrNm_f32" 0 DISPLAY_IDENTIFIER Ap_DiagMgr8.ReceiverPorts.MtrTrq.MtrNm_f32 /end MEASUREMENT
/begin MEASUREMENT Ap_DiagMgr8.SystemState.Mode "MICROSAR RTE" UBYTE RTE_CM_ENUM_StaMd_Mode 0 0 0 255 ECU_ADDRESS 0 SYMBOL_LINK "Rte_ModeMachine_Ap_StaMd8_SystemState8_Mode" 0 DISPLAY_IDENTIFIER Ap_DiagMgr8.ModeRequirePorts.SystemState.Mode /end MEASUREMENT
/begin MEASUREMENT Ap_DiagMgr8.VehSpd.Kph_f32 "MICROSAR RTE" FLOAT32_IEEE NO_COMPU_METHOD 0 0 1.175494351e-38 3.402823466e+38 ECU_ADDRESS 0 SYMBOL_LINK "Rte_Ap_SignlCondn_VehicleSpeed_Kph_f32" 0 DISPLAY_IDENTIFIER Ap_DiagMgr8.ReceiverPorts.VehSpd.Kph_f32 /end MEASUREMENT
/begin MEASUREMENT Ap_DiagMgr9.HwTrq.HwNm_f32 "MICROSAR RTE" FLOAT32_IEEE NO_COMPU_METHOD 0 0 1.175494351e-38 3.402823466e+38 ECU_ADDRESS 0 SYMBOL_LINK "Rte_Ap_Sweep_OutputHwTrq_HwNm_f32" 0 DISPLAY_IDENTIFIER Ap_DiagMgr9.ReceiverPorts.HwTrq.HwNm_f32 /end MEASUREMENT
/begin MEASUREMENT Ap_DiagMgr9.IgnCnt.Cnt_u16 "MICROSAR RTE" UWORD NO_COMPU_METHOD 0 0 0 65535 ECU_ADDRESS 0 SYMBOL_LINK "Rte_CDDInterface_IgnCnt_Cnt_u16" 0 DISPLAY_IDENTIFIER Ap_DiagMgr9.ReceiverPorts.IgnCnt.Cnt_u16 /end MEASUREMENT
/begin MEASUREMENT Ap_DiagMgr9.MEC.Cnt_enum "MICROSAR RTE" UBYTE RTE_CM_ENUM_ManufModeType 0 0 0 2 ECU_ADDRESS 0 SYMBOL_LINK "Rte_CDDInterface_MEC_Cnt_enum" 0 DISPLAY_IDENTIFIER Ap_DiagMgr9.ReceiverPorts.MEC.Cnt_enum /end MEASUREMENT
/begin MEASUREMENT Ap_DiagMgr9.MfgDiagInhibit.Cnt_lgc "MICROSAR RTE" UBYTE RTE_CM_BOOLEAN 0 0 0 255 ECU_ADDRESS 0 SYMBOL_LINK "Rte_CDDInterface_MfgDiagInhibit_Cnt_lgc" 0 DISPLAY_IDENTIFIER Ap_DiagMgr9.ReceiverPorts.MfgDiagInhibit.Cnt_lgc /end MEASUREMENT
/begin MEASUREMENT Ap_DiagMgr9.MtrTrq.MtrNm_f32 "MICROSAR RTE" FLOAT32_IEEE NO_COMPU_METHOD 0 0 1.175494351e-38 3.402823466e+38 ECU_ADDRESS 0 SYMBOL_LINK "Rte_Ap_PwrLmtFuncCr_MRFMtrTrqCmd_MtrNm_f32" 0 DISPLAY_IDENTIFIER Ap_DiagMgr9.ReceiverPorts.MtrTrq.MtrNm_f32 /end MEASUREMENT
/begin MEASUREMENT Ap_DiagMgr9.SystemState.Mode "MICROSAR RTE" UBYTE RTE_CM_ENUM_StaMd_Mode 0 0 0 255 ECU_ADDRESS 0 SYMBOL_LINK "Rte_ModeMachine_Ap_StaMd9_SystemState9_Mode" 0 DISPLAY_IDENTIFIER Ap_DiagMgr9.ModeRequirePorts.SystemState.Mode /end MEASUREMENT
/begin MEASUREMENT Ap_DiagMgr9.VehSpd.Kph_f32 "MICROSAR RTE" FLOAT32_IEEE NO_COMPU_METHOD 0 0 1.175494351e-38 3.402823466e+38 ECU_ADDRESS 0 SYMBOL_LINK "Rte_Ap_SignlCondn_VehicleSpeed_Kph_f32" 0 DISPLAY_IDENTIFIER Ap_DiagMgr9.ReceiverPorts.VehSpd.Kph_f32 /end MEASUREMENT
/begin MEASUREMENT Ap_EtDmpFw.AssistEOTDamping.MtrNm_f32 "MICROSAR RTE" FLOAT32_IEEE NO_COMPU_METHOD 0 0 1.175494351e-38 3.402823466e+38 ECU_ADDRESS 0 SYMBOL_LINK "Rte_EOTActuatorMng_AssistEOTDamping_MtrNm_f32" 0 DISPLAY_IDENTIFIER Ap_EtDmpFw.ReceiverPorts.AssistEOTDamping.MtrNm_f32 /end MEASUREMENT
/begin MEASUREMENT Ap_EtDmpFw.CRFMtrVel.MtrRadpS_f32 "MICROSAR RTE" FLOAT32_IEEE NO_COMPU_METHOD 0 0 1.175494351e-38 3.402823466e+38 ECU_ADDRESS 0 SYMBOL_LINK "Rte_Sa_MtrVel_MotorVelCRF_MtrRadpS_f32" 0 DISPLAY_IDENTIFIER Ap_EtDmpFw.ReceiverPorts.CRFMtrVel.MtrRadpS_f32 /end MEASUREMENT
/begin MEASUREMENT Ap_EtDmpFw.EOTDampingLtd.MtrNm_f32 "MICROSAR RTE" FLOAT32_IEEE NO_COMPU_METHOD 0 0 1.175494351e-38 3.402823466e+38 ECU_ADDRESS 0 SYMBOL_LINK "Rte_Ap_EtDmpFw_EOTDampingLtd_MtrNm_f32" 0 DISPLAY_IDENTIFIER Ap_EtDmpFw.SenderPorts.EOTDampingLtd.MtrNm_f32 /end MEASUREMENT
/begin MEASUREMENT Ap_EtDmpFw.EOTDisable.Cnt_lgc "MICROSAR RTE" UBYTE RTE_CM_BOOLEAN 0 0 0 255 ECU_ADDRESS 0 SYMBOL_LINK "Rte_CDDInterface_EOTImpactSrlComSvcDft_Cnt_lgc" 0 DISPLAY_IDENTIFIER Ap_EtDmpFw.ReceiverPorts.EOTDisable.Cnt_lgc /end MEASUREMENT
/begin MEASUREMENT Ap_EtDmpFw.HandwheelAuthority.Uls_f32 "MICROSAR RTE" FLOAT32_IEEE NO_COMPU_METHOD 0 0 1.175494351e-38 3.402823466e+38 ECU_ADDRESS 0 SYMBOL_LINK "Rte_AbsHwPos_HandwheelAuthority_Uls_f32" 0 DISPLAY_IDENTIFIER Ap_EtDmpFw.ReceiverPorts.HandwheelAuthority.Uls_f32 /end MEASUREMENT
/begin MEASUREMENT Ap_EtDmpFw.HandwheelPosition.HwDeg_f32 "MICROSAR RTE" FLOAT32_IEEE NO_COMPU_METHOD 0 0 1.175494351e-38 3.402823466e+38 ECU_ADDRESS 0 SYMBOL_LINK "Rte_AbsHwPos_HandwheelPosition_HwDeg_f32" 0 DISPLAY_IDENTIFIER Ap_EtDmpFw.ReceiverPorts.HandwheelPosition.HwDeg_f32 /end MEASUREMENT
/begin MEASUREMENT Ap_EtDmpFw.MEC_Counter.Cnt_enum "MICROSAR RTE" UBYTE RTE_CM_ENUM_ManufModeType 0 0 0 2 ECU_ADDRESS 0 SYMBOL_LINK "Rte_CDDInterface_MEC_Cnt_enum" 0 DISPLAY_IDENTIFIER Ap_EtDmpFw.ReceiverPorts.MEC_Counter.Cnt_enum /end MEASUREMENT
/begin MEASUREMENT Ap_EtDmpFw.Vehicle_Speed.Kph_f32 "MICROSAR RTE" FLOAT32_IEEE NO_COMPU_METHOD 0 0 1.175494351e-38 3.402823466e+38 ECU_ADDRESS 0 SYMBOL_LINK "Rte_Ap_SignlCondn_VehicleSpeed_Kph_f32" 0 DISPLAY_IDENTIFIER Ap_EtDmpFw.ReceiverPorts.Vehicle_Speed.Kph_f32 /end MEASUREMENT
/begin MEASUREMENT Ap_GCCDiag.DftGrossCCDiag.Cnt_lgc "MICROSAR RTE" UBYTE RTE_CM_BOOLEAN 0 0 0 255 ECU_ADDRESS 0 SYMBOL_LINK "Rte_Ap_GCCDiag_DftGrossCCDiag_Cnt_lgc" 0 DISPLAY_IDENTIFIER Ap_GCCDiag.ReceiverPorts.DftGrossCCDiag.Cnt_lgc /end MEASUREMENT
/begin MEASUREMENT Ap_GCCDiag.HwTorque.HwNm_f32 "MICROSAR RTE" FLOAT32_IEEE NO_COMPU_METHOD 0 0 1.175494351e-38 3.402823466e+38 ECU_ADDRESS 0 SYMBOL_LINK "Rte_Ap_Sweep_OutputHwTrq_HwNm_f32" 0 DISPLAY_IDENTIFIER Ap_GCCDiag.ReceiverPorts.HwTorque.HwNm_f32 /end MEASUREMENT
/begin MEASUREMENT Ap_GCCDiag.MRFMtrTrqCmdScl.MtrNm_f32 "MICROSAR RTE" FLOAT32_IEEE NO_COMPU_METHOD 0 0 1.175494351e-38 3.402823466e+38 ECU_ADDRESS 0 SYMBOL_LINK "Rte_TrqCmdScl_MRFMtrTrqCmdScl_MtrNm_f32" 0 DISPLAY_IDENTIFIER Ap_GCCDiag.ReceiverPorts.MRFMtrTrqCmdScl.MtrNm_f32 /end MEASUREMENT
/begin MEASUREMENT Ap_GCCDiag.VehicleSpeed.Kph_f32 "MICROSAR RTE" FLOAT32_IEEE NO_COMPU_METHOD 0 0 1.175494351e-38 3.402823466e+38 ECU_ADDRESS 0 SYMBOL_LINK "Rte_Ap_SignlCondn_VehicleSpeed_Kph_f32" 0 DISPLAY_IDENTIFIER Ap_GCCDiag.ReceiverPorts.VehicleSpeed.Kph_f32 /end MEASUREMENT
/begin MEASUREMENT Ap_GMStrtStop.APAState.State_enum "MICROSAR RTE" UBYTE RTE_CM_ENUM_APA_State_enum 0 0 0 4 ECU_ADDRESS 0 SYMBOL_LINK "Rte_TrqOvlSta_APAState_State_enum" 0 DISPLAY_IDENTIFIER Ap_GMStrtStop.ReceiverPorts.APAState.State_enum /end MEASUREMENT
/begin MEASUREMENT Ap_GMStrtStop.EngSpd.Rpm_f32 "MICROSAR RTE" FLOAT32_IEEE NO_COMPU_METHOD 0 0 1.175494351e-38 3.402823466e+38 ECU_ADDRESS 0 SYMBOL_LINK "Rte_SrlComInput_SrlComEngineSpeed_Rpm_f32" 0 DISPLAY_IDENTIFIER Ap_GMStrtStop.ReceiverPorts.EngSpd.Rpm_f32 /end MEASUREMENT
/begin MEASUREMENT Ap_GMStrtStop.HandwheelVelocity.HwRadpS_f32 "MICROSAR RTE" FLOAT32_IEEE NO_COMPU_METHOD 0 0 1.175494351e-38 3.402823466e+38 ECU_ADDRESS 0 SYMBOL_LINK "Rte_Sa_MtrVel_HandwheelVel_HwRadpS_f32" 0 DISPLAY_IDENTIFIER Ap_GMStrtStop.ReceiverPorts.HandwheelVelocity.HwRadpS_f32 /end MEASUREMENT
/begin MEASUREMENT Ap_GMStrtStop.HwTorque.HwNm_f32 "MICROSAR RTE" FLOAT32_IEEE NO_COMPU_METHOD 0 0 1.175494351e-38 3.402823466e+38 ECU_ADDRESS 0 SYMBOL_LINK "Rte_Ap_Sweep_OutputHwTrq_HwNm_f32" 0 DISPLAY_IDENTIFIER Ap_GMStrtStop.ReceiverPorts.HwTorque.HwNm_f32 /end MEASUREMENT
/begin MEASUREMENT Ap_GMStrtStop.SS12VFault.Cnt_lgc "MICROSAR RTE" UBYTE RTE_CM_BOOLEAN 0 0 0 255 ECU_ADDRESS 0 SYMBOL_LINK "Rte_SrlComInput_StrtStopFaultActive_Cnt_lgc" 0 DISPLAY_IDENTIFIER Ap_GMStrtStop.ReceiverPorts.SS12VFault.Cnt_lgc /end MEASUREMENT
/begin MEASUREMENT Ap_GMStrtStop.SSScale.Uls_f32 "MICROSAR RTE" FLOAT32_IEEE NO_COMPU_METHOD 0 0 1.175494351e-38 3.402823466e+38 ECU_ADDRESS 0 SYMBOL_LINK "Rte_Ap_GMStrtStop_SSScale_Uls_f32" 0 DISPLAY_IDENTIFIER Ap_GMStrtStop.SenderPorts.SSScale.Uls_f32 /end MEASUREMENT
/begin MEASUREMENT Ap_GMStrtStop.SSSlew.UlspS_f32 "MICROSAR RTE" FLOAT32_IEEE NO_COMPU_METHOD 0 0 1.175494351e-38 3.402823466e+38 ECU_ADDRESS 0 SYMBOL_LINK "Rte_Ap_GMStrtStop_SSSlew_UlspS_f32" 0 DISPLAY_IDENTIFIER Ap_GMStrtStop.SenderPorts.SSSlew.UlspS_f32 /end MEASUREMENT
/begin MEASUREMENT Ap_GMStrtStop.SSState.State_enum "MICROSAR RTE" UBYTE RTE_CM_ENUM_SS_State_enum 0 0 0 5 ECU_ADDRESS 0 SYMBOL_LINK "Rte_Ap_GMStrtStop_SSState_State_enum" 0 DISPLAY_IDENTIFIER Ap_GMStrtStop.SenderPorts.SSState.State_enum /end MEASUREMENT
/begin MEASUREMENT Ap_GMStrtStop.SystemState.Mode "MICROSAR RTE" UBYTE RTE_CM_ENUM_StaMd_Mode 0 0 0 255 ECU_ADDRESS 0 SYMBOL_LINK "Rte_ModeMachine_StaMd_SystemState_Mode" 0 DISPLAY_IDENTIFIER Ap_GMStrtStop.ModeRequirePorts.SystemState.Mode /end MEASUREMENT
/begin MEASUREMENT Ap_GMStrtStop.VehicleSpeed.Kph_f32 "MICROSAR RTE" FLOAT32_IEEE NO_COMPU_METHOD 0 0 1.175494351e-38 3.402823466e+38 ECU_ADDRESS 0 SYMBOL_LINK "Rte_Ap_SignlCondn_VehicleSpeed_Kph_f32" 0 DISPLAY_IDENTIFIER Ap_GMStrtStop.ReceiverPorts.VehicleSpeed.Kph_f32 /end MEASUREMENT
/begin MEASUREMENT Ap_GenPosTraj.HwPosition.HwDeg_f32 "MICROSAR RTE" FLOAT32_IEEE NO_COMPU_METHOD 0 0 1.175494351e-38 3.402823466e+38 ECU_ADDRESS 0 SYMBOL_LINK "Rte_AbsHwPos_HandwheelPosition_HwDeg_f32" 0 DISPLAY_IDENTIFIER Ap_GenPosTraj.ReceiverPorts.HwPosition.HwDeg_f32 /end MEASUREMENT
/begin MEASUREMENT Ap_GenPosTraj.PosTrajEnable.Cnt_lgc "MICROSAR RTE" UBYTE RTE_CM_BOOLEAN 0 0 0 255 ECU_ADDRESS 0 SYMBOL_LINK "Rte_CDDInterface_PosTrajEnable_Cnt_lgc" 0 DISPLAY_IDENTIFIER Ap_GenPosTraj.ReceiverPorts.PosTrajEnable.Cnt_lgc /end MEASUREMENT
/begin MEASUREMENT Ap_GenPosTraj.PosTrajHwAngle.HwDeg_f32 "MICROSAR RTE" FLOAT32_IEEE NO_COMPU_METHOD 0 0 1.175494351e-38 3.402823466e+38 ECU_ADDRESS 0 SYMBOL_LINK "Rte_Ap_GenPosTraj_PosTrajHwAngle_HwDeg_f32" 0 DISPLAY_IDENTIFIER Ap_GenPosTraj.SenderPorts.PosTrajHwAngle.HwDeg_f32 /end MEASUREMENT
/begin MEASUREMENT Ap_HOWDetect.HOWEstimate.Uls_f32 "MICROSAR RTE" FLOAT32_IEEE NO_COMPU_METHOD 0 0 1.175494351e-38 3.402823466e+38 ECU_ADDRESS 0 SYMBOL_LINK "Rte_Ap_HOWDetect_HOWEstimate_Uls_f32" 0 DISPLAY_IDENTIFIER Ap_HOWDetect.SenderPorts.HOWEstimate.Uls_f32 /end MEASUREMENT
/begin MEASUREMENT Ap_HOWDetect.HOWState.Cnt_s08 "MICROSAR RTE" SBYTE NO_COMPU_METHOD 0 0 -128 127 ECU_ADDRESS 0 SYMBOL_LINK "Rte_Ap_HOWDetect_HOWState_Cnt_s08" 0 DISPLAY_IDENTIFIER Ap_HOWDetect.SenderPorts.HOWState.Cnt_s08 /end MEASUREMENT
/begin MEASUREMENT Ap_HOWDetect.HwTrq.HwNm_f32 "MICROSAR RTE" FLOAT32_IEEE NO_COMPU_METHOD 0 0 1.175494351e-38 3.402823466e+38 ECU_ADDRESS 0 SYMBOL_LINK "Rte_Ap_Sweep_OutputHwTrq_HwNm_f32" 0 DISPLAY_IDENTIFIER Ap_HOWDetect.ReceiverPorts.HwTrq.HwNm_f32 /end MEASUREMENT
/begin MEASUREMENT Ap_HOWDetect.VehSpd.Kph_f32 "MICROSAR RTE" FLOAT32_IEEE NO_COMPU_METHOD 0 0 1.175494351e-38 3.402823466e+38 ECU_ADDRESS 0 SYMBOL_LINK "Rte_Ap_SignlCondn_VehicleSpeed_Kph_f32" 0 DISPLAY_IDENTIFIER Ap_HOWDetect.ReceiverPorts.VehSpd.Kph_f32 /end MEASUREMENT
/begin MEASUREMENT Ap_HwPwUp.MtrDrvrInitComplete.Cnt_lgc "MICROSAR RTE" UBYTE RTE_CM_BOOLEAN 0 0 0 255 ECU_ADDRESS 0 SYMBOL_LINK "Rte_MtrDrvDiag_MtrDrvrInitComplete_Cnt_lgc" 0 DISPLAY_IDENTIFIER Ap_HwPwUp.ReceiverPorts.MtrDrvrInitComplete.Cnt_lgc /end MEASUREMENT
/begin MEASUREMENT Ap_HwPwUp.MtrDrvrInitStart.Cnt_lgc "MICROSAR RTE" UBYTE RTE_CM_BOOLEAN 0 0 0 255 ECU_ADDRESS 0 SYMBOL_LINK "Rte_Ap_HwPwUp_MtrDrvrInitStart_Cnt_lgc" 0 DISPLAY_IDENTIFIER Ap_HwPwUp.SenderPorts.MtrDrvrInitStart.Cnt_lgc /end MEASUREMENT
/begin MEASUREMENT Ap_HwPwUp.PwrDiscATestComplete.Cnt_lgc "MICROSAR RTE" UBYTE RTE_CM_BOOLEAN 0 0 0 255 ECU_ADDRESS 0 SYMBOL_LINK "Rte_BkCpPc_PwrDiscATestComplete_Cnt_lgc" 0 DISPLAY_IDENTIFIER Ap_HwPwUp.ReceiverPorts.PwrDiscATestComplete.Cnt_lgc /end MEASUREMENT
/begin MEASUREMENT Ap_HwPwUp.PwrDiscATestStart.Cnt_lgc "MICROSAR RTE" UBYTE RTE_CM_BOOLEAN 0 0 0 255 ECU_ADDRESS 0 SYMBOL_LINK "Rte_Ap_HwPwUp_PwrDiscATestStart_Cnt_lgc" 0 DISPLAY_IDENTIFIER Ap_HwPwUp.SenderPorts.PwrDiscATestStart.Cnt_lgc /end MEASUREMENT
/begin MEASUREMENT Ap_HwPwUp.PwrDiscBTestComplete.Cnt_lgc "MICROSAR RTE" UBYTE RTE_CM_BOOLEAN 0 0 0 255 ECU_ADDRESS 0 SYMBOL_LINK "Rte_BkCpPc_PwrDiscBTestComplete_Cnt_lgc" 0 DISPLAY_IDENTIFIER Ap_HwPwUp.ReceiverPorts.PwrDiscBTestComplete.Cnt_lgc /end MEASUREMENT
/begin MEASUREMENT Ap_HwPwUp.PwrDiscBTestStart.Cnt_lgc "MICROSAR RTE" UBYTE RTE_CM_BOOLEAN 0 0 0 255 ECU_ADDRESS 0 SYMBOL_LINK "Rte_Ap_HwPwUp_PwrDiscBTestStart_Cnt_lgc" 0 DISPLAY_IDENTIFIER Ap_HwPwUp.SenderPorts.PwrDiscBTestStart.Cnt_lgc /end MEASUREMENT
/begin MEASUREMENT Ap_HwPwUp.SystemState.Mode "MICROSAR RTE" UBYTE RTE_CM_ENUM_StaMd_Mode 0 0 0 255 ECU_ADDRESS 0 SYMBOL_LINK "Rte_ModeMachine_StaMd_SystemState_Mode" 0 DISPLAY_IDENTIFIER Ap_HwPwUp.ModeRequirePorts.SystemState.Mode /end MEASUREMENT
/begin MEASUREMENT Ap_HwPwUp.TMFTestComplete.Cnt_lgc "MICROSAR RTE" UBYTE RTE_CM_BOOLEAN 0 0 0 255 ECU_ADDRESS 0 SYMBOL_LINK "Rte_TmprlMon_TMFTestComplete_Cnt_lgc" 0 DISPLAY_IDENTIFIER Ap_HwPwUp.ReceiverPorts.TMFTestComplete.Cnt_lgc /end MEASUREMENT
/begin MEASUREMENT Ap_HwPwUp.TMFTestStart.Cnt_lgc "MICROSAR RTE" UBYTE RTE_CM_BOOLEAN 0 0 0 255 ECU_ADDRESS 0 SYMBOL_LINK "Rte_Ap_HwPwUp_TMFTestStart_Cnt_lgc" 0 DISPLAY_IDENTIFIER Ap_HwPwUp.SenderPorts.TMFTestStart.Cnt_lgc /end MEASUREMENT
/begin MEASUREMENT Ap_LmtCod.AssistEOTGain.Uls_f32 "MICROSAR RTE" FLOAT32_IEEE NO_COMPU_METHOD 0 0 1.175494351e-38 3.402823466e+38 ECU_ADDRESS 0 SYMBOL_LINK "Rte_EOTActuatorMng_AssistEOTGain_Uls_f32" 0 DISPLAY_IDENTIFIER Ap_LmtCod.ReceiverPorts.AssistEOTGain.Uls_f32 /end MEASUREMENT
/begin MEASUREMENT Ap_LmtCod.AssistEOTLimit.MtrNm_f32 "MICROSAR RTE" FLOAT32_IEEE NO_COMPU_METHOD 0 0 1.175494351e-38 3.402823466e+38 ECU_ADDRESS 0 SYMBOL_LINK "Rte_EOTActuatorMng_AssistEOTLimit_MtrNm_f32" 0 DISPLAY_IDENTIFIER Ap_LmtCod.ReceiverPorts.AssistEOTLimit.MtrNm_f32 /end MEASUREMENT
/begin MEASUREMENT Ap_LmtCod.AssistStallLimit.MtrNm_f32 "MICROSAR RTE" FLOAT32_IEEE NO_COMPU_METHOD 0 0 1.175494351e-38 3.402823466e+38 ECU_ADDRESS 0 SYMBOL_LINK "Rte_HiLoadStall_AssistStallLimit_MtrNm_f32" 0 DISPLAY_IDENTIFIER Ap_LmtCod.ReceiverPorts.AssistStallLimit.MtrNm_f32 /end MEASUREMENT
/begin MEASUREMENT Ap_LmtCod.AssistVehSpdLimit.MtrNm_f32 "MICROSAR RTE" FLOAT32_IEEE NO_COMPU_METHOD 0 0 1.175494351e-38 3.402823466e+38 ECU_ADDRESS 0 SYMBOL_LINK "Rte_VehSpdLmt_AstVehSpdLimit_MtrNm_f32" 0 DISPLAY_IDENTIFIER Ap_LmtCod.ReceiverPorts.AssistVehSpdLimit.MtrNm_f32 /end MEASUREMENT
/begin MEASUREMENT Ap_LmtCod.CCLTrqRamp.Uls_f32 "MICROSAR RTE" FLOAT32_IEEE NO_COMPU_METHOD 0 0 1.175494351e-38 3.402823466e+38 ECU_ADDRESS 0 SYMBOL_LINK "Rte_Ap_LmtCod_CCLTrqRamp_Uls_f32" 0 DISPLAY_IDENTIFIER Ap_LmtCod.ReceiverPorts.CCLTrqRamp.Uls_f32 /end MEASUREMENT
/begin MEASUREMENT Ap_LmtCod.EOTGainLtd.Uls_f32 "MICROSAR RTE" FLOAT32_IEEE NO_COMPU_METHOD 0 0 1.175494351e-38 3.402823466e+38 ECU_ADDRESS 0 SYMBOL_LINK "Rte_Ap_LmtCod_EOTGainLtd_Uls_f32" 0 DISPLAY_IDENTIFIER Ap_LmtCod.SenderPorts.EOTGainLtd.Uls_f32 /end MEASUREMENT
/begin MEASUREMENT Ap_LmtCod.EOTLimitLtd.MtrNm_f32 "MICROSAR RTE" FLOAT32_IEEE NO_COMPU_METHOD 0 0 1.175494351e-38 3.402823466e+38 ECU_ADDRESS 0 SYMBOL_LINK "Rte_Ap_LmtCod_EOTLimitLtd_MtrNm_f32" 0 DISPLAY_IDENTIFIER Ap_LmtCod.SenderPorts.EOTLimitLtd.MtrNm_f32 /end MEASUREMENT
/begin MEASUREMENT Ap_LmtCod.OutputRampMult.Uls_f32 "MICROSAR RTE" FLOAT32_IEEE NO_COMPU_METHOD 0 0 1.175494351e-38 3.402823466e+38 ECU_ADDRESS 0 SYMBOL_LINK "Rte_StOpCtrl_OutputRampMult_Uls_f32" 0 DISPLAY_IDENTIFIER Ap_LmtCod.ReceiverPorts.OutputRampMult.Uls_f32 /end MEASUREMENT
/begin MEASUREMENT Ap_LmtCod.OutputRampMultLtd.Uls_f32 "MICROSAR RTE" FLOAT32_IEEE NO_COMPU_METHOD 0 0 1.175494351e-38 3.402823466e+38 ECU_ADDRESS 0 SYMBOL_LINK "Rte_Ap_LmtCod_OutputRampMultLtd_Uls_f32" 0 DISPLAY_IDENTIFIER Ap_LmtCod.SenderPorts.OutputRampMultLtd.Uls_f32 /end MEASUREMENT
/begin MEASUREMENT Ap_LmtCod.StallLimitLtd.MtrNm_f32 "MICROSAR RTE" FLOAT32_IEEE NO_COMPU_METHOD 0 0 1.175494351e-38 3.402823466e+38 ECU_ADDRESS 0 SYMBOL_LINK "Rte_Ap_LmtCod_StallLimitLtd_MtrNm_f32" 0 DISPLAY_IDENTIFIER Ap_LmtCod.SenderPorts.StallLimitLtd.MtrNm_f32 /end MEASUREMENT
/begin MEASUREMENT Ap_LmtCod.ThermalLimit.MtrNm_f32 "MICROSAR RTE" FLOAT32_IEEE NO_COMPU_METHOD 0 0 1.175494351e-38 3.402823466e+38 ECU_ADDRESS 0 SYMBOL_LINK "Rte_Ap_ThrmlDutyCycle_ThermalLimit_MtrNm_f32" 0 DISPLAY_IDENTIFIER Ap_LmtCod.ReceiverPorts.ThermalLimit.MtrNm_f32 /end MEASUREMENT
/begin MEASUREMENT Ap_LmtCod.ThermalLimitLtd.MtrNm_f32 "MICROSAR RTE" FLOAT32_IEEE NO_COMPU_METHOD 0 0 1.175494351e-38 3.402823466e+38 ECU_ADDRESS 0 SYMBOL_LINK "Rte_Ap_LmtCod_ThermalLimitLtd_MtrNm_f32" 0 DISPLAY_IDENTIFIER Ap_LmtCod.SenderPorts.ThermalLimitLtd.MtrNm_f32 /end MEASUREMENT
/begin MEASUREMENT Ap_LmtCod.VehSpdLimitLtd.MtrNm_f32 "MICROSAR RTE" FLOAT32_IEEE NO_COMPU_METHOD 0 0 1.175494351e-38 3.402823466e+38 ECU_ADDRESS 0 SYMBOL_LINK "Rte_Ap_LmtCod_VehSpdLimitLtd_MtrNm_f32" 0 DISPLAY_IDENTIFIER Ap_LmtCod.SenderPorts.VehSpdLimitLtd.MtrNm_f32 /end MEASUREMENT
/begin MEASUREMENT Ap_LmtCod.VehicleSpeed.Kph_f32 "MICROSAR RTE" FLOAT32_IEEE NO_COMPU_METHOD 0 0 1.175494351e-38 3.402823466e+38 ECU_ADDRESS 0 SYMBOL_LINK "Rte_Ap_SignlCondn_VehicleSpeed_Kph_f32" 0 DISPLAY_IDENTIFIER Ap_LmtCod.ReceiverPorts.VehicleSpeed.Kph_f32 /end MEASUREMENT
/begin MEASUREMENT Ap_LrnEOT.CCWFound.Cnt_lgc "MICROSAR RTE" UBYTE RTE_CM_BOOLEAN 0 0 0 255 ECU_ADDRESS 0 SYMBOL_LINK "Rte_Ap_LrnEOT_CCWFound_Cnt_lgc" 0 DISPLAY_IDENTIFIER Ap_LrnEOT.SenderPorts.CCWFound.Cnt_lgc /end MEASUREMENT
/begin MEASUREMENT Ap_LrnEOT.CCWPosition.HwDeg_f32 "MICROSAR RTE" FLOAT32_IEEE NO_COMPU_METHOD 0 0 1.175494351e-38 3.402823466e+38 ECU_ADDRESS 0 SYMBOL_LINK "Rte_Ap_LrnEOT_CCWPosition_HwDeg_f32" 0 DISPLAY_IDENTIFIER Ap_LrnEOT.SenderPorts.CCWPosition.HwDeg_f32 /end MEASUREMENT
/begin MEASUREMENT Ap_LrnEOT.CWFound.Cnt_lgc "MICROSAR RTE" UBYTE RTE_CM_BOOLEAN 0 0 0 255 ECU_ADDRESS 0 SYMBOL_LINK "Rte_Ap_LrnEOT_CWFound_Cnt_lgc" 0 DISPLAY_IDENTIFIER Ap_LrnEOT.SenderPorts.CWFound.Cnt_lgc /end MEASUREMENT
/begin MEASUREMENT Ap_LrnEOT.CWPosition.HwDeg_f32 "MICROSAR RTE" FLOAT32_IEEE NO_COMPU_METHOD 0 0 1.175494351e-38 3.402823466e+38 ECU_ADDRESS 0 SYMBOL_LINK "Rte_Ap_LrnEOT_CWPosition_HwDeg_f32" 0 DISPLAY_IDENTIFIER Ap_LrnEOT.SenderPorts.CWPosition.HwDeg_f32 /end MEASUREMENT
/begin MEASUREMENT Ap_LrnEOT.DiagStsHwPosDis.Cnt_lgc "MICROSAR RTE" UBYTE RTE_CM_BOOLEAN 0 0 0 255 ECU_ADDRESS 0 SYMBOL_LINK "Rte_DiagMgr_DiagStsHWASbSystmFltPres_Cnt_lgc" 0 DISPLAY_IDENTIFIER Ap_LrnEOT.ReceiverPorts.DiagStsHwPosDis.Cnt_lgc /end MEASUREMENT
/begin MEASUREMENT Ap_LrnEOT.HandwheelAuthority.Uls_f32 "MICROSAR RTE" FLOAT32_IEEE NO_COMPU_METHOD 0 0 1.175494351e-38 3.402823466e+38 ECU_ADDRESS 0 SYMBOL_LINK "Rte_AbsHwPos_HandwheelAuthority_Uls_f32" 0 DISPLAY_IDENTIFIER Ap_LrnEOT.ReceiverPorts.HandwheelAuthority.Uls_f32 /end MEASUREMENT
/begin MEASUREMENT Ap_LrnEOT.HandwheelPosition.HwDeg_f32 "MICROSAR RTE" FLOAT32_IEEE NO_COMPU_METHOD 0 0 1.175494351e-38 3.402823466e+38 ECU_ADDRESS 0 SYMBOL_LINK "Rte_AbsHwPos_HandwheelPosition_HwDeg_f32" 0 DISPLAY_IDENTIFIER Ap_LrnEOT.ReceiverPorts.HandwheelPosition.HwDeg_f32 /end MEASUREMENT
/begin MEASUREMENT Ap_LrnEOT.HwTorque.HwNm_f32 "MICROSAR RTE" FLOAT32_IEEE NO_COMPU_METHOD 0 0 1.175494351e-38 3.402823466e+38 ECU_ADDRESS 0 SYMBOL_LINK "Rte_Ap_Sweep_OutputHwTrq_HwNm_f32" 0 DISPLAY_IDENTIFIER Ap_LrnEOT.ReceiverPorts.HwTorque.HwNm_f32 /end MEASUREMENT
/begin MEASUREMENT Ap_LrnEOT.LearnedEOT.CCWEOTFound_Cnt_lgc "MICROSAR RTE" UBYTE RTE_CM_BOOLEAN 0 0 0 255 ECU_ADDRESS 0 SYMBOL_LINK "Rte_Ap_LrnEOT_LearnedEOT.CCWEOTFound_Cnt_lgc" 0 DISPLAY_IDENTIFIER Ap_LrnEOT.PerInstanceMemories.LearnedEOT.CCWEOTFound_Cnt_lgc READ_WRITE /end MEASUREMENT
/begin MEASUREMENT Ap_LrnEOT.LearnedEOT.CCWEOTPosition_HwDeg_f32 "MICROSAR RTE" FLOAT32_IEEE NO_COMPU_METHOD 0 0 1.175494351e-38 3.402823466e+38 ECU_ADDRESS 0 SYMBOL_LINK "Rte_Ap_LrnEOT_LearnedEOT.CCWEOTPosition_HwDeg_f32" 0 DISPLAY_IDENTIFIER Ap_LrnEOT.PerInstanceMemories.LearnedEOT.CCWEOTPosition_HwDeg_f32 READ_WRITE /end MEASUREMENT
/begin MEASUREMENT Ap_LrnEOT.LearnedEOT.CWEOTFound_Cnt_lgc "MICROSAR RTE" UBYTE RTE_CM_BOOLEAN 0 0 0 255 ECU_ADDRESS 0 SYMBOL_LINK "Rte_Ap_LrnEOT_LearnedEOT.CWEOTFound_Cnt_lgc" 0 DISPLAY_IDENTIFIER Ap_LrnEOT.PerInstanceMemories.LearnedEOT.CWEOTFound_Cnt_lgc READ_WRITE /end MEASUREMENT
/begin MEASUREMENT Ap_LrnEOT.LearnedEOT.CWEOTPosition_HwDeg_f32 "MICROSAR RTE" FLOAT32_IEEE NO_COMPU_METHOD 0 0 1.175494351e-38 3.402823466e+38 ECU_ADDRESS 0 SYMBOL_LINK "Rte_Ap_LrnEOT_LearnedEOT.CWEOTPosition_HwDeg_f32" 0 DISPLAY_IDENTIFIER Ap_LrnEOT.PerInstanceMemories.LearnedEOT.CWEOTPosition_HwDeg_f32 READ_WRITE /end MEASUREMENT
/begin MEASUREMENT Ap_LrnEOT.MtrVelCRF.MtrRadpS_f32 "MICROSAR RTE" FLOAT32_IEEE NO_COMPU_METHOD 0 0 1.175494351e-38 3.402823466e+38 ECU_ADDRESS 0 SYMBOL_LINK "Rte_Sa_MtrVel_MotorVelCRF_MtrRadpS_f32" 0 DISPLAY_IDENTIFIER Ap_LrnEOT.ReceiverPorts.MtrVelCRF.MtrRadpS_f32 /end MEASUREMENT
/begin MEASUREMENT Ap_LrnEOT.PostLimitTorque.MtrNm_f32 "MICROSAR RTE" FLOAT32_IEEE NO_COMPU_METHOD 0 0 1.175494351e-38 3.402823466e+38 ECU_ADDRESS 0 SYMBOL_LINK "Rte_Ap_Sweep2_OutputMtrTrq_MtrNm_f32" 0 DISPLAY_IDENTIFIER Ap_LrnEOT.ReceiverPorts.PostLimitTorque.MtrNm_f32 /end MEASUREMENT
/begin MEASUREMENT Ap_MtrTempEst.AMTempEstDisable.Cnt_lgc "MICROSAR RTE" UBYTE RTE_CM_BOOLEAN 0 0 0 255 ECU_ADDRESS 0 SYMBOL_LINK "Rte_CDDInterface_BallNutTempEstSrlComSvcDft_Cnt_lgc" 0 DISPLAY_IDENTIFIER Ap_MtrTempEst.ReceiverPorts.AMTempEstDisable.Cnt_lgc /end MEASUREMENT
/begin MEASUREMENT Ap_MtrTempEst.AmbTemp.DegC_f32 "MICROSAR RTE" FLOAT32_IEEE NO_COMPU_METHOD 0 0 1.175494351e-38 3.402823466e+38 ECU_ADDRESS 0 SYMBOL_LINK "Rte_SrlComInput_SrlComAmbTemp_DegC_f32" 0 DISPLAY_IDENTIFIER Ap_MtrTempEst.ReceiverPorts.AmbTemp.DegC_f32 /end MEASUREMENT
/begin MEASUREMENT Ap_MtrTempEst.AssistMechTempEst.DegC_f32 "MICROSAR RTE" FLOAT32_IEEE NO_COMPU_METHOD 0 0 1.175494351e-38 3.402823466e+38 ECU_ADDRESS 0 SYMBOL_LINK "Rte_Ap_MtrTempEst_AssistMechTempEst_DegC_f32" 0 DISPLAY_IDENTIFIER Ap_MtrTempEst.SenderPorts.AssistMechTempEst.DegC_f32 /end MEASUREMENT
/begin MEASUREMENT Ap_MtrTempEst.CtrlTempFinal.DegC_f32 "MICROSAR RTE" FLOAT32_IEEE NO_COMPU_METHOD 0 0 1.175494351e-38 3.402823466e+38 ECU_ADDRESS 0 SYMBOL_LINK "Rte_CtrlTemp_FiltMeasTemp_DegC_f32" 0 DISPLAY_IDENTIFIER Ap_MtrTempEst.ReceiverPorts.CtrlTempFinal.DegC_f32 /end MEASUREMENT
/begin MEASUREMENT Ap_MtrTempEst.CuTempEst.DegC_f32 "MICROSAR RTE" FLOAT32_IEEE NO_COMPU_METHOD 0 0 1.175494351e-38 3.402823466e+38 ECU_ADDRESS 0 SYMBOL_LINK "Rte_Ap_MtrTempEst_CuTempEst_DegC_f32" 0 DISPLAY_IDENTIFIER Ap_MtrTempEst.SenderPorts.CuTempEst.DegC_f32 /end MEASUREMENT
/begin MEASUREMENT Ap_MtrTempEst.EngTemp.DegC_f32 "MICROSAR RTE" FLOAT32_IEEE NO_COMPU_METHOD 0 0 1.175494351e-38 3.402823466e+38 ECU_ADDRESS 0 SYMBOL_LINK "Rte_SrlComInput_SrlComEngTemp_DegC_f32" 0 DISPLAY_IDENTIFIER Ap_MtrTempEst.ReceiverPorts.EngTemp.DegC_f32 /end MEASUREMENT
/begin MEASUREMENT Ap_MtrTempEst.EstPkCurr.AmpSq_f32 "MICROSAR RTE" FLOAT32_IEEE NO_COMPU_METHOD 0 0 1.175494351e-38 3.402823466e+38 ECU_ADDRESS 0 SYMBOL_LINK "Rte_PeakCurrEst_EstPkCurr_AmpSq_f32" 0 DISPLAY_IDENTIFIER Ap_MtrTempEst.ReceiverPorts.EstPkCurr.AmpSq_f32 /end MEASUREMENT
/begin MEASUREMENT Ap_MtrTempEst.HwVel.HwRadpS_f32 "MICROSAR RTE" FLOAT32_IEEE NO_COMPU_METHOD 0 0 1.175494351e-38 3.402823466e+38 ECU_ADDRESS 0 SYMBOL_LINK "Rte_Sa_MtrVel_HandwheelVel_HwRadpS_f32" 0 DISPLAY_IDENTIFIER Ap_MtrTempEst.ReceiverPorts.HwVel.HwRadpS_f32 /end MEASUREMENT
/begin MEASUREMENT Ap_MtrTempEst.MagTempEst.DegC_f32 "MICROSAR RTE" FLOAT32_IEEE NO_COMPU_METHOD 0 0 1.175494351e-38 3.402823466e+38 ECU_ADDRESS 0 SYMBOL_LINK "Rte_Ap_MtrTempEst_MagTempEst_DegC_f32" 0 DISPLAY_IDENTIFIER Ap_MtrTempEst.SenderPorts.MagTempEst.DegC_f32 /end MEASUREMENT
/begin MEASUREMENT Ap_MtrTempEst.ScomTempDataRcvd.Cnt_lgc "MICROSAR RTE" UBYTE RTE_CM_BOOLEAN 0 0 0 255 ECU_ADDRESS 0 SYMBOL_LINK "Rte_Ap_MtrTempEst_ScomTempDataRcvd_Cnt_lgc" 0 DISPLAY_IDENTIFIER Ap_MtrTempEst.ReceiverPorts.ScomTempDataRcvd.Cnt_lgc /end MEASUREMENT
/begin MEASUREMENT Ap_MtrTempEst.SiTempEst.DegC_f32 "MICROSAR RTE" FLOAT32_IEEE NO_COMPU_METHOD 0 0 1.175494351e-38 3.402823466e+38 ECU_ADDRESS 0 SYMBOL_LINK "Rte_Ap_MtrTempEst_SiTempEst_DegC_f32" 0 DISPLAY_IDENTIFIER Ap_MtrTempEst.SenderPorts.SiTempEst.DegC_f32 /end MEASUREMENT
/begin MEASUREMENT Ap_PICurrCntrl.CorrMtrPosElec.Rev_f32 "MICROSAR RTE" FLOAT32_IEEE NO_COMPU_METHOD 0 0 1.175494351e-38 3.402823466e+38 ECU_ADDRESS 0 SYMBOL_LINK "Rte_CDDInterface_CorrectedElecMtrPosFloat_Rev_f32" 0 DISPLAY_IDENTIFIER Ap_PICurrCntrl.ReceiverPorts.CorrMtrPosElec.Rev_f32 /end MEASUREMENT
/begin MEASUREMENT Ap_PICurrCntrl.DervLambdaAlphaDiag.Volt_f32 "This signal is intended to communicate any type voltage signal measured by the ecu.  This signal has a lower limit of 0 which reequires users of the signal to provide divide by 0 protection if it is used as a denominator in a calculation.  See Vecu port p" FLOAT32_IEEE NO_COMPU_METHOD 0 0 1.175494351e-38 3.402823466e+38 ECU_ADDRESS 0 SYMBOL_LINK "Rte_Ap_PICurrCntrl_DervLambdaAlphaDiag_Volt_f32" 0 DISPLAY_IDENTIFIER Ap_PICurrCntrl.SenderPorts.DervLambdaAlphaDiag.Volt_f32 /end MEASUREMENT
/begin MEASUREMENT Ap_PICurrCntrl.DervLambdaBetaDiag.Volt_f32 "This signal is intended to communicate any type voltage signal measured by the ecu.  This signal has a lower limit of 0 which reequires users of the signal to provide divide by 0 protection if it is used as a denominator in a calculation.  See Vecu port p" FLOAT32_IEEE NO_COMPU_METHOD 0 0 1.175494351e-38 3.402823466e+38 ECU_ADDRESS 0 SYMBOL_LINK "Rte_Ap_PICurrCntrl_DervLambdaBetaDiag_Volt_f32" 0 DISPLAY_IDENTIFIER Ap_PICurrCntrl.SenderPorts.DervLambdaBetaDiag.Volt_f32 /end MEASUREMENT
/begin MEASUREMENT Ap_PICurrCntrl.EstKe.VpRadpS_f32 "MICROSAR RTE" FLOAT32_IEEE NO_COMPU_METHOD 0 0 1.175494351e-38 3.402823466e+38 ECU_ADDRESS 0 SYMBOL_LINK "Rte_CurrParamComp_EstKe_VpRadpS_f32" 0 DISPLAY_IDENTIFIER Ap_PICurrCntrl.ReceiverPorts.EstKe.VpRadpS_f32 /end MEASUREMENT
/begin MEASUREMENT Ap_PICurrCntrl.EstR.Ohm_f32 "MICROSAR RTE" FLOAT32_IEEE NO_COMPU_METHOD 0 0 1.175494351e-38 3.402823466e+38 ECU_ADDRESS 0 SYMBOL_LINK "Rte_CurrParamComp_EstR_Ohm_f32" 0 DISPLAY_IDENTIFIER Ap_PICurrCntrl.ReceiverPorts.EstR.Ohm_f32 /end MEASUREMENT
/begin MEASUREMENT Ap_PICurrCntrl.MRFMtrVel.MtrRadpS_f32 "MICROSAR RTE" FLOAT32_IEEE NO_COMPU_METHOD 0 0 1.175494351e-38 3.402823466e+38 ECU_ADDRESS 0 SYMBOL_LINK "Rte_Sa_MtrVel_MotorVelMRF_MtrRadpS_f32" 0 DISPLAY_IDENTIFIER Ap_PICurrCntrl.ReceiverPorts.MRFMtrVel.MtrRadpS_f32 /end MEASUREMENT
/begin MEASUREMENT Ap_PICurrCntrl.MtrCurrDaxRef.Amp_f32 "MICROSAR RTE" FLOAT32_IEEE NO_COMPU_METHOD 0 0 1.175494351e-38 3.402823466e+38 ECU_ADDRESS 0 SYMBOL_LINK "Rte_CurrCmd_MtrCurrDaxRef_Amp_f32" 0 DISPLAY_IDENTIFIER Ap_PICurrCntrl.ReceiverPorts.MtrCurrDaxRef.Amp_f32 /end MEASUREMENT
/begin MEASUREMENT Ap_PICurrCntrl.SystemState.Mode "MICROSAR RTE" UBYTE RTE_CM_ENUM_StaMd_Mode 0 0 0 255 ECU_ADDRESS 0 SYMBOL_LINK "Rte_ModeMachine_StaMd_SystemState_Mode" 0 DISPLAY_IDENTIFIER Ap_PICurrCntrl.ModeRequirePorts.SystemState.Mode /end MEASUREMENT
/begin MEASUREMENT Ap_PosServo.HandwheelPosition.HwDeg_f32 "MICROSAR RTE" FLOAT32_IEEE NO_COMPU_METHOD 0 0 1.175494351e-38 3.402823466e+38 ECU_ADDRESS 0 SYMBOL_LINK "Rte_AbsHwPos_HandwheelPosition_HwDeg_f32" 0 DISPLAY_IDENTIFIER Ap_PosServo.ReceiverPorts.HandwheelPosition.HwDeg_f32 /end MEASUREMENT
/begin MEASUREMENT Ap_PosServo.HwTorque.HwNm_f32 "MICROSAR RTE" FLOAT32_IEEE NO_COMPU_METHOD 0 0 1.175494351e-38 3.402823466e+38 ECU_ADDRESS 0 SYMBOL_LINK "Rte_Ap_Sweep_OutputHwTrq_HwNm_f32" 0 DISPLAY_IDENTIFIER Ap_PosServo.ReceiverPorts.HwTorque.HwNm_f32 /end MEASUREMENT
/begin MEASUREMENT Ap_PosServo.MotorVelCRF.MtrRadpS_f32 "MICROSAR RTE" FLOAT32_IEEE NO_COMPU_METHOD 0 0 1.175494351e-38 3.402823466e+38 ECU_ADDRESS 0 SYMBOL_LINK "Rte_Sa_MtrVel_MotorVelCRF_MtrRadpS_f32" 0 DISPLAY_IDENTIFIER Ap_PosServo.ReceiverPorts.MotorVelCRF.MtrRadpS_f32 /end MEASUREMENT
/begin MEASUREMENT Ap_PosServo.PosSrvoCmd.MtrNm_f32 "MICROSAR RTE" FLOAT32_IEEE NO_COMPU_METHOD 0 0 1.175494351e-38 3.402823466e+38 ECU_ADDRESS 0 SYMBOL_LINK "Rte_Ap_PosServo_PosSrvoCmd_MtrNm_f32" 0 DISPLAY_IDENTIFIER Ap_PosServo.SenderPorts.PosSrvoCmd.MtrNm_f32 /end MEASUREMENT
/begin MEASUREMENT Ap_PosServo.PosSrvoEnable.Cnt_lgc "MICROSAR RTE" UBYTE RTE_CM_BOOLEAN 0 0 0 255 ECU_ADDRESS 0 SYMBOL_LINK "Rte_TrqOvlSta_PosServEnable_Cnt_lgc" 0 DISPLAY_IDENTIFIER Ap_PosServo.ReceiverPorts.PosSrvoEnable.Cnt_lgc /end MEASUREMENT
/begin MEASUREMENT Ap_PosServo.PosSrvoHwAngle.HwDeg_f32 "MICROSAR RTE" FLOAT32_IEEE NO_COMPU_METHOD 0 0 1.175494351e-38 3.402823466e+38 ECU_ADDRESS 0 SYMBOL_LINK "Rte_TrqOvlSta_PosSrvoHwAngle_HwDeg_f32" 0 DISPLAY_IDENTIFIER Ap_PosServo.ReceiverPorts.PosSrvoHwAngle.HwDeg_f32 /end MEASUREMENT
/begin MEASUREMENT Ap_PosServo.PosSrvoReturnSclFct.Uls_f32 "MICROSAR RTE" FLOAT32_IEEE NO_COMPU_METHOD 0 0 1.175494351e-38 3.402823466e+38 ECU_ADDRESS 0 SYMBOL_LINK "Rte_Ap_PosServo_PosSrvoReturnSclFct_Uls_f32" 0 DISPLAY_IDENTIFIER Ap_PosServo.SenderPorts.PosSrvoReturnSclFct.Uls_f32 /end MEASUREMENT
/begin MEASUREMENT Ap_PosServo.PosSrvoSmoothEnable.Uls_f32 "MICROSAR RTE" FLOAT32_IEEE NO_COMPU_METHOD 0 0 1.175494351e-38 3.402823466e+38 ECU_ADDRESS 0 SYMBOL_LINK "Rte_Ap_PosServo_PosSrvoSmoothEnable_Uls_f32" 0 DISPLAY_IDENTIFIER Ap_PosServo.SenderPorts.PosSrvoSmoothEnable.Uls_f32 /end MEASUREMENT
/begin MEASUREMENT Ap_PosServo.VehicleSpeed.Kph_f32 "MICROSAR RTE" FLOAT32_IEEE NO_COMPU_METHOD 0 0 1.175494351e-38 3.402823466e+38 ECU_ADDRESS 0 SYMBOL_LINK "Rte_Ap_SignlCondn_VehicleSpeed_Kph_f32" 0 DISPLAY_IDENTIFIER Ap_PosServo.ReceiverPorts.VehicleSpeed.Kph_f32 /end MEASUREMENT
/begin MEASUREMENT Ap_PwrLmtFuncCr.CntDisMtrTrqCmdMRF.MtrNm_f32 "MICROSAR RTE" FLOAT32_IEEE NO_COMPU_METHOD 0 0 1.175494351e-38 3.402823466e+38 ECU_ADDRESS 0 SYMBOL_LINK "Rte_CtrldDisShtdn_CntDisMtrTrqCmdMRF_MtrNm_f32" 0 DISPLAY_IDENTIFIER Ap_PwrLmtFuncCr.ReceiverPorts.CntDisMtrTrqCmdMRF.MtrNm_f32 /end MEASUREMENT
/begin MEASUREMENT Ap_PwrLmtFuncCr.EstKe.VpRadpS_f32 "MICROSAR RTE" FLOAT32_IEEE NO_COMPU_METHOD 0 0 1.175494351e-38 3.402823466e+38 ECU_ADDRESS 0 SYMBOL_LINK "Rte_CurrParamComp_EstKe_VpRadpS_f32" 0 DISPLAY_IDENTIFIER Ap_PwrLmtFuncCr.ReceiverPorts.EstKe.VpRadpS_f32 /end MEASUREMENT
/begin MEASUREMENT Ap_PwrLmtFuncCr.FltTrqLmt.Uls_f32 "MICROSAR RTE" FLOAT32_IEEE NO_COMPU_METHOD 0 0 1.175494351e-38 3.402823466e+38 ECU_ADDRESS 0 SYMBOL_LINK "Rte_Ap_PwrLmtFuncCr_FltTrqLmt_Uls_f32" 0 DISPLAY_IDENTIFIER Ap_PwrLmtFuncCr.SenderPorts.FltTrqLmt.Uls_f32 /end MEASUREMENT
/begin MEASUREMENT Ap_PwrLmtFuncCr.MRFMtrTrqCmd.MtrNm_f32 "MICROSAR RTE" FLOAT32_IEEE NO_COMPU_METHOD 0 0 1.175494351e-38 3.402823466e+38 ECU_ADDRESS 0 SYMBOL_LINK "Rte_Ap_PwrLmtFuncCr_MRFMtrTrqCmd_MtrNm_f32" 0 DISPLAY_IDENTIFIER Ap_PwrLmtFuncCr.SenderPorts.MRFMtrTrqCmd.MtrNm_f32 /end MEASUREMENT
/begin MEASUREMENT Ap_PwrLmtFuncCr.MotorVelMRF.MtrRadpS_f32 "MICROSAR RTE" FLOAT32_IEEE NO_COMPU_METHOD 0 0 1.175494351e-38 3.402823466e+38 ECU_ADDRESS 0 SYMBOL_LINK "Rte_Sa_MtrVel_MotorVelMRF_MtrRadpS_f32" 0 DISPLAY_IDENTIFIER Ap_PwrLmtFuncCr.ReceiverPorts.MotorVelMRF.MtrRadpS_f32 /end MEASUREMENT
/begin MEASUREMENT Ap_PwrLmtFuncCr.PosServEnable.Cnt_lgc "MICROSAR RTE" UBYTE RTE_CM_BOOLEAN 0 0 0 255 ECU_ADDRESS 0 SYMBOL_LINK "Rte_Ap_PwrLmtFuncCr_PosServEnable_Cnt_lgc" 0 DISPLAY_IDENTIFIER Ap_PwrLmtFuncCr.ReceiverPorts.PosServEnable.Cnt_lgc /end MEASUREMENT
/begin MEASUREMENT Ap_PwrLmtFuncCr.SystemState.Mode "MICROSAR RTE" UBYTE RTE_CM_ENUM_StaMd_Mode 0 0 0 255 ECU_ADDRESS 0 SYMBOL_LINK "Rte_ModeMachine_StaMd_SystemState_Mode" 0 DISPLAY_IDENTIFIER Ap_PwrLmtFuncCr.ModeRequirePorts.SystemState.Mode /end MEASUREMENT
/begin MEASUREMENT Ap_PwrLmtFuncCr.ThresholdExceeded.Cnt_lgc "MICROSAR RTE" UBYTE RTE_CM_BOOLEAN 0 0 0 255 ECU_ADDRESS 0 SYMBOL_LINK "Rte_Ap_PwrLmtFuncCr_ThresholdExceeded_Cnt_lgc" 0 DISPLAY_IDENTIFIER Ap_PwrLmtFuncCr.SenderPorts.ThresholdExceeded.Cnt_lgc /end MEASUREMENT
/begin MEASUREMENT Ap_PwrLmtFuncCr.Vecu.Volt_f32 "This port prototype is inteded to communicate voltage signals that represent the ecu supplied voltage.  This signal has a lower limit, which is non-zero, to allow users of the signal to use it as a denominator in an expression without requiring a divide b" FLOAT32_IEEE NO_COMPU_METHOD 0 0 1.175494351e-38 3.402823466e+38 ECU_ADDRESS 0 SYMBOL_LINK "Rte_BatteryVoltage_Vecu_Volt_f32" 0 DISPLAY_IDENTIFIER Ap_PwrLmtFuncCr.ReceiverPorts.Vecu.Volt_f32 /end MEASUREMENT
/begin MEASUREMENT Ap_SASPlausDiag.I2CHwAbsPos.HwDeg_f32 "MICROSAR RTE" FLOAT32_IEEE NO_COMPU_METHOD 0 0 1.175494351e-38 3.402823466e+38 ECU_ADDRESS 0 SYMBOL_LINK "Rte_DigColPs_I2CHwAbsPos_HwDeg_f32" 0 DISPLAY_IDENTIFIER Ap_SASPlausDiag.ReceiverPorts.I2CHwAbsPos.HwDeg_f32 /end MEASUREMENT
/begin MEASUREMENT Ap_SASPlausDiag.I2CHwAbsPosValid.Cnt_lgc "MICROSAR RTE" UBYTE RTE_CM_BOOLEAN 0 0 0 255 ECU_ADDRESS 0 SYMBOL_LINK "Rte_DigColPs_I2CHwAbsPosValid_Cnt_lgc" 0 DISPLAY_IDENTIFIER Ap_SASPlausDiag.ReceiverPorts.I2CHwAbsPosValid.Cnt_lgc /end MEASUREMENT
/begin MEASUREMENT Ap_SASPlausDiag.VdAuthority.Uls_f32 "MICROSAR RTE" FLOAT32_IEEE NO_COMPU_METHOD 0 0 1.175494351e-38 3.402823466e+38 ECU_ADDRESS 0 SYMBOL_LINK "Rte_VehDyn_SensorlessAuthority_Uls_f32" 0 DISPLAY_IDENTIFIER Ap_SASPlausDiag.ReceiverPorts.VdAuthority.Uls_f32 /end MEASUREMENT
/begin MEASUREMENT Ap_SASPlausDiag.VdHwPos.HwDeg_f32 "MICROSAR RTE" FLOAT32_IEEE NO_COMPU_METHOD 0 0 1.175494351e-38 3.402823466e+38 ECU_ADDRESS 0 SYMBOL_LINK "Rte_VehDyn_SensorlessHwPos_HwDeg_f32" 0 DISPLAY_IDENTIFIER Ap_SASPlausDiag.ReceiverPorts.VdHwPos.HwDeg_f32 /end MEASUREMENT
/begin MEASUREMENT Ap_SignlCondn.SrlComVehSpeed.Kph_f32 "MICROSAR RTE" FLOAT32_IEEE NO_COMPU_METHOD 0 0 1.175494351e-38 3.402823466e+38 ECU_ADDRESS 0 SYMBOL_LINK "Rte_SrlComInput_SrlComVehSpd_Kph_f32" 0 DISPLAY_IDENTIFIER Ap_SignlCondn.ReceiverPorts.SrlComVehSpeed.Kph_f32 /end MEASUREMENT
/begin MEASUREMENT Ap_SignlCondn.SrlCom_VehicleLonAccel.KphpS_f32 "MICROSAR RTE" FLOAT32_IEEE NO_COMPU_METHOD 0 0 1.175494351e-38 3.402823466e+38 ECU_ADDRESS 0 SYMBOL_LINK "Rte_SrlComInput_SrlComVehicleLonAccel_KphpS_f32" 0 DISPLAY_IDENTIFIER Ap_SignlCondn.ReceiverPorts.SrlCom_VehicleLonAccel.KphpS_f32 /end MEASUREMENT
/begin MEASUREMENT Ap_SignlCondn.VehicleSpeed.Kph_f32 "MICROSAR RTE" FLOAT32_IEEE NO_COMPU_METHOD 0 0 1.175494351e-38 3.402823466e+38 ECU_ADDRESS 0 SYMBOL_LINK "Rte_Ap_SignlCondn_VehicleSpeed_Kph_f32" 0 DISPLAY_IDENTIFIER Ap_SignlCondn.SenderPorts.VehicleSpeed.Kph_f32 /end MEASUREMENT
/**********************************************************************************************************************
* GROUP
*********************************************************************************************************************/
/begin GROUP AbsHwPos "MICROSAR RTE"
 /begin SUB_GROUP AbsHwPos.PerInstanceMemories AbsHwPos.ReceiverPorts AbsHwPos.SenderPorts /end SUB_GROUP
 /begin FUNCTION_LIST /end FUNCTION_LIST
 /begin REF_CHARACTERISTIC /end REF_CHARACTERISTIC
 /begin REF_MEASUREMENT /end REF_MEASUREMENT
/end GROUP
/begin GROUP AbsHwPos.AlignedCumMechMtrPosCRF.Deg_f32 "MICROSAR RTE" /begin SUB_GROUP /end SUB_GROUP /begin FUNCTION_LIST /end FUNCTION_LIST /begin REF_CHARACTERISTIC /end REF_CHARACTERISTIC /begin REF_MEASUREMENT AbsHwPos.AlignedCumMechMtrPosCRF.Deg_f32 /end REF_MEASUREMENT /end GROUP
/begin GROUP AbsHwPos.ComplError.HwDeg_f32 "MICROSAR RTE" /begin SUB_GROUP /end SUB_GROUP /begin FUNCTION_LIST /end FUNCTION_LIST /begin REF_CHARACTERISTIC /end REF_CHARACTERISTIC /begin REF_MEASUREMENT AbsHwPos.ComplError.HwDeg_f32 /end REF_MEASUREMENT /end GROUP
/begin GROUP AbsHwPos.CumMechMtrPosCRF.Deg_f32 "MICROSAR RTE" /begin SUB_GROUP /end SUB_GROUP /begin FUNCTION_LIST /end FUNCTION_LIST /begin REF_CHARACTERISTIC /end REF_CHARACTERISTIC /begin REF_MEASUREMENT AbsHwPos.CumMechMtrPosCRF.Deg_f32 /end REF_MEASUREMENT /end GROUP
/begin GROUP AbsHwPos.DiagStatusHwPosReducedPerf.Cnt_lgc "MICROSAR RTE" /begin SUB_GROUP /end SUB_GROUP /begin FUNCTION_LIST /end FUNCTION_LIST /begin REF_CHARACTERISTIC /end REF_CHARACTERISTIC /begin REF_MEASUREMENT AbsHwPos.DiagStatusHwPosReducedPerf.Cnt_lgc /end REF_MEASUREMENT /end GROUP
/begin GROUP AbsHwPos.EOLVehCntrOffset "MICROSAR RTE" /begin SUB_GROUP /end SUB_GROUP /begin FUNCTION_LIST /end FUNCTION_LIST /begin REF_CHARACTERISTIC /end REF_CHARACTERISTIC
 /begin REF_MEASUREMENT AbsHwPos.EOLVehCntrOffset.EOLHwPosTrimPerformed_Cnt_u16 AbsHwPos.EOLVehCntrOffset.EOLVehCntrOffset_HwDeg_f32 /end REF_MEASUREMENT
/end GROUP
/begin GROUP AbsHwPos.HandwheelAuthority.Uls_f32 "MICROSAR RTE" /begin SUB_GROUP /end SUB_GROUP /begin FUNCTION_LIST /end FUNCTION_LIST /begin REF_CHARACTERISTIC /end REF_CHARACTERISTIC /begin REF_MEASUREMENT AbsHwPos.HandwheelAuthority.Uls_f32 /end REF_MEASUREMENT /end GROUP
/begin GROUP AbsHwPos.HandwheelPosition.HwDeg_f32 "MICROSAR RTE" /begin SUB_GROUP /end SUB_GROUP /begin FUNCTION_LIST /end FUNCTION_LIST /begin REF_CHARACTERISTIC /end REF_CHARACTERISTIC /begin REF_MEASUREMENT AbsHwPos.HandwheelPosition.HwDeg_f32 /end REF_MEASUREMENT /end GROUP
/begin GROUP AbsHwPos.HwPosSource.Cnt_u16 "MICROSAR RTE" /begin SUB_GROUP /end SUB_GROUP /begin FUNCTION_LIST /end FUNCTION_LIST /begin REF_CHARACTERISTIC /end REF_CHARACTERISTIC /begin REF_MEASUREMENT AbsHwPos.HwPosSource.Cnt_u16 /end REF_MEASUREMENT /end GROUP
/begin GROUP AbsHwPos.I2CHwAbsPos.HwDeg_f32 "MICROSAR RTE" /begin SUB_GROUP /end SUB_GROUP /begin FUNCTION_LIST /end FUNCTION_LIST /begin REF_CHARACTERISTIC /end REF_CHARACTERISTIC /begin REF_MEASUREMENT AbsHwPos.I2CHwAbsPos.HwDeg_f32 /end REF_MEASUREMENT /end GROUP
/begin GROUP AbsHwPos.I2CHwAbsPosValid.Cnt_lgc "MICROSAR RTE" /begin SUB_GROUP /end SUB_GROUP /begin FUNCTION_LIST /end FUNCTION_LIST /begin REF_CHARACTERISTIC /end REF_CHARACTERISTIC /begin REF_MEASUREMENT AbsHwPos.I2CHwAbsPosValid.Cnt_lgc /end REF_MEASUREMENT /end GROUP
/begin GROUP AbsHwPos.ManufMode.Cnt_enum "MICROSAR RTE" /begin SUB_GROUP /end SUB_GROUP /begin FUNCTION_LIST /end FUNCTION_LIST /begin REF_CHARACTERISTIC /end REF_CHARACTERISTIC /begin REF_MEASUREMENT AbsHwPos.ManufMode.Cnt_enum /end REF_MEASUREMENT /end GROUP
/begin GROUP AbsHwPos.PerInstanceMemories "MICROSAR RTE" /begin SUB_GROUP AbsHwPos.EOLVehCntrOffset /end SUB_GROUP /begin FUNCTION_LIST /end FUNCTION_LIST /begin REF_CHARACTERISTIC /end REF_CHARACTERISTIC /begin REF_MEASUREMENT /end REF_MEASUREMENT /end GROUP
/begin GROUP AbsHwPos.ReceiverPorts "MICROSAR RTE"
 /begin SUB_GROUP AbsHwPos.AlignedCumMechMtrPosCRF.Deg_f32 AbsHwPos.ComplError.HwDeg_f32 AbsHwPos.CumMechMtrPosCRF.Deg_f32 AbsHwPos.DiagStatusHwPosReducedPerf.Cnt_lgc AbsHwPos.I2CHwAbsPos.HwDeg_f32 AbsHwPos.I2CHwAbsPosValid.Cnt_lgc AbsHwPos.ManufMode.Cnt_enum AbsHwPos.TurnsCntrValidity.Cnt_u08 AbsHwPos.VdAuthority.Uls_f32 AbsHwPos.VdHwPos.HwDeg_f32 /end SUB_GROUP
 /begin FUNCTION_LIST /end FUNCTION_LIST
 /begin REF_CHARACTERISTIC /end REF_CHARACTERISTIC
 /begin REF_MEASUREMENT /end REF_MEASUREMENT
/end GROUP
/begin GROUP AbsHwPos.RelHwPos.HwDeg_f32 "MICROSAR RTE" /begin SUB_GROUP /end SUB_GROUP /begin FUNCTION_LIST /end FUNCTION_LIST /begin REF_CHARACTERISTIC /end REF_CHARACTERISTIC /begin REF_MEASUREMENT AbsHwPos.RelHwPos.HwDeg_f32 /end REF_MEASUREMENT /end GROUP
/begin GROUP AbsHwPos.SenderPorts "MICROSAR RTE"
 /begin SUB_GROUP AbsHwPos.HandwheelAuthority.Uls_f32 AbsHwPos.HandwheelPosition.HwDeg_f32 AbsHwPos.HwPosSource.Cnt_u16 AbsHwPos.RelHwPos.HwDeg_f32 AbsHwPos.SrlComHwPos.HwDeg_f32 AbsHwPos.SrlComHwPosStatus.Cnt_u16 /end SUB_GROUP
 /begin FUNCTION_LIST /end FUNCTION_LIST
 /begin REF_CHARACTERISTIC /end REF_CHARACTERISTIC
 /begin REF_MEASUREMENT /end REF_MEASUREMENT
/end GROUP
/begin GROUP AbsHwPos.SrlComHwPos.HwDeg_f32 "MICROSAR RTE" /begin SUB_GROUP /end SUB_GROUP /begin FUNCTION_LIST /end FUNCTION_LIST /begin REF_CHARACTERISTIC /end REF_CHARACTERISTIC /begin REF_MEASUREMENT AbsHwPos.SrlComHwPos.HwDeg_f32 /end REF_MEASUREMENT /end GROUP
/begin GROUP AbsHwPos.SrlComHwPosStatus.Cnt_u16 "MICROSAR RTE" /begin SUB_GROUP /end SUB_GROUP /begin FUNCTION_LIST /end FUNCTION_LIST /begin REF_CHARACTERISTIC /end REF_CHARACTERISTIC /begin REF_MEASUREMENT AbsHwPos.SrlComHwPosStatus.Cnt_u16 /end REF_MEASUREMENT /end GROUP
/begin GROUP AbsHwPos.TurnsCntrValidity.Cnt_u08 "MICROSAR RTE" /begin SUB_GROUP /end SUB_GROUP /begin FUNCTION_LIST /end FUNCTION_LIST /begin REF_CHARACTERISTIC /end REF_CHARACTERISTIC /begin REF_MEASUREMENT AbsHwPos.TurnsCntrValidity.Cnt_u08 /end REF_MEASUREMENT /end GROUP
/begin GROUP AbsHwPos.VdAuthority.Uls_f32 "MICROSAR RTE" /begin SUB_GROUP /end SUB_GROUP /begin FUNCTION_LIST /end FUNCTION_LIST /begin REF_CHARACTERISTIC /end REF_CHARACTERISTIC /begin REF_MEASUREMENT AbsHwPos.VdAuthority.Uls_f32 /end REF_MEASUREMENT /end GROUP
/begin GROUP AbsHwPos.VdHwPos.HwDeg_f32 "MICROSAR RTE" /begin SUB_GROUP /end SUB_GROUP /begin FUNCTION_LIST /end FUNCTION_LIST /begin REF_CHARACTERISTIC /end REF_CHARACTERISTIC /begin REF_MEASUREMENT AbsHwPos.VdHwPos.HwDeg_f32 /end REF_MEASUREMENT /end GROUP
/begin GROUP Ap_ActivePull "MICROSAR RTE"
 /begin SUB_GROUP Ap_ActivePull.ModeRequirePorts Ap_ActivePull.ReceiverPorts Ap_ActivePull.SenderPorts /end SUB_GROUP
 /begin FUNCTION_LIST /end FUNCTION_LIST
 /begin REF_CHARACTERISTIC /end REF_CHARACTERISTIC
 /begin REF_MEASUREMENT /end REF_MEASUREMENT
/end GROUP
/begin GROUP Ap_ActivePull.DisableLearning.Cnt_lgc "MICROSAR RTE" /begin SUB_GROUP /end SUB_GROUP /begin FUNCTION_LIST /end FUNCTION_LIST /begin REF_CHARACTERISTIC /end REF_CHARACTERISTIC /begin REF_MEASUREMENT Ap_ActivePull.DisableLearning.Cnt_lgc /end REF_MEASUREMENT /end GROUP
/begin GROUP Ap_ActivePull.DisableOutput.Cnt_lgc "MICROSAR RTE" /begin SUB_GROUP /end SUB_GROUP /begin FUNCTION_LIST /end FUNCTION_LIST /begin REF_CHARACTERISTIC /end REF_CHARACTERISTIC /begin REF_MEASUREMENT Ap_ActivePull.DisableOutput.Cnt_lgc /end REF_MEASUREMENT /end GROUP
/begin GROUP Ap_ActivePull.HandwheelAuthority.Uls_f32 "MICROSAR RTE" /begin SUB_GROUP /end SUB_GROUP /begin FUNCTION_LIST /end FUNCTION_LIST /begin REF_CHARACTERISTIC /end REF_CHARACTERISTIC /begin REF_MEASUREMENT Ap_ActivePull.HandwheelAuthority.Uls_f32 /end REF_MEASUREMENT /end GROUP
/begin GROUP Ap_ActivePull.HandwheelPosition.HwDeg_f32 "MICROSAR RTE" /begin SUB_GROUP /end SUB_GROUP /begin FUNCTION_LIST /end FUNCTION_LIST /begin REF_CHARACTERISTIC /end REF_CHARACTERISTIC /begin REF_MEASUREMENT Ap_ActivePull.HandwheelPosition.HwDeg_f32 /end REF_MEASUREMENT /end GROUP
/begin GROUP Ap_ActivePull.HandwheelVelocity.HwRadpS_f32 "MICROSAR RTE" /begin SUB_GROUP /end SUB_GROUP /begin FUNCTION_LIST /end FUNCTION_LIST /begin REF_CHARACTERISTIC /end REF_CHARACTERISTIC /begin REF_MEASUREMENT Ap_ActivePull.HandwheelVelocity.HwRadpS_f32 /end REF_MEASUREMENT /end GROUP
/begin GROUP Ap_ActivePull.HwTorque.HwNm_f32 "MICROSAR RTE" /begin SUB_GROUP /end SUB_GROUP /begin FUNCTION_LIST /end FUNCTION_LIST /begin REF_CHARACTERISTIC /end REF_CHARACTERISTIC /begin REF_MEASUREMENT Ap_ActivePull.HwTorque.HwNm_f32 /end REF_MEASUREMENT /end GROUP
/begin GROUP Ap_ActivePull.ModeRequirePorts "MICROSAR RTE" /begin SUB_GROUP Ap_ActivePull.SystemState.Mode /end SUB_GROUP /begin FUNCTION_LIST /end FUNCTION_LIST /begin REF_CHARACTERISTIC /end REF_CHARACTERISTIC /begin REF_MEASUREMENT /end REF_MEASUREMENT /end GROUP
/begin GROUP Ap_ActivePull.PullCompCmd.MtrNm_f32 "MICROSAR RTE" /begin SUB_GROUP /end SUB_GROUP /begin FUNCTION_LIST /end FUNCTION_LIST /begin REF_CHARACTERISTIC /end REF_CHARACTERISTIC /begin REF_MEASUREMENT Ap_ActivePull.PullCompCmd.MtrNm_f32 /end REF_MEASUREMENT /end GROUP
/begin GROUP Ap_ActivePull.ReceiverPorts "MICROSAR RTE"
 /begin SUB_GROUP Ap_ActivePull.DisableLearning.Cnt_lgc Ap_ActivePull.DisableOutput.Cnt_lgc Ap_ActivePull.HandwheelAuthority.Uls_f32 Ap_ActivePull.HandwheelPosition.HwDeg_f32 Ap_ActivePull.HandwheelVelocity.HwRadpS_f32 Ap_ActivePull.HwTorque.HwNm_f32 Ap_ActivePull.SrlComYawRate.DegpS_f32 Ap_ActivePull.VehicleSpeed.Kph_f32 Ap_ActivePull.VehicleSpeedValid.Cnt_lgc /end SUB_GROUP
 /begin FUNCTION_LIST /end FUNCTION_LIST
 /begin REF_CHARACTERISTIC /end REF_CHARACTERISTIC
 /begin REF_MEASUREMENT /end REF_MEASUREMENT
/end GROUP
/begin GROUP Ap_ActivePull.SenderPorts "MICROSAR RTE" /begin SUB_GROUP Ap_ActivePull.PullCompCmd.MtrNm_f32 /end SUB_GROUP /begin FUNCTION_LIST /end FUNCTION_LIST /begin REF_CHARACTERISTIC /end REF_CHARACTERISTIC /begin REF_MEASUREMENT /end REF_MEASUREMENT /end GROUP
/begin GROUP Ap_ActivePull.SrlComYawRate.DegpS_f32 "MICROSAR RTE" /begin SUB_GROUP /end SUB_GROUP /begin FUNCTION_LIST /end FUNCTION_LIST /begin REF_CHARACTERISTIC /end REF_CHARACTERISTIC /begin REF_MEASUREMENT Ap_ActivePull.SrlComYawRate.DegpS_f32 /end REF_MEASUREMENT /end GROUP
/begin GROUP Ap_ActivePull.SystemState.Mode "MICROSAR RTE" /begin SUB_GROUP /end SUB_GROUP /begin FUNCTION_LIST /end FUNCTION_LIST /begin REF_CHARACTERISTIC /end REF_CHARACTERISTIC /begin REF_MEASUREMENT Ap_ActivePull.SystemState.Mode /end REF_MEASUREMENT /end GROUP
/begin GROUP Ap_ActivePull.VehicleSpeed.Kph_f32 "MICROSAR RTE" /begin SUB_GROUP /end SUB_GROUP /begin FUNCTION_LIST /end FUNCTION_LIST /begin REF_CHARACTERISTIC /end REF_CHARACTERISTIC /begin REF_MEASUREMENT Ap_ActivePull.VehicleSpeed.Kph_f32 /end REF_MEASUREMENT /end GROUP
/begin GROUP Ap_ActivePull.VehicleSpeedValid.Cnt_lgc "MICROSAR RTE" /begin SUB_GROUP /end SUB_GROUP /begin FUNCTION_LIST /end FUNCTION_LIST /begin REF_CHARACTERISTIC /end REF_CHARACTERISTIC /begin REF_MEASUREMENT Ap_ActivePull.VehicleSpeedValid.Cnt_lgc /end REF_MEASUREMENT /end GROUP
/begin GROUP Ap_AssistFirewall "MICROSAR RTE"
 /begin SUB_GROUP Ap_AssistFirewall.ReceiverPorts Ap_AssistFirewall.SenderPorts /end SUB_GROUP
 /begin FUNCTION_LIST /end FUNCTION_LIST
 /begin REF_CHARACTERISTIC /end REF_CHARACTERISTIC
 /begin REF_MEASUREMENT /end REF_MEASUREMENT
/end GROUP
/begin GROUP Ap_AssistFirewall.AsstFirewallActive.Uls_f32 "MICROSAR RTE" /begin SUB_GROUP /end SUB_GROUP /begin FUNCTION_LIST /end FUNCTION_LIST /begin REF_CHARACTERISTIC /end REF_CHARACTERISTIC /begin REF_MEASUREMENT Ap_AssistFirewall.AsstFirewallActive.Uls_f32 /end REF_MEASUREMENT /end GROUP
/begin GROUP Ap_AssistFirewall.BaseAssistCmd.MtrNm_f32 "MICROSAR RTE" /begin SUB_GROUP /end SUB_GROUP /begin FUNCTION_LIST /end FUNCTION_LIST /begin REF_CHARACTERISTIC /end REF_CHARACTERISTIC /begin REF_MEASUREMENT Ap_AssistFirewall.BaseAssistCmd.MtrNm_f32 /end REF_MEASUREMENT /end GROUP
/begin GROUP Ap_AssistFirewall.CombinedAssist.MtrNm_f32 "MICROSAR RTE" /begin SUB_GROUP /end SUB_GROUP /begin FUNCTION_LIST /end FUNCTION_LIST /begin REF_CHARACTERISTIC /end REF_CHARACTERISTIC /begin REF_MEASUREMENT Ap_AssistFirewall.CombinedAssist.MtrNm_f32 /end REF_MEASUREMENT /end GROUP
/begin GROUP Ap_AssistFirewall.Defeat_AsstTbl_Service.Cnt_lgc "MICROSAR RTE" /begin SUB_GROUP /end SUB_GROUP /begin FUNCTION_LIST /end FUNCTION_LIST /begin REF_CHARACTERISTIC /end REF_CHARACTERISTIC /begin REF_MEASUREMENT Ap_AssistFirewall.Defeat_AsstTbl_Service.Cnt_lgc /end REF_MEASUREMENT /end GROUP
/begin GROUP Ap_AssistFirewall.HighFreqAssist.MtrNm_f32 "MICROSAR RTE" /begin SUB_GROUP /end SUB_GROUP /begin FUNCTION_LIST /end FUNCTION_LIST /begin REF_CHARACTERISTIC /end REF_CHARACTERISTIC /begin REF_MEASUREMENT Ap_AssistFirewall.HighFreqAssist.MtrNm_f32 /end REF_MEASUREMENT /end GROUP
/begin GROUP Ap_AssistFirewall.HwTorque.HwNm_f32 "MICROSAR RTE" /begin SUB_GROUP /end SUB_GROUP /begin FUNCTION_LIST /end FUNCTION_LIST /begin REF_CHARACTERISTIC /end REF_CHARACTERISTIC /begin REF_MEASUREMENT Ap_AssistFirewall.HwTorque.HwNm_f32 /end REF_MEASUREMENT /end GROUP
/begin GROUP Ap_AssistFirewall.HysteresisComp.MtrNm_f32 "MICROSAR RTE" /begin SUB_GROUP /end SUB_GROUP /begin FUNCTION_LIST /end FUNCTION_LIST /begin REF_CHARACTERISTIC /end REF_CHARACTERISTIC /begin REF_MEASUREMENT Ap_AssistFirewall.HysteresisComp.MtrNm_f32 /end REF_MEASUREMENT /end GROUP
/begin GROUP Ap_AssistFirewall.MEC_Counter.Cnt_enum "MICROSAR RTE" /begin SUB_GROUP /end SUB_GROUP /begin FUNCTION_LIST /end FUNCTION_LIST /begin REF_CHARACTERISTIC /end REF_CHARACTERISTIC /begin REF_MEASUREMENT Ap_AssistFirewall.MEC_Counter.Cnt_enum /end REF_MEASUREMENT /end GROUP
/begin GROUP Ap_AssistFirewall.ReceiverPorts "MICROSAR RTE"
 /begin SUB_GROUP Ap_AssistFirewall.BaseAssistCmd.MtrNm_f32 Ap_AssistFirewall.Defeat_AsstTbl_Service.Cnt_lgc Ap_AssistFirewall.HighFreqAssist.MtrNm_f32 Ap_AssistFirewall.HwTorque.HwNm_f32 Ap_AssistFirewall.HysteresisComp.MtrNm_f32 Ap_AssistFirewall.MEC_Counter.Cnt_enum Ap_AssistFirewall.VehicleSpeed.Kph_f32 /end SUB_GROUP
 /begin FUNCTION_LIST /end FUNCTION_LIST
 /begin REF_CHARACTERISTIC /end REF_CHARACTERISTIC
 /begin REF_MEASUREMENT /end REF_MEASUREMENT
/end GROUP
/begin GROUP Ap_AssistFirewall.SenderPorts "MICROSAR RTE"
 /begin SUB_GROUP Ap_AssistFirewall.AsstFirewallActive.Uls_f32 Ap_AssistFirewall.CombinedAssist.MtrNm_f32 /end SUB_GROUP
 /begin FUNCTION_LIST /end FUNCTION_LIST
 /begin REF_CHARACTERISTIC /end REF_CHARACTERISTIC
 /begin REF_MEASUREMENT /end REF_MEASUREMENT
/end GROUP
/begin GROUP Ap_AssistFirewall.VehicleSpeed.Kph_f32 "MICROSAR RTE" /begin SUB_GROUP /end SUB_GROUP /begin FUNCTION_LIST /end FUNCTION_LIST /begin REF_CHARACTERISTIC /end REF_CHARACTERISTIC /begin REF_MEASUREMENT Ap_AssistFirewall.VehicleSpeed.Kph_f32 /end REF_MEASUREMENT /end GROUP
/begin GROUP Ap_AstLmt "MICROSAR RTE"
 /begin SUB_GROUP Ap_AstLmt.PerInstanceMemories Ap_AstLmt.ReceiverPorts Ap_AstLmt.SenderPorts /end SUB_GROUP
 /begin FUNCTION_LIST /end FUNCTION_LIST
 /begin REF_CHARACTERISTIC /end REF_CHARACTERISTIC
 /begin REF_MEASUREMENT /end REF_MEASUREMENT
/end GROUP
/begin GROUP Ap_AstLmt.AssistCmd.MtrNm_f32 "MICROSAR RTE" /begin SUB_GROUP /end SUB_GROUP /begin FUNCTION_LIST /end FUNCTION_LIST /begin REF_CHARACTERISTIC /end REF_CHARACTERISTIC /begin REF_MEASUREMENT Ap_AstLmt.AssistCmd.MtrNm_f32 /end REF_MEASUREMENT /end GROUP
/begin GROUP Ap_AstLmt.AssistEOTDamping.MtrNm_f32 "MICROSAR RTE" /begin SUB_GROUP /end SUB_GROUP /begin FUNCTION_LIST /end FUNCTION_LIST /begin REF_CHARACTERISTIC /end REF_CHARACTERISTIC /begin REF_MEASUREMENT Ap_AstLmt.AssistEOTDamping.MtrNm_f32 /end REF_MEASUREMENT /end GROUP
/begin GROUP Ap_AstLmt.AssistEOTGain.Uls_f32 "MICROSAR RTE" /begin SUB_GROUP /end SUB_GROUP /begin FUNCTION_LIST /end FUNCTION_LIST /begin REF_CHARACTERISTIC /end REF_CHARACTERISTIC /begin REF_MEASUREMENT Ap_AstLmt.AssistEOTGain.Uls_f32 /end REF_MEASUREMENT /end GROUP
/begin GROUP Ap_AstLmt.AssistEOTLimit.MtrNm_f32 "MICROSAR RTE" /begin SUB_GROUP /end SUB_GROUP /begin FUNCTION_LIST /end FUNCTION_LIST /begin REF_CHARACTERISTIC /end REF_CHARACTERISTIC /begin REF_MEASUREMENT Ap_AstLmt.AssistEOTLimit.MtrNm_f32 /end REF_MEASUREMENT /end GROUP
/begin GROUP Ap_AstLmt.AssistStallLimit.MtrNm_f32 "MICROSAR RTE" /begin SUB_GROUP /end SUB_GROUP /begin FUNCTION_LIST /end FUNCTION_LIST /begin REF_CHARACTERISTIC /end REF_CHARACTERISTIC /begin REF_MEASUREMENT Ap_AstLmt.AssistStallLimit.MtrNm_f32 /end REF_MEASUREMENT /end GROUP
/begin GROUP Ap_AstLmt.AssistVehSpdLimit.MtrNm_f32 "MICROSAR RTE" /begin SUB_GROUP /end SUB_GROUP /begin FUNCTION_LIST /end FUNCTION_LIST /begin REF_CHARACTERISTIC /end REF_CHARACTERISTIC /begin REF_MEASUREMENT Ap_AstLmt.AssistVehSpdLimit.MtrNm_f32 /end REF_MEASUREMENT /end GROUP
/begin GROUP Ap_AstLmt.CombinedDamping.MtrNm_f32 "MICROSAR RTE" /begin SUB_GROUP /end SUB_GROUP /begin FUNCTION_LIST /end FUNCTION_LIST /begin REF_CHARACTERISTIC /end REF_CHARACTERISTIC /begin REF_MEASUREMENT Ap_AstLmt.CombinedDamping.MtrNm_f32 /end REF_MEASUREMENT /end GROUP
/begin GROUP Ap_AstLmt.DefeatLimitService.Cnt_lgc "MICROSAR RTE" /begin SUB_GROUP /end SUB_GROUP /begin FUNCTION_LIST /end FUNCTION_LIST /begin REF_CHARACTERISTIC /end REF_CHARACTERISTIC /begin REF_MEASUREMENT Ap_AstLmt.DefeatLimitService.Cnt_lgc /end REF_MEASUREMENT /end GROUP
/begin GROUP Ap_AstLmt.LimitPercentFiltered.Uls_f32 "MICROSAR RTE" /begin SUB_GROUP /end SUB_GROUP /begin FUNCTION_LIST /end FUNCTION_LIST /begin REF_CHARACTERISTIC /end REF_CHARACTERISTIC /begin REF_MEASUREMENT Ap_AstLmt.LimitPercentFiltered.Uls_f32 /end REF_MEASUREMENT /end GROUP
/begin GROUP Ap_AstLmt.LimitedReturn.MtrNm_f32 "MICROSAR RTE" /begin SUB_GROUP /end SUB_GROUP /begin FUNCTION_LIST /end FUNCTION_LIST /begin REF_CHARACTERISTIC /end REF_CHARACTERISTIC /begin REF_MEASUREMENT Ap_AstLmt.LimitedReturn.MtrNm_f32 /end REF_MEASUREMENT /end GROUP
/begin GROUP Ap_AstLmt.LrnPnCtrCCDisable.Cnt_lgc "MICROSAR RTE" /begin SUB_GROUP /end SUB_GROUP /begin FUNCTION_LIST /end FUNCTION_LIST /begin REF_CHARACTERISTIC /end REF_CHARACTERISTIC /begin REF_MEASUREMENT Ap_AstLmt.LrnPnCtrCCDisable.Cnt_lgc /end REF_MEASUREMENT /end GROUP
/begin GROUP Ap_AstLmt.LrnPnCtrEnable.Cnt_lgc "MICROSAR RTE" /begin SUB_GROUP /end SUB_GROUP /begin FUNCTION_LIST /end FUNCTION_LIST /begin REF_CHARACTERISTIC /end REF_CHARACTERISTIC /begin REF_MEASUREMENT Ap_AstLmt.LrnPnCtrEnable.Cnt_lgc /end REF_MEASUREMENT /end GROUP
/begin GROUP Ap_AstLmt.LrnPnCtrTCmd.MtrNm_f32 "MICROSAR RTE" /begin SUB_GROUP /end SUB_GROUP /begin FUNCTION_LIST /end FUNCTION_LIST /begin REF_CHARACTERISTIC /end REF_CHARACTERISTIC /begin REF_MEASUREMENT Ap_AstLmt.LrnPnCtrTCmd.MtrNm_f32 /end REF_MEASUREMENT /end GROUP
/begin GROUP Ap_AstLmt.OpTrqOvr.MtrNm_f32 "MICROSAR RTE" /begin SUB_GROUP /end SUB_GROUP /begin FUNCTION_LIST /end FUNCTION_LIST /begin REF_CHARACTERISTIC /end REF_CHARACTERISTIC /begin REF_MEASUREMENT Ap_AstLmt.OpTrqOvr.MtrNm_f32 /end REF_MEASUREMENT /end GROUP
/begin GROUP Ap_AstLmt.OutputRampMult.Uls_f32 "MICROSAR RTE" /begin SUB_GROUP /end SUB_GROUP /begin FUNCTION_LIST /end FUNCTION_LIST /begin REF_CHARACTERISTIC /end REF_CHARACTERISTIC /begin REF_MEASUREMENT Ap_AstLmt.OutputRampMult.Uls_f32 /end REF_MEASUREMENT /end GROUP
/begin GROUP Ap_AstLmt.PerInstanceMemories "MICROSAR RTE" /begin SUB_GROUP Ap_AstLmt.SteerAsstDefeat /end SUB_GROUP /begin FUNCTION_LIST /end FUNCTION_LIST /begin REF_CHARACTERISTIC /end REF_CHARACTERISTIC /begin REF_MEASUREMENT /end REF_MEASUREMENT /end GROUP
/begin GROUP Ap_AstLmt.PosServCCDisable.Cnt_lgc "MICROSAR RTE" /begin SUB_GROUP /end SUB_GROUP /begin FUNCTION_LIST /end FUNCTION_LIST /begin REF_CHARACTERISTIC /end REF_CHARACTERISTIC /begin REF_MEASUREMENT Ap_AstLmt.PosServCCDisable.Cnt_lgc /end REF_MEASUREMENT /end GROUP
/begin GROUP Ap_AstLmt.PowerLimitPerc.Uls_f32 "MICROSAR RTE" /begin SUB_GROUP /end SUB_GROUP /begin FUNCTION_LIST /end FUNCTION_LIST /begin REF_CHARACTERISTIC /end REF_CHARACTERISTIC /begin REF_MEASUREMENT Ap_AstLmt.PowerLimitPerc.Uls_f32 /end REF_MEASUREMENT /end GROUP
/begin GROUP Ap_AstLmt.PreLimitForStall.MtrNm_f32 "MICROSAR RTE" /begin SUB_GROUP /end SUB_GROUP /begin FUNCTION_LIST /end FUNCTION_LIST /begin REF_CHARACTERISTIC /end REF_CHARACTERISTIC /begin REF_MEASUREMENT Ap_AstLmt.PreLimitForStall.MtrNm_f32 /end REF_MEASUREMENT /end GROUP
/begin GROUP Ap_AstLmt.PreLimitTorque.MtrNm_f32 "MICROSAR RTE" /begin SUB_GROUP /end SUB_GROUP /begin FUNCTION_LIST /end FUNCTION_LIST /begin REF_CHARACTERISTIC /end REF_CHARACTERISTIC /begin REF_MEASUREMENT Ap_AstLmt.PreLimitTorque.MtrNm_f32 /end REF_MEASUREMENT /end GROUP
/begin GROUP Ap_AstLmt.PrkAssistCmd.MtrNm_f32 "MICROSAR RTE" /begin SUB_GROUP /end SUB_GROUP /begin FUNCTION_LIST /end FUNCTION_LIST /begin REF_CHARACTERISTIC /end REF_CHARACTERISTIC /begin REF_MEASUREMENT Ap_AstLmt.PrkAssistCmd.MtrNm_f32 /end REF_MEASUREMENT /end GROUP
/begin GROUP Ap_AstLmt.PullCompCmd.MtrNm_f32 "MICROSAR RTE" /begin SUB_GROUP /end SUB_GROUP /begin FUNCTION_LIST /end FUNCTION_LIST /begin REF_CHARACTERISTIC /end REF_CHARACTERISTIC /begin REF_MEASUREMENT Ap_AstLmt.PullCompCmd.MtrNm_f32 /end REF_MEASUREMENT /end GROUP
/begin GROUP Ap_AstLmt.ReceiverPorts "MICROSAR RTE"
 /begin SUB_GROUP Ap_AstLmt.AssistCmd.MtrNm_f32 Ap_AstLmt.AssistEOTDamping.MtrNm_f32 Ap_AstLmt.AssistEOTGain.Uls_f32 Ap_AstLmt.AssistEOTLimit.MtrNm_f32 Ap_AstLmt.AssistStallLimit.MtrNm_f32 Ap_AstLmt.AssistVehSpdLimit.MtrNm_f32 Ap_AstLmt.CombinedDamping.MtrNm_f32 Ap_AstLmt.DefeatLimitService.Cnt_lgc Ap_AstLmt.LimitedReturn.MtrNm_f32 Ap_AstLmt.LrnPnCtrCCDisable.Cnt_lgc Ap_AstLmt.LrnPnCtrEnable.Cnt_lgc Ap_AstLmt.LrnPnCtrTCmd.MtrNm_f32 Ap_AstLmt.OpTrqOvr.MtrNm_f32 Ap_AstLmt.OutputRampMult.Uls_f32 Ap_AstLmt.PosServCCDisable.Cnt_lgc Ap_AstLmt.PowerLimitPerc.Uls_f32 Ap_AstLmt.PrkAssistCmd.MtrNm_f32 Ap_AstLmt.PullCompCmd.MtrNm_f32 Ap_AstLmt.TSMitCommand.MtrNm_f32 Ap_AstLmt.ThermalLimit.MtrNm_f32 Ap_AstLmt.ThermalLimitPerc.Uls_f32 Ap_AstLmt.VehSpd.Kph_f32 Ap_AstLmt.WheelImbalanceCmd.MtrNm_f32 /end SUB_GROUP
 /begin FUNCTION_LIST /end FUNCTION_LIST
 /begin REF_CHARACTERISTIC /end REF_CHARACTERISTIC
 /begin REF_MEASUREMENT /end REF_MEASUREMENT
/end GROUP
/begin GROUP Ap_AstLmt.SenderPorts "MICROSAR RTE"
 /begin SUB_GROUP Ap_AstLmt.LimitPercentFiltered.Uls_f32 Ap_AstLmt.PreLimitForStall.MtrNm_f32 Ap_AstLmt.PreLimitTorque.MtrNm_f32 Ap_AstLmt.SumLimTrqCmd.MtrNm_f32 Ap_AstLmt.TrqLimitMin.MtrNm_f32 /end SUB_GROUP
 /begin FUNCTION_LIST /end FUNCTION_LIST
 /begin REF_CHARACTERISTIC /end REF_CHARACTERISTIC
 /begin REF_MEASUREMENT /end REF_MEASUREMENT
/end GROUP
/begin GROUP Ap_AstLmt.SteerAsstDefeat "MICROSAR RTE" /begin SUB_GROUP /end SUB_GROUP /begin FUNCTION_LIST /end FUNCTION_LIST /begin REF_CHARACTERISTIC /end REF_CHARACTERISTIC /begin REF_MEASUREMENT Ap_AstLmt.SteerAsstDefeat /end REF_MEASUREMENT /end GROUP
/begin GROUP Ap_AstLmt.SumLimTrqCmd.MtrNm_f32 "MICROSAR RTE" /begin SUB_GROUP /end SUB_GROUP /begin FUNCTION_LIST /end FUNCTION_LIST /begin REF_CHARACTERISTIC /end REF_CHARACTERISTIC /begin REF_MEASUREMENT Ap_AstLmt.SumLimTrqCmd.MtrNm_f32 /end REF_MEASUREMENT /end GROUP
/begin GROUP Ap_AstLmt.TSMitCommand.MtrNm_f32 "MICROSAR RTE" /begin SUB_GROUP /end SUB_GROUP /begin FUNCTION_LIST /end FUNCTION_LIST /begin REF_CHARACTERISTIC /end REF_CHARACTERISTIC /begin REF_MEASUREMENT Ap_AstLmt.TSMitCommand.MtrNm_f32 /end REF_MEASUREMENT /end GROUP
/begin GROUP Ap_AstLmt.ThermalLimit.MtrNm_f32 "MICROSAR RTE" /begin SUB_GROUP /end SUB_GROUP /begin FUNCTION_LIST /end FUNCTION_LIST /begin REF_CHARACTERISTIC /end REF_CHARACTERISTIC /begin REF_MEASUREMENT Ap_AstLmt.ThermalLimit.MtrNm_f32 /end REF_MEASUREMENT /end GROUP
/begin GROUP Ap_AstLmt.ThermalLimitPerc.Uls_f32 "MICROSAR RTE" /begin SUB_GROUP /end SUB_GROUP /begin FUNCTION_LIST /end FUNCTION_LIST /begin REF_CHARACTERISTIC /end REF_CHARACTERISTIC /begin REF_MEASUREMENT Ap_AstLmt.ThermalLimitPerc.Uls_f32 /end REF_MEASUREMENT /end GROUP
/begin GROUP Ap_AstLmt.TrqLimitMin.MtrNm_f32 "MICROSAR RTE" /begin SUB_GROUP /end SUB_GROUP /begin FUNCTION_LIST /end FUNCTION_LIST /begin REF_CHARACTERISTIC /end REF_CHARACTERISTIC /begin REF_MEASUREMENT Ap_AstLmt.TrqLimitMin.MtrNm_f32 /end REF_MEASUREMENT /end GROUP
/begin GROUP Ap_AstLmt.VehSpd.Kph_f32 "MICROSAR RTE" /begin SUB_GROUP /end SUB_GROUP /begin FUNCTION_LIST /end FUNCTION_LIST /begin REF_CHARACTERISTIC /end REF_CHARACTERISTIC /begin REF_MEASUREMENT Ap_AstLmt.VehSpd.Kph_f32 /end REF_MEASUREMENT /end GROUP
/begin GROUP Ap_AstLmt.WheelImbalanceCmd.MtrNm_f32 "MICROSAR RTE" /begin SUB_GROUP /end SUB_GROUP /begin FUNCTION_LIST /end FUNCTION_LIST /begin REF_CHARACTERISTIC /end REF_CHARACTERISTIC /begin REF_MEASUREMENT Ap_AstLmt.WheelImbalanceCmd.MtrNm_f32 /end REF_MEASUREMENT /end GROUP
/begin GROUP Ap_AvgFricLrn "MICROSAR RTE"
 /begin SUB_GROUP Ap_AvgFricLrn.ModeRequirePorts Ap_AvgFricLrn.PerInstanceMemories Ap_AvgFricLrn.ReceiverPorts Ap_AvgFricLrn.SenderPorts /end SUB_GROUP
 /begin FUNCTION_LIST /end FUNCTION_LIST
 /begin REF_CHARACTERISTIC /end REF_CHARACTERISTIC
 /begin REF_MEASUREMENT /end REF_MEASUREMENT
/end GROUP
/begin GROUP Ap_AvgFricLrn.AvgFricLrnData "MICROSAR RTE" /begin SUB_GROUP /end SUB_GROUP /begin FUNCTION_LIST /end FUNCTION_LIST /begin REF_CHARACTERISTIC /end REF_CHARACTERISTIC
 /begin REF_MEASUREMENT Ap_AvgFricLrn.AvgFricLrnData.EOLFric_HwNm_f32 Ap_AvgFricLrn.AvgFricLrnData.EnableFricLearning_Cnt_lgc Ap_AvgFricLrn.AvgFricLrnData.EnableFricOffsetOutput_Cnt_lgc Ap_AvgFricLrn.AvgFricLrnData.FricOffset_HwNm_f32 Ap_AvgFricLrn.AvgFricLrnData.OpMode_Cnt_enum Ap_AvgFricLrn.AvgFricLrnData.RangeCounter_Cnt_u16 Ap_AvgFricLrn.AvgFricLrnData.Theta_HwNm_f32 Ap_AvgFricLrn.AvgFricLrnData.VehLearnedFric_HwNm_f32 /end REF_MEASUREMENT
/end GROUP
/begin GROUP Ap_AvgFricLrn.CRFMtrTrq.MtrNm_f32 "MICROSAR RTE" /begin SUB_GROUP /end SUB_GROUP /begin FUNCTION_LIST /end FUNCTION_LIST /begin REF_CHARACTERISTIC /end REF_CHARACTERISTIC /begin REF_MEASUREMENT Ap_AvgFricLrn.CRFMtrTrq.MtrNm_f32 /end REF_MEASUREMENT /end GROUP
/begin GROUP Ap_AvgFricLrn.DefeatFricLearning.Cnt_lgc "MICROSAR RTE" /begin SUB_GROUP /end SUB_GROUP /begin FUNCTION_LIST /end FUNCTION_LIST /begin REF_CHARACTERISTIC /end REF_CHARACTERISTIC /begin REF_MEASUREMENT Ap_AvgFricLrn.DefeatFricLearning.Cnt_lgc /end REF_MEASUREMENT /end GROUP
/begin GROUP Ap_AvgFricLrn.EstFric.HwNm_f32 "MICROSAR RTE" /begin SUB_GROUP /end SUB_GROUP /begin FUNCTION_LIST /end FUNCTION_LIST /begin REF_CHARACTERISTIC /end REF_CHARACTERISTIC /begin REF_MEASUREMENT Ap_AvgFricLrn.EstFric.HwNm_f32 /end REF_MEASUREMENT /end GROUP
/begin GROUP Ap_AvgFricLrn.FricOffset.HwNm_f32 "MICROSAR RTE" /begin SUB_GROUP /end SUB_GROUP /begin FUNCTION_LIST /end FUNCTION_LIST /begin REF_CHARACTERISTIC /end REF_CHARACTERISTIC /begin REF_MEASUREMENT Ap_AvgFricLrn.FricOffset.HwNm_f32 /end REF_MEASUREMENT /end GROUP
/begin GROUP Ap_AvgFricLrn.HwAng.HwDeg_f32 "MICROSAR RTE" /begin SUB_GROUP /end SUB_GROUP /begin FUNCTION_LIST /end FUNCTION_LIST /begin REF_CHARACTERISTIC /end REF_CHARACTERISTIC /begin REF_MEASUREMENT Ap_AvgFricLrn.HwAng.HwDeg_f32 /end REF_MEASUREMENT /end GROUP
/begin GROUP Ap_AvgFricLrn.HwPosAuthority.Uls_f32 "MICROSAR RTE" /begin SUB_GROUP /end SUB_GROUP /begin FUNCTION_LIST /end FUNCTION_LIST /begin REF_CHARACTERISTIC /end REF_CHARACTERISTIC /begin REF_MEASUREMENT Ap_AvgFricLrn.HwPosAuthority.Uls_f32 /end REF_MEASUREMENT /end GROUP
/begin GROUP Ap_AvgFricLrn.HwTrq.HwNm_f32 "MICROSAR RTE" /begin SUB_GROUP /end SUB_GROUP /begin FUNCTION_LIST /end FUNCTION_LIST /begin REF_CHARACTERISTIC /end REF_CHARACTERISTIC /begin REF_MEASUREMENT Ap_AvgFricLrn.HwTrq.HwNm_f32 /end REF_MEASUREMENT /end GROUP
/begin GROUP Ap_AvgFricLrn.HwVel.HwRadpS_f32 "MICROSAR RTE" /begin SUB_GROUP /end SUB_GROUP /begin FUNCTION_LIST /end FUNCTION_LIST /begin REF_CHARACTERISTIC /end REF_CHARACTERISTIC /begin REF_MEASUREMENT Ap_AvgFricLrn.HwVel.HwRadpS_f32 /end REF_MEASUREMENT /end GROUP
/begin GROUP Ap_AvgFricLrn.LatAcc.g_f32 "MICROSAR RTE" /begin SUB_GROUP /end SUB_GROUP /begin FUNCTION_LIST /end FUNCTION_LIST /begin REF_CHARACTERISTIC /end REF_CHARACTERISTIC /begin REF_MEASUREMENT Ap_AvgFricLrn.LatAcc.g_f32 /end REF_MEASUREMENT /end GROUP
/begin GROUP Ap_AvgFricLrn.ModeRequirePorts "MICROSAR RTE" /begin SUB_GROUP Ap_AvgFricLrn.SystemState.Mode /end SUB_GROUP /begin FUNCTION_LIST /end FUNCTION_LIST /begin REF_CHARACTERISTIC /end REF_CHARACTERISTIC /begin REF_MEASUREMENT /end REF_MEASUREMENT /end GROUP
/begin GROUP Ap_AvgFricLrn.PerInstanceMemories "MICROSAR RTE" /begin SUB_GROUP Ap_AvgFricLrn.AvgFricLrnData /end SUB_GROUP /begin FUNCTION_LIST /end FUNCTION_LIST /begin REF_CHARACTERISTIC /end REF_CHARACTERISTIC /begin REF_MEASUREMENT /end REF_MEASUREMENT /end GROUP
/begin GROUP Ap_AvgFricLrn.ReceiverPorts "MICROSAR RTE"
 /begin SUB_GROUP Ap_AvgFricLrn.CRFMtrTrq.MtrNm_f32 Ap_AvgFricLrn.DefeatFricLearning.Cnt_lgc Ap_AvgFricLrn.HwAng.HwDeg_f32 Ap_AvgFricLrn.HwPosAuthority.Uls_f32 Ap_AvgFricLrn.HwTrq.HwNm_f32 Ap_AvgFricLrn.HwVel.HwRadpS_f32 Ap_AvgFricLrn.LatAcc.g_f32 Ap_AvgFricLrn.Temperature.DegC_f32 Ap_AvgFricLrn.VehSpd.Kph_f32 Ap_AvgFricLrn.VehicleSpeedValid.Cnt_lgc /end SUB_GROUP
 /begin FUNCTION_LIST /end FUNCTION_LIST
 /begin REF_CHARACTERISTIC /end REF_CHARACTERISTIC
 /begin REF_MEASUREMENT /end REF_MEASUREMENT
/end GROUP
/begin GROUP Ap_AvgFricLrn.SatEstFric.HwNm_f32 "MICROSAR RTE" /begin SUB_GROUP /end SUB_GROUP /begin FUNCTION_LIST /end FUNCTION_LIST /begin REF_CHARACTERISTIC /end REF_CHARACTERISTIC /begin REF_MEASUREMENT Ap_AvgFricLrn.SatEstFric.HwNm_f32 /end REF_MEASUREMENT /end GROUP
/begin GROUP Ap_AvgFricLrn.SenderPorts "MICROSAR RTE"
 /begin SUB_GROUP Ap_AvgFricLrn.EstFric.HwNm_f32 Ap_AvgFricLrn.FricOffset.HwNm_f32 Ap_AvgFricLrn.SatEstFric.HwNm_f32 /end SUB_GROUP
 /begin FUNCTION_LIST /end FUNCTION_LIST
 /begin REF_CHARACTERISTIC /end REF_CHARACTERISTIC
 /begin REF_MEASUREMENT /end REF_MEASUREMENT
/end GROUP
/begin GROUP Ap_AvgFricLrn.SystemState.Mode "MICROSAR RTE" /begin SUB_GROUP /end SUB_GROUP /begin FUNCTION_LIST /end FUNCTION_LIST /begin REF_CHARACTERISTIC /end REF_CHARACTERISTIC /begin REF_MEASUREMENT Ap_AvgFricLrn.SystemState.Mode /end REF_MEASUREMENT /end GROUP
/begin GROUP Ap_AvgFricLrn.Temperature.DegC_f32 "MICROSAR RTE" /begin SUB_GROUP /end SUB_GROUP /begin FUNCTION_LIST /end FUNCTION_LIST /begin REF_CHARACTERISTIC /end REF_CHARACTERISTIC /begin REF_MEASUREMENT Ap_AvgFricLrn.Temperature.DegC_f32 /end REF_MEASUREMENT /end GROUP
/begin GROUP Ap_AvgFricLrn.VehSpd.Kph_f32 "MICROSAR RTE" /begin SUB_GROUP /end SUB_GROUP /begin FUNCTION_LIST /end FUNCTION_LIST /begin REF_CHARACTERISTIC /end REF_CHARACTERISTIC /begin REF_MEASUREMENT Ap_AvgFricLrn.VehSpd.Kph_f32 /end REF_MEASUREMENT /end GROUP
/begin GROUP Ap_AvgFricLrn.VehicleSpeedValid.Cnt_lgc "MICROSAR RTE" /begin SUB_GROUP /end SUB_GROUP /begin FUNCTION_LIST /end FUNCTION_LIST /begin REF_CHARACTERISTIC /end REF_CHARACTERISTIC /begin REF_MEASUREMENT Ap_AvgFricLrn.VehicleSpeedValid.Cnt_lgc /end REF_MEASUREMENT /end GROUP
/begin GROUP Ap_BVDiag "MICROSAR RTE" /begin SUB_GROUP Ap_BVDiag.ReceiverPorts /end SUB_GROUP /begin FUNCTION_LIST /end FUNCTION_LIST /begin REF_CHARACTERISTIC /end REF_CHARACTERISTIC /begin REF_MEASUREMENT /end REF_MEASUREMENT /end GROUP
/begin GROUP Ap_BVDiag.Batt.Volt_f32 "MICROSAR RTE" /begin SUB_GROUP /end SUB_GROUP /begin FUNCTION_LIST /end FUNCTION_LIST /begin REF_CHARACTERISTIC /end REF_CHARACTERISTIC /begin REF_MEASUREMENT Ap_BVDiag.Batt.Volt_f32 /end REF_MEASUREMENT /end GROUP
/begin GROUP Ap_BVDiag.ReceiverPorts "MICROSAR RTE" /begin SUB_GROUP Ap_BVDiag.Batt.Volt_f32 /end SUB_GROUP /begin FUNCTION_LIST /end FUNCTION_LIST /begin REF_CHARACTERISTIC /end REF_CHARACTERISTIC /begin REF_MEASUREMENT /end REF_MEASUREMENT /end GROUP
/begin GROUP Ap_DampingFirewall "MICROSAR RTE"
 /begin SUB_GROUP Ap_DampingFirewall.ModeRequirePorts Ap_DampingFirewall.ReceiverPorts Ap_DampingFirewall.SenderPorts /end SUB_GROUP
 /begin FUNCTION_LIST /end FUNCTION_LIST
 /begin REF_CHARACTERISTIC /end REF_CHARACTERISTIC
 /begin REF_MEASUREMENT /end REF_MEASUREMENT
/end GROUP
/begin GROUP Ap_DampingFirewall.AsstFirewallActive.Uls_f32 "MICROSAR RTE" /begin SUB_GROUP /end SUB_GROUP /begin FUNCTION_LIST /end FUNCTION_LIST /begin REF_CHARACTERISTIC /end REF_CHARACTERISTIC /begin REF_MEASUREMENT Ap_DampingFirewall.AsstFirewallActive.Uls_f32 /end REF_MEASUREMENT /end GROUP
/begin GROUP Ap_DampingFirewall.BaseAssistCmd.MtrNm_f32 "MICROSAR RTE" /begin SUB_GROUP /end SUB_GROUP /begin FUNCTION_LIST /end FUNCTION_LIST /begin REF_CHARACTERISTIC /end REF_CHARACTERISTIC /begin REF_MEASUREMENT Ap_DampingFirewall.BaseAssistCmd.MtrNm_f32 /end REF_MEASUREMENT /end GROUP
/begin GROUP Ap_DampingFirewall.CombinedDamping.MtrNm_f32 "MICROSAR RTE" /begin SUB_GROUP /end SUB_GROUP /begin FUNCTION_LIST /end FUNCTION_LIST /begin REF_CHARACTERISTIC /end REF_CHARACTERISTIC /begin REF_MEASUREMENT Ap_DampingFirewall.CombinedDamping.MtrNm_f32 /end REF_MEASUREMENT /end GROUP
/begin GROUP Ap_DampingFirewall.DampingCmd.MtrNm_f32 "MICROSAR RTE" /begin SUB_GROUP /end SUB_GROUP /begin FUNCTION_LIST /end FUNCTION_LIST /begin REF_CHARACTERISTIC /end REF_CHARACTERISTIC /begin REF_MEASUREMENT Ap_DampingFirewall.DampingCmd.MtrNm_f32 /end REF_MEASUREMENT /end GROUP
/begin GROUP Ap_DampingFirewall.Defeat_Damping_Svc.Cnt_lgc "MICROSAR RTE" /begin SUB_GROUP /end SUB_GROUP /begin FUNCTION_LIST /end FUNCTION_LIST /begin REF_CHARACTERISTIC /end REF_CHARACTERISTIC /begin REF_MEASUREMENT Ap_DampingFirewall.Defeat_Damping_Svc.Cnt_lgc /end REF_MEASUREMENT /end GROUP
/begin GROUP Ap_DampingFirewall.FreqDepDmpSrlComSvcDft.Cnt_lgc "MICROSAR RTE" /begin SUB_GROUP /end SUB_GROUP /begin FUNCTION_LIST /end FUNCTION_LIST /begin REF_CHARACTERISTIC /end REF_CHARACTERISTIC /begin REF_MEASUREMENT Ap_DampingFirewall.FreqDepDmpSrlComSvcDft.Cnt_lgc /end REF_MEASUREMENT /end GROUP
/begin GROUP Ap_DampingFirewall.HwTorque.HwNm_f32 "MICROSAR RTE" /begin SUB_GROUP /end SUB_GROUP /begin FUNCTION_LIST /end FUNCTION_LIST /begin REF_CHARACTERISTIC /end REF_CHARACTERISTIC /begin REF_MEASUREMENT Ap_DampingFirewall.HwTorque.HwNm_f32 /end REF_MEASUREMENT /end GROUP
/begin GROUP Ap_DampingFirewall.InertiaComp.MtrNm_f32 "MICROSAR RTE" /begin SUB_GROUP /end SUB_GROUP /begin FUNCTION_LIST /end FUNCTION_LIST /begin REF_CHARACTERISTIC /end REF_CHARACTERISTIC /begin REF_MEASUREMENT Ap_DampingFirewall.InertiaComp.MtrNm_f32 /end REF_MEASUREMENT /end GROUP
/begin GROUP Ap_DampingFirewall.MEC_Counter.Cnt_enum "MICROSAR RTE" /begin SUB_GROUP /end SUB_GROUP /begin FUNCTION_LIST /end FUNCTION_LIST /begin REF_CHARACTERISTIC /end REF_CHARACTERISTIC /begin REF_MEASUREMENT Ap_DampingFirewall.MEC_Counter.Cnt_enum /end REF_MEASUREMENT /end GROUP
/begin GROUP Ap_DampingFirewall.ModeRequirePorts "MICROSAR RTE" /begin SUB_GROUP Ap_DampingFirewall.SystemState.Mode /end SUB_GROUP /begin FUNCTION_LIST /end FUNCTION_LIST /begin REF_CHARACTERISTIC /end REF_CHARACTERISTIC /begin REF_MEASUREMENT /end REF_MEASUREMENT /end GROUP
/begin GROUP Ap_DampingFirewall.MtrVelCRF.MtrRadpS_f32 "MICROSAR RTE" /begin SUB_GROUP /end SUB_GROUP /begin FUNCTION_LIST /end FUNCTION_LIST /begin REF_CHARACTERISTIC /end REF_CHARACTERISTIC /begin REF_MEASUREMENT Ap_DampingFirewall.MtrVelCRF.MtrRadpS_f32 /end REF_MEASUREMENT /end GROUP
/begin GROUP Ap_DampingFirewall.ReceiverPorts "MICROSAR RTE"
 /begin SUB_GROUP Ap_DampingFirewall.AsstFirewallActive.Uls_f32 Ap_DampingFirewall.BaseAssistCmd.MtrNm_f32 Ap_DampingFirewall.DampingCmd.MtrNm_f32 Ap_DampingFirewall.Defeat_Damping_Svc.Cnt_lgc Ap_DampingFirewall.FreqDepDmpSrlComSvcDft.Cnt_lgc Ap_DampingFirewall.HwTorque.HwNm_f32 Ap_DampingFirewall.InertiaComp.MtrNm_f32 Ap_DampingFirewall.MEC_Counter.Cnt_enum Ap_DampingFirewall.MtrVelCRF.MtrRadpS_f32 Ap_DampingFirewall.VehicleLonAccel.KphpS_f32 Ap_DampingFirewall.VehicleSpeed.Kph_f32 Ap_DampingFirewall.WIRCmdAmpBlnd.MtrNm_f32 /end SUB_GROUP
 /begin FUNCTION_LIST /end FUNCTION_LIST
 /begin REF_CHARACTERISTIC /end REF_CHARACTERISTIC
 /begin REF_MEASUREMENT /end REF_MEASUREMENT
/end GROUP
/begin GROUP Ap_DampingFirewall.SenderPorts "MICROSAR RTE" /begin SUB_GROUP Ap_DampingFirewall.CombinedDamping.MtrNm_f32 /end SUB_GROUP /begin FUNCTION_LIST /end FUNCTION_LIST /begin REF_CHARACTERISTIC /end REF_CHARACTERISTIC /begin REF_MEASUREMENT /end REF_MEASUREMENT /end GROUP
/begin GROUP Ap_DampingFirewall.SystemState.Mode "MICROSAR RTE" /begin SUB_GROUP /end SUB_GROUP /begin FUNCTION_LIST /end FUNCTION_LIST /begin REF_CHARACTERISTIC /end REF_CHARACTERISTIC /begin REF_MEASUREMENT Ap_DampingFirewall.SystemState.Mode /end REF_MEASUREMENT /end GROUP
/begin GROUP Ap_DampingFirewall.VehicleLonAccel.KphpS_f32 "MICROSAR RTE" /begin SUB_GROUP /end SUB_GROUP /begin FUNCTION_LIST /end FUNCTION_LIST /begin REF_CHARACTERISTIC /end REF_CHARACTERISTIC /begin REF_MEASUREMENT Ap_DampingFirewall.VehicleLonAccel.KphpS_f32 /end REF_MEASUREMENT /end GROUP
/begin GROUP Ap_DampingFirewall.VehicleSpeed.Kph_f32 "MICROSAR RTE" /begin SUB_GROUP /end SUB_GROUP /begin FUNCTION_LIST /end FUNCTION_LIST /begin REF_CHARACTERISTIC /end REF_CHARACTERISTIC /begin REF_MEASUREMENT Ap_DampingFirewall.VehicleSpeed.Kph_f32 /end REF_MEASUREMENT /end GROUP
/begin GROUP Ap_DampingFirewall.WIRCmdAmpBlnd.MtrNm_f32 "MICROSAR RTE" /begin SUB_GROUP /end SUB_GROUP /begin FUNCTION_LIST /end FUNCTION_LIST /begin REF_CHARACTERISTIC /end REF_CHARACTERISTIC /begin REF_MEASUREMENT Ap_DampingFirewall.WIRCmdAmpBlnd.MtrNm_f32 /end REF_MEASUREMENT /end GROUP
/begin GROUP Ap_DiagMgr8 "MICROSAR RTE" /begin SUB_GROUP Ap_DiagMgr8.ModeRequirePorts Ap_DiagMgr8.ReceiverPorts /end SUB_GROUP /begin FUNCTION_LIST /end FUNCTION_LIST /begin REF_CHARACTERISTIC /end REF_CHARACTERISTIC /begin REF_MEASUREMENT /end REF_MEASUREMENT /end GROUP
/begin GROUP Ap_DiagMgr8.HwTrq.HwNm_f32 "MICROSAR RTE" /begin SUB_GROUP /end SUB_GROUP /begin FUNCTION_LIST /end FUNCTION_LIST /begin REF_CHARACTERISTIC /end REF_CHARACTERISTIC /begin REF_MEASUREMENT Ap_DiagMgr8.HwTrq.HwNm_f32 /end REF_MEASUREMENT /end GROUP
/begin GROUP Ap_DiagMgr8.IgnCnt.Cnt_u16 "MICROSAR RTE" /begin SUB_GROUP /end SUB_GROUP /begin FUNCTION_LIST /end FUNCTION_LIST /begin REF_CHARACTERISTIC /end REF_CHARACTERISTIC /begin REF_MEASUREMENT Ap_DiagMgr8.IgnCnt.Cnt_u16 /end REF_MEASUREMENT /end GROUP
/begin GROUP Ap_DiagMgr8.MEC.Cnt_enum "MICROSAR RTE" /begin SUB_GROUP /end SUB_GROUP /begin FUNCTION_LIST /end FUNCTION_LIST /begin REF_CHARACTERISTIC /end REF_CHARACTERISTIC /begin REF_MEASUREMENT Ap_DiagMgr8.MEC.Cnt_enum /end REF_MEASUREMENT /end GROUP
/begin GROUP Ap_DiagMgr8.MfgDiagInhibit.Cnt_lgc "MICROSAR RTE" /begin SUB_GROUP /end SUB_GROUP /begin FUNCTION_LIST /end FUNCTION_LIST /begin REF_CHARACTERISTIC /end REF_CHARACTERISTIC /begin REF_MEASUREMENT Ap_DiagMgr8.MfgDiagInhibit.Cnt_lgc /end REF_MEASUREMENT /end GROUP
/begin GROUP Ap_DiagMgr8.ModeRequirePorts "MICROSAR RTE" /begin SUB_GROUP Ap_DiagMgr8.SystemState.Mode /end SUB_GROUP /begin FUNCTION_LIST /end FUNCTION_LIST /begin REF_CHARACTERISTIC /end REF_CHARACTERISTIC /begin REF_MEASUREMENT /end REF_MEASUREMENT /end GROUP
/begin GROUP Ap_DiagMgr8.MtrTrq.MtrNm_f32 "MICROSAR RTE" /begin SUB_GROUP /end SUB_GROUP /begin FUNCTION_LIST /end FUNCTION_LIST /begin REF_CHARACTERISTIC /end REF_CHARACTERISTIC /begin REF_MEASUREMENT Ap_DiagMgr8.MtrTrq.MtrNm_f32 /end REF_MEASUREMENT /end GROUP
/begin GROUP Ap_DiagMgr8.ReceiverPorts "MICROSAR RTE"
 /begin SUB_GROUP Ap_DiagMgr8.HwTrq.HwNm_f32 Ap_DiagMgr8.IgnCnt.Cnt_u16 Ap_DiagMgr8.MEC.Cnt_enum Ap_DiagMgr8.MfgDiagInhibit.Cnt_lgc Ap_DiagMgr8.MtrTrq.MtrNm_f32 Ap_DiagMgr8.VehSpd.Kph_f32 /end SUB_GROUP
 /begin FUNCTION_LIST /end FUNCTION_LIST
 /begin REF_CHARACTERISTIC /end REF_CHARACTERISTIC
 /begin REF_MEASUREMENT /end REF_MEASUREMENT
/end GROUP
/begin GROUP Ap_DiagMgr8.SystemState.Mode "MICROSAR RTE" /begin SUB_GROUP /end SUB_GROUP /begin FUNCTION_LIST /end FUNCTION_LIST /begin REF_CHARACTERISTIC /end REF_CHARACTERISTIC /begin REF_MEASUREMENT Ap_DiagMgr8.SystemState.Mode /end REF_MEASUREMENT /end GROUP
/begin GROUP Ap_DiagMgr8.VehSpd.Kph_f32 "MICROSAR RTE" /begin SUB_GROUP /end SUB_GROUP /begin FUNCTION_LIST /end FUNCTION_LIST /begin REF_CHARACTERISTIC /end REF_CHARACTERISTIC /begin REF_MEASUREMENT Ap_DiagMgr8.VehSpd.Kph_f32 /end REF_MEASUREMENT /end GROUP
/begin GROUP Ap_DiagMgr9 "MICROSAR RTE" /begin SUB_GROUP Ap_DiagMgr9.ModeRequirePorts Ap_DiagMgr9.ReceiverPorts /end SUB_GROUP /begin FUNCTION_LIST /end FUNCTION_LIST /begin REF_CHARACTERISTIC /end REF_CHARACTERISTIC /begin REF_MEASUREMENT /end REF_MEASUREMENT /end GROUP
/begin GROUP Ap_DiagMgr9.HwTrq.HwNm_f32 "MICROSAR RTE" /begin SUB_GROUP /end SUB_GROUP /begin FUNCTION_LIST /end FUNCTION_LIST /begin REF_CHARACTERISTIC /end REF_CHARACTERISTIC /begin REF_MEASUREMENT Ap_DiagMgr9.HwTrq.HwNm_f32 /end REF_MEASUREMENT /end GROUP
/begin GROUP Ap_DiagMgr9.IgnCnt.Cnt_u16 "MICROSAR RTE" /begin SUB_GROUP /end SUB_GROUP /begin FUNCTION_LIST /end FUNCTION_LIST /begin REF_CHARACTERISTIC /end REF_CHARACTERISTIC /begin REF_MEASUREMENT Ap_DiagMgr9.IgnCnt.Cnt_u16 /end REF_MEASUREMENT /end GROUP
/begin GROUP Ap_DiagMgr9.MEC.Cnt_enum "MICROSAR RTE" /begin SUB_GROUP /end SUB_GROUP /begin FUNCTION_LIST /end FUNCTION_LIST /begin REF_CHARACTERISTIC /end REF_CHARACTERISTIC /begin REF_MEASUREMENT Ap_DiagMgr9.MEC.Cnt_enum /end REF_MEASUREMENT /end GROUP
/begin GROUP Ap_DiagMgr9.MfgDiagInhibit.Cnt_lgc "MICROSAR RTE" /begin SUB_GROUP /end SUB_GROUP /begin FUNCTION_LIST /end FUNCTION_LIST /begin REF_CHARACTERISTIC /end REF_CHARACTERISTIC /begin REF_MEASUREMENT Ap_DiagMgr9.MfgDiagInhibit.Cnt_lgc /end REF_MEASUREMENT /end GROUP
/begin GROUP Ap_DiagMgr9.ModeRequirePorts "MICROSAR RTE" /begin SUB_GROUP Ap_DiagMgr9.SystemState.Mode /end SUB_GROUP /begin FUNCTION_LIST /end FUNCTION_LIST /begin REF_CHARACTERISTIC /end REF_CHARACTERISTIC /begin REF_MEASUREMENT /end REF_MEASUREMENT /end GROUP
/begin GROUP Ap_DiagMgr9.MtrTrq.MtrNm_f32 "MICROSAR RTE" /begin SUB_GROUP /end SUB_GROUP /begin FUNCTION_LIST /end FUNCTION_LIST /begin REF_CHARACTERISTIC /end REF_CHARACTERISTIC /begin REF_MEASUREMENT Ap_DiagMgr9.MtrTrq.MtrNm_f32 /end REF_MEASUREMENT /end GROUP
/begin GROUP Ap_DiagMgr9.ReceiverPorts "MICROSAR RTE"
 /begin SUB_GROUP Ap_DiagMgr9.HwTrq.HwNm_f32 Ap_DiagMgr9.IgnCnt.Cnt_u16 Ap_DiagMgr9.MEC.Cnt_enum Ap_DiagMgr9.MfgDiagInhibit.Cnt_lgc Ap_DiagMgr9.MtrTrq.MtrNm_f32 Ap_DiagMgr9.VehSpd.Kph_f32 /end SUB_GROUP
 /begin FUNCTION_LIST /end FUNCTION_LIST
 /begin REF_CHARACTERISTIC /end REF_CHARACTERISTIC
 /begin REF_MEASUREMENT /end REF_MEASUREMENT
/end GROUP
/begin GROUP Ap_DiagMgr9.SystemState.Mode "MICROSAR RTE" /begin SUB_GROUP /end SUB_GROUP /begin FUNCTION_LIST /end FUNCTION_LIST /begin REF_CHARACTERISTIC /end REF_CHARACTERISTIC /begin REF_MEASUREMENT Ap_DiagMgr9.SystemState.Mode /end REF_MEASUREMENT /end GROUP
/begin GROUP Ap_DiagMgr9.VehSpd.Kph_f32 "MICROSAR RTE" /begin SUB_GROUP /end SUB_GROUP /begin FUNCTION_LIST /end FUNCTION_LIST /begin REF_CHARACTERISTIC /end REF_CHARACTERISTIC /begin REF_MEASUREMENT Ap_DiagMgr9.VehSpd.Kph_f32 /end REF_MEASUREMENT /end GROUP
/begin GROUP Ap_EtDmpFw "MICROSAR RTE" /begin SUB_GROUP Ap_EtDmpFw.ReceiverPorts Ap_EtDmpFw.SenderPorts /end SUB_GROUP /begin FUNCTION_LIST /end FUNCTION_LIST /begin REF_CHARACTERISTIC /end REF_CHARACTERISTIC /begin REF_MEASUREMENT /end REF_MEASUREMENT /end GROUP
/begin GROUP Ap_EtDmpFw.AssistEOTDamping.MtrNm_f32 "MICROSAR RTE" /begin SUB_GROUP /end SUB_GROUP /begin FUNCTION_LIST /end FUNCTION_LIST /begin REF_CHARACTERISTIC /end REF_CHARACTERISTIC /begin REF_MEASUREMENT Ap_EtDmpFw.AssistEOTDamping.MtrNm_f32 /end REF_MEASUREMENT /end GROUP
/begin GROUP Ap_EtDmpFw.CRFMtrVel.MtrRadpS_f32 "MICROSAR RTE" /begin SUB_GROUP /end SUB_GROUP /begin FUNCTION_LIST /end FUNCTION_LIST /begin REF_CHARACTERISTIC /end REF_CHARACTERISTIC /begin REF_MEASUREMENT Ap_EtDmpFw.CRFMtrVel.MtrRadpS_f32 /end REF_MEASUREMENT /end GROUP
/begin GROUP Ap_EtDmpFw.EOTDampingLtd.MtrNm_f32 "MICROSAR RTE" /begin SUB_GROUP /end SUB_GROUP /begin FUNCTION_LIST /end FUNCTION_LIST /begin REF_CHARACTERISTIC /end REF_CHARACTERISTIC /begin REF_MEASUREMENT Ap_EtDmpFw.EOTDampingLtd.MtrNm_f32 /end REF_MEASUREMENT /end GROUP
/begin GROUP Ap_EtDmpFw.EOTDisable.Cnt_lgc "MICROSAR RTE" /begin SUB_GROUP /end SUB_GROUP /begin FUNCTION_LIST /end FUNCTION_LIST /begin REF_CHARACTERISTIC /end REF_CHARACTERISTIC /begin REF_MEASUREMENT Ap_EtDmpFw.EOTDisable.Cnt_lgc /end REF_MEASUREMENT /end GROUP
/begin GROUP Ap_EtDmpFw.HandwheelAuthority.Uls_f32 "MICROSAR RTE" /begin SUB_GROUP /end SUB_GROUP /begin FUNCTION_LIST /end FUNCTION_LIST /begin REF_CHARACTERISTIC /end REF_CHARACTERISTIC /begin REF_MEASUREMENT Ap_EtDmpFw.HandwheelAuthority.Uls_f32 /end REF_MEASUREMENT /end GROUP
/begin GROUP Ap_EtDmpFw.HandwheelPosition.HwDeg_f32 "MICROSAR RTE" /begin SUB_GROUP /end SUB_GROUP /begin FUNCTION_LIST /end FUNCTION_LIST /begin REF_CHARACTERISTIC /end REF_CHARACTERISTIC /begin REF_MEASUREMENT Ap_EtDmpFw.HandwheelPosition.HwDeg_f32 /end REF_MEASUREMENT /end GROUP
/begin GROUP Ap_EtDmpFw.MEC_Counter.Cnt_enum "MICROSAR RTE" /begin SUB_GROUP /end SUB_GROUP /begin FUNCTION_LIST /end FUNCTION_LIST /begin REF_CHARACTERISTIC /end REF_CHARACTERISTIC /begin REF_MEASUREMENT Ap_EtDmpFw.MEC_Counter.Cnt_enum /end REF_MEASUREMENT /end GROUP
/begin GROUP Ap_EtDmpFw.ReceiverPorts "MICROSAR RTE"
 /begin SUB_GROUP Ap_EtDmpFw.AssistEOTDamping.MtrNm_f32 Ap_EtDmpFw.CRFMtrVel.MtrRadpS_f32 Ap_EtDmpFw.EOTDisable.Cnt_lgc Ap_EtDmpFw.HandwheelAuthority.Uls_f32 Ap_EtDmpFw.HandwheelPosition.HwDeg_f32 Ap_EtDmpFw.MEC_Counter.Cnt_enum Ap_EtDmpFw.Vehicle_Speed.Kph_f32 /end SUB_GROUP
 /begin FUNCTION_LIST /end FUNCTION_LIST
 /begin REF_CHARACTERISTIC /end REF_CHARACTERISTIC
 /begin REF_MEASUREMENT /end REF_MEASUREMENT
/end GROUP
/begin GROUP Ap_EtDmpFw.SenderPorts "MICROSAR RTE" /begin SUB_GROUP Ap_EtDmpFw.EOTDampingLtd.MtrNm_f32 /end SUB_GROUP /begin FUNCTION_LIST /end FUNCTION_LIST /begin REF_CHARACTERISTIC /end REF_CHARACTERISTIC /begin REF_MEASUREMENT /end REF_MEASUREMENT /end GROUP
/begin GROUP Ap_EtDmpFw.Vehicle_Speed.Kph_f32 "MICROSAR RTE" /begin SUB_GROUP /end SUB_GROUP /begin FUNCTION_LIST /end FUNCTION_LIST /begin REF_CHARACTERISTIC /end REF_CHARACTERISTIC /begin REF_MEASUREMENT Ap_EtDmpFw.Vehicle_Speed.Kph_f32 /end REF_MEASUREMENT /end GROUP
/begin GROUP Ap_GCCDiag "MICROSAR RTE" /begin SUB_GROUP Ap_GCCDiag.ReceiverPorts /end SUB_GROUP /begin FUNCTION_LIST /end FUNCTION_LIST /begin REF_CHARACTERISTIC /end REF_CHARACTERISTIC /begin REF_MEASUREMENT /end REF_MEASUREMENT /end GROUP
/begin GROUP Ap_GCCDiag.DftGrossCCDiag.Cnt_lgc "MICROSAR RTE" /begin SUB_GROUP /end SUB_GROUP /begin FUNCTION_LIST /end FUNCTION_LIST /begin REF_CHARACTERISTIC /end REF_CHARACTERISTIC /begin REF_MEASUREMENT Ap_GCCDiag.DftGrossCCDiag.Cnt_lgc /end REF_MEASUREMENT /end GROUP
/begin GROUP Ap_GCCDiag.HwTorque.HwNm_f32 "MICROSAR RTE" /begin SUB_GROUP /end SUB_GROUP /begin FUNCTION_LIST /end FUNCTION_LIST /begin REF_CHARACTERISTIC /end REF_CHARACTERISTIC /begin REF_MEASUREMENT Ap_GCCDiag.HwTorque.HwNm_f32 /end REF_MEASUREMENT /end GROUP
/begin GROUP Ap_GCCDiag.MRFMtrTrqCmdScl.MtrNm_f32 "MICROSAR RTE" /begin SUB_GROUP /end SUB_GROUP /begin FUNCTION_LIST /end FUNCTION_LIST /begin REF_CHARACTERISTIC /end REF_CHARACTERISTIC /begin REF_MEASUREMENT Ap_GCCDiag.MRFMtrTrqCmdScl.MtrNm_f32 /end REF_MEASUREMENT /end GROUP
/begin GROUP Ap_GCCDiag.ReceiverPorts "MICROSAR RTE"
 /begin SUB_GROUP Ap_GCCDiag.DftGrossCCDiag.Cnt_lgc Ap_GCCDiag.HwTorque.HwNm_f32 Ap_GCCDiag.MRFMtrTrqCmdScl.MtrNm_f32 Ap_GCCDiag.VehicleSpeed.Kph_f32 /end SUB_GROUP
 /begin FUNCTION_LIST /end FUNCTION_LIST
 /begin REF_CHARACTERISTIC /end REF_CHARACTERISTIC
 /begin REF_MEASUREMENT /end REF_MEASUREMENT
/end GROUP
/begin GROUP Ap_GCCDiag.VehicleSpeed.Kph_f32 "MICROSAR RTE" /begin SUB_GROUP /end SUB_GROUP /begin FUNCTION_LIST /end FUNCTION_LIST /begin REF_CHARACTERISTIC /end REF_CHARACTERISTIC /begin REF_MEASUREMENT Ap_GCCDiag.VehicleSpeed.Kph_f32 /end REF_MEASUREMENT /end GROUP
/begin GROUP Ap_GMStrtStop "MICROSAR RTE"
 /begin SUB_GROUP Ap_GMStrtStop.ModeRequirePorts Ap_GMStrtStop.ReceiverPorts Ap_GMStrtStop.SenderPorts /end SUB_GROUP
 /begin FUNCTION_LIST /end FUNCTION_LIST
 /begin REF_CHARACTERISTIC /end REF_CHARACTERISTIC
 /begin REF_MEASUREMENT /end REF_MEASUREMENT
/end GROUP
/begin GROUP Ap_GMStrtStop.APAState.State_enum "MICROSAR RTE" /begin SUB_GROUP /end SUB_GROUP /begin FUNCTION_LIST /end FUNCTION_LIST /begin REF_CHARACTERISTIC /end REF_CHARACTERISTIC /begin REF_MEASUREMENT Ap_GMStrtStop.APAState.State_enum /end REF_MEASUREMENT /end GROUP
/begin GROUP Ap_GMStrtStop.EngSpd.Rpm_f32 "MICROSAR RTE" /begin SUB_GROUP /end SUB_GROUP /begin FUNCTION_LIST /end FUNCTION_LIST /begin REF_CHARACTERISTIC /end REF_CHARACTERISTIC /begin REF_MEASUREMENT Ap_GMStrtStop.EngSpd.Rpm_f32 /end REF_MEASUREMENT /end GROUP
/begin GROUP Ap_GMStrtStop.HandwheelVelocity.HwRadpS_f32 "MICROSAR RTE" /begin SUB_GROUP /end SUB_GROUP /begin FUNCTION_LIST /end FUNCTION_LIST /begin REF_CHARACTERISTIC /end REF_CHARACTERISTIC /begin REF_MEASUREMENT Ap_GMStrtStop.HandwheelVelocity.HwRadpS_f32 /end REF_MEASUREMENT /end GROUP
/begin GROUP Ap_GMStrtStop.HwTorque.HwNm_f32 "MICROSAR RTE" /begin SUB_GROUP /end SUB_GROUP /begin FUNCTION_LIST /end FUNCTION_LIST /begin REF_CHARACTERISTIC /end REF_CHARACTERISTIC /begin REF_MEASUREMENT Ap_GMStrtStop.HwTorque.HwNm_f32 /end REF_MEASUREMENT /end GROUP
/begin GROUP Ap_GMStrtStop.ModeRequirePorts "MICROSAR RTE" /begin SUB_GROUP Ap_GMStrtStop.SystemState.Mode /end SUB_GROUP /begin FUNCTION_LIST /end FUNCTION_LIST /begin REF_CHARACTERISTIC /end REF_CHARACTERISTIC /begin REF_MEASUREMENT /end REF_MEASUREMENT /end GROUP
/begin GROUP Ap_GMStrtStop.ReceiverPorts "MICROSAR RTE"
 /begin SUB_GROUP Ap_GMStrtStop.APAState.State_enum Ap_GMStrtStop.EngSpd.Rpm_f32 Ap_GMStrtStop.HandwheelVelocity.HwRadpS_f32 Ap_GMStrtStop.HwTorque.HwNm_f32 Ap_GMStrtStop.SS12VFault.Cnt_lgc Ap_GMStrtStop.VehicleSpeed.Kph_f32 /end SUB_GROUP
 /begin FUNCTION_LIST /end FUNCTION_LIST
 /begin REF_CHARACTERISTIC /end REF_CHARACTERISTIC
 /begin REF_MEASUREMENT /end REF_MEASUREMENT
/end GROUP
/begin GROUP Ap_GMStrtStop.SS12VFault.Cnt_lgc "MICROSAR RTE" /begin SUB_GROUP /end SUB_GROUP /begin FUNCTION_LIST /end FUNCTION_LIST /begin REF_CHARACTERISTIC /end REF_CHARACTERISTIC /begin REF_MEASUREMENT Ap_GMStrtStop.SS12VFault.Cnt_lgc /end REF_MEASUREMENT /end GROUP
/begin GROUP Ap_GMStrtStop.SSScale.Uls_f32 "MICROSAR RTE" /begin SUB_GROUP /end SUB_GROUP /begin FUNCTION_LIST /end FUNCTION_LIST /begin REF_CHARACTERISTIC /end REF_CHARACTERISTIC /begin REF_MEASUREMENT Ap_GMStrtStop.SSScale.Uls_f32 /end REF_MEASUREMENT /end GROUP
/begin GROUP Ap_GMStrtStop.SSSlew.UlspS_f32 "MICROSAR RTE" /begin SUB_GROUP /end SUB_GROUP /begin FUNCTION_LIST /end FUNCTION_LIST /begin REF_CHARACTERISTIC /end REF_CHARACTERISTIC /begin REF_MEASUREMENT Ap_GMStrtStop.SSSlew.UlspS_f32 /end REF_MEASUREMENT /end GROUP
/begin GROUP Ap_GMStrtStop.SSState.State_enum "MICROSAR RTE" /begin SUB_GROUP /end SUB_GROUP /begin FUNCTION_LIST /end FUNCTION_LIST /begin REF_CHARACTERISTIC /end REF_CHARACTERISTIC /begin REF_MEASUREMENT Ap_GMStrtStop.SSState.State_enum /end REF_MEASUREMENT /end GROUP
/begin GROUP Ap_GMStrtStop.SenderPorts "MICROSAR RTE"
 /begin SUB_GROUP Ap_GMStrtStop.SSScale.Uls_f32 Ap_GMStrtStop.SSSlew.UlspS_f32 Ap_GMStrtStop.SSState.State_enum /end SUB_GROUP
 /begin FUNCTION_LIST /end FUNCTION_LIST
 /begin REF_CHARACTERISTIC /end REF_CHARACTERISTIC
 /begin REF_MEASUREMENT /end REF_MEASUREMENT
/end GROUP
/begin GROUP Ap_GMStrtStop.SystemState.Mode "MICROSAR RTE" /begin SUB_GROUP /end SUB_GROUP /begin FUNCTION_LIST /end FUNCTION_LIST /begin REF_CHARACTERISTIC /end REF_CHARACTERISTIC /begin REF_MEASUREMENT Ap_GMStrtStop.SystemState.Mode /end REF_MEASUREMENT /end GROUP
/begin GROUP Ap_GMStrtStop.VehicleSpeed.Kph_f32 "MICROSAR RTE" /begin SUB_GROUP /end SUB_GROUP /begin FUNCTION_LIST /end FUNCTION_LIST /begin REF_CHARACTERISTIC /end REF_CHARACTERISTIC /begin REF_MEASUREMENT Ap_GMStrtStop.VehicleSpeed.Kph_f32 /end REF_MEASUREMENT /end GROUP
/begin GROUP Ap_GenPosTraj "MICROSAR RTE" /begin SUB_GROUP Ap_GenPosTraj.ReceiverPorts Ap_GenPosTraj.SenderPorts /end SUB_GROUP /begin FUNCTION_LIST /end FUNCTION_LIST /begin REF_CHARACTERISTIC /end REF_CHARACTERISTIC /begin REF_MEASUREMENT /end REF_MEASUREMENT /end GROUP
/begin GROUP Ap_GenPosTraj.HwPosition.HwDeg_f32 "MICROSAR RTE" /begin SUB_GROUP /end SUB_GROUP /begin FUNCTION_LIST /end FUNCTION_LIST /begin REF_CHARACTERISTIC /end REF_CHARACTERISTIC /begin REF_MEASUREMENT Ap_GenPosTraj.HwPosition.HwDeg_f32 /end REF_MEASUREMENT /end GROUP
/begin GROUP Ap_GenPosTraj.PosTrajEnable.Cnt_lgc "MICROSAR RTE" /begin SUB_GROUP /end SUB_GROUP /begin FUNCTION_LIST /end FUNCTION_LIST /begin REF_CHARACTERISTIC /end REF_CHARACTERISTIC /begin REF_MEASUREMENT Ap_GenPosTraj.PosTrajEnable.Cnt_lgc /end REF_MEASUREMENT /end GROUP
/begin GROUP Ap_GenPosTraj.PosTrajHwAngle.HwDeg_f32 "MICROSAR RTE" /begin SUB_GROUP /end SUB_GROUP /begin FUNCTION_LIST /end FUNCTION_LIST /begin REF_CHARACTERISTIC /end REF_CHARACTERISTIC /begin REF_MEASUREMENT Ap_GenPosTraj.PosTrajHwAngle.HwDeg_f32 /end REF_MEASUREMENT /end GROUP
/begin GROUP Ap_GenPosTraj.ReceiverPorts "MICROSAR RTE"
 /begin SUB_GROUP Ap_GenPosTraj.HwPosition.HwDeg_f32 Ap_GenPosTraj.PosTrajEnable.Cnt_lgc /end SUB_GROUP
 /begin FUNCTION_LIST /end FUNCTION_LIST
 /begin REF_CHARACTERISTIC /end REF_CHARACTERISTIC
 /begin REF_MEASUREMENT /end REF_MEASUREMENT
/end GROUP
/begin GROUP Ap_GenPosTraj.SenderPorts "MICROSAR RTE" /begin SUB_GROUP Ap_GenPosTraj.PosTrajHwAngle.HwDeg_f32 /end SUB_GROUP /begin FUNCTION_LIST /end FUNCTION_LIST /begin REF_CHARACTERISTIC /end REF_CHARACTERISTIC /begin REF_MEASUREMENT /end REF_MEASUREMENT /end GROUP
/begin GROUP Ap_HOWDetect "MICROSAR RTE" /begin SUB_GROUP Ap_HOWDetect.ReceiverPorts Ap_HOWDetect.SenderPorts /end SUB_GROUP /begin FUNCTION_LIST /end FUNCTION_LIST /begin REF_CHARACTERISTIC /end REF_CHARACTERISTIC /begin REF_MEASUREMENT /end REF_MEASUREMENT /end GROUP
/begin GROUP Ap_HOWDetect.HOWEstimate.Uls_f32 "MICROSAR RTE" /begin SUB_GROUP /end SUB_GROUP /begin FUNCTION_LIST /end FUNCTION_LIST /begin REF_CHARACTERISTIC /end REF_CHARACTERISTIC /begin REF_MEASUREMENT Ap_HOWDetect.HOWEstimate.Uls_f32 /end REF_MEASUREMENT /end GROUP
/begin GROUP Ap_HOWDetect.HOWState.Cnt_s08 "MICROSAR RTE" /begin SUB_GROUP /end SUB_GROUP /begin FUNCTION_LIST /end FUNCTION_LIST /begin REF_CHARACTERISTIC /end REF_CHARACTERISTIC /begin REF_MEASUREMENT Ap_HOWDetect.HOWState.Cnt_s08 /end REF_MEASUREMENT /end GROUP
/begin GROUP Ap_HOWDetect.HwTrq.HwNm_f32 "MICROSAR RTE" /begin SUB_GROUP /end SUB_GROUP /begin FUNCTION_LIST /end FUNCTION_LIST /begin REF_CHARACTERISTIC /end REF_CHARACTERISTIC /begin REF_MEASUREMENT Ap_HOWDetect.HwTrq.HwNm_f32 /end REF_MEASUREMENT /end GROUP
/begin GROUP Ap_HOWDetect.ReceiverPorts "MICROSAR RTE" /begin SUB_GROUP Ap_HOWDetect.HwTrq.HwNm_f32 Ap_HOWDetect.VehSpd.Kph_f32 /end SUB_GROUP /begin FUNCTION_LIST /end FUNCTION_LIST /begin REF_CHARACTERISTIC /end REF_CHARACTERISTIC /begin REF_MEASUREMENT /end REF_MEASUREMENT /end GROUP
/begin GROUP Ap_HOWDetect.SenderPorts "MICROSAR RTE"
 /begin SUB_GROUP Ap_HOWDetect.HOWEstimate.Uls_f32 Ap_HOWDetect.HOWState.Cnt_s08 /end SUB_GROUP
 /begin FUNCTION_LIST /end FUNCTION_LIST
 /begin REF_CHARACTERISTIC /end REF_CHARACTERISTIC
 /begin REF_MEASUREMENT /end REF_MEASUREMENT
/end GROUP
/begin GROUP Ap_HOWDetect.VehSpd.Kph_f32 "MICROSAR RTE" /begin SUB_GROUP /end SUB_GROUP /begin FUNCTION_LIST /end FUNCTION_LIST /begin REF_CHARACTERISTIC /end REF_CHARACTERISTIC /begin REF_MEASUREMENT Ap_HOWDetect.VehSpd.Kph_f32 /end REF_MEASUREMENT /end GROUP
/begin GROUP Ap_HwPwUp "MICROSAR RTE"
 /begin SUB_GROUP Ap_HwPwUp.ModeRequirePorts Ap_HwPwUp.ReceiverPorts Ap_HwPwUp.SenderPorts /end SUB_GROUP
 /begin FUNCTION_LIST /end FUNCTION_LIST
 /begin REF_CHARACTERISTIC /end REF_CHARACTERISTIC
 /begin REF_MEASUREMENT /end REF_MEASUREMENT
/end GROUP
/begin GROUP Ap_HwPwUp.ModeRequirePorts "MICROSAR RTE" /begin SUB_GROUP Ap_HwPwUp.SystemState.Mode /end SUB_GROUP /begin FUNCTION_LIST /end FUNCTION_LIST /begin REF_CHARACTERISTIC /end REF_CHARACTERISTIC /begin REF_MEASUREMENT /end REF_MEASUREMENT /end GROUP
/begin GROUP Ap_HwPwUp.MtrDrvrInitComplete.Cnt_lgc "MICROSAR RTE" /begin SUB_GROUP /end SUB_GROUP /begin FUNCTION_LIST /end FUNCTION_LIST /begin REF_CHARACTERISTIC /end REF_CHARACTERISTIC /begin REF_MEASUREMENT Ap_HwPwUp.MtrDrvrInitComplete.Cnt_lgc /end REF_MEASUREMENT /end GROUP
/begin GROUP Ap_HwPwUp.MtrDrvrInitStart.Cnt_lgc "MICROSAR RTE" /begin SUB_GROUP /end SUB_GROUP /begin FUNCTION_LIST /end FUNCTION_LIST /begin REF_CHARACTERISTIC /end REF_CHARACTERISTIC /begin REF_MEASUREMENT Ap_HwPwUp.MtrDrvrInitStart.Cnt_lgc /end REF_MEASUREMENT /end GROUP
/begin GROUP Ap_HwPwUp.PwrDiscATestComplete.Cnt_lgc "MICROSAR RTE" /begin SUB_GROUP /end SUB_GROUP /begin FUNCTION_LIST /end FUNCTION_LIST /begin REF_CHARACTERISTIC /end REF_CHARACTERISTIC /begin REF_MEASUREMENT Ap_HwPwUp.PwrDiscATestComplete.Cnt_lgc /end REF_MEASUREMENT /end GROUP
/begin GROUP Ap_HwPwUp.PwrDiscATestStart.Cnt_lgc "MICROSAR RTE" /begin SUB_GROUP /end SUB_GROUP /begin FUNCTION_LIST /end FUNCTION_LIST /begin REF_CHARACTERISTIC /end REF_CHARACTERISTIC /begin REF_MEASUREMENT Ap_HwPwUp.PwrDiscATestStart.Cnt_lgc /end REF_MEASUREMENT /end GROUP
/begin GROUP Ap_HwPwUp.PwrDiscBTestComplete.Cnt_lgc "MICROSAR RTE" /begin SUB_GROUP /end SUB_GROUP /begin FUNCTION_LIST /end FUNCTION_LIST /begin REF_CHARACTERISTIC /end REF_CHARACTERISTIC /begin REF_MEASUREMENT Ap_HwPwUp.PwrDiscBTestComplete.Cnt_lgc /end REF_MEASUREMENT /end GROUP
/begin GROUP Ap_HwPwUp.PwrDiscBTestStart.Cnt_lgc "MICROSAR RTE" /begin SUB_GROUP /end SUB_GROUP /begin FUNCTION_LIST /end FUNCTION_LIST /begin REF_CHARACTERISTIC /end REF_CHARACTERISTIC /begin REF_MEASUREMENT Ap_HwPwUp.PwrDiscBTestStart.Cnt_lgc /end REF_MEASUREMENT /end GROUP
/begin GROUP Ap_HwPwUp.ReceiverPorts "MICROSAR RTE"
 /begin SUB_GROUP Ap_HwPwUp.MtrDrvrInitComplete.Cnt_lgc Ap_HwPwUp.PwrDiscATestComplete.Cnt_lgc Ap_HwPwUp.PwrDiscBTestComplete.Cnt_lgc Ap_HwPwUp.TMFTestComplete.Cnt_lgc /end SUB_GROUP
 /begin FUNCTION_LIST /end FUNCTION_LIST
 /begin REF_CHARACTERISTIC /end REF_CHARACTERISTIC
 /begin REF_MEASUREMENT /end REF_MEASUREMENT
/end GROUP
/begin GROUP Ap_HwPwUp.SenderPorts "MICROSAR RTE"
 /begin SUB_GROUP Ap_HwPwUp.MtrDrvrInitStart.Cnt_lgc Ap_HwPwUp.PwrDiscATestStart.Cnt_lgc Ap_HwPwUp.PwrDiscBTestStart.Cnt_lgc Ap_HwPwUp.TMFTestStart.Cnt_lgc /end SUB_GROUP
 /begin FUNCTION_LIST /end FUNCTION_LIST
 /begin REF_CHARACTERISTIC /end REF_CHARACTERISTIC
 /begin REF_MEASUREMENT /end REF_MEASUREMENT
/end GROUP
/begin GROUP Ap_HwPwUp.SystemState.Mode "MICROSAR RTE" /begin SUB_GROUP /end SUB_GROUP /begin FUNCTION_LIST /end FUNCTION_LIST /begin REF_CHARACTERISTIC /end REF_CHARACTERISTIC /begin REF_MEASUREMENT Ap_HwPwUp.SystemState.Mode /end REF_MEASUREMENT /end GROUP
/begin GROUP Ap_HwPwUp.TMFTestComplete.Cnt_lgc "MICROSAR RTE" /begin SUB_GROUP /end SUB_GROUP /begin FUNCTION_LIST /end FUNCTION_LIST /begin REF_CHARACTERISTIC /end REF_CHARACTERISTIC /begin REF_MEASUREMENT Ap_HwPwUp.TMFTestComplete.Cnt_lgc /end REF_MEASUREMENT /end GROUP
/begin GROUP Ap_HwPwUp.TMFTestStart.Cnt_lgc "MICROSAR RTE" /begin SUB_GROUP /end SUB_GROUP /begin FUNCTION_LIST /end FUNCTION_LIST /begin REF_CHARACTERISTIC /end REF_CHARACTERISTIC /begin REF_MEASUREMENT Ap_HwPwUp.TMFTestStart.Cnt_lgc /end REF_MEASUREMENT /end GROUP
/begin GROUP Ap_LmtCod "MICROSAR RTE" /begin SUB_GROUP Ap_LmtCod.ReceiverPorts Ap_LmtCod.SenderPorts /end SUB_GROUP /begin FUNCTION_LIST /end FUNCTION_LIST /begin REF_CHARACTERISTIC /end REF_CHARACTERISTIC /begin REF_MEASUREMENT /end REF_MEASUREMENT /end GROUP
/begin GROUP Ap_LmtCod.AssistEOTGain.Uls_f32 "MICROSAR RTE" /begin SUB_GROUP /end SUB_GROUP /begin FUNCTION_LIST /end FUNCTION_LIST /begin REF_CHARACTERISTIC /end REF_CHARACTERISTIC /begin REF_MEASUREMENT Ap_LmtCod.AssistEOTGain.Uls_f32 /end REF_MEASUREMENT /end GROUP
/begin GROUP Ap_LmtCod.AssistEOTLimit.MtrNm_f32 "MICROSAR RTE" /begin SUB_GROUP /end SUB_GROUP /begin FUNCTION_LIST /end FUNCTION_LIST /begin REF_CHARACTERISTIC /end REF_CHARACTERISTIC /begin REF_MEASUREMENT Ap_LmtCod.AssistEOTLimit.MtrNm_f32 /end REF_MEASUREMENT /end GROUP
/begin GROUP Ap_LmtCod.AssistStallLimit.MtrNm_f32 "MICROSAR RTE" /begin SUB_GROUP /end SUB_GROUP /begin FUNCTION_LIST /end FUNCTION_LIST /begin REF_CHARACTERISTIC /end REF_CHARACTERISTIC /begin REF_MEASUREMENT Ap_LmtCod.AssistStallLimit.MtrNm_f32 /end REF_MEASUREMENT /end GROUP
/begin GROUP Ap_LmtCod.AssistVehSpdLimit.MtrNm_f32 "MICROSAR RTE" /begin SUB_GROUP /end SUB_GROUP /begin FUNCTION_LIST /end FUNCTION_LIST /begin REF_CHARACTERISTIC /end REF_CHARACTERISTIC /begin REF_MEASUREMENT Ap_LmtCod.AssistVehSpdLimit.MtrNm_f32 /end REF_MEASUREMENT /end GROUP
/begin GROUP Ap_LmtCod.CCLTrqRamp.Uls_f32 "MICROSAR RTE" /begin SUB_GROUP /end SUB_GROUP /begin FUNCTION_LIST /end FUNCTION_LIST /begin REF_CHARACTERISTIC /end REF_CHARACTERISTIC /begin REF_MEASUREMENT Ap_LmtCod.CCLTrqRamp.Uls_f32 /end REF_MEASUREMENT /end GROUP
/begin GROUP Ap_LmtCod.EOTGainLtd.Uls_f32 "MICROSAR RTE" /begin SUB_GROUP /end SUB_GROUP /begin FUNCTION_LIST /end FUNCTION_LIST /begin REF_CHARACTERISTIC /end REF_CHARACTERISTIC /begin REF_MEASUREMENT Ap_LmtCod.EOTGainLtd.Uls_f32 /end REF_MEASUREMENT /end GROUP
/begin GROUP Ap_LmtCod.EOTLimitLtd.MtrNm_f32 "MICROSAR RTE" /begin SUB_GROUP /end SUB_GROUP /begin FUNCTION_LIST /end FUNCTION_LIST /begin REF_CHARACTERISTIC /end REF_CHARACTERISTIC /begin REF_MEASUREMENT Ap_LmtCod.EOTLimitLtd.MtrNm_f32 /end REF_MEASUREMENT /end GROUP
/begin GROUP Ap_LmtCod.OutputRampMult.Uls_f32 "MICROSAR RTE" /begin SUB_GROUP /end SUB_GROUP /begin FUNCTION_LIST /end FUNCTION_LIST /begin REF_CHARACTERISTIC /end REF_CHARACTERISTIC /begin REF_MEASUREMENT Ap_LmtCod.OutputRampMult.Uls_f32 /end REF_MEASUREMENT /end GROUP
/begin GROUP Ap_LmtCod.OutputRampMultLtd.Uls_f32 "MICROSAR RTE" /begin SUB_GROUP /end SUB_GROUP /begin FUNCTION_LIST /end FUNCTION_LIST /begin REF_CHARACTERISTIC /end REF_CHARACTERISTIC /begin REF_MEASUREMENT Ap_LmtCod.OutputRampMultLtd.Uls_f32 /end REF_MEASUREMENT /end GROUP
/begin GROUP Ap_LmtCod.ReceiverPorts "MICROSAR RTE"
 /begin SUB_GROUP Ap_LmtCod.AssistEOTGain.Uls_f32 Ap_LmtCod.AssistEOTLimit.MtrNm_f32 Ap_LmtCod.AssistStallLimit.MtrNm_f32 Ap_LmtCod.AssistVehSpdLimit.MtrNm_f32 Ap_LmtCod.CCLTrqRamp.Uls_f32 Ap_LmtCod.OutputRampMult.Uls_f32 Ap_LmtCod.ThermalLimit.MtrNm_f32 Ap_LmtCod.VehicleSpeed.Kph_f32 /end SUB_GROUP
 /begin FUNCTION_LIST /end FUNCTION_LIST
 /begin REF_CHARACTERISTIC /end REF_CHARACTERISTIC
 /begin REF_MEASUREMENT /end REF_MEASUREMENT
/end GROUP
/begin GROUP Ap_LmtCod.SenderPorts "MICROSAR RTE"
 /begin SUB_GROUP Ap_LmtCod.EOTGainLtd.Uls_f32 Ap_LmtCod.EOTLimitLtd.MtrNm_f32 Ap_LmtCod.OutputRampMultLtd.Uls_f32 Ap_LmtCod.StallLimitLtd.MtrNm_f32 Ap_LmtCod.ThermalLimitLtd.MtrNm_f32 Ap_LmtCod.VehSpdLimitLtd.MtrNm_f32 /end SUB_GROUP
 /begin FUNCTION_LIST /end FUNCTION_LIST
 /begin REF_CHARACTERISTIC /end REF_CHARACTERISTIC
 /begin REF_MEASUREMENT /end REF_MEASUREMENT
/end GROUP
/begin GROUP Ap_LmtCod.StallLimitLtd.MtrNm_f32 "MICROSAR RTE" /begin SUB_GROUP /end SUB_GROUP /begin FUNCTION_LIST /end FUNCTION_LIST /begin REF_CHARACTERISTIC /end REF_CHARACTERISTIC /begin REF_MEASUREMENT Ap_LmtCod.StallLimitLtd.MtrNm_f32 /end REF_MEASUREMENT /end GROUP
/begin GROUP Ap_LmtCod.ThermalLimit.MtrNm_f32 "MICROSAR RTE" /begin SUB_GROUP /end SUB_GROUP /begin FUNCTION_LIST /end FUNCTION_LIST /begin REF_CHARACTERISTIC /end REF_CHARACTERISTIC /begin REF_MEASUREMENT Ap_LmtCod.ThermalLimit.MtrNm_f32 /end REF_MEASUREMENT /end GROUP
/begin GROUP Ap_LmtCod.ThermalLimitLtd.MtrNm_f32 "MICROSAR RTE" /begin SUB_GROUP /end SUB_GROUP /begin FUNCTION_LIST /end FUNCTION_LIST /begin REF_CHARACTERISTIC /end REF_CHARACTERISTIC /begin REF_MEASUREMENT Ap_LmtCod.ThermalLimitLtd.MtrNm_f32 /end REF_MEASUREMENT /end GROUP
/begin GROUP Ap_LmtCod.VehSpdLimitLtd.MtrNm_f32 "MICROSAR RTE" /begin SUB_GROUP /end SUB_GROUP /begin FUNCTION_LIST /end FUNCTION_LIST /begin REF_CHARACTERISTIC /end REF_CHARACTERISTIC /begin REF_MEASUREMENT Ap_LmtCod.VehSpdLimitLtd.MtrNm_f32 /end REF_MEASUREMENT /end GROUP
/begin GROUP Ap_LmtCod.VehicleSpeed.Kph_f32 "MICROSAR RTE" /begin SUB_GROUP /end SUB_GROUP /begin FUNCTION_LIST /end FUNCTION_LIST /begin REF_CHARACTERISTIC /end REF_CHARACTERISTIC /begin REF_MEASUREMENT Ap_LmtCod.VehicleSpeed.Kph_f32 /end REF_MEASUREMENT /end GROUP
/begin GROUP Ap_LrnEOT "MICROSAR RTE"
 /begin SUB_GROUP Ap_LrnEOT.PerInstanceMemories Ap_LrnEOT.ReceiverPorts Ap_LrnEOT.SenderPorts /end SUB_GROUP
 /begin FUNCTION_LIST /end FUNCTION_LIST
 /begin REF_CHARACTERISTIC /end REF_CHARACTERISTIC
 /begin REF_MEASUREMENT /end REF_MEASUREMENT
/end GROUP
/begin GROUP Ap_LrnEOT.CCWFound.Cnt_lgc "MICROSAR RTE" /begin SUB_GROUP /end SUB_GROUP /begin FUNCTION_LIST /end FUNCTION_LIST /begin REF_CHARACTERISTIC /end REF_CHARACTERISTIC /begin REF_MEASUREMENT Ap_LrnEOT.CCWFound.Cnt_lgc /end REF_MEASUREMENT /end GROUP
/begin GROUP Ap_LrnEOT.CCWPosition.HwDeg_f32 "MICROSAR RTE" /begin SUB_GROUP /end SUB_GROUP /begin FUNCTION_LIST /end FUNCTION_LIST /begin REF_CHARACTERISTIC /end REF_CHARACTERISTIC /begin REF_MEASUREMENT Ap_LrnEOT.CCWPosition.HwDeg_f32 /end REF_MEASUREMENT /end GROUP
/begin GROUP Ap_LrnEOT.CWFound.Cnt_lgc "MICROSAR RTE" /begin SUB_GROUP /end SUB_GROUP /begin FUNCTION_LIST /end FUNCTION_LIST /begin REF_CHARACTERISTIC /end REF_CHARACTERISTIC /begin REF_MEASUREMENT Ap_LrnEOT.CWFound.Cnt_lgc /end REF_MEASUREMENT /end GROUP
/begin GROUP Ap_LrnEOT.CWPosition.HwDeg_f32 "MICROSAR RTE" /begin SUB_GROUP /end SUB_GROUP /begin FUNCTION_LIST /end FUNCTION_LIST /begin REF_CHARACTERISTIC /end REF_CHARACTERISTIC /begin REF_MEASUREMENT Ap_LrnEOT.CWPosition.HwDeg_f32 /end REF_MEASUREMENT /end GROUP
/begin GROUP Ap_LrnEOT.DiagStsHwPosDis.Cnt_lgc "MICROSAR RTE" /begin SUB_GROUP /end SUB_GROUP /begin FUNCTION_LIST /end FUNCTION_LIST /begin REF_CHARACTERISTIC /end REF_CHARACTERISTIC /begin REF_MEASUREMENT Ap_LrnEOT.DiagStsHwPosDis.Cnt_lgc /end REF_MEASUREMENT /end GROUP
/begin GROUP Ap_LrnEOT.HandwheelAuthority.Uls_f32 "MICROSAR RTE" /begin SUB_GROUP /end SUB_GROUP /begin FUNCTION_LIST /end FUNCTION_LIST /begin REF_CHARACTERISTIC /end REF_CHARACTERISTIC /begin REF_MEASUREMENT Ap_LrnEOT.HandwheelAuthority.Uls_f32 /end REF_MEASUREMENT /end GROUP
/begin GROUP Ap_LrnEOT.HandwheelPosition.HwDeg_f32 "MICROSAR RTE" /begin SUB_GROUP /end SUB_GROUP /begin FUNCTION_LIST /end FUNCTION_LIST /begin REF_CHARACTERISTIC /end REF_CHARACTERISTIC /begin REF_MEASUREMENT Ap_LrnEOT.HandwheelPosition.HwDeg_f32 /end REF_MEASUREMENT /end GROUP
/begin GROUP Ap_LrnEOT.HwTorque.HwNm_f32 "MICROSAR RTE" /begin SUB_GROUP /end SUB_GROUP /begin FUNCTION_LIST /end FUNCTION_LIST /begin REF_CHARACTERISTIC /end REF_CHARACTERISTIC /begin REF_MEASUREMENT Ap_LrnEOT.HwTorque.HwNm_f32 /end REF_MEASUREMENT /end GROUP
/begin GROUP Ap_LrnEOT.LearnedEOT "MICROSAR RTE" /begin SUB_GROUP /end SUB_GROUP /begin FUNCTION_LIST /end FUNCTION_LIST /begin REF_CHARACTERISTIC /end REF_CHARACTERISTIC
 /begin REF_MEASUREMENT Ap_LrnEOT.LearnedEOT.CCWEOTFound_Cnt_lgc Ap_LrnEOT.LearnedEOT.CCWEOTPosition_HwDeg_f32 Ap_LrnEOT.LearnedEOT.CWEOTFound_Cnt_lgc Ap_LrnEOT.LearnedEOT.CWEOTPosition_HwDeg_f32 /end REF_MEASUREMENT
/end GROUP
/begin GROUP Ap_LrnEOT.MtrVelCRF.MtrRadpS_f32 "MICROSAR RTE" /begin SUB_GROUP /end SUB_GROUP /begin FUNCTION_LIST /end FUNCTION_LIST /begin REF_CHARACTERISTIC /end REF_CHARACTERISTIC /begin REF_MEASUREMENT Ap_LrnEOT.MtrVelCRF.MtrRadpS_f32 /end REF_MEASUREMENT /end GROUP
/begin GROUP Ap_LrnEOT.PerInstanceMemories "MICROSAR RTE" /begin SUB_GROUP Ap_LrnEOT.LearnedEOT /end SUB_GROUP /begin FUNCTION_LIST /end FUNCTION_LIST /begin REF_CHARACTERISTIC /end REF_CHARACTERISTIC /begin REF_MEASUREMENT /end REF_MEASUREMENT /end GROUP
/begin GROUP Ap_LrnEOT.PostLimitTorque.MtrNm_f32 "MICROSAR RTE" /begin SUB_GROUP /end SUB_GROUP /begin FUNCTION_LIST /end FUNCTION_LIST /begin REF_CHARACTERISTIC /end REF_CHARACTERISTIC /begin REF_MEASUREMENT Ap_LrnEOT.PostLimitTorque.MtrNm_f32 /end REF_MEASUREMENT /end GROUP
/begin GROUP Ap_LrnEOT.ReceiverPorts "MICROSAR RTE"
 /begin SUB_GROUP Ap_LrnEOT.DiagStsHwPosDis.Cnt_lgc Ap_LrnEOT.HandwheelAuthority.Uls_f32 Ap_LrnEOT.HandwheelPosition.HwDeg_f32 Ap_LrnEOT.HwTorque.HwNm_f32 Ap_LrnEOT.MtrVelCRF.MtrRadpS_f32 Ap_LrnEOT.PostLimitTorque.MtrNm_f32 /end SUB_GROUP
 /begin FUNCTION_LIST /end FUNCTION_LIST
 /begin REF_CHARACTERISTIC /end REF_CHARACTERISTIC
 /begin REF_MEASUREMENT /end REF_MEASUREMENT
/end GROUP
/begin GROUP Ap_LrnEOT.SenderPorts "MICROSAR RTE"
 /begin SUB_GROUP Ap_LrnEOT.CCWFound.Cnt_lgc Ap_LrnEOT.CCWPosition.HwDeg_f32 Ap_LrnEOT.CWFound.Cnt_lgc Ap_LrnEOT.CWPosition.HwDeg_f32 /end SUB_GROUP
 /begin FUNCTION_LIST /end FUNCTION_LIST
 /begin REF_CHARACTERISTIC /end REF_CHARACTERISTIC
 /begin REF_MEASUREMENT /end REF_MEASUREMENT
/end GROUP
/begin GROUP Ap_MtrTempEst "MICROSAR RTE" /begin SUB_GROUP Ap_MtrTempEst.ReceiverPorts Ap_MtrTempEst.SenderPorts /end SUB_GROUP /begin FUNCTION_LIST /end FUNCTION_LIST /begin REF_CHARACTERISTIC /end REF_CHARACTERISTIC /begin REF_MEASUREMENT /end REF_MEASUREMENT /end GROUP
/begin GROUP Ap_MtrTempEst.AMTempEstDisable.Cnt_lgc "MICROSAR RTE" /begin SUB_GROUP /end SUB_GROUP /begin FUNCTION_LIST /end FUNCTION_LIST /begin REF_CHARACTERISTIC /end REF_CHARACTERISTIC /begin REF_MEASUREMENT Ap_MtrTempEst.AMTempEstDisable.Cnt_lgc /end REF_MEASUREMENT /end GROUP
/begin GROUP Ap_MtrTempEst.AmbTemp.DegC_f32 "MICROSAR RTE" /begin SUB_GROUP /end SUB_GROUP /begin FUNCTION_LIST /end FUNCTION_LIST /begin REF_CHARACTERISTIC /end REF_CHARACTERISTIC /begin REF_MEASUREMENT Ap_MtrTempEst.AmbTemp.DegC_f32 /end REF_MEASUREMENT /end GROUP
/begin GROUP Ap_MtrTempEst.AssistMechTempEst.DegC_f32 "MICROSAR RTE" /begin SUB_GROUP /end SUB_GROUP /begin FUNCTION_LIST /end FUNCTION_LIST /begin REF_CHARACTERISTIC /end REF_CHARACTERISTIC /begin REF_MEASUREMENT Ap_MtrTempEst.AssistMechTempEst.DegC_f32 /end REF_MEASUREMENT /end GROUP
/begin GROUP Ap_MtrTempEst.CtrlTempFinal.DegC_f32 "MICROSAR RTE" /begin SUB_GROUP /end SUB_GROUP /begin FUNCTION_LIST /end FUNCTION_LIST /begin REF_CHARACTERISTIC /end REF_CHARACTERISTIC /begin REF_MEASUREMENT Ap_MtrTempEst.CtrlTempFinal.DegC_f32 /end REF_MEASUREMENT /end GROUP
/begin GROUP Ap_MtrTempEst.CuTempEst.DegC_f32 "MICROSAR RTE" /begin SUB_GROUP /end SUB_GROUP /begin FUNCTION_LIST /end FUNCTION_LIST /begin REF_CHARACTERISTIC /end REF_CHARACTERISTIC /begin REF_MEASUREMENT Ap_MtrTempEst.CuTempEst.DegC_f32 /end REF_MEASUREMENT /end GROUP
/begin GROUP Ap_MtrTempEst.EngTemp.DegC_f32 "MICROSAR RTE" /begin SUB_GROUP /end SUB_GROUP /begin FUNCTION_LIST /end FUNCTION_LIST /begin REF_CHARACTERISTIC /end REF_CHARACTERISTIC /begin REF_MEASUREMENT Ap_MtrTempEst.EngTemp.DegC_f32 /end REF_MEASUREMENT /end GROUP
/begin GROUP Ap_MtrTempEst.EstPkCurr.AmpSq_f32 "MICROSAR RTE" /begin SUB_GROUP /end SUB_GROUP /begin FUNCTION_LIST /end FUNCTION_LIST /begin REF_CHARACTERISTIC /end REF_CHARACTERISTIC /begin REF_MEASUREMENT Ap_MtrTempEst.EstPkCurr.AmpSq_f32 /end REF_MEASUREMENT /end GROUP
/begin GROUP Ap_MtrTempEst.HwVel.HwRadpS_f32 "MICROSAR RTE" /begin SUB_GROUP /end SUB_GROUP /begin FUNCTION_LIST /end FUNCTION_LIST /begin REF_CHARACTERISTIC /end REF_CHARACTERISTIC /begin REF_MEASUREMENT Ap_MtrTempEst.HwVel.HwRadpS_f32 /end REF_MEASUREMENT /end GROUP
/begin GROUP Ap_MtrTempEst.MagTempEst.DegC_f32 "MICROSAR RTE" /begin SUB_GROUP /end SUB_GROUP /begin FUNCTION_LIST /end FUNCTION_LIST /begin REF_CHARACTERISTIC /end REF_CHARACTERISTIC /begin REF_MEASUREMENT Ap_MtrTempEst.MagTempEst.DegC_f32 /end REF_MEASUREMENT /end GROUP
/begin GROUP Ap_MtrTempEst.ReceiverPorts "MICROSAR RTE"
 /begin SUB_GROUP Ap_MtrTempEst.AMTempEstDisable.Cnt_lgc Ap_MtrTempEst.AmbTemp.DegC_f32 Ap_MtrTempEst.CtrlTempFinal.DegC_f32 Ap_MtrTempEst.EngTemp.DegC_f32 Ap_MtrTempEst.EstPkCurr.AmpSq_f32 Ap_MtrTempEst.HwVel.HwRadpS_f32 Ap_MtrTempEst.ScomTempDataRcvd.Cnt_lgc /end SUB_GROUP
 /begin FUNCTION_LIST /end FUNCTION_LIST
 /begin REF_CHARACTERISTIC /end REF_CHARACTERISTIC
 /begin REF_MEASUREMENT /end REF_MEASUREMENT
/end GROUP
/begin GROUP Ap_MtrTempEst.ScomTempDataRcvd.Cnt_lgc "MICROSAR RTE" /begin SUB_GROUP /end SUB_GROUP /begin FUNCTION_LIST /end FUNCTION_LIST /begin REF_CHARACTERISTIC /end REF_CHARACTERISTIC /begin REF_MEASUREMENT Ap_MtrTempEst.ScomTempDataRcvd.Cnt_lgc /end REF_MEASUREMENT /end GROUP
/begin GROUP Ap_MtrTempEst.SenderPorts "MICROSAR RTE"
 /begin SUB_GROUP Ap_MtrTempEst.AssistMechTempEst.DegC_f32 Ap_MtrTempEst.CuTempEst.DegC_f32 Ap_MtrTempEst.MagTempEst.DegC_f32 Ap_MtrTempEst.SiTempEst.DegC_f32 /end SUB_GROUP
 /begin FUNCTION_LIST /end FUNCTION_LIST
 /begin REF_CHARACTERISTIC /end REF_CHARACTERISTIC
 /begin REF_MEASUREMENT /end REF_MEASUREMENT
/end GROUP
/begin GROUP Ap_MtrTempEst.SiTempEst.DegC_f32 "MICROSAR RTE" /begin SUB_GROUP /end SUB_GROUP /begin FUNCTION_LIST /end FUNCTION_LIST /begin REF_CHARACTERISTIC /end REF_CHARACTERISTIC /begin REF_MEASUREMENT Ap_MtrTempEst.SiTempEst.DegC_f32 /end REF_MEASUREMENT /end GROUP
/begin GROUP Ap_PICurrCntrl "MICROSAR RTE"
 /begin SUB_GROUP Ap_PICurrCntrl.ModeRequirePorts Ap_PICurrCntrl.ReceiverPorts Ap_PICurrCntrl.SenderPorts /end SUB_GROUP
 /begin FUNCTION_LIST /end FUNCTION_LIST
 /begin REF_CHARACTERISTIC /end REF_CHARACTERISTIC
 /begin REF_MEASUREMENT /end REF_MEASUREMENT
/end GROUP
/begin GROUP Ap_PICurrCntrl.CorrMtrPosElec.Rev_f32 "MICROSAR RTE" /begin SUB_GROUP /end SUB_GROUP /begin FUNCTION_LIST /end FUNCTION_LIST /begin REF_CHARACTERISTIC /end REF_CHARACTERISTIC /begin REF_MEASUREMENT Ap_PICurrCntrl.CorrMtrPosElec.Rev_f32 /end REF_MEASUREMENT /end GROUP
/begin GROUP Ap_PICurrCntrl.DervLambdaAlphaDiag.Volt_f32 "MICROSAR RTE" /begin SUB_GROUP /end SUB_GROUP /begin FUNCTION_LIST /end FUNCTION_LIST /begin REF_CHARACTERISTIC /end REF_CHARACTERISTIC /begin REF_MEASUREMENT Ap_PICurrCntrl.DervLambdaAlphaDiag.Volt_f32 /end REF_MEASUREMENT /end GROUP
/begin GROUP Ap_PICurrCntrl.DervLambdaBetaDiag.Volt_f32 "MICROSAR RTE" /begin SUB_GROUP /end SUB_GROUP /begin FUNCTION_LIST /end FUNCTION_LIST /begin REF_CHARACTERISTIC /end REF_CHARACTERISTIC /begin REF_MEASUREMENT Ap_PICurrCntrl.DervLambdaBetaDiag.Volt_f32 /end REF_MEASUREMENT /end GROUP
/begin GROUP Ap_PICurrCntrl.EstKe.VpRadpS_f32 "MICROSAR RTE" /begin SUB_GROUP /end SUB_GROUP /begin FUNCTION_LIST /end FUNCTION_LIST /begin REF_CHARACTERISTIC /end REF_CHARACTERISTIC /begin REF_MEASUREMENT Ap_PICurrCntrl.EstKe.VpRadpS_f32 /end REF_MEASUREMENT /end GROUP
/begin GROUP Ap_PICurrCntrl.EstR.Ohm_f32 "MICROSAR RTE" /begin SUB_GROUP /end SUB_GROUP /begin FUNCTION_LIST /end FUNCTION_LIST /begin REF_CHARACTERISTIC /end REF_CHARACTERISTIC /begin REF_MEASUREMENT Ap_PICurrCntrl.EstR.Ohm_f32 /end REF_MEASUREMENT /end GROUP
/begin GROUP Ap_PICurrCntrl.MRFMtrVel.MtrRadpS_f32 "MICROSAR RTE" /begin SUB_GROUP /end SUB_GROUP /begin FUNCTION_LIST /end FUNCTION_LIST /begin REF_CHARACTERISTIC /end REF_CHARACTERISTIC /begin REF_MEASUREMENT Ap_PICurrCntrl.MRFMtrVel.MtrRadpS_f32 /end REF_MEASUREMENT /end GROUP
/begin GROUP Ap_PICurrCntrl.ModeRequirePorts "MICROSAR RTE" /begin SUB_GROUP Ap_PICurrCntrl.SystemState.Mode /end SUB_GROUP /begin FUNCTION_LIST /end FUNCTION_LIST /begin REF_CHARACTERISTIC /end REF_CHARACTERISTIC /begin REF_MEASUREMENT /end REF_MEASUREMENT /end GROUP
/begin GROUP Ap_PICurrCntrl.MtrCurrDaxRef.Amp_f32 "MICROSAR RTE" /begin SUB_GROUP /end SUB_GROUP /begin FUNCTION_LIST /end FUNCTION_LIST /begin REF_CHARACTERISTIC /end REF_CHARACTERISTIC /begin REF_MEASUREMENT Ap_PICurrCntrl.MtrCurrDaxRef.Amp_f32 /end REF_MEASUREMENT /end GROUP
/begin GROUP Ap_PICurrCntrl.ReceiverPorts "MICROSAR RTE"
 /begin SUB_GROUP Ap_PICurrCntrl.CorrMtrPosElec.Rev_f32 Ap_PICurrCntrl.EstKe.VpRadpS_f32 Ap_PICurrCntrl.EstR.Ohm_f32 Ap_PICurrCntrl.MRFMtrVel.MtrRadpS_f32 Ap_PICurrCntrl.MtrCurrDaxRef.Amp_f32 /end SUB_GROUP
 /begin FUNCTION_LIST /end FUNCTION_LIST
 /begin REF_CHARACTERISTIC /end REF_CHARACTERISTIC
 /begin REF_MEASUREMENT /end REF_MEASUREMENT
/end GROUP
/begin GROUP Ap_PICurrCntrl.SenderPorts "MICROSAR RTE"
 /begin SUB_GROUP Ap_PICurrCntrl.DervLambdaAlphaDiag.Volt_f32 Ap_PICurrCntrl.DervLambdaBetaDiag.Volt_f32 /end SUB_GROUP
 /begin FUNCTION_LIST /end FUNCTION_LIST
 /begin REF_CHARACTERISTIC /end REF_CHARACTERISTIC
 /begin REF_MEASUREMENT /end REF_MEASUREMENT
/end GROUP
/begin GROUP Ap_PICurrCntrl.SystemState.Mode "MICROSAR RTE" /begin SUB_GROUP /end SUB_GROUP /begin FUNCTION_LIST /end FUNCTION_LIST /begin REF_CHARACTERISTIC /end REF_CHARACTERISTIC /begin REF_MEASUREMENT Ap_PICurrCntrl.SystemState.Mode /end REF_MEASUREMENT /end GROUP
/begin GROUP Ap_PosServo "MICROSAR RTE" /begin SUB_GROUP Ap_PosServo.ReceiverPorts Ap_PosServo.SenderPorts /end SUB_GROUP /begin FUNCTION_LIST /end FUNCTION_LIST /begin REF_CHARACTERISTIC /end REF_CHARACTERISTIC /begin REF_MEASUREMENT /end REF_MEASUREMENT /end GROUP
/begin GROUP Ap_PosServo.HandwheelPosition.HwDeg_f32 "MICROSAR RTE" /begin SUB_GROUP /end SUB_GROUP /begin FUNCTION_LIST /end FUNCTION_LIST /begin REF_CHARACTERISTIC /end REF_CHARACTERISTIC /begin REF_MEASUREMENT Ap_PosServo.HandwheelPosition.HwDeg_f32 /end REF_MEASUREMENT /end GROUP
/begin GROUP Ap_PosServo.HwTorque.HwNm_f32 "MICROSAR RTE" /begin SUB_GROUP /end SUB_GROUP /begin FUNCTION_LIST /end FUNCTION_LIST /begin REF_CHARACTERISTIC /end REF_CHARACTERISTIC /begin REF_MEASUREMENT Ap_PosServo.HwTorque.HwNm_f32 /end REF_MEASUREMENT /end GROUP
/begin GROUP Ap_PosServo.MotorVelCRF.MtrRadpS_f32 "MICROSAR RTE" /begin SUB_GROUP /end SUB_GROUP /begin FUNCTION_LIST /end FUNCTION_LIST /begin REF_CHARACTERISTIC /end REF_CHARACTERISTIC /begin REF_MEASUREMENT Ap_PosServo.MotorVelCRF.MtrRadpS_f32 /end REF_MEASUREMENT /end GROUP
/begin GROUP Ap_PosServo.PosSrvoCmd.MtrNm_f32 "MICROSAR RTE" /begin SUB_GROUP /end SUB_GROUP /begin FUNCTION_LIST /end FUNCTION_LIST /begin REF_CHARACTERISTIC /end REF_CHARACTERISTIC /begin REF_MEASUREMENT Ap_PosServo.PosSrvoCmd.MtrNm_f32 /end REF_MEASUREMENT /end GROUP
/begin GROUP Ap_PosServo.PosSrvoEnable.Cnt_lgc "MICROSAR RTE" /begin SUB_GROUP /end SUB_GROUP /begin FUNCTION_LIST /end FUNCTION_LIST /begin REF_CHARACTERISTIC /end REF_CHARACTERISTIC /begin REF_MEASUREMENT Ap_PosServo.PosSrvoEnable.Cnt_lgc /end REF_MEASUREMENT /end GROUP
/begin GROUP Ap_PosServo.PosSrvoHwAngle.HwDeg_f32 "MICROSAR RTE" /begin SUB_GROUP /end SUB_GROUP /begin FUNCTION_LIST /end FUNCTION_LIST /begin REF_CHARACTERISTIC /end REF_CHARACTERISTIC /begin REF_MEASUREMENT Ap_PosServo.PosSrvoHwAngle.HwDeg_f32 /end REF_MEASUREMENT /end GROUP
/begin GROUP Ap_PosServo.PosSrvoReturnSclFct.Uls_f32 "MICROSAR RTE" /begin SUB_GROUP /end SUB_GROUP /begin FUNCTION_LIST /end FUNCTION_LIST /begin REF_CHARACTERISTIC /end REF_CHARACTERISTIC /begin REF_MEASUREMENT Ap_PosServo.PosSrvoReturnSclFct.Uls_f32 /end REF_MEASUREMENT /end GROUP
/begin GROUP Ap_PosServo.PosSrvoSmoothEnable.Uls_f32 "MICROSAR RTE" /begin SUB_GROUP /end SUB_GROUP /begin FUNCTION_LIST /end FUNCTION_LIST /begin REF_CHARACTERISTIC /end REF_CHARACTERISTIC /begin REF_MEASUREMENT Ap_PosServo.PosSrvoSmoothEnable.Uls_f32 /end REF_MEASUREMENT /end GROUP
/begin GROUP Ap_PosServo.ReceiverPorts "MICROSAR RTE"
 /begin SUB_GROUP Ap_PosServo.HandwheelPosition.HwDeg_f32 Ap_PosServo.HwTorque.HwNm_f32 Ap_PosServo.MotorVelCRF.MtrRadpS_f32 Ap_PosServo.PosSrvoEnable.Cnt_lgc Ap_PosServo.PosSrvoHwAngle.HwDeg_f32 Ap_PosServo.VehicleSpeed.Kph_f32 /end SUB_GROUP
 /begin FUNCTION_LIST /end FUNCTION_LIST
 /begin REF_CHARACTERISTIC /end REF_CHARACTERISTIC
 /begin REF_MEASUREMENT /end REF_MEASUREMENT
/end GROUP
/begin GROUP Ap_PosServo.SenderPorts "MICROSAR RTE"
 /begin SUB_GROUP Ap_PosServo.PosSrvoCmd.MtrNm_f32 Ap_PosServo.PosSrvoReturnSclFct.Uls_f32 Ap_PosServo.PosSrvoSmoothEnable.Uls_f32 /end SUB_GROUP
 /begin FUNCTION_LIST /end FUNCTION_LIST
 /begin REF_CHARACTERISTIC /end REF_CHARACTERISTIC
 /begin REF_MEASUREMENT /end REF_MEASUREMENT
/end GROUP
/begin GROUP Ap_PosServo.VehicleSpeed.Kph_f32 "MICROSAR RTE" /begin SUB_GROUP /end SUB_GROUP /begin FUNCTION_LIST /end FUNCTION_LIST /begin REF_CHARACTERISTIC /end REF_CHARACTERISTIC /begin REF_MEASUREMENT Ap_PosServo.VehicleSpeed.Kph_f32 /end REF_MEASUREMENT /end GROUP
/begin GROUP Ap_PwrLmtFuncCr "MICROSAR RTE"
 /begin SUB_GROUP Ap_PwrLmtFuncCr.ModeRequirePorts Ap_PwrLmtFuncCr.ReceiverPorts Ap_PwrLmtFuncCr.SenderPorts /end SUB_GROUP
 /begin FUNCTION_LIST /end FUNCTION_LIST
 /begin REF_CHARACTERISTIC /end REF_CHARACTERISTIC
 /begin REF_MEASUREMENT /end REF_MEASUREMENT
/end GROUP
/begin GROUP Ap_PwrLmtFuncCr.CntDisMtrTrqCmdMRF.MtrNm_f32 "MICROSAR RTE" /begin SUB_GROUP /end SUB_GROUP /begin FUNCTION_LIST /end FUNCTION_LIST /begin REF_CHARACTERISTIC /end REF_CHARACTERISTIC /begin REF_MEASUREMENT Ap_PwrLmtFuncCr.CntDisMtrTrqCmdMRF.MtrNm_f32 /end REF_MEASUREMENT /end GROUP
/begin GROUP Ap_PwrLmtFuncCr.EstKe.VpRadpS_f32 "MICROSAR RTE" /begin SUB_GROUP /end SUB_GROUP /begin FUNCTION_LIST /end FUNCTION_LIST /begin REF_CHARACTERISTIC /end REF_CHARACTERISTIC /begin REF_MEASUREMENT Ap_PwrLmtFuncCr.EstKe.VpRadpS_f32 /end REF_MEASUREMENT /end GROUP
/begin GROUP Ap_PwrLmtFuncCr.FltTrqLmt.Uls_f32 "MICROSAR RTE" /begin SUB_GROUP /end SUB_GROUP /begin FUNCTION_LIST /end FUNCTION_LIST /begin REF_CHARACTERISTIC /end REF_CHARACTERISTIC /begin REF_MEASUREMENT Ap_PwrLmtFuncCr.FltTrqLmt.Uls_f32 /end REF_MEASUREMENT /end GROUP
/begin GROUP Ap_PwrLmtFuncCr.MRFMtrTrqCmd.MtrNm_f32 "MICROSAR RTE" /begin SUB_GROUP /end SUB_GROUP /begin FUNCTION_LIST /end FUNCTION_LIST /begin REF_CHARACTERISTIC /end REF_CHARACTERISTIC /begin REF_MEASUREMENT Ap_PwrLmtFuncCr.MRFMtrTrqCmd.MtrNm_f32 /end REF_MEASUREMENT /end GROUP
/begin GROUP Ap_PwrLmtFuncCr.ModeRequirePorts "MICROSAR RTE" /begin SUB_GROUP Ap_PwrLmtFuncCr.SystemState.Mode /end SUB_GROUP /begin FUNCTION_LIST /end FUNCTION_LIST /begin REF_CHARACTERISTIC /end REF_CHARACTERISTIC /begin REF_MEASUREMENT /end REF_MEASUREMENT /end GROUP
/begin GROUP Ap_PwrLmtFuncCr.MotorVelMRF.MtrRadpS_f32 "MICROSAR RTE" /begin SUB_GROUP /end SUB_GROUP /begin FUNCTION_LIST /end FUNCTION_LIST /begin REF_CHARACTERISTIC /end REF_CHARACTERISTIC /begin REF_MEASUREMENT Ap_PwrLmtFuncCr.MotorVelMRF.MtrRadpS_f32 /end REF_MEASUREMENT /end GROUP
/begin GROUP Ap_PwrLmtFuncCr.PosServEnable.Cnt_lgc "MICROSAR RTE" /begin SUB_GROUP /end SUB_GROUP /begin FUNCTION_LIST /end FUNCTION_LIST /begin REF_CHARACTERISTIC /end REF_CHARACTERISTIC /begin REF_MEASUREMENT Ap_PwrLmtFuncCr.PosServEnable.Cnt_lgc /end REF_MEASUREMENT /end GROUP
/begin GROUP Ap_PwrLmtFuncCr.ReceiverPorts "MICROSAR RTE"
 /begin SUB_GROUP Ap_PwrLmtFuncCr.CntDisMtrTrqCmdMRF.MtrNm_f32 Ap_PwrLmtFuncCr.EstKe.VpRadpS_f32 Ap_PwrLmtFuncCr.MotorVelMRF.MtrRadpS_f32 Ap_PwrLmtFuncCr.PosServEnable.Cnt_lgc Ap_PwrLmtFuncCr.Vecu.Volt_f32 /end SUB_GROUP
 /begin FUNCTION_LIST /end FUNCTION_LIST
 /begin REF_CHARACTERISTIC /end REF_CHARACTERISTIC
 /begin REF_MEASUREMENT /end REF_MEASUREMENT
/end GROUP
/begin GROUP Ap_PwrLmtFuncCr.SenderPorts "MICROSAR RTE"
 /begin SUB_GROUP Ap_PwrLmtFuncCr.FltTrqLmt.Uls_f32 Ap_PwrLmtFuncCr.MRFMtrTrqCmd.MtrNm_f32 Ap_PwrLmtFuncCr.ThresholdExceeded.Cnt_lgc /end SUB_GROUP
 /begin FUNCTION_LIST /end FUNCTION_LIST
 /begin REF_CHARACTERISTIC /end REF_CHARACTERISTIC
 /begin REF_MEASUREMENT /end REF_MEASUREMENT
/end GROUP
/begin GROUP Ap_PwrLmtFuncCr.SystemState.Mode "MICROSAR RTE" /begin SUB_GROUP /end SUB_GROUP /begin FUNCTION_LIST /end FUNCTION_LIST /begin REF_CHARACTERISTIC /end REF_CHARACTERISTIC /begin REF_MEASUREMENT Ap_PwrLmtFuncCr.SystemState.Mode /end REF_MEASUREMENT /end GROUP
/begin GROUP Ap_PwrLmtFuncCr.ThresholdExceeded.Cnt_lgc "MICROSAR RTE" /begin SUB_GROUP /end SUB_GROUP /begin FUNCTION_LIST /end FUNCTION_LIST /begin REF_CHARACTERISTIC /end REF_CHARACTERISTIC /begin REF_MEASUREMENT Ap_PwrLmtFuncCr.ThresholdExceeded.Cnt_lgc /end REF_MEASUREMENT /end GROUP
/begin GROUP Ap_PwrLmtFuncCr.Vecu.Volt_f32 "MICROSAR RTE" /begin SUB_GROUP /end SUB_GROUP /begin FUNCTION_LIST /end FUNCTION_LIST /begin REF_CHARACTERISTIC /end REF_CHARACTERISTIC /begin REF_MEASUREMENT Ap_PwrLmtFuncCr.Vecu.Volt_f32 /end REF_MEASUREMENT /end GROUP
/begin GROUP Ap_SASPlausDiag "MICROSAR RTE" /begin SUB_GROUP Ap_SASPlausDiag.ReceiverPorts /end SUB_GROUP /begin FUNCTION_LIST /end FUNCTION_LIST /begin REF_CHARACTERISTIC /end REF_CHARACTERISTIC /begin REF_MEASUREMENT /end REF_MEASUREMENT /end GROUP
/begin GROUP Ap_SASPlausDiag.I2CHwAbsPos.HwDeg_f32 "MICROSAR RTE" /begin SUB_GROUP /end SUB_GROUP /begin FUNCTION_LIST /end FUNCTION_LIST /begin REF_CHARACTERISTIC /end REF_CHARACTERISTIC /begin REF_MEASUREMENT Ap_SASPlausDiag.I2CHwAbsPos.HwDeg_f32 /end REF_MEASUREMENT /end GROUP
/begin GROUP Ap_SASPlausDiag.I2CHwAbsPosValid.Cnt_lgc "MICROSAR RTE" /begin SUB_GROUP /end SUB_GROUP /begin FUNCTION_LIST /end FUNCTION_LIST /begin REF_CHARACTERISTIC /end REF_CHARACTERISTIC /begin REF_MEASUREMENT Ap_SASPlausDiag.I2CHwAbsPosValid.Cnt_lgc /end REF_MEASUREMENT /end GROUP
/begin GROUP Ap_SASPlausDiag.ReceiverPorts "MICROSAR RTE"
 /begin SUB_GROUP Ap_SASPlausDiag.I2CHwAbsPos.HwDeg_f32 Ap_SASPlausDiag.I2CHwAbsPosValid.Cnt_lgc Ap_SASPlausDiag.VdAuthority.Uls_f32 Ap_SASPlausDiag.VdHwPos.HwDeg_f32 /end SUB_GROUP
 /begin FUNCTION_LIST /end FUNCTION_LIST
 /begin REF_CHARACTERISTIC /end REF_CHARACTERISTIC
 /begin REF_MEASUREMENT /end REF_MEASUREMENT
/end GROUP
/begin GROUP Ap_SASPlausDiag.VdAuthority.Uls_f32 "MICROSAR RTE" /begin SUB_GROUP /end SUB_GROUP /begin FUNCTION_LIST /end FUNCTION_LIST /begin REF_CHARACTERISTIC /end REF_CHARACTERISTIC /begin REF_MEASUREMENT Ap_SASPlausDiag.VdAuthority.Uls_f32 /end REF_MEASUREMENT /end GROUP
/begin GROUP Ap_SASPlausDiag.VdHwPos.HwDeg_f32 "MICROSAR RTE" /begin SUB_GROUP /end SUB_GROUP /begin FUNCTION_LIST /end FUNCTION_LIST /begin REF_CHARACTERISTIC /end REF_CHARACTERISTIC /begin REF_MEASUREMENT Ap_SASPlausDiag.VdHwPos.HwDeg_f32 /end REF_MEASUREMENT /end GROUP
/begin GROUP Ap_SignlCondn "MICROSAR RTE" /begin SUB_GROUP Ap_SignlCondn.ReceiverPorts Ap_SignlCondn.SenderPorts /end SUB_GROUP /begin FUNCTION_LIST /end FUNCTION_LIST /begin REF_CHARACTERISTIC /end REF_CHARACTERISTIC /begin REF_MEASUREMENT /end REF_MEASUREMENT /end GROUP
/begin GROUP Ap_SignlCondn.ReceiverPorts "MICROSAR RTE"
 /begin SUB_GROUP Ap_SignlCondn.SrlComVehSpeed.Kph_f32 Ap_SignlCondn.SrlCom_VehicleLonAccel.KphpS_f32 /end SUB_GROUP
 /begin FUNCTION_LIST /end FUNCTION_LIST
 /begin REF_CHARACTERISTIC /end REF_CHARACTERISTIC
 /begin REF_MEASUREMENT /end REF_MEASUREMENT
/end GROUP
/begin GROUP Ap_SignlCondn.SenderPorts "MICROSAR RTE"
 /begin SUB_GROUP Ap_SignlCondn.VehicleSpeed.Kph_f32 Ap_SignlCondn.Vehicle_LonAccel.KphpS_f32 /end SUB_GROUP
 /begin FUNCTION_LIST /end FUNCTION_LIST
 /begin REF_CHARACTERISTIC /end REF_CHARACTERISTIC
 /begin REF_MEASUREMENT /end REF_MEASUREMENT
/end GROUP
/begin GROUP Ap_SignlCondn.SrlComVehSpeed.Kph_f32 "MICROSAR RTE" /begin SUB_GROUP /end SUB_GROUP /begin FUNCTION_LIST /end FUNCTION_LIST /begin REF_CHARACTERISTIC /end REF_CHARACTERISTIC /begin REF_MEASUREMENT Ap_SignlCondn.SrlComVehSpeed.Kph_f32 /end REF_MEASUREMENT /end GROUP
/begin GROUP Ap_SignlCondn.SrlCom_VehicleLonAccel.KphpS_f32 "MICROSAR RTE" /begin SUB_GROUP /end SUB_GROUP /begin FUNCTION_LIST /end FUNCTION_LIST /begin REF_CHARACTERISTIC /end REF_CHARACTERISTIC /begin REF_MEASUREMENT Ap_SignlCondn.SrlCom_VehicleLonAccel.KphpS_f32 /end REF_MEASUREMENT /end GROUP
/begin GROUP Ap_SignlCondn.VehicleSpeed.Kph_f32 "MICROSAR RTE" /begin SUB_GROUP /end SUB_GROUP /begin FUNCTION_LIST /end FUNCTION_LIST /begin REF_CHARACTERISTIC /end REF_CHARACTERISTIC /begin REF_MEASUREMENT Ap_SignlCondn.VehicleSpeed.Kph_f32 /end REF_MEASUREMENT /end GROUP
/**********************************************************************************************************************
* RECORD_LAYOUT
*********************************************************************************************************************/
/begin RECORD_LAYOUT RTE_RL_UBYTE FNC_VALUES 1 UBYTE ROW_DIR DIRECT /end RECORD_LAYOUT
/begin RECORD_LAYOUT RTE_RL_UWORD FNC_VALUES 1 UWORD ROW_DIR DIRECT /end RECORD_LAYOUT
/**********************************************************************************************************************
* COMPU_METHOD / COMPU_VTAB_RANGE
*********************************************************************************************************************/
/begin COMPU_METHOD RTE_CM_BOOLEAN "" TAB_VERB "%3.1" "" COMPU_TAB_REF RTE_CM_BOOLEAN /end COMPU_METHOD
/begin COMPU_VTAB_RANGE RTE_CM_BOOLEAN "" 2 0 0 "false" 1 255 "true" /end COMPU_VTAB_RANGE
/begin COMPU_METHOD RTE_CM_ENUM_ManufModeType "" TAB_VERB "%.1" "" COMPU_TAB_REF RTE_CM_ENUM_ManufModeType /end COMPU_METHOD
/begin COMPU_VTAB_RANGE RTE_CM_ENUM_ManufModeType "" 3 0 0 "ProductionMode" 1 1 "ManufacturingMode" 2 2 "EngineeringMode" /end COMPU_VTAB_RANGE
/begin COMPU_METHOD RTE_CM_ENUM_StaMd_Mode "" TAB_VERB "%.1" "" COMPU_TAB_REF RTE_CM_ENUM_StaMd_Mode /end COMPU_METHOD
/begin COMPU_VTAB_RANGE RTE_CM_ENUM_StaMd_Mode "" 5 0 0 "RTE_MODE_StaMd_Mode_DISABLE" 1 1 "RTE_MODE_StaMd_Mode_OFF" 2 2 "RTE_MODE_StaMd_Mode_OPERATE" 3 3 "RTE_MODE_StaMd_Mode_WARMINIT" 4 4 "RTE_TRANSITION_StaMd_Mode" /end COMPU_VTAB_RANGE
/begin COMPU_METHOD RTE_CM_ENUM_APA_State_enum "" TAB_VERB "%.1" "" COMPU_TAB_REF RTE_CM_ENUM_APA_State_enum /end COMPU_METHOD
/begin COMPU_VTAB_RANGE RTE_CM_ENUM_APA_State_enum "" 5 0 0 "APA_TempInhibit" 1 1 "APA_AvailCntrl" 2 2 "APA_Active" 3 3 "APA_PermanentlyFailed" 4 4 "APA_ManufacturingDisable" /end COMPU_VTAB_RANGE
/begin COMPU_METHOD RTE_CM_ENUM_SS_State_enum "" TAB_VERB "%.1" "" COMPU_TAB_REF RTE_CM_ENUM_SS_State_enum /end COMPU_METHOD
/begin COMPU_VTAB_RANGE RTE_CM_ENUM_SS_State_enum "" 6 0 0 "SS_Normal" 1 1 "SS_Intermediate1" 2 2 "SS_Stop" 3 3 "SS_Intermediate2" 4 4 "SS_Fault" 5 5 "SS_Disable" /end COMPU_VTAB_RANGE
