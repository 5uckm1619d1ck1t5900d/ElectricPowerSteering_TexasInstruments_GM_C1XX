/begin MEASUREMENT RteErrata9.SystemState.Mode "MICROSAR RTE" UBYTE RTE_CM_ENUM_StaMd_Mode 0 0 0 255 ECU_ADDRESS 0 SYMBOL_LINK "Rte_ModeMachine_Ap_StaMd9_SystemState9_Mode" 0 DISPLAY_IDENTIFIER RteErrata9.ModeRequirePorts.SystemState.Mode /end MEASUREMENT
/begin MEASUREMENT Sa_DigHwTrqSENT.DigTrqTrim.k_EOLHwTrqTrimPerformed_Cnt_Lgc "MICROSAR RTE" UBYTE RTE_CM_BOOLEAN 0 0 0 255 ECU_ADDRESS 0 SYMBOL_LINK "Rte_Sa_DigHwTrqSENT_DigTrqTrim.k_EOLHwTrqTrimPerformed_Cnt_Lgc" 0 DISPLAY_IDENTIFIER Sa_DigHwTrqSENT.PerInstanceMemories.DigTrqTrim.k_EOLHwTrqTrimPerformed_Cnt_Lgc READ_WRITE /end MEASUREMENT
/begin MEASUREMENT Sa_DigHwTrqSENT.DigTrqTrim.k_EOLHwTrqTrim_HwNm_f32 "MICROSAR RTE" FLOAT32_IEEE NO_COMPU_METHOD 0 0 1.175494351e-38 3.402823466e+38 ECU_ADDRESS 0 SYMBOL_LINK "Rte_Sa_DigHwTrqSENT_DigTrqTrim.k_EOLHwTrqTrim_HwNm_f32" 0 DISPLAY_IDENTIFIER Sa_DigHwTrqSENT.PerInstanceMemories.DigTrqTrim.k_EOLHwTrqTrim_HwNm_f32 READ_WRITE /end MEASUREMENT
/begin MEASUREMENT Sa_DigHwTrqSENT.HwTorque.HwNm_f32 "MICROSAR RTE" FLOAT32_IEEE NO_COMPU_METHOD 0 0 1.175494351e-38 3.402823466e+38 ECU_ADDRESS 0 SYMBOL_LINK "Rte_Sa_DigHwTrqSENT_HwTorque_HwNm_f32" 0 DISPLAY_IDENTIFIER Sa_DigHwTrqSENT.SenderPorts.HwTorque.HwNm_f32 /end MEASUREMENT
/begin MEASUREMENT Sa_DigHwTrqSENT.MECCounter.Cnt_enum "MICROSAR RTE" UBYTE RTE_CM_ENUM_ManufModeType 0 0 0 2 ECU_ADDRESS 0 SYMBOL_LINK "Rte_CDDInterface_MEC_Cnt_enum" 0 DISPLAY_IDENTIFIER Sa_DigHwTrqSENT.ReceiverPorts.MECCounter.Cnt_enum /end MEASUREMENT
/begin MEASUREMENT Sa_DigHwTrqSENT.SrlComHwTrq.HwNm_f32 "MICROSAR RTE" FLOAT32_IEEE NO_COMPU_METHOD 0 0 1.175494351e-38 3.402823466e+38 ECU_ADDRESS 0 SYMBOL_LINK "Rte_Sa_DigHwTrqSENT_SrlComHwTrq_HwNm_f32" 0 DISPLAY_IDENTIFIER Sa_DigHwTrqSENT.SenderPorts.SrlComHwTrq.HwNm_f32 /end MEASUREMENT
/begin MEASUREMENT Sa_DigHwTrqSENT.SrlComHwTrqValid.Cnt_lgc "MICROSAR RTE" UBYTE RTE_CM_BOOLEAN 0 0 0 255 ECU_ADDRESS 0 SYMBOL_LINK "Rte_Sa_DigHwTrqSENT_SrlComHwTrqValid_Cnt_lgc" 0 DISPLAY_IDENTIFIER Sa_DigHwTrqSENT.SenderPorts.SrlComHwTrqValid.Cnt_lgc /end MEASUREMENT
/begin MEASUREMENT Sa_DigHwTrqSENT.SysCHwTorque.HwNm_f32 "MICROSAR RTE" FLOAT32_IEEE NO_COMPU_METHOD 0 0 1.175494351e-38 3.402823466e+38 ECU_ADDRESS 0 SYMBOL_LINK "Rte_Sa_DigHwTrqSENT_SysCHwTorque_HwNm_f32" 0 DISPLAY_IDENTIFIER Sa_DigHwTrqSENT.SenderPorts.SysCHwTorque.HwNm_f32 /end MEASUREMENT
/begin MEASUREMENT Sa_DigHwTrqSENT.T1.HwNm_f32 "MICROSAR RTE" FLOAT32_IEEE NO_COMPU_METHOD 0 0 1.175494351e-38 3.402823466e+38 ECU_ADDRESS 0 SYMBOL_LINK "Rte_Cd_Nhet1_DigHwTrqT1_HwNm_f32" 0 DISPLAY_IDENTIFIER Sa_DigHwTrqSENT.ReceiverPorts.T1.HwNm_f32 /end MEASUREMENT
/begin MEASUREMENT Sa_DigHwTrqSENT.T2.HwNm_f32 "MICROSAR RTE" FLOAT32_IEEE NO_COMPU_METHOD 0 0 1.175494351e-38 3.402823466e+38 ECU_ADDRESS 0 SYMBOL_LINK "Rte_Cd_Nhet1_DigHwTrqT2_HwNm_f32" 0 DISPLAY_IDENTIFIER Sa_DigHwTrqSENT.ReceiverPorts.T2.HwNm_f32 /end MEASUREMENT
/begin MEASUREMENT Sa_DigMSB.AlignedCumMechMtrPosCRF.Deg_f32 "MICROSAR RTE" FLOAT32_IEEE NO_COMPU_METHOD 0 0 1.175494351e-38 3.402823466e+38 ECU_ADDRESS 0 SYMBOL_LINK "Rte_Sa_DigMSB_AlignedCumMechMtrPosCRF_Deg_f32" 0 DISPLAY_IDENTIFIER Sa_DigMSB.SenderPorts.AlignedCumMechMtrPosCRF.Deg_f32 /end MEASUREMENT
/begin MEASUREMENT Sa_DigMSB.AlignedCumMechMtrPosMRF.Deg_f32 "MICROSAR RTE" FLOAT32_IEEE NO_COMPU_METHOD 0 0 1.175494351e-38 3.402823466e+38 ECU_ADDRESS 0 SYMBOL_LINK "Rte_Sa_DigMSB_AlignedCumMechMtrPosMRF_Deg_f32" 0 DISPLAY_IDENTIFIER Sa_DigMSB.SenderPorts.AlignedCumMechMtrPosMRF.Deg_f32 /end MEASUREMENT
/begin MEASUREMENT Sa_DigMSB.AlignedCumMechMtrPosStatus.Cnt_u08 "MICROSAR RTE" UBYTE NO_COMPU_METHOD 0 0 0 255 ECU_ADDRESS 0 SYMBOL_LINK "Rte_Sa_DigMSB_AlignedCumMechMtrPosStatus_Cnt_u08" 0 DISPLAY_IDENTIFIER Sa_DigMSB.SenderPorts.AlignedCumMechMtrPosStatus.Cnt_u08 /end MEASUREMENT
/begin MEASUREMENT Sa_DigMSB.AssistAssemblyPolarity.Cnt_s08 "MICROSAR RTE" SBYTE NO_COMPU_METHOD 0 0 -128 127 ECU_ADDRESS 0 SYMBOL_LINK "Rte_Polarity_AssistAssyPolarity_Cnt_s08" 0 DISPLAY_IDENTIFIER Sa_DigMSB.ReceiverPorts.AssistAssemblyPolarity.Cnt_s08 /end MEASUREMENT
/begin MEASUREMENT Sa_DigMSB.CorrectedElecMtrPos.Rev_u0p16 "MICROSAR RTE" UWORD NO_COMPU_METHOD 0 0 0 65535 ECU_ADDRESS 0 SYMBOL_LINK "Rte_CDDInterface_CorrectedElecMtrPos_Rev_u0p16" 0 DISPLAY_IDENTIFIER Sa_DigMSB.ReceiverPorts.CorrectedElecMtrPos.Rev_u0p16 /end MEASUREMENT
/begin MEASUREMENT Sa_DigMSB.CumMechMtrPos.Rev_f32 "MICROSAR RTE" FLOAT32_IEEE NO_COMPU_METHOD 0 0 1.175494351e-38 3.402823466e+38 ECU_ADDRESS 0 SYMBOL_LINK "Rte_CDDInterface_CumMechMtrPos_Rev_f32" 0 DISPLAY_IDENTIFIER Sa_DigMSB.ReceiverPorts.CumMechMtrPos.Rev_f32 /end MEASUREMENT
/begin MEASUREMENT Sa_DigMSB.CumMechMtrPosCRF.Deg_f32 "MICROSAR RTE" FLOAT32_IEEE NO_COMPU_METHOD 0 0 1.175494351e-38 3.402823466e+38 ECU_ADDRESS 0 SYMBOL_LINK "Rte_Sa_DigMSB_CumMechMtrPosCRF_Deg_f32" 0 DISPLAY_IDENTIFIER Sa_DigMSB.SenderPorts.CumMechMtrPosCRF.Deg_f32 /end MEASUREMENT
/begin MEASUREMENT Sa_DigMSB.CumMechMtrPosMRF.Deg_f32 "MICROSAR RTE" FLOAT32_IEEE NO_COMPU_METHOD 0 0 1.175494351e-38 3.402823466e+38 ECU_ADDRESS 0 SYMBOL_LINK "Rte_Sa_DigMSB_CumMechMtrPosMRF_Deg_f32" 0 DISPLAY_IDENTIFIER Sa_DigMSB.SenderPorts.CumMechMtrPosMRF.Deg_f32 /end MEASUREMENT
/begin MEASUREMENT Sa_DigMSB.CumMechMtrPosStatus.Cnt_u08 "MICROSAR RTE" UBYTE NO_COMPU_METHOD 0 0 0 255 ECU_ADDRESS 0 SYMBOL_LINK "Rte_Sa_DigMSB_CumMechMtrPosStatus_Cnt_u08" 0 DISPLAY_IDENTIFIER Sa_DigMSB.SenderPorts.CumMechMtrPosStatus.Cnt_u08 /end MEASUREMENT
/begin MEASUREMENT Sa_DigMSB.Die1RxError.Cnt_u16 "MICROSAR RTE" UWORD NO_COMPU_METHOD 0 0 0 65535 ECU_ADDRESS 0 SYMBOL_LINK "Rte_CDDInterface_Die1RxError_Cnt_u16" 0 DISPLAY_IDENTIFIER Sa_DigMSB.ReceiverPorts.Die1RxError.Cnt_u16 /end MEASUREMENT
/begin MEASUREMENT Sa_DigMSB.Die1RxMtrPos.Cnt_u16 "MICROSAR RTE" UWORD NO_COMPU_METHOD 0 0 0 65535 ECU_ADDRESS 0 SYMBOL_LINK "Rte_CDDInterface_Die1RxMtrPos_Cnt_u16" 0 DISPLAY_IDENTIFIER Sa_DigMSB.ReceiverPorts.Die1RxMtrPos.Cnt_u16 /end MEASUREMENT
/begin MEASUREMENT Sa_DigMSB.Die1RxRevCtr.Cnt_u16 "MICROSAR RTE" UWORD NO_COMPU_METHOD 0 0 0 65535 ECU_ADDRESS 0 SYMBOL_LINK "Rte_CDDInterface_Die1RxRevCtr_Cnt_u16" 0 DISPLAY_IDENTIFIER Sa_DigMSB.ReceiverPorts.Die1RxRevCtr.Cnt_u16 /end MEASUREMENT
/begin MEASUREMENT Sa_DigMSB.Die1UnderVoltgFltAccum.Cnt_u16 "MICROSAR RTE" UWORD NO_COMPU_METHOD 0 0 0 65535 ECU_ADDRESS 0 SYMBOL_LINK "Rte_CDDInterface_Die1UnderVoltgFltAccum_Cnt_u16" 0 DISPLAY_IDENTIFIER Sa_DigMSB.ReceiverPorts.Die1UnderVoltgFltAccum.Cnt_u16 /end MEASUREMENT
/begin MEASUREMENT Sa_DigMSB.Die2RxError.Cnt_u16 "MICROSAR RTE" UWORD NO_COMPU_METHOD 0 0 0 65535 ECU_ADDRESS 0 SYMBOL_LINK "Rte_CDDInterface_Die2RxError_Cnt_u16" 0 DISPLAY_IDENTIFIER Sa_DigMSB.ReceiverPorts.Die2RxError.Cnt_u16 /end MEASUREMENT
/begin MEASUREMENT Sa_DigMSB.Die2RxMtrPos.Cnt_u16 "MICROSAR RTE" UWORD NO_COMPU_METHOD 0 0 0 65535 ECU_ADDRESS 0 SYMBOL_LINK "Rte_CDDInterface_Die2RxMtrPos_Cnt_u16" 0 DISPLAY_IDENTIFIER Sa_DigMSB.ReceiverPorts.Die2RxMtrPos.Cnt_u16 /end MEASUREMENT
/begin MEASUREMENT Sa_DigMSB.Die2RxRevCtr.Cnt_u16 "MICROSAR RTE" UWORD NO_COMPU_METHOD 0 0 0 65535 ECU_ADDRESS 0 SYMBOL_LINK "Rte_CDDInterface_Die2RxRevCtr_Cnt_u16" 0 DISPLAY_IDENTIFIER Sa_DigMSB.ReceiverPorts.Die2RxRevCtr.Cnt_u16 /end MEASUREMENT
/begin MEASUREMENT Sa_DigMSB.DigMSBEOLData.CRC_Cnt_u16 "MICROSAR RTE" UWORD NO_COMPU_METHOD 0 0 0 65535 ECU_ADDRESS 0 SYMBOL_LINK "Rte_Sa_DigMSB_DigMSBEOLData.CRC_Cnt_u16" 0 DISPLAY_IDENTIFIER Sa_DigMSB.PerInstanceMemories.DigMSBEOLData.CRC_Cnt_u16 READ_WRITE /end MEASUREMENT
/begin MEASUREMENT Sa_DigMSB.DigMSBEOLData.MtrPos1HarCompTbl_Rev_s2p13 "MICROSAR RTE" SWORD NO_COMPU_METHOD 0 0 -32768 32767 MATRIX_DIM 1024 1 1 ECU_ADDRESS 0 SYMBOL_LINK "Rte_Sa_DigMSB_DigMSBEOLData.MtrPos1HarCompTbl_Rev_s2p13" 0 DISPLAY_IDENTIFIER Sa_DigMSB.PerInstanceMemories.DigMSBEOLData.MtrPos1HarCompTbl_Rev_s2p13 READ_WRITE /end MEASUREMENT
/begin MEASUREMENT Sa_DigMSB.DigMSBEOLData.MtrPos2HarCompTbl_Rev_s2p13 "MICROSAR RTE" SWORD NO_COMPU_METHOD 0 0 -32768 32767 MATRIX_DIM 1024 1 1 ECU_ADDRESS 0 SYMBOL_LINK "Rte_Sa_DigMSB_DigMSBEOLData.MtrPos2HarCompTbl_Rev_s2p13" 0 DISPLAY_IDENTIFIER Sa_DigMSB.PerInstanceMemories.DigMSBEOLData.MtrPos2HarCompTbl_Rev_s2p13 READ_WRITE /end MEASUREMENT
/begin MEASUREMENT Sa_DigMSB.DigMSBEOLData.MtrPosBEMFRedundant_Rev_u0p16 "MICROSAR RTE" UWORD NO_COMPU_METHOD 0 0 0 65535 ECU_ADDRESS 0 SYMBOL_LINK "Rte_Sa_DigMSB_DigMSBEOLData.MtrPosBEMFRedundant_Rev_u0p16" 0 DISPLAY_IDENTIFIER Sa_DigMSB.PerInstanceMemories.DigMSBEOLData.MtrPosBEMFRedundant_Rev_u0p16 READ_WRITE /end MEASUREMENT
/begin MEASUREMENT Sa_DigMSB.DigMSBEOLData.MtrPosBEMF_Rev_u0p16 "MICROSAR RTE" UWORD NO_COMPU_METHOD 0 0 0 65535 ECU_ADDRESS 0 SYMBOL_LINK "Rte_Sa_DigMSB_DigMSBEOLData.MtrPosBEMF_Rev_u0p16" 0 DISPLAY_IDENTIFIER Sa_DigMSB.PerInstanceMemories.DigMSBEOLData.MtrPosBEMF_Rev_u0p16 READ_WRITE /end MEASUREMENT
/begin MEASUREMENT Sa_DigMSB.MechMtrPos2.Rev_u0p16 "MICROSAR RTE" UWORD NO_COMPU_METHOD 0 0 0 65535 ECU_ADDRESS 0 SYMBOL_LINK "Rte_Sa_DigMSB_MechMtrPos2_Rev_u0p16" 0 DISPLAY_IDENTIFIER Sa_DigMSB.SenderPorts.MechMtrPos2.Rev_u0p16 /end MEASUREMENT
/begin MEASUREMENT Sa_DigMSB.MtrPosPolarity.Cnt_s08 "MICROSAR RTE" SBYTE NO_COMPU_METHOD 0 0 -128 127 ECU_ADDRESS 0 SYMBOL_LINK "Rte_Polarity_MtrPosPolarity_Cnt_s08" 0 DISPLAY_IDENTIFIER Sa_DigMSB.ReceiverPorts.MtrPosPolarity.Cnt_s08 /end MEASUREMENT
/begin MEASUREMENT Sa_DigMSB.RxMtrPosParityAccum.Cnt_u16 "MICROSAR RTE" UWORD NO_COMPU_METHOD 0 0 0 65535 ECU_ADDRESS 0 SYMBOL_LINK "Rte_CDDInterface_RxMtrPos1ParityAccum_Cnt_u16" 0 DISPLAY_IDENTIFIER Sa_DigMSB.ReceiverPorts.RxMtrPosParityAccum.Cnt_u16 /end MEASUREMENT
/begin MEASUREMENT Sa_DigMSB.SysCCumMechMtrPosMRF.Deg_f32 "MICROSAR RTE" FLOAT32_IEEE NO_COMPU_METHOD 0 0 1.175494351e-38 3.402823466e+38 ECU_ADDRESS 0 SYMBOL_LINK "Rte_Sa_DigMSB_SysCCumMechMtrPosMRF_Deg_f32" 0 DISPLAY_IDENTIFIER Sa_DigMSB.SenderPorts.SysCCumMechMtrPosMRF.Deg_f32 /end MEASUREMENT
/begin MEASUREMENT Sa_DigMSB.UncorrMechMtrPos1.Rev_u0p16 "MICROSAR RTE" UWORD NO_COMPU_METHOD 0 0 0 65535 ECU_ADDRESS 0 SYMBOL_LINK "Rte_CDDInterface_UncorrMechMtrPos1_Rev_u0p16" 0 DISPLAY_IDENTIFIER Sa_DigMSB.ReceiverPorts.UncorrMechMtrPos1.Rev_u0p16 /end MEASUREMENT
/begin MEASUREMENT Sa_MtrVel.AsstAssemblyPolarity.Cnt_s08 "MICROSAR RTE" SBYTE NO_COMPU_METHOD 0 0 -128 127 ECU_ADDRESS 0 SYMBOL_LINK "Rte_Polarity_AssistAssyPolarity_Cnt_s08" 0 DISPLAY_IDENTIFIER Sa_MtrVel.ReceiverPorts.AsstAssemblyPolarity.Cnt_s08 /end MEASUREMENT
/begin MEASUREMENT Sa_MtrVel.HandwheelVel.HwRadpS_f32 "MICROSAR RTE" FLOAT32_IEEE NO_COMPU_METHOD 0 0 1.175494351e-38 3.402823466e+38 ECU_ADDRESS 0 SYMBOL_LINK "Rte_Sa_MtrVel_HandwheelVel_HwRadpS_f32" 0 DISPLAY_IDENTIFIER Sa_MtrVel.SenderPorts.HandwheelVel.HwRadpS_f32 /end MEASUREMENT
/begin MEASUREMENT Sa_MtrVel.HwVelValid.Cnt_lgc "MICROSAR RTE" UBYTE RTE_CM_BOOLEAN 0 0 0 255 ECU_ADDRESS 0 SYMBOL_LINK "Rte_Sa_MtrVel_HwVelValid_Cnt_lgc" 0 DISPLAY_IDENTIFIER Sa_MtrVel.SenderPorts.HwVelValid.Cnt_lgc /end MEASUREMENT
/begin MEASUREMENT Sa_MtrVel.MechMtrPos2.Rev_u0p16 "MICROSAR RTE" UWORD NO_COMPU_METHOD 0 0 0 65535 ECU_ADDRESS 0 SYMBOL_LINK "Rte_Sa_DigMSB_MechMtrPos2_Rev_u0p16" 0 DISPLAY_IDENTIFIER Sa_MtrVel.ReceiverPorts.MechMtrPos2.Rev_u0p16 /end MEASUREMENT
/begin MEASUREMENT Sa_MtrVel.MechMtrPos2Timestamp.USec_u32 "MICROSAR RTE" ULONG NO_COMPU_METHOD 0 0 0 4294967295 ECU_ADDRESS 0 SYMBOL_LINK "Rte_CDDInterface_MechMtrPos2TimeStamp_USec_u32" 0 DISPLAY_IDENTIFIER Sa_MtrVel.ReceiverPorts.MechMtrPos2Timestamp.USec_u32 /end MEASUREMENT
/begin MEASUREMENT Sa_MtrVel.MotorVelCRF.MtrRadpS_f32 "MICROSAR RTE" FLOAT32_IEEE NO_COMPU_METHOD 0 0 1.175494351e-38 3.402823466e+38 ECU_ADDRESS 0 SYMBOL_LINK "Rte_Sa_MtrVel_MotorVelCRF_MtrRadpS_f32" 0 DISPLAY_IDENTIFIER Sa_MtrVel.SenderPorts.MotorVelCRF.MtrRadpS_f32 /end MEASUREMENT
/begin MEASUREMENT Sa_MtrVel.MotorVelMRF.MtrRadpS_f32 "MICROSAR RTE" FLOAT32_IEEE NO_COMPU_METHOD 0 0 1.175494351e-38 3.402823466e+38 ECU_ADDRESS 0 SYMBOL_LINK "Rte_Sa_MtrVel_MotorVelMRF_MtrRadpS_f32" 0 DISPLAY_IDENTIFIER Sa_MtrVel.SenderPorts.MotorVelMRF.MtrRadpS_f32 /end MEASUREMENT
/begin MEASUREMENT Sa_MtrVel.SysCDiagHwVel.HwRadpS_f32 "MICROSAR RTE" FLOAT32_IEEE NO_COMPU_METHOD 0 0 1.175494351e-38 3.402823466e+38 ECU_ADDRESS 0 SYMBOL_LINK "Rte_Sa_MtrVel2_SysCDiagHwVel_HwRadpS_f32" 0 DISPLAY_IDENTIFIER Sa_MtrVel.ReceiverPorts.SysCDiagHwVel.HwRadpS_f32 /end MEASUREMENT
/begin MEASUREMENT Sa_MtrVel.SysCDiagMtrVelMRF.MtrRadpS_f32 "MICROSAR RTE" FLOAT32_IEEE NO_COMPU_METHOD 0 0 1.175494351e-38 3.402823466e+38 ECU_ADDRESS 0 SYMBOL_LINK "Rte_Sa_MtrVel2_SysCDiagMtrVelMRF_MtrRadpS_f32" 0 DISPLAY_IDENTIFIER Sa_MtrVel.ReceiverPorts.SysCDiagMtrVelMRF.MtrRadpS_f32 /end MEASUREMENT
/begin MEASUREMENT Sa_MtrVel.SysCHandwheelVel.HwRadpS_f32 "MICROSAR RTE" FLOAT32_IEEE NO_COMPU_METHOD 0 0 1.175494351e-38 3.402823466e+38 ECU_ADDRESS 0 SYMBOL_LINK "Rte_Sa_MtrVel_SysCHandwheelVel_HwRadpS_f32" 0 DISPLAY_IDENTIFIER Sa_MtrVel.SenderPorts.SysCHandwheelVel.HwRadpS_f32 /end MEASUREMENT
/begin MEASUREMENT Sa_MtrVel.SysCMotorVelMRF.MtrRadpS_f32 "MICROSAR RTE" FLOAT32_IEEE NO_COMPU_METHOD 0 0 1.175494351e-38 3.402823466e+38 ECU_ADDRESS 0 SYMBOL_LINK "Rte_Sa_MtrVel_SysCMotorVelMRF_MtrRadpS_f32" 0 DISPLAY_IDENTIFIER Sa_MtrVel.SenderPorts.SysCMotorVelMRF.MtrRadpS_f32 /end MEASUREMENT
/begin MEASUREMENT Sa_MtrVel2.AsstAssemblyPolarity.Cnt_s08 "MICROSAR RTE" SBYTE NO_COMPU_METHOD 0 0 -128 127 ECU_ADDRESS 0 SYMBOL_LINK "Rte_Polarity_AssistAssyPolarity_Cnt_s08" 0 DISPLAY_IDENTIFIER Sa_MtrVel2.ReceiverPorts.AsstAssemblyPolarity.Cnt_s08 /end MEASUREMENT
/begin MEASUREMENT Sa_MtrVel2.CumMechMtrPosMRF.Deg_f32 "MICROSAR RTE" FLOAT32_IEEE NO_COMPU_METHOD 0 0 1.175494351e-38 3.402823466e+38 ECU_ADDRESS 0 SYMBOL_LINK "Rte_Sa_DigMSB_CumMechMtrPosMRF_Deg_f32" 0 DISPLAY_IDENTIFIER Sa_MtrVel2.ReceiverPorts.CumMechMtrPosMRF.Deg_f32 /end MEASUREMENT
/begin MEASUREMENT Sa_MtrVel2.HandwheelVel.HwRadpS_f32 "MICROSAR RTE" FLOAT32_IEEE NO_COMPU_METHOD 0 0 1.175494351e-38 3.402823466e+38 ECU_ADDRESS 0 SYMBOL_LINK "Rte_Sa_MtrVel_HandwheelVel_HwRadpS_f32" 0 DISPLAY_IDENTIFIER Sa_MtrVel2.ReceiverPorts.HandwheelVel.HwRadpS_f32 /end MEASUREMENT
/begin MEASUREMENT Sa_MtrVel2.MechMtrPos1Timestamp.USec_u32 "MICROSAR RTE" ULONG NO_COMPU_METHOD 0 0 0 4294967295 ECU_ADDRESS 0 SYMBOL_LINK "Rte_CDDInterface_MechMtrPos1TimeStamp_USec_u32" 0 DISPLAY_IDENTIFIER Sa_MtrVel2.ReceiverPorts.MechMtrPos1Timestamp.USec_u32 /end MEASUREMENT
/begin MEASUREMENT Sa_MtrVel2.MotorVelMRF.MtrRadpS_f32 "MICROSAR RTE" FLOAT32_IEEE NO_COMPU_METHOD 0 0 1.175494351e-38 3.402823466e+38 ECU_ADDRESS 0 SYMBOL_LINK "Rte_Sa_MtrVel_MotorVelMRF_MtrRadpS_f32" 0 DISPLAY_IDENTIFIER Sa_MtrVel2.ReceiverPorts.MotorVelMRF.MtrRadpS_f32 /end MEASUREMENT
/begin MEASUREMENT Sa_MtrVel2.SysCDiagHwVel.HwRadpS_f32 "MICROSAR RTE" FLOAT32_IEEE NO_COMPU_METHOD 0 0 1.175494351e-38 3.402823466e+38 ECU_ADDRESS 0 SYMBOL_LINK "Rte_Sa_MtrVel2_SysCDiagHwVel_HwRadpS_f32" 0 DISPLAY_IDENTIFIER Sa_MtrVel2.SenderPorts.SysCDiagHwVel.HwRadpS_f32 /end MEASUREMENT
/begin MEASUREMENT Sa_MtrVel2.SysCDiagMtrVelMRF.MtrRadpS_f32 "MICROSAR RTE" FLOAT32_IEEE NO_COMPU_METHOD 0 0 1.175494351e-38 3.402823466e+38 ECU_ADDRESS 0 SYMBOL_LINK "Rte_Sa_MtrVel2_SysCDiagMtrVelMRF_MtrRadpS_f32" 0 DISPLAY_IDENTIFIER Sa_MtrVel2.SenderPorts.SysCDiagMtrVelMRF.MtrRadpS_f32 /end MEASUREMENT
/begin MEASUREMENT Sa_OvrVoltMon.PwrDiscBTestStart.Cnt_lgc "MICROSAR RTE" UBYTE RTE_CM_BOOLEAN 0 0 0 255 ECU_ADDRESS 0 SYMBOL_LINK "Rte_Ap_HwPwUp_PwrDiscBTestStart_Cnt_lgc" 0 DISPLAY_IDENTIFIER Sa_OvrVoltMon.ReceiverPorts.PwrDiscBTestStart.Cnt_lgc /end MEASUREMENT
/begin MEASUREMENT Sa_OvrVoltMon.SystemState.Mode "MICROSAR RTE" UBYTE RTE_CM_ENUM_StaMd_Mode 0 0 0 255 ECU_ADDRESS 0 SYMBOL_LINK "Rte_ModeMachine_StaMd_SystemState_Mode" 0 DISPLAY_IDENTIFIER Sa_OvrVoltMon.ModeRequirePorts.SystemState.Mode /end MEASUREMENT
/begin MEASUREMENT SrlComInput.APAMfgEnable.Cnt_lgc "MICROSAR RTE" UBYTE RTE_CM_BOOLEAN 0 0 0 255 ECU_ADDRESS 0 SYMBOL_LINK "Rte_SrlComInput_APAMfgEnable_Cnt_lgc" 0 DISPLAY_IDENTIFIER SrlComInput.SenderPorts.APAMfgEnable.Cnt_lgc /end MEASUREMENT
/begin MEASUREMENT SrlComInput.APANonRecoverableFaults.Cnt_lgc "MICROSAR RTE" UBYTE RTE_CM_BOOLEAN 0 0 0 255 ECU_ADDRESS 0 SYMBOL_LINK "Rte_SrlComInput_APANonRecoverableFaults_Cnt_lgc" 0 DISPLAY_IDENTIFIER SrlComInput.SenderPorts.APANonRecoverableFaults.Cnt_lgc /end MEASUREMENT
/begin MEASUREMENT SrlComInput.APARecoverableFaults.Cnt_lgc "MICROSAR RTE" UBYTE RTE_CM_BOOLEAN 0 0 0 255 ECU_ADDRESS 0 SYMBOL_LINK "Rte_SrlComInput_APARecoverableFaults_Cnt_lgc" 0 DISPLAY_IDENTIFIER SrlComInput.SenderPorts.APARecoverableFaults.Cnt_lgc /end MEASUREMENT
/begin MEASUREMENT SrlComInput.APARequest.Cnt_lgc "MICROSAR RTE" UBYTE RTE_CM_BOOLEAN 0 0 0 255 ECU_ADDRESS 0 SYMBOL_LINK "Rte_SrlComInput_APARequest_Cnt_lgc" 0 DISPLAY_IDENTIFIER SrlComInput.SenderPorts.APARequest.Cnt_lgc /end MEASUREMENT
/begin MEASUREMENT SrlComInput.BusOffCE.Cnt_lgc "MICROSAR RTE" UBYTE RTE_CM_BOOLEAN 0 0 0 255 ECU_ADDRESS 0 SYMBOL_LINK "Rte_SrlComOutput_BusOffCE_Cnt_lgc" 0 DISPLAY_IDENTIFIER SrlComInput.ReceiverPorts.BusOffCE.Cnt_lgc /end MEASUREMENT
/begin MEASUREMENT SrlComInput.BusOffHS.Cnt_lgc "MICROSAR RTE" UBYTE RTE_CM_BOOLEAN 0 0 0 255 ECU_ADDRESS 0 SYMBOL_LINK "Rte_SrlComOutput_BusOffHS_Cnt_lgc" 0 DISPLAY_IDENTIFIER SrlComInput.ReceiverPorts.BusOffHS.Cnt_lgc /end MEASUREMENT
/begin MEASUREMENT SrlComInput.DesiredTunPers.Cnt_u16 "MICROSAR RTE" UWORD NO_COMPU_METHOD 0 0 0 65535 ECU_ADDRESS 0 SYMBOL_LINK "Rte_SrlComInput_DesiredTunPers_Cnt_u16" 0 DISPLAY_IDENTIFIER SrlComInput.SenderPorts.DesiredTunPers.Cnt_u16 /end MEASUREMENT
/begin MEASUREMENT SrlComInput.DiagRmpToZeroActive.Cnt_lgc "MICROSAR RTE" UBYTE RTE_CM_BOOLEAN 0 0 0 255 ECU_ADDRESS 0 SYMBOL_LINK "Rte_DiagMgr_DiagRmpToZeroActive_Cnt_lgc" 0 DISPLAY_IDENTIFIER SrlComInput.ReceiverPorts.DiagRmpToZeroActive.Cnt_lgc /end MEASUREMENT
/begin MEASUREMENT SrlComInput.DiagStsDefVehSpd.Cnt_lgc "MICROSAR RTE" UBYTE RTE_CM_BOOLEAN 0 0 0 255 ECU_ADDRESS 0 SYMBOL_LINK "Rte_DiagMgr_DiagStsDefVehSpd_Cnt_lgc" 0 DISPLAY_IDENTIFIER SrlComInput.ReceiverPorts.DiagStsDefVehSpd.Cnt_lgc /end MEASUREMENT
/begin MEASUREMENT SrlComInput.DiagStsNonRecRmpToZeroFltPres.Cnt_lgc "MICROSAR RTE" UBYTE RTE_CM_BOOLEAN 0 0 0 255 ECU_ADDRESS 0 SYMBOL_LINK "Rte_DiagMgr_DiagStsNonRecRmpToZeroFltPres_Cnt_lgc" 0 DISPLAY_IDENTIFIER SrlComInput.ReceiverPorts.DiagStsNonRecRmpToZeroFltPres.Cnt_lgc /end MEASUREMENT
/begin MEASUREMENT SrlComInput.ESCCmd.HwNm_f32 "MICROSAR RTE" FLOAT32_IEEE NO_COMPU_METHOD 0 0 1.175494351e-38 3.402823466e+38 ECU_ADDRESS 0 SYMBOL_LINK "Rte_SrlComInput_ESCCmd_HwNm_f32" 0 DISPLAY_IDENTIFIER SrlComInput.SenderPorts.ESCCmd.HwNm_f32 /end MEASUREMENT
/begin MEASUREMENT SrlComInput.ESCFault.Cnt_lgc "MICROSAR RTE" UBYTE RTE_CM_BOOLEAN 0 0 0 255 ECU_ADDRESS 0 SYMBOL_LINK "Rte_SrlComInput_ESCFault_Cnt_lgc" 0 DISPLAY_IDENTIFIER SrlComInput.SenderPorts.ESCFault.Cnt_lgc /end MEASUREMENT
/begin MEASUREMENT SrlComInput.ESCMfgEnable.Cnt_lgc "MICROSAR RTE" UBYTE RTE_CM_BOOLEAN 0 0 0 255 ECU_ADDRESS 0 SYMBOL_LINK "Rte_SrlComInput_ESCMfgEnable_Cnt_lgc" 0 DISPLAY_IDENTIFIER SrlComInput.SenderPorts.ESCMfgEnable.Cnt_lgc /end MEASUREMENT
/begin MEASUREMENT SrlComInput.ESCRequest.Cnt_lgc "MICROSAR RTE" UBYTE RTE_CM_BOOLEAN 0 0 0 255 ECU_ADDRESS 0 SYMBOL_LINK "Rte_SrlComInput_ESCRequest_Cnt_lgc" 0 DISPLAY_IDENTIFIER SrlComInput.SenderPorts.ESCRequest.Cnt_lgc /end MEASUREMENT
/begin MEASUREMENT SrlComInput.EngRunAtvForCTCInhibit.Cnt_lgc "MICROSAR RTE" UBYTE RTE_CM_BOOLEAN 0 0 0 255 ECU_ADDRESS 0 SYMBOL_LINK "Rte_SrlComInput_EngRunAtvForCTCInhibit_Cnt_lgc" 0 DISPLAY_IDENTIFIER SrlComInput.SenderPorts.EngRunAtvForCTCInhibit.Cnt_lgc /end MEASUREMENT
/begin MEASUREMENT SrlComInput.HapticRequest.Cnt_lgc "MICROSAR RTE" UBYTE RTE_CM_BOOLEAN 0 0 0 255 ECU_ADDRESS 0 SYMBOL_LINK "Rte_SrlComInput_HapticRequest_Cnt_lgc" 0 DISPLAY_IDENTIFIER SrlComInput.SenderPorts.HapticRequest.Cnt_lgc /end MEASUREMENT
/begin MEASUREMENT SrlComInput.LKACmd.HwNm_f32 "MICROSAR RTE" FLOAT32_IEEE NO_COMPU_METHOD 0 0 1.175494351e-38 3.402823466e+38 ECU_ADDRESS 0 SYMBOL_LINK "Rte_SrlComInput_LKACmd_HwNm_f32" 0 DISPLAY_IDENTIFIER SrlComInput.SenderPorts.LKACmd.HwNm_f32 /end MEASUREMENT
/begin MEASUREMENT SrlComInput.LKAFault.Cnt_lgc "MICROSAR RTE" UBYTE RTE_CM_BOOLEAN 0 0 0 255 ECU_ADDRESS 0 SYMBOL_LINK "Rte_SrlComInput_LKAFault_Cnt_lgc" 0 DISPLAY_IDENTIFIER SrlComInput.SenderPorts.LKAFault.Cnt_lgc /end MEASUREMENT
/begin MEASUREMENT SrlComInput.LKAInhibit.Cnt_lgc "MICROSAR RTE" UBYTE RTE_CM_BOOLEAN 0 0 0 255 ECU_ADDRESS 0 SYMBOL_LINK "Rte_SrlComInput_LKAInhibit_Cnt_lgc" 0 DISPLAY_IDENTIFIER SrlComInput.SenderPorts.LKAInhibit.Cnt_lgc /end MEASUREMENT
/begin MEASUREMENT SrlComInput.LKAMfgEnable.Cnt_lgc "MICROSAR RTE" UBYTE RTE_CM_BOOLEAN 0 0 0 255 ECU_ADDRESS 0 SYMBOL_LINK "Rte_SrlComInput_LKAMfgEnable_Cnt_lgc" 0 DISPLAY_IDENTIFIER SrlComInput.SenderPorts.LKAMfgEnable.Cnt_lgc /end MEASUREMENT
/begin MEASUREMENT SrlComInput.LKARequest.Cnt_lgc "MICROSAR RTE" UBYTE RTE_CM_BOOLEAN 0 0 0 255 ECU_ADDRESS 0 SYMBOL_LINK "Rte_SrlComInput_LKARequest_Cnt_lgc" 0 DISPLAY_IDENTIFIER SrlComInput.SenderPorts.LKARequest.Cnt_lgc /end MEASUREMENT
/begin MEASUREMENT SrlComInput.MaxSecureVehicleSpeed.Kph_f32 "MICROSAR RTE" FLOAT32_IEEE NO_COMPU_METHOD 0 0 1.175494351e-38 3.402823466e+38 ECU_ADDRESS 0 SYMBOL_LINK "Rte_SrlComInput_MaxSecureVehicleSpeed_Kph_f32" 0 DISPLAY_IDENTIFIER SrlComInput.SenderPorts.MaxSecureVehicleSpeed.Kph_f32 /end MEASUREMENT
/begin MEASUREMENT SrlComInput.MinSecureVehicleSpeed.Kph_f32 "MICROSAR RTE" FLOAT32_IEEE NO_COMPU_METHOD 0 0 1.175494351e-38 3.402823466e+38 ECU_ADDRESS 0 SYMBOL_LINK "Rte_SrlComInput_MinSecureVehicleSpeed_Kph_f32" 0 DISPLAY_IDENTIFIER SrlComInput.SenderPorts.MinSecureVehicleSpeed.Kph_f32 /end MEASUREMENT
/begin MEASUREMENT SrlComInput.PowertrainCrankActive.Cnt_lgc "MICROSAR RTE" UBYTE RTE_CM_BOOLEAN 0 0 0 255 ECU_ADDRESS 0 SYMBOL_LINK "Rte_SrlComInput_PowertrainCrankActive_Cnt_lgc" 0 DISPLAY_IDENTIFIER SrlComInput.SenderPorts.PowertrainCrankActive.Cnt_lgc /end MEASUREMENT
/begin MEASUREMENT SrlComInput.PrevSrlComEngOn.Cnt_lgc "MICROSAR RTE" UBYTE RTE_CM_BOOLEAN 0 0 0 255 ECU_ADDRESS 0 SYMBOL_LINK "Rte_SrlComInput_SrlComEngOn_Cnt_lgc" 0 DISPLAY_IDENTIFIER SrlComInput.ReceiverPorts.PrevSrlComEngOn.Cnt_lgc /end MEASUREMENT
/begin MEASUREMENT SrlComInput.RxMsgsSrlComSvcDft.Cnt_lgc "MICROSAR RTE" UBYTE RTE_CM_BOOLEAN 0 0 0 255 ECU_ADDRESS 0 SYMBOL_LINK "Rte_CDDInterface_RxMsgsSrlComSvcDft_Cnt_lgc" 0 DISPLAY_IDENTIFIER SrlComInput.ReceiverPorts.RxMsgsSrlComSvcDft.Cnt_lgc /end MEASUREMENT
/begin MEASUREMENT SrlComInput.SPMForCTCInhibit.Cnt_lgc "MICROSAR RTE" UBYTE RTE_CM_BOOLEAN 0 0 0 255 ECU_ADDRESS 0 SYMBOL_LINK "Rte_SrlComInput_SPMForCTCInhibit_Cnt_lgc" 0 DISPLAY_IDENTIFIER SrlComInput.SenderPorts.SPMForCTCInhibit.Cnt_lgc /end MEASUREMENT
/begin MEASUREMENT SrlComInput.SWARTrgtAngRequest.HwDeg_f32 "MICROSAR RTE" FLOAT32_IEEE NO_COMPU_METHOD 0 0 1.175494351e-38 3.402823466e+38 ECU_ADDRESS 0 SYMBOL_LINK "Rte_SrlComInput_SWARTrgtAngRequest_HwDeg_f32" 0 DISPLAY_IDENTIFIER SrlComInput.SenderPorts.SWARTrgtAngRequest.HwDeg_f32 /end MEASUREMENT
/begin MEASUREMENT SrlComInput.ShiftLeverIsInReverse.Cnt_lgc "MICROSAR RTE" UBYTE RTE_CM_BOOLEAN 0 0 0 255 ECU_ADDRESS 0 SYMBOL_LINK "Rte_SrlComInput_ShiftLeverIsInReverse_Cnt_lgc" 0 DISPLAY_IDENTIFIER SrlComInput.SenderPorts.ShiftLeverIsInReverse.Cnt_lgc /end MEASUREMENT
/begin MEASUREMENT SrlComInput.SrlComABSActive.Cnt_lgc "MICROSAR RTE" UBYTE RTE_CM_BOOLEAN 0 0 0 255 ECU_ADDRESS 0 SYMBOL_LINK "Rte_SrlComInput_SrlComABSActive_Cnt_lgc" 0 DISPLAY_IDENTIFIER SrlComInput.SenderPorts.SrlComABSActive.Cnt_lgc /end MEASUREMENT
/begin MEASUREMENT SrlComInput.SrlComAmbTemp.DegC_f32 "MICROSAR RTE" FLOAT32_IEEE NO_COMPU_METHOD 0 0 1.175494351e-38 3.402823466e+38 ECU_ADDRESS 0 SYMBOL_LINK "Rte_SrlComInput_SrlComAmbTemp_DegC_f32" 0 DISPLAY_IDENTIFIER SrlComInput.SenderPorts.SrlComAmbTemp.DegC_f32 /end MEASUREMENT
/begin MEASUREMENT SrlComInput.SrlComESCActive.Cnt_lgc "MICROSAR RTE" UBYTE RTE_CM_BOOLEAN 0 0 0 255 ECU_ADDRESS 0 SYMBOL_LINK "Rte_SrlComInput_SrlComESCActive_Cnt_lgc" 0 DISPLAY_IDENTIFIER SrlComInput.SenderPorts.SrlComESCActive.Cnt_lgc /end MEASUREMENT
/begin MEASUREMENT SrlComInput.SrlComEngOn.Cnt_lgc "MICROSAR RTE" UBYTE RTE_CM_BOOLEAN 0 0 0 255 ECU_ADDRESS 0 SYMBOL_LINK "Rte_SrlComInput_SrlComEngOn_Cnt_lgc" 0 DISPLAY_IDENTIFIER SrlComInput.SenderPorts.SrlComEngOn.Cnt_lgc /end MEASUREMENT
/begin MEASUREMENT SrlComInput.SrlComEngTemp.DegC_f32 "MICROSAR RTE" FLOAT32_IEEE NO_COMPU_METHOD 0 0 1.175494351e-38 3.402823466e+38 ECU_ADDRESS 0 SYMBOL_LINK "Rte_SrlComInput_SrlComEngTemp_DegC_f32" 0 DISPLAY_IDENTIFIER SrlComInput.SenderPorts.SrlComEngTemp.DegC_f32 /end MEASUREMENT
/begin MEASUREMENT SrlComInput.SrlComEngineSpeed.Rpm_f32 "MICROSAR RTE" FLOAT32_IEEE NO_COMPU_METHOD 0 0 1.175494351e-38 3.402823466e+38 ECU_ADDRESS 0 SYMBOL_LINK "Rte_SrlComInput_SrlComEngineSpeed_Rpm_f32" 0 DISPLAY_IDENTIFIER SrlComInput.SenderPorts.SrlComEngineSpeed.Rpm_f32 /end MEASUREMENT
/begin MEASUREMENT SrlComInput.SrlComLWhlSpd.Hz_f32 "MICROSAR RTE" FLOAT32_IEEE NO_COMPU_METHOD 0 0 1.175494351e-38 3.402823466e+38 ECU_ADDRESS 0 SYMBOL_LINK "Rte_SrlComInput_SrlComLWhlSpd_Hz_f32" 0 DISPLAY_IDENTIFIER SrlComInput.SenderPorts.SrlComLWhlSpd.Hz_f32 /end MEASUREMENT
/begin MEASUREMENT SrlComInput.SrlComLWhlSpdVld.Cnt_lgc "MICROSAR RTE" UBYTE RTE_CM_BOOLEAN 0 0 0 255 ECU_ADDRESS 0 SYMBOL_LINK "Rte_SrlComInput_SrlComLWhlSpdVld_Cnt_lgc" 0 DISPLAY_IDENTIFIER SrlComInput.SenderPorts.SrlComLWhlSpdVld.Cnt_lgc /end MEASUREMENT
/begin MEASUREMENT SrlComInput.SrlComLatAccel.g_f32 "MICROSAR RTE" FLOAT32_IEEE NO_COMPU_METHOD 0 0 1.175494351e-38 3.402823466e+38 ECU_ADDRESS 0 SYMBOL_LINK "Rte_SrlComInput_SrlComLatAccel_g_f32" 0 DISPLAY_IDENTIFIER SrlComInput.SenderPorts.SrlComLatAccel.g_f32 /end MEASUREMENT
/begin MEASUREMENT SrlComInput.SrlComRWhlSpd.Hz_f32 "MICROSAR RTE" FLOAT32_IEEE NO_COMPU_METHOD 0 0 1.175494351e-38 3.402823466e+38 ECU_ADDRESS 0 SYMBOL_LINK "Rte_SrlComInput_SrlComRWhlSpd_Hz_f32" 0 DISPLAY_IDENTIFIER SrlComInput.SenderPorts.SrlComRWhlSpd.Hz_f32 /end MEASUREMENT
/begin MEASUREMENT SrlComInput.SrlComRWhlSpdVld.Cnt_lgc "MICROSAR RTE" UBYTE RTE_CM_BOOLEAN 0 0 0 255 ECU_ADDRESS 0 SYMBOL_LINK "Rte_SrlComInput_SrlComRWhlSpdVld_Cnt_lgc" 0 DISPLAY_IDENTIFIER SrlComInput.SenderPorts.SrlComRWhlSpdVld.Cnt_lgc /end MEASUREMENT
/begin MEASUREMENT SrlComInput.SrlComSPMOn.Cnt_lgc "MICROSAR RTE" UBYTE RTE_CM_BOOLEAN 0 0 0 255 ECU_ADDRESS 0 SYMBOL_LINK "Rte_SrlComInput_SrlComSPMOn_Cnt_lgc" 0 DISPLAY_IDENTIFIER SrlComInput.SenderPorts.SrlComSPMOn.Cnt_lgc /end MEASUREMENT
/begin MEASUREMENT SrlComInput.SrlComSysPwrMd.Cnt_enum "MICROSAR RTE" UBYTE RTE_CM_ENUM_SysPwrMd 0 0 0 3 ECU_ADDRESS 0 SYMBOL_LINK "Rte_SrlComInput_SrlComSysPwrMd_Cnt_enum" 0 DISPLAY_IDENTIFIER SrlComInput.SenderPorts.SrlComSysPwrMd.Cnt_enum /end MEASUREMENT
/begin MEASUREMENT SrlComInput.SrlComTCSActive.Cnt_lgc "MICROSAR RTE" UBYTE RTE_CM_BOOLEAN 0 0 0 255 ECU_ADDRESS 0 SYMBOL_LINK "Rte_SrlComInput_SrlComTCSActive_Cnt_lgc" 0 DISPLAY_IDENTIFIER SrlComInput.SenderPorts.SrlComTCSActive.Cnt_lgc /end MEASUREMENT
/begin MEASUREMENT SrlComInput.SrlComTSMitDefeat.Cnt_lgc "MICROSAR RTE" UBYTE RTE_CM_BOOLEAN 0 0 0 255 ECU_ADDRESS 0 SYMBOL_LINK "Rte_SrlComInput_SrlComTSMitDefeat_Cnt_lgc" 0 DISPLAY_IDENTIFIER SrlComInput.SenderPorts.SrlComTSMitDefeat.Cnt_lgc /end MEASUREMENT
/begin MEASUREMENT SrlComInput.SrlComVehSpd.Kph_f32 "MICROSAR RTE" FLOAT32_IEEE NO_COMPU_METHOD 0 0 1.175494351e-38 3.402823466e+38 ECU_ADDRESS 0 SYMBOL_LINK "Rte_SrlComInput_SrlComVehSpd_Kph_f32" 0 DISPLAY_IDENTIFIER SrlComInput.SenderPorts.SrlComVehSpd.Kph_f32 /end MEASUREMENT
/begin MEASUREMENT SrlComInput.SrlComVehicleLonAccel.KphpS_f32 "MICROSAR RTE" FLOAT32_IEEE NO_COMPU_METHOD 0 0 1.175494351e-38 3.402823466e+38 ECU_ADDRESS 0 SYMBOL_LINK "Rte_SrlComInput_SrlComVehicleLonAccel_KphpS_f32" 0 DISPLAY_IDENTIFIER SrlComInput.SenderPorts.SrlComVehicleLonAccel.KphpS_f32 /end MEASUREMENT
/begin MEASUREMENT SrlComInput.SrlComYawRate.DegpS_f32 "MICROSAR RTE" FLOAT32_IEEE NO_COMPU_METHOD 0 0 1.175494351e-38 3.402823466e+38 ECU_ADDRESS 0 SYMBOL_LINK "Rte_SrlComInput_SrlComYawRate_DegpS_f32" 0 DISPLAY_IDENTIFIER SrlComInput.SenderPorts.SrlComYawRate.DegpS_f32 /end MEASUREMENT
/begin MEASUREMENT SrlComInput.StrtStopFaultActive.Cnt_lgc "MICROSAR RTE" UBYTE RTE_CM_BOOLEAN 0 0 0 255 ECU_ADDRESS 0 SYMBOL_LINK "Rte_SrlComInput_StrtStopFaultActive_Cnt_lgc" 0 DISPLAY_IDENTIFIER SrlComInput.SenderPorts.StrtStopFaultActive.Cnt_lgc /end MEASUREMENT
/begin MEASUREMENT SrlComInput.SystemState.Mode "MICROSAR RTE" UBYTE RTE_CM_ENUM_StaMd_Mode 0 0 0 255 ECU_ADDRESS 0 SYMBOL_LINK "Rte_ModeMachine_Ap_StaMd9_SystemState9_Mode" 0 DISPLAY_IDENTIFIER SrlComInput.ModeRequirePorts.SystemState.Mode /end MEASUREMENT
/begin MEASUREMENT SrlComInput.VehicleSpeedValid.Cnt_lgc "MICROSAR RTE" UBYTE RTE_CM_BOOLEAN 0 0 0 255 ECU_ADDRESS 0 SYMBOL_LINK "Rte_SrlComInput_VehicleSpeedValid_Cnt_lgc" 0 DISPLAY_IDENTIFIER SrlComInput.SenderPorts.VehicleSpeedValid.Cnt_lgc /end MEASUREMENT
/begin MEASUREMENT SrlComInput.WIREnabled.Cnt_lgc "MICROSAR RTE" UBYTE RTE_CM_BOOLEAN 0 0 0 255 ECU_ADDRESS 0 SYMBOL_LINK "Rte_CDDInterface_WIRMfgEnabled_Cnt_lgc" 0 DISPLAY_IDENTIFIER SrlComInput.ReceiverPorts.WIREnabled.Cnt_lgc /end MEASUREMENT
/begin MEASUREMENT SrlComOutput.APADrvrInterventionDetected.Cnt_lgc "MICROSAR RTE" UBYTE RTE_CM_BOOLEAN 0 0 0 255 ECU_ADDRESS 0 SYMBOL_LINK "Rte_TrqOvlSta_APADrvrInterventionDetected_Cnt_lgc" 0 DISPLAY_IDENTIFIER SrlComOutput.ReceiverPorts.APADrvrInterventionDetected.Cnt_lgc /end MEASUREMENT
/begin MEASUREMENT SrlComOutput.APAState.State_enum "MICROSAR RTE" UBYTE RTE_CM_ENUM_APA_State_enum 0 0 0 4 ECU_ADDRESS 0 SYMBOL_LINK "Rte_TrqOvlSta_APAState_State_enum" 0 DISPLAY_IDENTIFIER SrlComOutput.ReceiverPorts.APAState.State_enum /end MEASUREMENT
/begin MEASUREMENT SrlComOutput.BusOffCE.Cnt_lgc "MICROSAR RTE" UBYTE RTE_CM_BOOLEAN 0 0 0 255 ECU_ADDRESS 0 SYMBOL_LINK "Rte_SrlComOutput_BusOffCE_Cnt_lgc" 0 DISPLAY_IDENTIFIER SrlComOutput.SenderPorts.BusOffCE.Cnt_lgc /end MEASUREMENT
/begin MEASUREMENT SrlComOutput.BusOffHS.Cnt_lgc "MICROSAR RTE" UBYTE RTE_CM_BOOLEAN 0 0 0 255 ECU_ADDRESS 0 SYMBOL_LINK "Rte_SrlComOutput_BusOffHS_Cnt_lgc" 0 DISPLAY_IDENTIFIER SrlComOutput.SenderPorts.BusOffHS.Cnt_lgc /end MEASUREMENT
/begin MEASUREMENT SrlComOutput.DTCTrigSts "MICROSAR RTE" UBYTE RTE_CM_BOOLEAN 0 0 0 255 MATRIX_DIM 40 1 1 ECU_ADDRESS 0 SYMBOL_LINK "Rte_SrlComOutput_DTCTrigSts" 0 DISPLAY_IDENTIFIER SrlComOutput.PerInstanceMemories.DTCTrigSts READ_WRITE /end MEASUREMENT
/begin MEASUREMENT SrlComOutput.DiagRmpToZeroActive.Cnt_lgc "MICROSAR RTE" UBYTE RTE_CM_BOOLEAN 0 0 0 255 ECU_ADDRESS 0 SYMBOL_LINK "Rte_DiagMgr_DiagRmpToZeroActive_Cnt_lgc" 0 DISPLAY_IDENTIFIER SrlComOutput.ReceiverPorts.DiagRmpToZeroActive.Cnt_lgc /end MEASUREMENT
/begin MEASUREMENT SrlComOutput.DiagStsHwPosDis.Cnt_lgc "MICROSAR RTE" UBYTE RTE_CM_BOOLEAN 0 0 0 255 ECU_ADDRESS 0 SYMBOL_LINK "Rte_DiagMgr_DiagStsScomHWANotValid_Cnt_lgc" 0 DISPLAY_IDENTIFIER SrlComOutput.ReceiverPorts.DiagStsHwPosDis.Cnt_lgc /end MEASUREMENT
/begin MEASUREMENT SrlComOutput.ESCState.State_enum "MICROSAR RTE" UBYTE RTE_CM_ENUM_ESC_State_enum 0 0 0 4 ECU_ADDRESS 0 SYMBOL_LINK "Rte_TrqOvlSta_ESCState_State_enum" 0 DISPLAY_IDENTIFIER SrlComOutput.ReceiverPorts.ESCState.State_enum /end MEASUREMENT
/begin MEASUREMENT SrlComOutput.ESCTorqueDelivered.HwNm_f32 "MICROSAR RTE" FLOAT32_IEEE NO_COMPU_METHOD 0 0 1.175494351e-38 3.402823466e+38 ECU_ADDRESS 0 SYMBOL_LINK "Rte_Ap_TrqArblim_ESCTorqueDelivered_HwNm_f32" 0 DISPLAY_IDENTIFIER SrlComOutput.ReceiverPorts.ESCTorqueDelivered.HwNm_f32 /end MEASUREMENT
/begin MEASUREMENT SrlComOutput.HOWEstimate.Uls_f32 "MICROSAR RTE" FLOAT32_IEEE NO_COMPU_METHOD 0 0 1.175494351e-38 3.402823466e+38 ECU_ADDRESS 0 SYMBOL_LINK "Rte_Ap_HOWDetect_HOWEstimate_Uls_f32" 0 DISPLAY_IDENTIFIER SrlComOutput.ReceiverPorts.HOWEstimate.Uls_f32 /end MEASUREMENT
/begin MEASUREMENT SrlComOutput.HandwheelVel.HwRadpS_f32 "MICROSAR RTE" FLOAT32_IEEE NO_COMPU_METHOD 0 0 1.175494351e-38 3.402823466e+38 ECU_ADDRESS 0 SYMBOL_LINK "Rte_Sa_MtrVel_HandwheelVel_HwRadpS_f32" 0 DISPLAY_IDENTIFIER SrlComOutput.ReceiverPorts.HandwheelVel.HwRadpS_f32 /end MEASUREMENT
/begin MEASUREMENT SrlComOutput.HwTrq.HwNm_f32 "MICROSAR RTE" FLOAT32_IEEE NO_COMPU_METHOD 0 0 1.175494351e-38 3.402823466e+38 ECU_ADDRESS 0 SYMBOL_LINK "Rte_Ap_Sweep_OutputHwTrq_HwNm_f32" 0 DISPLAY_IDENTIFIER SrlComOutput.ReceiverPorts.HwTrq.HwNm_f32 /end MEASUREMENT
/begin MEASUREMENT SrlComOutput.HwVelValid.Cnt_lgc "MICROSAR RTE" UBYTE RTE_CM_BOOLEAN 0 0 0 255 ECU_ADDRESS 0 SYMBOL_LINK "Rte_Sa_MtrVel_HwVelValid_Cnt_lgc" 0 DISPLAY_IDENTIFIER SrlComOutput.ReceiverPorts.HwVelValid.Cnt_lgc /end MEASUREMENT
/begin MEASUREMENT SrlComOutput.LKAState.State_enum "MICROSAR RTE" UBYTE RTE_CM_ENUM_LKA_State_enum 0 0 0 4 ECU_ADDRESS 0 SYMBOL_LINK "Rte_TrqOvlSta_LKAState_State_enum" 0 DISPLAY_IDENTIFIER SrlComOutput.ReceiverPorts.LKAState.State_enum /end MEASUREMENT
/begin MEASUREMENT SrlComOutput.LKATrqDelivered.HwNm_f32 "MICROSAR RTE" FLOAT32_IEEE NO_COMPU_METHOD 0 0 1.175494351e-38 3.402823466e+38 ECU_ADDRESS 0 SYMBOL_LINK "Rte_Ap_TrqArblim_LKATorqueDelivered_HwNm_f32" 0 DISPLAY_IDENTIFIER SrlComOutput.ReceiverPorts.LKATrqDelivered.HwNm_f32 /end MEASUREMENT
/begin MEASUREMENT SrlComOutput.SrlComHwPos.HwDeg_f32 "MICROSAR RTE" FLOAT32_IEEE NO_COMPU_METHOD 0 0 1.175494351e-38 3.402823466e+38 ECU_ADDRESS 0 SYMBOL_LINK "Rte_AbsHwPos_SrlComHwPos_HwDeg_f32" 0 DISPLAY_IDENTIFIER SrlComOutput.ReceiverPorts.SrlComHwPos.HwDeg_f32 /end MEASUREMENT
/begin MEASUREMENT SrlComOutput.SrlComSysPwrMd.Cnt_enum "MICROSAR RTE" UBYTE RTE_CM_ENUM_SysPwrMd 0 0 0 3 ECU_ADDRESS 0 SYMBOL_LINK "Rte_SrlComInput_SrlComSysPwrMd_Cnt_enum" 0 DISPLAY_IDENTIFIER SrlComOutput.ReceiverPorts.SrlComSysPwrMd.Cnt_enum /end MEASUREMENT
/begin MEASUREMENT SrlComOutput.SystemState.Mode "MICROSAR RTE" UBYTE RTE_CM_ENUM_StaMd_Mode 0 0 0 255 ECU_ADDRESS 0 SYMBOL_LINK "Rte_ModeMachine_Ap_StaMd9_SystemState9_Mode" 0 DISPLAY_IDENTIFIER SrlComOutput.ModeRequirePorts.SystemState.Mode /end MEASUREMENT
/begin MEASUREMENT SrlComOutput.TrimCompEOL.Cnt_lgc "MICROSAR RTE" UBYTE RTE_CM_BOOLEAN 0 0 0 255 ECU_ADDRESS 0 SYMBOL_LINK "Rte_DigColPs_TrimComp_Cnt_lgc" 0 DISPLAY_IDENTIFIER SrlComOutput.ReceiverPorts.TrimCompEOL.Cnt_lgc /end MEASUREMENT
/begin MEASUREMENT StOpCtrl.DiagRampRate.XpmS_f32 "MICROSAR RTE" FLOAT32_IEEE NO_COMPU_METHOD 0 0 1.175494351e-38 3.402823466e+38 ECU_ADDRESS 0 SYMBOL_LINK "Rte_DiagMgr_DiagRampRate_XpmS_f32" 0 DISPLAY_IDENTIFIER StOpCtrl.ReceiverPorts.DiagRampRate.XpmS_f32 /end MEASUREMENT
/begin MEASUREMENT StOpCtrl.DiagRampValue.Uls_f32 "MICROSAR RTE" FLOAT32_IEEE NO_COMPU_METHOD 0 0 1.175494351e-38 3.402823466e+38 ECU_ADDRESS 0 SYMBOL_LINK "Rte_DiagMgr_DiagRampValue_Uls_f32" 0 DISPLAY_IDENTIFIER StOpCtrl.ReceiverPorts.DiagRampValue.Uls_f32 /end MEASUREMENT
/begin MEASUREMENT StOpCtrl.DiagStsDiagRmpActive.Cnt_lgc "MICROSAR RTE" UBYTE RTE_CM_BOOLEAN 0 0 0 255 ECU_ADDRESS 0 SYMBOL_LINK "Rte_DiagMgr_DiagRmpToZeroActive_Cnt_lgc" 0 DISPLAY_IDENTIFIER StOpCtrl.ReceiverPorts.DiagStsDiagRmpActive.Cnt_lgc /end MEASUREMENT
/begin MEASUREMENT StOpCtrl.LoaRateLimit.UlspS_f32 "MICROSAR RTE" FLOAT32_IEEE NO_COMPU_METHOD 0 0 1.175494351e-38 3.402823466e+38 ECU_ADDRESS 0 SYMBOL_LINK "Rte_StOpCtrl_LoaRateLimit_UlspS_f32" 0 DISPLAY_IDENTIFIER StOpCtrl.ReceiverPorts.LoaRateLimit.UlspS_f32 /end MEASUREMENT
/begin MEASUREMENT StOpCtrl.LoaScaleFctr.Uls_f32 "MICROSAR RTE" FLOAT32_IEEE NO_COMPU_METHOD 0 0 1.175494351e-38 3.402823466e+38 ECU_ADDRESS 0 SYMBOL_LINK "Rte_StOpCtrl_LoaScaleFctr_Uls_f32" 0 DISPLAY_IDENTIFIER StOpCtrl.ReceiverPorts.LoaScaleFctr.Uls_f32 /end MEASUREMENT
/begin MEASUREMENT StOpCtrl.OperRampRate.XpmS_f32 "MICROSAR RTE" FLOAT32_IEEE NO_COMPU_METHOD 0 0 1.175494351e-38 3.402823466e+38 ECU_ADDRESS 0 SYMBOL_LINK "Rte_VehPwrMd_OperRampRate_XpmS_f32" 0 DISPLAY_IDENTIFIER StOpCtrl.ReceiverPorts.OperRampRate.XpmS_f32 /end MEASUREMENT
/begin MEASUREMENT StOpCtrl.OperRampValue.Uls_f32 "MICROSAR RTE" FLOAT32_IEEE NO_COMPU_METHOD 0 0 1.175494351e-38 3.402823466e+38 ECU_ADDRESS 0 SYMBOL_LINK "Rte_VehPwrMd_OperRampValue_Uls_f32" 0 DISPLAY_IDENTIFIER StOpCtrl.ReceiverPorts.OperRampValue.Uls_f32 /end MEASUREMENT
/begin MEASUREMENT StOpCtrl.OutputRampMult.Uls_f32 "MICROSAR RTE" FLOAT32_IEEE NO_COMPU_METHOD 0 0 1.175494351e-38 3.402823466e+38 ECU_ADDRESS 0 SYMBOL_LINK "Rte_StOpCtrl_OutputRampMult_Uls_f32" 0 DISPLAY_IDENTIFIER StOpCtrl.SenderPorts.OutputRampMult.Uls_f32 /end MEASUREMENT
/begin MEASUREMENT StOpCtrl.RampSrlComSvcDft.Cnt_lgc "MICROSAR RTE" UBYTE RTE_CM_BOOLEAN 0 0 0 255 ECU_ADDRESS 0 SYMBOL_LINK "Rte_CDDInterface_TrqRmpSrlComSvcDft_Cnt_lgc" 0 DISPLAY_IDENTIFIER StOpCtrl.ReceiverPorts.RampSrlComSvcDft.Cnt_lgc /end MEASUREMENT
/begin MEASUREMENT StOpCtrl.StrtStopRateLimit.UlspS_f32 "MICROSAR RTE" FLOAT32_IEEE NO_COMPU_METHOD 0 0 1.175494351e-38 3.402823466e+38 ECU_ADDRESS 0 SYMBOL_LINK "Rte_Ap_GMStrtStop_SSSlew_UlspS_f32" 0 DISPLAY_IDENTIFIER StOpCtrl.ReceiverPorts.StrtStopRateLimit.UlspS_f32 /end MEASUREMENT
/begin MEASUREMENT StOpCtrl.StrtStopScaleFctr.Uls_f32 "MICROSAR RTE" FLOAT32_IEEE NO_COMPU_METHOD 0 0 1.175494351e-38 3.402823466e+38 ECU_ADDRESS 0 SYMBOL_LINK "Rte_Ap_GMStrtStop_SSScale_Uls_f32" 0 DISPLAY_IDENTIFIER StOpCtrl.ReceiverPorts.StrtStopScaleFctr.Uls_f32 /end MEASUREMENT
/begin MEASUREMENT StOpCtrl.SysStReqDi.Cnt_lgc "MICROSAR RTE" UBYTE RTE_CM_BOOLEAN 0 0 0 255 ECU_ADDRESS 0 SYMBOL_LINK "Rte_StOpCtrl_SysStReqDi_Cnt_lgc" 0 DISPLAY_IDENTIFIER StOpCtrl.SenderPorts.SysStReqDi.Cnt_lgc /end MEASUREMENT
/begin MEASUREMENT StaMd.ATerm.Cnt_lgc "MICROSAR RTE" UBYTE RTE_CM_BOOLEAN 0 0 0 255 ECU_ADDRESS 0 SYMBOL_LINK "Rte_VehPwrMd_ATermActive_Cnt_lgc" 0 DISPLAY_IDENTIFIER StaMd.ReceiverPorts.ATerm.Cnt_lgc /end MEASUREMENT
/begin MEASUREMENT StaMd.CTerm.Cnt_lgc "MICROSAR RTE" UBYTE RTE_CM_BOOLEAN 0 0 0 255 ECU_ADDRESS 0 SYMBOL_LINK "Rte_VehPwrMd_CTermActive_Cnt_lgc" 0 DISPLAY_IDENTIFIER StaMd.ReceiverPorts.CTerm.Cnt_lgc /end MEASUREMENT
/begin MEASUREMENT StaMd.ControlledDampStatusComplete.Cnt_lgc "MICROSAR RTE" UBYTE RTE_CM_BOOLEAN 0 0 0 255 ECU_ADDRESS 0 SYMBOL_LINK "Rte_CtrldDisShtdn_CtrldDmpStsCmp_Cnt_lgc" 0 DISPLAY_IDENTIFIER StaMd.ReceiverPorts.ControlledDampStatusComplete.Cnt_lgc /end MEASUREMENT
/begin MEASUREMENT StaMd.CurrentSystemState.Mode "MICROSAR RTE" UBYTE RTE_CM_ENUM_StaMd_Mode 0 0 0 255 ECU_ADDRESS 0 SYMBOL_LINK "Rte_ModeMachine_StaMd_SystemState_Mode" 0 DISPLAY_IDENTIFIER StaMd.ModeRequirePorts.CurrentSystemState.Mode /end MEASUREMENT
/begin MEASUREMENT StaMd.FTerm.Cnt_lgc "MICROSAR RTE" UBYTE RTE_CM_BOOLEAN 0 0 0 255 ECU_ADDRESS 0 SYMBOL_LINK "Rte_DiagMgr_DiagRmpToZeroActive_Cnt_lgc" 0 DISPLAY_IDENTIFIER StaMd.ReceiverPorts.FTerm.Cnt_lgc /end MEASUREMENT
/begin MEASUREMENT StaMd.RampStatusComplete.Cnt_lgc "MICROSAR RTE" UBYTE RTE_CM_BOOLEAN 0 0 0 255 ECU_ADDRESS 0 SYMBOL_LINK "Rte_StOpCtrl_SysStReqDi_Cnt_lgc" 0 DISPLAY_IDENTIFIER StaMd.ReceiverPorts.RampStatusComplete.Cnt_lgc /end MEASUREMENT
/begin MEASUREMENT StaMd.SystemState.Mode "MICROSAR RTE" UBYTE RTE_CM_ENUM_StaMd_Mode 0 0 0 255 ECU_ADDRESS 0 SYMBOL_LINK "Rte_ModeMachine_StaMd_SystemState_Mode" 0 DISPLAY_IDENTIFIER StaMd.ModeProvidePorts.SystemState.Mode /end MEASUREMENT
/begin MEASUREMENT StaMd.TMFTestComplete.Cnt_lgc "MICROSAR RTE" UBYTE RTE_CM_BOOLEAN 0 0 0 255 ECU_ADDRESS 0 SYMBOL_LINK "Rte_TmprlMon_TMFTestComplete_Cnt_lgc" 0 DISPLAY_IDENTIFIER StaMd.ReceiverPorts.TMFTestComplete.Cnt_lgc /end MEASUREMENT
/begin MEASUREMENT StabilityComp.AssistCmd.MtrNm_f32 "MICROSAR RTE" FLOAT32_IEEE NO_COMPU_METHOD 0 0 1.175494351e-38 3.402823466e+38 ECU_ADDRESS 0 SYMBOL_LINK "Rte_StabilityComp_AssistCmd_MtrNm_f32" 0 DISPLAY_IDENTIFIER StabilityComp.SenderPorts.AssistCmd.MtrNm_f32 /end MEASUREMENT
/begin MEASUREMENT StabilityComp.AssistDDFactor.Uls_f32 "MICROSAR RTE" FLOAT32_IEEE NO_COMPU_METHOD 0 0 1.175494351e-38 3.402823466e+38 ECU_ADDRESS 0 SYMBOL_LINK "Rte_Ap_TrqArblim_AssistDDFactor_Uls_f32" 0 DISPLAY_IDENTIFIER StabilityComp.ReceiverPorts.AssistDDFactor.Uls_f32 /end MEASUREMENT
/begin MEASUREMENT StabilityComp.AsstFWActive.Uls_f32 "MICROSAR RTE" FLOAT32_IEEE NO_COMPU_METHOD 0 0 1.175494351e-38 3.402823466e+38 ECU_ADDRESS 0 SYMBOL_LINK "Rte_Ap_AssistFirewall_AsstFirewallActive_Uls_f32" 0 DISPLAY_IDENTIFIER StabilityComp.ReceiverPorts.AsstFWActive.Uls_f32 /end MEASUREMENT
/begin MEASUREMENT StabilityComp.CombinedAssist.MtrNm_f32 "MICROSAR RTE" FLOAT32_IEEE NO_COMPU_METHOD 0 0 1.175494351e-38 3.402823466e+38 ECU_ADDRESS 0 SYMBOL_LINK "Rte_Ap_AssistFirewall_CombinedAssist_MtrNm_f32" 0 DISPLAY_IDENTIFIER StabilityComp.ReceiverPorts.CombinedAssist.MtrNm_f32 /end MEASUREMENT
/begin MEASUREMENT StabilityComp.HwTorque.HwNm_f32 "MICROSAR RTE" FLOAT32_IEEE NO_COMPU_METHOD 0 0 1.175494351e-38 3.402823466e+38 ECU_ADDRESS 0 SYMBOL_LINK "Rte_Ap_Sweep_OutputHwTrq_HwNm_f32" 0 DISPLAY_IDENTIFIER StabilityComp.ReceiverPorts.HwTorque.HwNm_f32 /end MEASUREMENT
/begin MEASUREMENT StabilityComp.SysAssistCmd_MtrNm.MtrNm_f32 "MICROSAR RTE" FLOAT32_IEEE NO_COMPU_METHOD 0 0 1.175494351e-38 3.402823466e+38 ECU_ADDRESS 0 SYMBOL_LINK "Rte_Ap_StabilityComp2_SysAssistCmd_MtrNm_f32" 0 DISPLAY_IDENTIFIER StabilityComp.ReceiverPorts.SysAssistCmd_MtrNm.MtrNm_f32 /end MEASUREMENT
/begin MEASUREMENT StabilityComp.VehicleSpeed.Kph_f32 "MICROSAR RTE" FLOAT32_IEEE NO_COMPU_METHOD 0 0 1.175494351e-38 3.402823466e+38 ECU_ADDRESS 0 SYMBOL_LINK "Rte_Ap_SignlCondn_VehicleSpeed_Kph_f32" 0 DISPLAY_IDENTIFIER StabilityComp.ReceiverPorts.VehicleSpeed.Kph_f32 /end MEASUREMENT
/begin MEASUREMENT TmprlMon.SystemState.Mode "MICROSAR RTE" UBYTE RTE_CM_ENUM_StaMd_Mode 0 0 0 255 ECU_ADDRESS 0 SYMBOL_LINK "Rte_ModeMachine_StaMd_SystemState_Mode" 0 DISPLAY_IDENTIFIER TmprlMon.ModeRequirePorts.SystemState.Mode /end MEASUREMENT
/begin MEASUREMENT TmprlMon.TMFTestComplete.Cnt_lgc "MICROSAR RTE" UBYTE RTE_CM_BOOLEAN 0 0 0 255 ECU_ADDRESS 0 SYMBOL_LINK "Rte_TmprlMon_TMFTestComplete_Cnt_lgc" 0 DISPLAY_IDENTIFIER TmprlMon.SenderPorts.TMFTestComplete.Cnt_lgc /end MEASUREMENT
/begin MEASUREMENT TmprlMon.TMFTestStart.Cnt_lgc "MICROSAR RTE" UBYTE RTE_CM_BOOLEAN 0 0 0 255 ECU_ADDRESS 0 SYMBOL_LINK "Rte_Ap_HwPwUp_TMFTestStart_Cnt_lgc" 0 DISPLAY_IDENTIFIER TmprlMon.ReceiverPorts.TMFTestStart.Cnt_lgc /end MEASUREMENT
/begin MEASUREMENT TrqCmdScl.MRFMtrTrqCmd.MtrNm_f32 "MICROSAR RTE" FLOAT32_IEEE NO_COMPU_METHOD 0 0 1.175494351e-38 3.402823466e+38 ECU_ADDRESS 0 SYMBOL_LINK "Rte_Ap_PwrLmtFuncCr_MRFMtrTrqCmd_MtrNm_f32" 0 DISPLAY_IDENTIFIER TrqCmdScl.ReceiverPorts.MRFMtrTrqCmd.MtrNm_f32 /end MEASUREMENT
/begin MEASUREMENT TrqCmdScl.MRFMtrTrqCmdScl.MtrNm_f32 "MICROSAR RTE" FLOAT32_IEEE NO_COMPU_METHOD 0 0 1.175494351e-38 3.402823466e+38 ECU_ADDRESS 0 SYMBOL_LINK "Rte_TrqCmdScl_MRFMtrTrqCmdScl_MtrNm_f32" 0 DISPLAY_IDENTIFIER TrqCmdScl.SenderPorts.MRFMtrTrqCmdScl.MtrNm_f32 /end MEASUREMENT
/begin MEASUREMENT TrqCmdScl.TorqueCmdSF_Uls_f32 "MICROSAR RTE" FLOAT32_IEEE NO_COMPU_METHOD 0 0 1.175494351e-38 3.402823466e+38 ECU_ADDRESS 0 SYMBOL_LINK "Rte_TrqCmdScl_TorqueCmdSF_Uls_f32" 0 DISPLAY_IDENTIFIER TrqCmdScl.PerInstanceMemories.TorqueCmdSF_Uls_f32 READ_WRITE /end MEASUREMENT
/begin MEASUREMENT TrqOvlSta.APADrvrInterventionDetected.Cnt_lgc "MICROSAR RTE" UBYTE RTE_CM_BOOLEAN 0 0 0 255 ECU_ADDRESS 0 SYMBOL_LINK "Rte_TrqOvlSta_APADrvrInterventionDetected_Cnt_lgc" 0 DISPLAY_IDENTIFIER TrqOvlSta.SenderPorts.APADrvrInterventionDetected.Cnt_lgc /end MEASUREMENT
/begin MEASUREMENT TrqOvlSta.APANonRecoverableFaults.Cnt_lgc "MICROSAR RTE" UBYTE RTE_CM_BOOLEAN 0 0 0 255 ECU_ADDRESS 0 SYMBOL_LINK "Rte_SrlComInput_APANonRecoverableFaults_Cnt_lgc" 0 DISPLAY_IDENTIFIER TrqOvlSta.ReceiverPorts.APANonRecoverableFaults.Cnt_lgc /end MEASUREMENT
/begin MEASUREMENT TrqOvlSta.APARecoverableFaults.Cnt_lgc "MICROSAR RTE" UBYTE RTE_CM_BOOLEAN 0 0 0 255 ECU_ADDRESS 0 SYMBOL_LINK "Rte_SrlComInput_APARecoverableFaults_Cnt_lgc" 0 DISPLAY_IDENTIFIER TrqOvlSta.ReceiverPorts.APARecoverableFaults.Cnt_lgc /end MEASUREMENT
/begin MEASUREMENT TrqOvlSta.APARequest.Cnt_lgc "MICROSAR RTE" UBYTE RTE_CM_BOOLEAN 0 0 0 255 ECU_ADDRESS 0 SYMBOL_LINK "Rte_SrlComInput_APARequest_Cnt_lgc" 0 DISPLAY_IDENTIFIER TrqOvlSta.ReceiverPorts.APARequest.Cnt_lgc /end MEASUREMENT
/begin MEASUREMENT TrqOvlSta.APAState.State_enum "MICROSAR RTE" UBYTE RTE_CM_ENUM_APA_State_enum 0 0 0 4 ECU_ADDRESS 0 SYMBOL_LINK "Rte_TrqOvlSta_APAState_State_enum" 0 DISPLAY_IDENTIFIER TrqOvlSta.SenderPorts.APAState.State_enum /end MEASUREMENT
/begin MEASUREMENT TrqOvlSta.CCWPosition.HwDeg_f32 "MICROSAR RTE" FLOAT32_IEEE NO_COMPU_METHOD 0 0 1.175494351e-38 3.402823466e+38 ECU_ADDRESS 0 SYMBOL_LINK "Rte_Ap_LrnEOT_CCWPosition_HwDeg_f32" 0 DISPLAY_IDENTIFIER TrqOvlSta.ReceiverPorts.CCWPosition.HwDeg_f32 /end MEASUREMENT
/begin MEASUREMENT TrqOvlSta.CWPosition.HwDeg_f32 "MICROSAR RTE" FLOAT32_IEEE NO_COMPU_METHOD 0 0 1.175494351e-38 3.402823466e+38 ECU_ADDRESS 0 SYMBOL_LINK "Rte_Ap_LrnEOT_CWPosition_HwDeg_f32" 0 DISPLAY_IDENTIFIER TrqOvlSta.ReceiverPorts.CWPosition.HwDeg_f32 /end MEASUREMENT
/begin MEASUREMENT TrqOvlSta.ESCFault.Cnt_lgc "MICROSAR RTE" UBYTE RTE_CM_BOOLEAN 0 0 0 255 ECU_ADDRESS 0 SYMBOL_LINK "Rte_SrlComInput_ESCFault_Cnt_lgc" 0 DISPLAY_IDENTIFIER TrqOvlSta.ReceiverPorts.ESCFault.Cnt_lgc /end MEASUREMENT
/begin MEASUREMENT TrqOvlSta.ESCIsLimited.Cnt_lgc "MICROSAR RTE" UBYTE RTE_CM_BOOLEAN 0 0 0 255 ECU_ADDRESS 0 SYMBOL_LINK "Rte_Ap_TrqArblim_ESCIsLimited_Cnt_lgc" 0 DISPLAY_IDENTIFIER TrqOvlSta.ReceiverPorts.ESCIsLimited.Cnt_lgc /end MEASUREMENT
/begin MEASUREMENT TrqOvlSta.ESCRequest.Cnt_lgc "MICROSAR RTE" UBYTE RTE_CM_BOOLEAN 0 0 0 255 ECU_ADDRESS 0 SYMBOL_LINK "Rte_SrlComInput_ESCRequest_Cnt_lgc" 0 DISPLAY_IDENTIFIER TrqOvlSta.ReceiverPorts.ESCRequest.Cnt_lgc /end MEASUREMENT
/begin MEASUREMENT TrqOvlSta.ESCState.State_enum "MICROSAR RTE" UBYTE RTE_CM_ENUM_ESC_State_enum 0 0 0 4 ECU_ADDRESS 0 SYMBOL_LINK "Rte_TrqOvlSta_ESCState_State_enum" 0 DISPLAY_IDENTIFIER TrqOvlSta.SenderPorts.ESCState.State_enum /end MEASUREMENT
/begin MEASUREMENT TrqOvlSta.GMOSHOscillateState.State_enum "MICROSAR RTE" UBYTE RTE_CM_ENUM_Haptic_State_enum 0 0 0 2 ECU_ADDRESS 0 SYMBOL_LINK "Rte_TrqOvlSta_GMOSHOscillateState_State_enum" 0 DISPLAY_IDENTIFIER TrqOvlSta.SenderPorts.GMOSHOscillateState.State_enum /end MEASUREMENT
/begin MEASUREMENT TrqOvlSta.GMOSH_APAMfgEnable.Cnt_lgc "MICROSAR RTE" UBYTE RTE_CM_BOOLEAN 0 0 0 255 ECU_ADDRESS 0 SYMBOL_LINK "Rte_SrlComInput_APAMfgEnable_Cnt_lgc" 0 DISPLAY_IDENTIFIER TrqOvlSta.ReceiverPorts.GMOSH_APAMfgEnable.Cnt_lgc /end MEASUREMENT
/begin MEASUREMENT TrqOvlSta.GMOSH_ESCMfgEnable.Cnt_lgc "MICROSAR RTE" UBYTE RTE_CM_BOOLEAN 0 0 0 255 ECU_ADDRESS 0 SYMBOL_LINK "Rte_SrlComInput_ESCMfgEnable_Cnt_lgc" 0 DISPLAY_IDENTIFIER TrqOvlSta.ReceiverPorts.GMOSH_ESCMfgEnable.Cnt_lgc /end MEASUREMENT
/begin MEASUREMENT TrqOvlSta.GMOSH_LKAMfgEnable.Cnt_lgc "MICROSAR RTE" UBYTE RTE_CM_BOOLEAN 0 0 0 255 ECU_ADDRESS 0 SYMBOL_LINK "Rte_SrlComInput_LKAMfgEnable_Cnt_lgc" 0 DISPLAY_IDENTIFIER TrqOvlSta.ReceiverPorts.GMOSH_LKAMfgEnable.Cnt_lgc /end MEASUREMENT
/begin MEASUREMENT TrqOvlSta.HapticRequest.Cnt_lgc "MICROSAR RTE" UBYTE RTE_CM_BOOLEAN 0 0 0 255 ECU_ADDRESS 0 SYMBOL_LINK "Rte_SrlComInput_HapticRequest_Cnt_lgc" 0 DISPLAY_IDENTIFIER TrqOvlSta.ReceiverPorts.HapticRequest.Cnt_lgc /end MEASUREMENT
/begin MEASUREMENT TrqOvlSta.HwTorque.HwNm_f32 "MICROSAR RTE" FLOAT32_IEEE NO_COMPU_METHOD 0 0 1.175494351e-38 3.402823466e+38 ECU_ADDRESS 0 SYMBOL_LINK "Rte_Ap_Sweep_OutputHwTrq_HwNm_f32" 0 DISPLAY_IDENTIFIER TrqOvlSta.ReceiverPorts.HwTorque.HwNm_f32 /end MEASUREMENT
/begin MEASUREMENT TrqOvlSta.LKAFault.Cnt_lgc "MICROSAR RTE" UBYTE RTE_CM_BOOLEAN 0 0 0 255 ECU_ADDRESS 0 SYMBOL_LINK "Rte_SrlComInput_LKAFault_Cnt_lgc" 0 DISPLAY_IDENTIFIER TrqOvlSta.ReceiverPorts.LKAFault.Cnt_lgc /end MEASUREMENT
/begin MEASUREMENT TrqOvlSta.LKAInhibit.Cnt_lgc "MICROSAR RTE" UBYTE RTE_CM_BOOLEAN 0 0 0 255 ECU_ADDRESS 0 SYMBOL_LINK "Rte_SrlComInput_LKAInhibit_Cnt_lgc" 0 DISPLAY_IDENTIFIER TrqOvlSta.ReceiverPorts.LKAInhibit.Cnt_lgc /end MEASUREMENT
/begin MEASUREMENT TrqOvlSta.LKARequest.Cnt_lgc "MICROSAR RTE" UBYTE RTE_CM_BOOLEAN 0 0 0 255 ECU_ADDRESS 0 SYMBOL_LINK "Rte_SrlComInput_LKARequest_Cnt_lgc" 0 DISPLAY_IDENTIFIER TrqOvlSta.ReceiverPorts.LKARequest.Cnt_lgc /end MEASUREMENT
/begin MEASUREMENT TrqOvlSta.LKAState.State_enum "MICROSAR RTE" UBYTE RTE_CM_ENUM_LKA_State_enum 0 0 0 4 ECU_ADDRESS 0 SYMBOL_LINK "Rte_TrqOvlSta_LKAState_State_enum" 0 DISPLAY_IDENTIFIER TrqOvlSta.SenderPorts.LKAState.State_enum /end MEASUREMENT
/begin MEASUREMENT TrqOvlSta.MaxSecureVehicleSpeed.Kph_f32 "MICROSAR RTE" FLOAT32_IEEE NO_COMPU_METHOD 0 0 1.175494351e-38 3.402823466e+38 ECU_ADDRESS 0 SYMBOL_LINK "Rte_SrlComInput_MaxSecureVehicleSpeed_Kph_f32" 0 DISPLAY_IDENTIFIER TrqOvlSta.ReceiverPorts.MaxSecureVehicleSpeed.Kph_f32 /end MEASUREMENT
/begin MEASUREMENT TrqOvlSta.MinSecureVehicleSpeed.Kph_f32 "MICROSAR RTE" FLOAT32_IEEE NO_COMPU_METHOD 0 0 1.175494351e-38 3.402823466e+38 ECU_ADDRESS 0 SYMBOL_LINK "Rte_SrlComInput_MinSecureVehicleSpeed_Kph_f32" 0 DISPLAY_IDENTIFIER TrqOvlSta.ReceiverPorts.MinSecureVehicleSpeed.Kph_f32 /end MEASUREMENT
/begin MEASUREMENT TrqOvlSta.PosServEnable.Cnt_lgc "MICROSAR RTE" UBYTE RTE_CM_BOOLEAN 0 0 0 255 ECU_ADDRESS 0 SYMBOL_LINK "Rte_TrqOvlSta_PosServEnable_Cnt_lgc" 0 DISPLAY_IDENTIFIER TrqOvlSta.SenderPorts.PosServEnable.Cnt_lgc /end MEASUREMENT
/begin MEASUREMENT TrqOvlSta.PosSrvoHwAngle.HwDeg_f32 "MICROSAR RTE" FLOAT32_IEEE NO_COMPU_METHOD 0 0 1.175494351e-38 3.402823466e+38 ECU_ADDRESS 0 SYMBOL_LINK "Rte_TrqOvlSta_PosSrvoHwAngle_HwDeg_f32" 0 DISPLAY_IDENTIFIER TrqOvlSta.SenderPorts.PosSrvoHwAngle.HwDeg_f32 /end MEASUREMENT
/begin MEASUREMENT TrqOvlSta.PosTrajEnable.Cnt_lgc "MICROSAR RTE" UBYTE RTE_CM_BOOLEAN 0 0 0 255 ECU_ADDRESS 0 SYMBOL_LINK "Rte_CDDInterface_PosTrajEnable_Cnt_lgc" 0 DISPLAY_IDENTIFIER TrqOvlSta.ReceiverPorts.PosTrajEnable.Cnt_lgc /end MEASUREMENT
/begin MEASUREMENT TrqOvlSta.PosTrajHwAngle.HwDeg_f32 "MICROSAR RTE" FLOAT32_IEEE NO_COMPU_METHOD 0 0 1.175494351e-38 3.402823466e+38 ECU_ADDRESS 0 SYMBOL_LINK "Rte_Ap_GenPosTraj_PosTrajHwAngle_HwDeg_f32" 0 DISPLAY_IDENTIFIER TrqOvlSta.ReceiverPorts.PosTrajHwAngle.HwDeg_f32 /end MEASUREMENT
/begin MEASUREMENT TrqOvlSta.SWARTrgtAngRequest.HwDeg_f32 "MICROSAR RTE" FLOAT32_IEEE NO_COMPU_METHOD 0 0 1.175494351e-38 3.402823466e+38 ECU_ADDRESS 0 SYMBOL_LINK "Rte_SrlComInput_SWARTrgtAngRequest_HwDeg_f32" 0 DISPLAY_IDENTIFIER TrqOvlSta.ReceiverPorts.SWARTrgtAngRequest.HwDeg_f32 /end MEASUREMENT
/begin MEASUREMENT TrqOvlSta.ShiftLeverIsInReverse.Cnt_lgc "MICROSAR RTE" UBYTE RTE_CM_BOOLEAN 0 0 0 255 ECU_ADDRESS 0 SYMBOL_LINK "Rte_SrlComInput_ShiftLeverIsInReverse_Cnt_lgc" 0 DISPLAY_IDENTIFIER TrqOvlSta.ReceiverPorts.ShiftLeverIsInReverse.Cnt_lgc /end MEASUREMENT
/begin MEASUREMENT TrqOvlSta.SystemState.Mode "MICROSAR RTE" UBYTE RTE_CM_ENUM_StaMd_Mode 0 0 0 255 ECU_ADDRESS 0 SYMBOL_LINK "Rte_ModeMachine_StaMd_SystemState_Mode" 0 DISPLAY_IDENTIFIER TrqOvlSta.ModeRequirePorts.SystemState.Mode /end MEASUREMENT
/begin MEASUREMENT TrqOvlSta.TrqOscAmp.MtrNm_f32 "MICROSAR RTE" FLOAT32_IEEE NO_COMPU_METHOD 0 0 1.175494351e-38 3.402823466e+38 ECU_ADDRESS 0 SYMBOL_LINK "Rte_TrqOvlSta_TrqOscAmp_MtrNm_f32" 0 DISPLAY_IDENTIFIER TrqOvlSta.SenderPorts.TrqOscAmp.MtrNm_f32 /end MEASUREMENT
/begin MEASUREMENT TrqOvlSta.TrqOscEnable.Cnt_lgc "MICROSAR RTE" UBYTE RTE_CM_BOOLEAN 0 0 0 255 ECU_ADDRESS 0 SYMBOL_LINK "Rte_TrqOvlSta_TrqOscEnable_Cnt_lgc" 0 DISPLAY_IDENTIFIER TrqOvlSta.SenderPorts.TrqOscEnable.Cnt_lgc /end MEASUREMENT
/begin MEASUREMENT TrqOvlSta.TrqOscFreq.Hz_f32 "MICROSAR RTE" FLOAT32_IEEE NO_COMPU_METHOD 0 0 1.175494351e-38 3.402823466e+38 ECU_ADDRESS 0 SYMBOL_LINK "Rte_TrqOvlSta_TrqOscFreq_Hz_f32" 0 DISPLAY_IDENTIFIER TrqOvlSta.SenderPorts.TrqOscFreq.Hz_f32 /end MEASUREMENT
/begin MEASUREMENT VehDyn.CcwEOT.HwDeg_f32 "MICROSAR RTE" FLOAT32_IEEE NO_COMPU_METHOD 0 0 1.175494351e-38 3.402823466e+38 ECU_ADDRESS 0 SYMBOL_LINK "Rte_Ap_LrnEOT_CCWPosition_HwDeg_f32" 0 DISPLAY_IDENTIFIER VehDyn.ReceiverPorts.CcwEOT.HwDeg_f32 /end MEASUREMENT
/begin MEASUREMENT VehDyn.CwEOT.HwDeg_f32 "MICROSAR RTE" FLOAT32_IEEE NO_COMPU_METHOD 0 0 1.175494351e-38 3.402823466e+38 ECU_ADDRESS 0 SYMBOL_LINK "Rte_Ap_LrnEOT_CWPosition_HwDeg_f32" 0 DISPLAY_IDENTIFIER VehDyn.ReceiverPorts.CwEOT.HwDeg_f32 /end MEASUREMENT
/begin MEASUREMENT VehDyn.HandwheelPosition.HwDeg_f32 "MICROSAR RTE" FLOAT32_IEEE NO_COMPU_METHOD 0 0 1.175494351e-38 3.402823466e+38 ECU_ADDRESS 0 SYMBOL_LINK "Rte_AbsHwPos_HandwheelPosition_HwDeg_f32" 0 DISPLAY_IDENTIFIER VehDyn.ReceiverPorts.HandwheelPosition.HwDeg_f32 /end MEASUREMENT
/begin MEASUREMENT VehDyn.HwAuth.Uls_f32 "MICROSAR RTE" FLOAT32_IEEE NO_COMPU_METHOD 0 0 1.175494351e-38 3.402823466e+38 ECU_ADDRESS 0 SYMBOL_LINK "Rte_AbsHwPos_HandwheelAuthority_Uls_f32" 0 DISPLAY_IDENTIFIER VehDyn.ReceiverPorts.HwAuth.Uls_f32 /end MEASUREMENT
/begin MEASUREMENT VehDyn.HwTorque.HwNm_f32 "MICROSAR RTE" FLOAT32_IEEE NO_COMPU_METHOD 0 0 1.175494351e-38 3.402823466e+38 ECU_ADDRESS 0 SYMBOL_LINK "Rte_Ap_Sweep_OutputHwTrq_HwNm_f32" 0 DISPLAY_IDENTIFIER VehDyn.ReceiverPorts.HwTorque.HwNm_f32 /end MEASUREMENT
/begin MEASUREMENT VehDyn.MechMtrPos1.Rev_f32 "MICROSAR RTE" FLOAT32_IEEE NO_COMPU_METHOD 0 0 1.175494351e-38 3.402823466e+38 ECU_ADDRESS 0 SYMBOL_LINK "Rte_CDDInterface_CumMechMtrPos_Rev_f32" 0 DISPLAY_IDENTIFIER VehDyn.ReceiverPorts.MechMtrPos1.Rev_f32 /end MEASUREMENT
/begin MEASUREMENT VehDyn.MotPosReset.NVMStoredLastPosValid_Cnt_lgc "MICROSAR RTE" UBYTE RTE_CM_BOOLEAN 0 0 0 255 ECU_ADDRESS 0 SYMBOL_LINK "Rte_VehDyn_MotPosReset.NVMStoredLastPosValid_Cnt_lgc" 0 DISPLAY_IDENTIFIER VehDyn.PerInstanceMemories.MotPosReset.NVMStoredLastPosValid_Cnt_lgc READ_WRITE /end MEASUREMENT
/begin MEASUREMENT VehDyn.MotPosReset.NVMStoredLastPos_HwDeg_f32 "MICROSAR RTE" FLOAT32_IEEE NO_COMPU_METHOD 0 0 1.175494351e-38 3.402823466e+38 ECU_ADDRESS 0 SYMBOL_LINK "Rte_VehDyn_MotPosReset.NVMStoredLastPos_HwDeg_f32" 0 DISPLAY_IDENTIFIER VehDyn.PerInstanceMemories.MotPosReset.NVMStoredLastPos_HwDeg_f32 READ_WRITE /end MEASUREMENT
/begin MEASUREMENT VehDyn.MotorVelCRF.MtrRadpS_f32 "MICROSAR RTE" FLOAT32_IEEE NO_COMPU_METHOD 0 0 1.175494351e-38 3.402823466e+38 ECU_ADDRESS 0 SYMBOL_LINK "Rte_Sa_MtrVel_MotorVelCRF_MtrRadpS_f32" 0 DISPLAY_IDENTIFIER VehDyn.ReceiverPorts.MotorVelCRF.MtrRadpS_f32 /end MEASUREMENT
/begin MEASUREMENT VehDyn.RelHwPos.HwDeg_f32 "MICROSAR RTE" FLOAT32_IEEE NO_COMPU_METHOD 0 0 1.175494351e-38 3.402823466e+38 ECU_ADDRESS 0 SYMBOL_LINK "Rte_AbsHwPos_RelHwPos_HwDeg_f32" 0 DISPLAY_IDENTIFIER VehDyn.ReceiverPorts.RelHwPos.HwDeg_f32 /end MEASUREMENT
/begin MEASUREMENT VehDyn.SensorlessAuthority.Uls_f32 "MICROSAR RTE" FLOAT32_IEEE NO_COMPU_METHOD 0 0 1.175494351e-38 3.402823466e+38 ECU_ADDRESS 0 SYMBOL_LINK "Rte_VehDyn_SensorlessAuthority_Uls_f32" 0 DISPLAY_IDENTIFIER VehDyn.SenderPorts.SensorlessAuthority.Uls_f32 /end MEASUREMENT
/begin MEASUREMENT VehDyn.SensorlessHwPos.HwDeg_f32 "MICROSAR RTE" FLOAT32_IEEE NO_COMPU_METHOD 0 0 1.175494351e-38 3.402823466e+38 ECU_ADDRESS 0 SYMBOL_LINK "Rte_VehDyn_SensorlessHwPos_HwDeg_f32" 0 DISPLAY_IDENTIFIER VehDyn.SenderPorts.SensorlessHwPos.HwDeg_f32 /end MEASUREMENT
/begin MEASUREMENT VehDyn.SystemState.Mode "MICROSAR RTE" UBYTE RTE_CM_ENUM_StaMd_Mode 0 0 0 255 ECU_ADDRESS 0 SYMBOL_LINK "Rte_ModeMachine_StaMd_SystemState_Mode" 0 DISPLAY_IDENTIFIER VehDyn.ModeRequirePorts.SystemState.Mode /end MEASUREMENT
/begin MEASUREMENT VehDyn.TorqueCmdCRF.MtrNm_f32 "MICROSAR RTE" FLOAT32_IEEE NO_COMPU_METHOD 0 0 1.175494351e-38 3.402823466e+38 ECU_ADDRESS 0 SYMBOL_LINK "Rte_CtrldDisShtdn_CntDisMtrTrqCmdCRF_MtrNm_f32" 0 DISPLAY_IDENTIFIER VehDyn.ReceiverPorts.TorqueCmdCRF.MtrNm_f32 /end MEASUREMENT
/begin MEASUREMENT VehDyn.VehicleSpeed.Kph_f32 "MICROSAR RTE" FLOAT32_IEEE NO_COMPU_METHOD 0 0 1.175494351e-38 3.402823466e+38 ECU_ADDRESS 0 SYMBOL_LINK "Rte_Ap_SignlCondn_VehicleSpeed_Kph_f32" 0 DISPLAY_IDENTIFIER VehDyn.ReceiverPorts.VehicleSpeed.Kph_f32 /end MEASUREMENT
/begin MEASUREMENT VehDyn.VehicleSpeedValid.Cnt_lgc "MICROSAR RTE" UBYTE RTE_CM_BOOLEAN 0 0 0 255 ECU_ADDRESS 0 SYMBOL_LINK "Rte_SrlComInput_VehicleSpeedValid_Cnt_lgc" 0 DISPLAY_IDENTIFIER VehDyn.ReceiverPorts.VehicleSpeedValid.Cnt_lgc /end MEASUREMENT
/begin MEASUREMENT VehPwrMd.ATermActive.Cnt_lgc "MICROSAR RTE" UBYTE RTE_CM_BOOLEAN 0 0 0 255 ECU_ADDRESS 0 SYMBOL_LINK "Rte_VehPwrMd_ATermActive_Cnt_lgc" 0 DISPLAY_IDENTIFIER VehPwrMd.SenderPorts.ATermActive.Cnt_lgc /end MEASUREMENT
/begin MEASUREMENT VehPwrMd.CTermActive.Cnt_lgc "MICROSAR RTE" UBYTE RTE_CM_BOOLEAN 0 0 0 255 ECU_ADDRESS 0 SYMBOL_LINK "Rte_VehPwrMd_CTermActive_Cnt_lgc" 0 DISPLAY_IDENTIFIER VehPwrMd.SenderPorts.CTermActive.Cnt_lgc /end MEASUREMENT
/begin MEASUREMENT VehPwrMd.EngONSrlComSvcDft.Cnt_lgc "MICROSAR RTE" UBYTE RTE_CM_BOOLEAN 0 0 0 255 ECU_ADDRESS 0 SYMBOL_LINK "Rte_CDDInterface_EngONSrlComSvcDft_Cnt_lgc" 0 DISPLAY_IDENTIFIER VehPwrMd.ReceiverPorts.EngONSrlComSvcDft.Cnt_lgc /end MEASUREMENT
/begin MEASUREMENT VehPwrMd.OperRampRate.XpmS_f32 "MICROSAR RTE" FLOAT32_IEEE NO_COMPU_METHOD 0 0 1.175494351e-38 3.402823466e+38 ECU_ADDRESS 0 SYMBOL_LINK "Rte_VehPwrMd_OperRampRate_XpmS_f32" 0 DISPLAY_IDENTIFIER VehPwrMd.SenderPorts.OperRampRate.XpmS_f32 /end MEASUREMENT
/begin MEASUREMENT VehPwrMd.OperRampValue.Uls_f32 "MICROSAR RTE" FLOAT32_IEEE NO_COMPU_METHOD 0 0 1.175494351e-38 3.402823466e+38 ECU_ADDRESS 0 SYMBOL_LINK "Rte_VehPwrMd_OperRampValue_Uls_f32" 0 DISPLAY_IDENTIFIER VehPwrMd.SenderPorts.OperRampValue.Uls_f32 /end MEASUREMENT
/begin MEASUREMENT VehPwrMd.SrlComEngOn.Cnt_lgc "MICROSAR RTE" UBYTE RTE_CM_BOOLEAN 0 0 0 255 ECU_ADDRESS 0 SYMBOL_LINK "Rte_SrlComInput_SrlComEngOn_Cnt_lgc" 0 DISPLAY_IDENTIFIER VehPwrMd.ReceiverPorts.SrlComEngOn.Cnt_lgc /end MEASUREMENT
/begin MEASUREMENT VehPwrMd.SrlComSPMOn.Cnt_lgc "MICROSAR RTE" UBYTE RTE_CM_BOOLEAN 0 0 0 255 ECU_ADDRESS 0 SYMBOL_LINK "Rte_SrlComInput_SrlComSPMOn_Cnt_lgc" 0 DISPLAY_IDENTIFIER VehPwrMd.ReceiverPorts.SrlComSPMOn.Cnt_lgc /end MEASUREMENT
/begin MEASUREMENT VehPwrMd.SystemState.Mode "MICROSAR RTE" UBYTE RTE_CM_ENUM_StaMd_Mode 0 0 0 255 ECU_ADDRESS 0 SYMBOL_LINK "Rte_ModeMachine_Ap_StaMd9_SystemState9_Mode" 0 DISPLAY_IDENTIFIER VehPwrMd.ModeRequirePorts.SystemState.Mode /end MEASUREMENT
/begin MEASUREMENT VehPwrMd.VehSpd.Kph_f32 "MICROSAR RTE" FLOAT32_IEEE NO_COMPU_METHOD 0 0 1.175494351e-38 3.402823466e+38 ECU_ADDRESS 0 SYMBOL_LINK "Rte_Ap_SignlCondn_VehicleSpeed_Kph_f32" 0 DISPLAY_IDENTIFIER VehPwrMd.ReceiverPorts.VehSpd.Kph_f32 /end MEASUREMENT
/begin MEASUREMENT VehPwrMd.VehSpdValid.Cnt_lgc "MICROSAR RTE" UBYTE RTE_CM_BOOLEAN 0 0 0 255 ECU_ADDRESS 0 SYMBOL_LINK "Rte_SrlComInput_VehicleSpeedValid_Cnt_lgc" 0 DISPLAY_IDENTIFIER VehPwrMd.ReceiverPorts.VehSpdValid.Cnt_lgc /end MEASUREMENT
/begin MEASUREMENT VehSpdLmt.AstVehSpdLimit.MtrNm_f32 "MICROSAR RTE" FLOAT32_IEEE NO_COMPU_METHOD 0 0 1.175494351e-38 3.402823466e+38 ECU_ADDRESS 0 SYMBOL_LINK "Rte_VehSpdLmt_AstVehSpdLimit_MtrNm_f32" 0 DISPLAY_IDENTIFIER VehSpdLmt.SenderPorts.AstVehSpdLimit.MtrNm_f32 /end MEASUREMENT
/begin MEASUREMENT VehSpdLmt.CCWPosition.HwDeg_f32 "MICROSAR RTE" FLOAT32_IEEE NO_COMPU_METHOD 0 0 1.175494351e-38 3.402823466e+38 ECU_ADDRESS 0 SYMBOL_LINK "Rte_Ap_LrnEOT_CCWPosition_HwDeg_f32" 0 DISPLAY_IDENTIFIER VehSpdLmt.ReceiverPorts.CCWPosition.HwDeg_f32 /end MEASUREMENT
/begin MEASUREMENT VehSpdLmt.CWPosition.HwDeg_f32 "MICROSAR RTE" FLOAT32_IEEE NO_COMPU_METHOD 0 0 1.175494351e-38 3.402823466e+38 ECU_ADDRESS 0 SYMBOL_LINK "Rte_Ap_LrnEOT_CWPosition_HwDeg_f32" 0 DISPLAY_IDENTIFIER VehSpdLmt.ReceiverPorts.CWPosition.HwDeg_f32 /end MEASUREMENT
/begin MEASUREMENT VehSpdLmt.HwPos.HwDeg_f32 "MICROSAR RTE" FLOAT32_IEEE NO_COMPU_METHOD 0 0 1.175494351e-38 3.402823466e+38 ECU_ADDRESS 0 SYMBOL_LINK "Rte_AbsHwPos_HandwheelPosition_HwDeg_f32" 0 DISPLAY_IDENTIFIER VehSpdLmt.ReceiverPorts.HwPos.HwDeg_f32 /end MEASUREMENT
/begin MEASUREMENT VehSpdLmt.HwPosAuth.Uls_f32 "MICROSAR RTE" FLOAT32_IEEE NO_COMPU_METHOD 0 0 1.175494351e-38 3.402823466e+38 ECU_ADDRESS 0 SYMBOL_LINK "Rte_AbsHwPos_HandwheelAuthority_Uls_f32" 0 DISPLAY_IDENTIFIER VehSpdLmt.ReceiverPorts.HwPosAuth.Uls_f32 /end MEASUREMENT
/begin MEASUREMENT VehSpdLmt.VehSpd.Kph_f32 "MICROSAR RTE" FLOAT32_IEEE NO_COMPU_METHOD 0 0 1.175494351e-38 3.402823466e+38 ECU_ADDRESS 0 SYMBOL_LINK "Rte_Ap_SignlCondn_VehicleSpeed_Kph_f32" 0 DISPLAY_IDENTIFIER VehSpdLmt.ReceiverPorts.VehSpd.Kph_f32 /end MEASUREMENT
/begin MEASUREMENT Xcp.ActiveTunOvrPtrAddr.Cnt_u32 "MICROSAR RTE" ULONG NO_COMPU_METHOD 0 0 0 4294967295 ECU_ADDRESS 0 SYMBOL_LINK "Rte_Xcp_ActiveTunOvrPtrAddr_Cnt_u32" 0 DISPLAY_IDENTIFIER Xcp.SenderPorts.ActiveTunOvrPtrAddr.Cnt_u32 /end MEASUREMENT
/begin MEASUREMENT Xcp.ActiveTunPers.Cnt_u16 "MICROSAR RTE" UWORD NO_COMPU_METHOD 0 0 0 65535 ECU_ADDRESS 0 SYMBOL_LINK "Rte_Ap_TuningSelAuth_ActiveTunPers_Cnt_u16" 0 DISPLAY_IDENTIFIER Xcp.ReceiverPorts.ActiveTunPers.Cnt_u16 /end MEASUREMENT
/begin MEASUREMENT Xcp.ActiveTunSet.Cnt_u16 "MICROSAR RTE" UWORD NO_COMPU_METHOD 0 0 0 65535 ECU_ADDRESS 0 SYMBOL_LINK "Rte_Ap_TuningSelAuth_ActiveTunSet_Cnt_u16" 0 DISPLAY_IDENTIFIER Xcp.ReceiverPorts.ActiveTunSet.Cnt_u16 /end MEASUREMENT
/begin MEASUREMENT Xcp.DesiredTunPers.Cnt_u16 "MICROSAR RTE" UWORD NO_COMPU_METHOD 0 0 0 65535 ECU_ADDRESS 0 SYMBOL_LINK "Rte_SrlComInput_DesiredTunPers_Cnt_u16" 0 DISPLAY_IDENTIFIER Xcp.ReceiverPorts.DesiredTunPers.Cnt_u16 /end MEASUREMENT
/begin MEASUREMENT Xcp.DesiredTunSet.Cnt_u16 "MICROSAR RTE" UWORD NO_COMPU_METHOD 0 0 0 65535 ECU_ADDRESS 0 SYMBOL_LINK "Rte_Xcp_DesiredTunSet_Cnt_u16" 0 DISPLAY_IDENTIFIER Xcp.ReceiverPorts.DesiredTunSet.Cnt_u16 /end MEASUREMENT
/begin MEASUREMENT Xcp.TuningSessionActPtr.Cnt_u8 "MICROSAR RTE" UBYTE RTE_CM_ENUM_TuningSessionAddrPtrEnum 0 0 0 255 ECU_ADDRESS 0 SYMBOL_LINK "Rte_Xcp_TuningSessionActPtr_Cnt_u8" 0 DISPLAY_IDENTIFIER Xcp.SenderPorts.TuningSessionActPtr.Cnt_u8 /end MEASUREMENT
/begin GROUP RteErrata9 "MICROSAR RTE" /begin SUB_GROUP RteErrata9.ModeRequirePorts /end SUB_GROUP /begin FUNCTION_LIST /end FUNCTION_LIST /begin REF_CHARACTERISTIC /end REF_CHARACTERISTIC /begin REF_MEASUREMENT /end REF_MEASUREMENT /end GROUP
/begin GROUP RteErrata9.ModeRequirePorts "MICROSAR RTE" /begin SUB_GROUP RteErrata9.SystemState.Mode /end SUB_GROUP /begin FUNCTION_LIST /end FUNCTION_LIST /begin REF_CHARACTERISTIC /end REF_CHARACTERISTIC /begin REF_MEASUREMENT /end REF_MEASUREMENT /end GROUP
/begin GROUP RteErrata9.SystemState.Mode "MICROSAR RTE" /begin SUB_GROUP /end SUB_GROUP /begin FUNCTION_LIST /end FUNCTION_LIST /begin REF_CHARACTERISTIC /end REF_CHARACTERISTIC /begin REF_MEASUREMENT RteErrata9.SystemState.Mode /end REF_MEASUREMENT /end GROUP
/begin GROUP SWCs "MICROSAR RTE"
 /begin SUB_GROUP AbsHwPos Ap_ActivePull Ap_AssistFirewall Ap_AstLmt Ap_AvgFricLrn Ap_BVDiag Ap_DampingFirewall Ap_DiagMgr8 Ap_DiagMgr9 Ap_EtDmpFw Ap_GCCDiag Ap_GMStrtStop Ap_GenPosTraj Ap_HOWDetect Ap_HwPwUp Ap_LmtCod Ap_LrnEOT Ap_MtrTempEst Ap_PICurrCntrl Ap_PosServo Ap_PwrLmtFuncCr Ap_SASPlausDiag Ap_SignlCondn Ap_StaMd8 Ap_StaMd9 Ap_StabilityComp2 Ap_Sweep Ap_Sweep2 Ap_TSMit Ap_ThrmlDutyCycle Ap_TqRsDg Ap_TrqArblim Ap_TrqCanc Ap_TrqOsc Ap_TuningSelAuth Ap_WIRInputQual Ap_WhlImbRej Ap_ePWM2 Assist BatteryVoltage BkCpPc CDDInterface Cd_Nhet1 CmMtrCurr ComplErr CtrlTemp CtrldDisShtdn CurrCmd CurrParamComp CustPerSrvcs Damping DemIf DiagMgr DigColPs DigPhsReasDiag EOTActuatorMng FltInjection FrqDepDmpnInrtCmp HiLoadStall HighFreqAssist HystComp IoHwAbstractionUsr MtrDrvDiag PeakCurrEst Polarity QuadDet Return ReturnFirewall RteErrata RteErrata8 RteErrata9 Sa_DigHwTrqSENT Sa_DigMSB Sa_MtrVel Sa_MtrVel2 Sa_OvrVoltMon SrlComInput SrlComOutput StOpCtrl StaMd StabilityComp TmprlMon TrqCmdScl TrqOvlSta VehDyn VehPwrMd VehSpdLmt Xcp /end SUB_GROUP
 /begin FUNCTION_LIST /end FUNCTION_LIST
 /begin REF_CHARACTERISTIC /end REF_CHARACTERISTIC
 /begin REF_MEASUREMENT /end REF_MEASUREMENT
/end GROUP
/begin GROUP Sa_DigHwTrqSENT "MICROSAR RTE"
 /begin SUB_GROUP Sa_DigHwTrqSENT.PerInstanceMemories Sa_DigHwTrqSENT.ReceiverPorts Sa_DigHwTrqSENT.SenderPorts /end SUB_GROUP
 /begin FUNCTION_LIST /end FUNCTION_LIST
 /begin REF_CHARACTERISTIC /end REF_CHARACTERISTIC
 /begin REF_MEASUREMENT /end REF_MEASUREMENT
/end GROUP
/begin GROUP Sa_DigHwTrqSENT.DigTrqTrim "MICROSAR RTE" /begin SUB_GROUP /end SUB_GROUP /begin FUNCTION_LIST /end FUNCTION_LIST /begin REF_CHARACTERISTIC /end REF_CHARACTERISTIC
 /begin REF_MEASUREMENT Sa_DigHwTrqSENT.DigTrqTrim.k_EOLHwTrqTrimPerformed_Cnt_Lgc Sa_DigHwTrqSENT.DigTrqTrim.k_EOLHwTrqTrim_HwNm_f32 /end REF_MEASUREMENT
/end GROUP
/begin GROUP Sa_DigHwTrqSENT.HwTorque.HwNm_f32 "MICROSAR RTE" /begin SUB_GROUP /end SUB_GROUP /begin FUNCTION_LIST /end FUNCTION_LIST /begin REF_CHARACTERISTIC /end REF_CHARACTERISTIC /begin REF_MEASUREMENT Sa_DigHwTrqSENT.HwTorque.HwNm_f32 /end REF_MEASUREMENT /end GROUP
/begin GROUP Sa_DigHwTrqSENT.MECCounter.Cnt_enum "MICROSAR RTE" /begin SUB_GROUP /end SUB_GROUP /begin FUNCTION_LIST /end FUNCTION_LIST /begin REF_CHARACTERISTIC /end REF_CHARACTERISTIC /begin REF_MEASUREMENT Sa_DigHwTrqSENT.MECCounter.Cnt_enum /end REF_MEASUREMENT /end GROUP
/begin GROUP Sa_DigHwTrqSENT.PerInstanceMemories "MICROSAR RTE" /begin SUB_GROUP Sa_DigHwTrqSENT.DigTrqTrim /end SUB_GROUP /begin FUNCTION_LIST /end FUNCTION_LIST /begin REF_CHARACTERISTIC /end REF_CHARACTERISTIC /begin REF_MEASUREMENT /end REF_MEASUREMENT /end GROUP
/begin GROUP Sa_DigHwTrqSENT.ReceiverPorts "MICROSAR RTE"
 /begin SUB_GROUP Sa_DigHwTrqSENT.MECCounter.Cnt_enum Sa_DigHwTrqSENT.T1.HwNm_f32 Sa_DigHwTrqSENT.T2.HwNm_f32 /end SUB_GROUP
 /begin FUNCTION_LIST /end FUNCTION_LIST
 /begin REF_CHARACTERISTIC /end REF_CHARACTERISTIC
 /begin REF_MEASUREMENT /end REF_MEASUREMENT
/end GROUP
/begin GROUP Sa_DigHwTrqSENT.SenderPorts "MICROSAR RTE"
 /begin SUB_GROUP Sa_DigHwTrqSENT.HwTorque.HwNm_f32 Sa_DigHwTrqSENT.SrlComHwTrq.HwNm_f32 Sa_DigHwTrqSENT.SrlComHwTrqValid.Cnt_lgc Sa_DigHwTrqSENT.SysCHwTorque.HwNm_f32 /end SUB_GROUP
 /begin FUNCTION_LIST /end FUNCTION_LIST
 /begin REF_CHARACTERISTIC /end REF_CHARACTERISTIC
 /begin REF_MEASUREMENT /end REF_MEASUREMENT
/end GROUP
/begin GROUP Sa_DigHwTrqSENT.SrlComHwTrq.HwNm_f32 "MICROSAR RTE" /begin SUB_GROUP /end SUB_GROUP /begin FUNCTION_LIST /end FUNCTION_LIST /begin REF_CHARACTERISTIC /end REF_CHARACTERISTIC /begin REF_MEASUREMENT Sa_DigHwTrqSENT.SrlComHwTrq.HwNm_f32 /end REF_MEASUREMENT /end GROUP
/begin GROUP Sa_DigHwTrqSENT.SrlComHwTrqValid.Cnt_lgc "MICROSAR RTE" /begin SUB_GROUP /end SUB_GROUP /begin FUNCTION_LIST /end FUNCTION_LIST /begin REF_CHARACTERISTIC /end REF_CHARACTERISTIC /begin REF_MEASUREMENT Sa_DigHwTrqSENT.SrlComHwTrqValid.Cnt_lgc /end REF_MEASUREMENT /end GROUP
/begin GROUP Sa_DigHwTrqSENT.SysCHwTorque.HwNm_f32 "MICROSAR RTE" /begin SUB_GROUP /end SUB_GROUP /begin FUNCTION_LIST /end FUNCTION_LIST /begin REF_CHARACTERISTIC /end REF_CHARACTERISTIC /begin REF_MEASUREMENT Sa_DigHwTrqSENT.SysCHwTorque.HwNm_f32 /end REF_MEASUREMENT /end GROUP
/begin GROUP Sa_DigHwTrqSENT.T1.HwNm_f32 "MICROSAR RTE" /begin SUB_GROUP /end SUB_GROUP /begin FUNCTION_LIST /end FUNCTION_LIST /begin REF_CHARACTERISTIC /end REF_CHARACTERISTIC /begin REF_MEASUREMENT Sa_DigHwTrqSENT.T1.HwNm_f32 /end REF_MEASUREMENT /end GROUP
/begin GROUP Sa_DigHwTrqSENT.T2.HwNm_f32 "MICROSAR RTE" /begin SUB_GROUP /end SUB_GROUP /begin FUNCTION_LIST /end FUNCTION_LIST /begin REF_CHARACTERISTIC /end REF_CHARACTERISTIC /begin REF_MEASUREMENT Sa_DigHwTrqSENT.T2.HwNm_f32 /end REF_MEASUREMENT /end GROUP
/begin GROUP Sa_DigMSB "MICROSAR RTE"
 /begin SUB_GROUP Sa_DigMSB.PerInstanceMemories Sa_DigMSB.ReceiverPorts Sa_DigMSB.SenderPorts /end SUB_GROUP
 /begin FUNCTION_LIST /end FUNCTION_LIST
 /begin REF_CHARACTERISTIC /end REF_CHARACTERISTIC
 /begin REF_MEASUREMENT /end REF_MEASUREMENT
/end GROUP
/begin GROUP Sa_DigMSB.AlignedCumMechMtrPosCRF.Deg_f32 "MICROSAR RTE" /begin SUB_GROUP /end SUB_GROUP /begin FUNCTION_LIST /end FUNCTION_LIST /begin REF_CHARACTERISTIC /end REF_CHARACTERISTIC /begin REF_MEASUREMENT Sa_DigMSB.AlignedCumMechMtrPosCRF.Deg_f32 /end REF_MEASUREMENT /end GROUP
/begin GROUP Sa_DigMSB.AlignedCumMechMtrPosMRF.Deg_f32 "MICROSAR RTE" /begin SUB_GROUP /end SUB_GROUP /begin FUNCTION_LIST /end FUNCTION_LIST /begin REF_CHARACTERISTIC /end REF_CHARACTERISTIC /begin REF_MEASUREMENT Sa_DigMSB.AlignedCumMechMtrPosMRF.Deg_f32 /end REF_MEASUREMENT /end GROUP
/begin GROUP Sa_DigMSB.AlignedCumMechMtrPosStatus.Cnt_u08 "MICROSAR RTE" /begin SUB_GROUP /end SUB_GROUP /begin FUNCTION_LIST /end FUNCTION_LIST /begin REF_CHARACTERISTIC /end REF_CHARACTERISTIC /begin REF_MEASUREMENT Sa_DigMSB.AlignedCumMechMtrPosStatus.Cnt_u08 /end REF_MEASUREMENT /end GROUP
/begin GROUP Sa_DigMSB.AssistAssemblyPolarity.Cnt_s08 "MICROSAR RTE" /begin SUB_GROUP /end SUB_GROUP /begin FUNCTION_LIST /end FUNCTION_LIST /begin REF_CHARACTERISTIC /end REF_CHARACTERISTIC /begin REF_MEASUREMENT Sa_DigMSB.AssistAssemblyPolarity.Cnt_s08 /end REF_MEASUREMENT /end GROUP
/begin GROUP Sa_DigMSB.CorrectedElecMtrPos.Rev_u0p16 "MICROSAR RTE" /begin SUB_GROUP /end SUB_GROUP /begin FUNCTION_LIST /end FUNCTION_LIST /begin REF_CHARACTERISTIC /end REF_CHARACTERISTIC /begin REF_MEASUREMENT Sa_DigMSB.CorrectedElecMtrPos.Rev_u0p16 /end REF_MEASUREMENT /end GROUP
/begin GROUP Sa_DigMSB.CumMechMtrPos.Rev_f32 "MICROSAR RTE" /begin SUB_GROUP /end SUB_GROUP /begin FUNCTION_LIST /end FUNCTION_LIST /begin REF_CHARACTERISTIC /end REF_CHARACTERISTIC /begin REF_MEASUREMENT Sa_DigMSB.CumMechMtrPos.Rev_f32 /end REF_MEASUREMENT /end GROUP
/begin GROUP Sa_DigMSB.CumMechMtrPosCRF.Deg_f32 "MICROSAR RTE" /begin SUB_GROUP /end SUB_GROUP /begin FUNCTION_LIST /end FUNCTION_LIST /begin REF_CHARACTERISTIC /end REF_CHARACTERISTIC /begin REF_MEASUREMENT Sa_DigMSB.CumMechMtrPosCRF.Deg_f32 /end REF_MEASUREMENT /end GROUP
/begin GROUP Sa_DigMSB.CumMechMtrPosMRF.Deg_f32 "MICROSAR RTE" /begin SUB_GROUP /end SUB_GROUP /begin FUNCTION_LIST /end FUNCTION_LIST /begin REF_CHARACTERISTIC /end REF_CHARACTERISTIC /begin REF_MEASUREMENT Sa_DigMSB.CumMechMtrPosMRF.Deg_f32 /end REF_MEASUREMENT /end GROUP
/begin GROUP Sa_DigMSB.CumMechMtrPosStatus.Cnt_u08 "MICROSAR RTE" /begin SUB_GROUP /end SUB_GROUP /begin FUNCTION_LIST /end FUNCTION_LIST /begin REF_CHARACTERISTIC /end REF_CHARACTERISTIC /begin REF_MEASUREMENT Sa_DigMSB.CumMechMtrPosStatus.Cnt_u08 /end REF_MEASUREMENT /end GROUP
/begin GROUP Sa_DigMSB.Die1RxError.Cnt_u16 "MICROSAR RTE" /begin SUB_GROUP /end SUB_GROUP /begin FUNCTION_LIST /end FUNCTION_LIST /begin REF_CHARACTERISTIC /end REF_CHARACTERISTIC /begin REF_MEASUREMENT Sa_DigMSB.Die1RxError.Cnt_u16 /end REF_MEASUREMENT /end GROUP
/begin GROUP Sa_DigMSB.Die1RxMtrPos.Cnt_u16 "MICROSAR RTE" /begin SUB_GROUP /end SUB_GROUP /begin FUNCTION_LIST /end FUNCTION_LIST /begin REF_CHARACTERISTIC /end REF_CHARACTERISTIC /begin REF_MEASUREMENT Sa_DigMSB.Die1RxMtrPos.Cnt_u16 /end REF_MEASUREMENT /end GROUP
/begin GROUP Sa_DigMSB.Die1RxRevCtr.Cnt_u16 "MICROSAR RTE" /begin SUB_GROUP /end SUB_GROUP /begin FUNCTION_LIST /end FUNCTION_LIST /begin REF_CHARACTERISTIC /end REF_CHARACTERISTIC /begin REF_MEASUREMENT Sa_DigMSB.Die1RxRevCtr.Cnt_u16 /end REF_MEASUREMENT /end GROUP
/begin GROUP Sa_DigMSB.Die1UnderVoltgFltAccum.Cnt_u16 "MICROSAR RTE" /begin SUB_GROUP /end SUB_GROUP /begin FUNCTION_LIST /end FUNCTION_LIST /begin REF_CHARACTERISTIC /end REF_CHARACTERISTIC /begin REF_MEASUREMENT Sa_DigMSB.Die1UnderVoltgFltAccum.Cnt_u16 /end REF_MEASUREMENT /end GROUP
/begin GROUP Sa_DigMSB.Die2RxError.Cnt_u16 "MICROSAR RTE" /begin SUB_GROUP /end SUB_GROUP /begin FUNCTION_LIST /end FUNCTION_LIST /begin REF_CHARACTERISTIC /end REF_CHARACTERISTIC /begin REF_MEASUREMENT Sa_DigMSB.Die2RxError.Cnt_u16 /end REF_MEASUREMENT /end GROUP
/begin GROUP Sa_DigMSB.Die2RxMtrPos.Cnt_u16 "MICROSAR RTE" /begin SUB_GROUP /end SUB_GROUP /begin FUNCTION_LIST /end FUNCTION_LIST /begin REF_CHARACTERISTIC /end REF_CHARACTERISTIC /begin REF_MEASUREMENT Sa_DigMSB.Die2RxMtrPos.Cnt_u16 /end REF_MEASUREMENT /end GROUP
/begin GROUP Sa_DigMSB.Die2RxRevCtr.Cnt_u16 "MICROSAR RTE" /begin SUB_GROUP /end SUB_GROUP /begin FUNCTION_LIST /end FUNCTION_LIST /begin REF_CHARACTERISTIC /end REF_CHARACTERISTIC /begin REF_MEASUREMENT Sa_DigMSB.Die2RxRevCtr.Cnt_u16 /end REF_MEASUREMENT /end GROUP
/begin GROUP Sa_DigMSB.DigMSBEOLData "MICROSAR RTE" /begin SUB_GROUP /end SUB_GROUP /begin FUNCTION_LIST /end FUNCTION_LIST /begin REF_CHARACTERISTIC /end REF_CHARACTERISTIC
 /begin REF_MEASUREMENT Sa_DigMSB.DigMSBEOLData.CRC_Cnt_u16 Sa_DigMSB.DigMSBEOLData.MtrPos1HarCompTbl_Rev_s2p13 Sa_DigMSB.DigMSBEOLData.MtrPos2HarCompTbl_Rev_s2p13 Sa_DigMSB.DigMSBEOLData.MtrPosBEMFRedundant_Rev_u0p16 Sa_DigMSB.DigMSBEOLData.MtrPosBEMF_Rev_u0p16 /end REF_MEASUREMENT
/end GROUP
/begin GROUP Sa_DigMSB.MechMtrPos2.Rev_u0p16 "MICROSAR RTE" /begin SUB_GROUP /end SUB_GROUP /begin FUNCTION_LIST /end FUNCTION_LIST /begin REF_CHARACTERISTIC /end REF_CHARACTERISTIC /begin REF_MEASUREMENT Sa_DigMSB.MechMtrPos2.Rev_u0p16 /end REF_MEASUREMENT /end GROUP
/begin GROUP Sa_DigMSB.MtrPosPolarity.Cnt_s08 "MICROSAR RTE" /begin SUB_GROUP /end SUB_GROUP /begin FUNCTION_LIST /end FUNCTION_LIST /begin REF_CHARACTERISTIC /end REF_CHARACTERISTIC /begin REF_MEASUREMENT Sa_DigMSB.MtrPosPolarity.Cnt_s08 /end REF_MEASUREMENT /end GROUP
/begin GROUP Sa_DigMSB.PerInstanceMemories "MICROSAR RTE" /begin SUB_GROUP Sa_DigMSB.DigMSBEOLData /end SUB_GROUP /begin FUNCTION_LIST /end FUNCTION_LIST /begin REF_CHARACTERISTIC /end REF_CHARACTERISTIC /begin REF_MEASUREMENT /end REF_MEASUREMENT /end GROUP
/begin GROUP Sa_DigMSB.ReceiverPorts "MICROSAR RTE"
 /begin SUB_GROUP Sa_DigMSB.AssistAssemblyPolarity.Cnt_s08 Sa_DigMSB.CorrectedElecMtrPos.Rev_u0p16 Sa_DigMSB.CumMechMtrPos.Rev_f32 Sa_DigMSB.Die1RxError.Cnt_u16 Sa_DigMSB.Die1RxMtrPos.Cnt_u16 Sa_DigMSB.Die1RxRevCtr.Cnt_u16 Sa_DigMSB.Die1UnderVoltgFltAccum.Cnt_u16 Sa_DigMSB.Die2RxError.Cnt_u16 Sa_DigMSB.Die2RxMtrPos.Cnt_u16 Sa_DigMSB.Die2RxRevCtr.Cnt_u16 Sa_DigMSB.MtrPosPolarity.Cnt_s08 Sa_DigMSB.RxMtrPosParityAccum.Cnt_u16 Sa_DigMSB.UncorrMechMtrPos1.Rev_u0p16 /end SUB_GROUP
 /begin FUNCTION_LIST /end FUNCTION_LIST
 /begin REF_CHARACTERISTIC /end REF_CHARACTERISTIC
 /begin REF_MEASUREMENT /end REF_MEASUREMENT
/end GROUP
/begin GROUP Sa_DigMSB.RxMtrPosParityAccum.Cnt_u16 "MICROSAR RTE" /begin SUB_GROUP /end SUB_GROUP /begin FUNCTION_LIST /end FUNCTION_LIST /begin REF_CHARACTERISTIC /end REF_CHARACTERISTIC /begin REF_MEASUREMENT Sa_DigMSB.RxMtrPosParityAccum.Cnt_u16 /end REF_MEASUREMENT /end GROUP
/begin GROUP Sa_DigMSB.SenderPorts "MICROSAR RTE"
 /begin SUB_GROUP Sa_DigMSB.AlignedCumMechMtrPosCRF.Deg_f32 Sa_DigMSB.AlignedCumMechMtrPosMRF.Deg_f32 Sa_DigMSB.AlignedCumMechMtrPosStatus.Cnt_u08 Sa_DigMSB.CumMechMtrPosCRF.Deg_f32 Sa_DigMSB.CumMechMtrPosMRF.Deg_f32 Sa_DigMSB.CumMechMtrPosStatus.Cnt_u08 Sa_DigMSB.MechMtrPos2.Rev_u0p16 Sa_DigMSB.SysCCumMechMtrPosMRF.Deg_f32 /end SUB_GROUP
 /begin FUNCTION_LIST /end FUNCTION_LIST
 /begin REF_CHARACTERISTIC /end REF_CHARACTERISTIC
 /begin REF_MEASUREMENT /end REF_MEASUREMENT
/end GROUP
/begin GROUP Sa_DigMSB.SysCCumMechMtrPosMRF.Deg_f32 "MICROSAR RTE" /begin SUB_GROUP /end SUB_GROUP /begin FUNCTION_LIST /end FUNCTION_LIST /begin REF_CHARACTERISTIC /end REF_CHARACTERISTIC /begin REF_MEASUREMENT Sa_DigMSB.SysCCumMechMtrPosMRF.Deg_f32 /end REF_MEASUREMENT /end GROUP
/begin GROUP Sa_DigMSB.UncorrMechMtrPos1.Rev_u0p16 "MICROSAR RTE" /begin SUB_GROUP /end SUB_GROUP /begin FUNCTION_LIST /end FUNCTION_LIST /begin REF_CHARACTERISTIC /end REF_CHARACTERISTIC /begin REF_MEASUREMENT Sa_DigMSB.UncorrMechMtrPos1.Rev_u0p16 /end REF_MEASUREMENT /end GROUP
/begin GROUP Sa_MtrVel "MICROSAR RTE" /begin SUB_GROUP Sa_MtrVel.ReceiverPorts Sa_MtrVel.SenderPorts /end SUB_GROUP /begin FUNCTION_LIST /end FUNCTION_LIST /begin REF_CHARACTERISTIC /end REF_CHARACTERISTIC /begin REF_MEASUREMENT /end REF_MEASUREMENT /end GROUP
/begin GROUP Sa_MtrVel.AsstAssemblyPolarity.Cnt_s08 "MICROSAR RTE" /begin SUB_GROUP /end SUB_GROUP /begin FUNCTION_LIST /end FUNCTION_LIST /begin REF_CHARACTERISTIC /end REF_CHARACTERISTIC /begin REF_MEASUREMENT Sa_MtrVel.AsstAssemblyPolarity.Cnt_s08 /end REF_MEASUREMENT /end GROUP
/begin GROUP Sa_MtrVel.HandwheelVel.HwRadpS_f32 "MICROSAR RTE" /begin SUB_GROUP /end SUB_GROUP /begin FUNCTION_LIST /end FUNCTION_LIST /begin REF_CHARACTERISTIC /end REF_CHARACTERISTIC /begin REF_MEASUREMENT Sa_MtrVel.HandwheelVel.HwRadpS_f32 /end REF_MEASUREMENT /end GROUP
/begin GROUP Sa_MtrVel.HwVelValid.Cnt_lgc "MICROSAR RTE" /begin SUB_GROUP /end SUB_GROUP /begin FUNCTION_LIST /end FUNCTION_LIST /begin REF_CHARACTERISTIC /end REF_CHARACTERISTIC /begin REF_MEASUREMENT Sa_MtrVel.HwVelValid.Cnt_lgc /end REF_MEASUREMENT /end GROUP
/begin GROUP Sa_MtrVel.MechMtrPos2.Rev_u0p16 "MICROSAR RTE" /begin SUB_GROUP /end SUB_GROUP /begin FUNCTION_LIST /end FUNCTION_LIST /begin REF_CHARACTERISTIC /end REF_CHARACTERISTIC /begin REF_MEASUREMENT Sa_MtrVel.MechMtrPos2.Rev_u0p16 /end REF_MEASUREMENT /end GROUP
/begin GROUP Sa_MtrVel.MechMtrPos2Timestamp.USec_u32 "MICROSAR RTE" /begin SUB_GROUP /end SUB_GROUP /begin FUNCTION_LIST /end FUNCTION_LIST /begin REF_CHARACTERISTIC /end REF_CHARACTERISTIC /begin REF_MEASUREMENT Sa_MtrVel.MechMtrPos2Timestamp.USec_u32 /end REF_MEASUREMENT /end GROUP
/begin GROUP Sa_MtrVel.MotorVelCRF.MtrRadpS_f32 "MICROSAR RTE" /begin SUB_GROUP /end SUB_GROUP /begin FUNCTION_LIST /end FUNCTION_LIST /begin REF_CHARACTERISTIC /end REF_CHARACTERISTIC /begin REF_MEASUREMENT Sa_MtrVel.MotorVelCRF.MtrRadpS_f32 /end REF_MEASUREMENT /end GROUP
/begin GROUP Sa_MtrVel.MotorVelMRF.MtrRadpS_f32 "MICROSAR RTE" /begin SUB_GROUP /end SUB_GROUP /begin FUNCTION_LIST /end FUNCTION_LIST /begin REF_CHARACTERISTIC /end REF_CHARACTERISTIC /begin REF_MEASUREMENT Sa_MtrVel.MotorVelMRF.MtrRadpS_f32 /end REF_MEASUREMENT /end GROUP
/begin GROUP Sa_MtrVel.ReceiverPorts "MICROSAR RTE"
 /begin SUB_GROUP Sa_MtrVel.AsstAssemblyPolarity.Cnt_s08 Sa_MtrVel.MechMtrPos2.Rev_u0p16 Sa_MtrVel.MechMtrPos2Timestamp.USec_u32 Sa_MtrVel.SysCDiagHwVel.HwRadpS_f32 Sa_MtrVel.SysCDiagMtrVelMRF.MtrRadpS_f32 /end SUB_GROUP
 /begin FUNCTION_LIST /end FUNCTION_LIST
 /begin REF_CHARACTERISTIC /end REF_CHARACTERISTIC
 /begin REF_MEASUREMENT /end REF_MEASUREMENT
/end GROUP
/begin GROUP Sa_MtrVel.SenderPorts "MICROSAR RTE"
 /begin SUB_GROUP Sa_MtrVel.HandwheelVel.HwRadpS_f32 Sa_MtrVel.HwVelValid.Cnt_lgc Sa_MtrVel.MotorVelCRF.MtrRadpS_f32 Sa_MtrVel.MotorVelMRF.MtrRadpS_f32 Sa_MtrVel.SysCHandwheelVel.HwRadpS_f32 Sa_MtrVel.SysCMotorVelMRF.MtrRadpS_f32 /end SUB_GROUP
 /begin FUNCTION_LIST /end FUNCTION_LIST
 /begin REF_CHARACTERISTIC /end REF_CHARACTERISTIC
 /begin REF_MEASUREMENT /end REF_MEASUREMENT
/end GROUP
/begin GROUP Sa_MtrVel.SysCDiagHwVel.HwRadpS_f32 "MICROSAR RTE" /begin SUB_GROUP /end SUB_GROUP /begin FUNCTION_LIST /end FUNCTION_LIST /begin REF_CHARACTERISTIC /end REF_CHARACTERISTIC /begin REF_MEASUREMENT Sa_MtrVel.SysCDiagHwVel.HwRadpS_f32 /end REF_MEASUREMENT /end GROUP
/begin GROUP Sa_MtrVel.SysCDiagMtrVelMRF.MtrRadpS_f32 "MICROSAR RTE" /begin SUB_GROUP /end SUB_GROUP /begin FUNCTION_LIST /end FUNCTION_LIST /begin REF_CHARACTERISTIC /end REF_CHARACTERISTIC /begin REF_MEASUREMENT Sa_MtrVel.SysCDiagMtrVelMRF.MtrRadpS_f32 /end REF_MEASUREMENT /end GROUP
/begin GROUP Sa_MtrVel.SysCHandwheelVel.HwRadpS_f32 "MICROSAR RTE" /begin SUB_GROUP /end SUB_GROUP /begin FUNCTION_LIST /end FUNCTION_LIST /begin REF_CHARACTERISTIC /end REF_CHARACTERISTIC /begin REF_MEASUREMENT Sa_MtrVel.SysCHandwheelVel.HwRadpS_f32 /end REF_MEASUREMENT /end GROUP
/begin GROUP Sa_MtrVel.SysCMotorVelMRF.MtrRadpS_f32 "MICROSAR RTE" /begin SUB_GROUP /end SUB_GROUP /begin FUNCTION_LIST /end FUNCTION_LIST /begin REF_CHARACTERISTIC /end REF_CHARACTERISTIC /begin REF_MEASUREMENT Sa_MtrVel.SysCMotorVelMRF.MtrRadpS_f32 /end REF_MEASUREMENT /end GROUP
/begin GROUP Sa_MtrVel2 "MICROSAR RTE" /begin SUB_GROUP Sa_MtrVel2.ReceiverPorts Sa_MtrVel2.SenderPorts /end SUB_GROUP /begin FUNCTION_LIST /end FUNCTION_LIST /begin REF_CHARACTERISTIC /end REF_CHARACTERISTIC /begin REF_MEASUREMENT /end REF_MEASUREMENT /end GROUP
/begin GROUP Sa_MtrVel2.AsstAssemblyPolarity.Cnt_s08 "MICROSAR RTE" /begin SUB_GROUP /end SUB_GROUP /begin FUNCTION_LIST /end FUNCTION_LIST /begin REF_CHARACTERISTIC /end REF_CHARACTERISTIC /begin REF_MEASUREMENT Sa_MtrVel2.AsstAssemblyPolarity.Cnt_s08 /end REF_MEASUREMENT /end GROUP
/begin GROUP Sa_MtrVel2.CumMechMtrPosMRF.Deg_f32 "MICROSAR RTE" /begin SUB_GROUP /end SUB_GROUP /begin FUNCTION_LIST /end FUNCTION_LIST /begin REF_CHARACTERISTIC /end REF_CHARACTERISTIC /begin REF_MEASUREMENT Sa_MtrVel2.CumMechMtrPosMRF.Deg_f32 /end REF_MEASUREMENT /end GROUP
/begin GROUP Sa_MtrVel2.HandwheelVel.HwRadpS_f32 "MICROSAR RTE" /begin SUB_GROUP /end SUB_GROUP /begin FUNCTION_LIST /end FUNCTION_LIST /begin REF_CHARACTERISTIC /end REF_CHARACTERISTIC /begin REF_MEASUREMENT Sa_MtrVel2.HandwheelVel.HwRadpS_f32 /end REF_MEASUREMENT /end GROUP
/begin GROUP Sa_MtrVel2.MechMtrPos1Timestamp.USec_u32 "MICROSAR RTE" /begin SUB_GROUP /end SUB_GROUP /begin FUNCTION_LIST /end FUNCTION_LIST /begin REF_CHARACTERISTIC /end REF_CHARACTERISTIC /begin REF_MEASUREMENT Sa_MtrVel2.MechMtrPos1Timestamp.USec_u32 /end REF_MEASUREMENT /end GROUP
/begin GROUP Sa_MtrVel2.MotorVelMRF.MtrRadpS_f32 "MICROSAR RTE" /begin SUB_GROUP /end SUB_GROUP /begin FUNCTION_LIST /end FUNCTION_LIST /begin REF_CHARACTERISTIC /end REF_CHARACTERISTIC /begin REF_MEASUREMENT Sa_MtrVel2.MotorVelMRF.MtrRadpS_f32 /end REF_MEASUREMENT /end GROUP
/begin GROUP Sa_MtrVel2.ReceiverPorts "MICROSAR RTE"
 /begin SUB_GROUP Sa_MtrVel2.AsstAssemblyPolarity.Cnt_s08 Sa_MtrVel2.CumMechMtrPosMRF.Deg_f32 Sa_MtrVel2.HandwheelVel.HwRadpS_f32 Sa_MtrVel2.MechMtrPos1Timestamp.USec_u32 Sa_MtrVel2.MotorVelMRF.MtrRadpS_f32 /end SUB_GROUP
 /begin FUNCTION_LIST /end FUNCTION_LIST
 /begin REF_CHARACTERISTIC /end REF_CHARACTERISTIC
 /begin REF_MEASUREMENT /end REF_MEASUREMENT
/end GROUP
/begin GROUP Sa_MtrVel2.SenderPorts "MICROSAR RTE"
 /begin SUB_GROUP Sa_MtrVel2.SysCDiagHwVel.HwRadpS_f32 Sa_MtrVel2.SysCDiagMtrVelMRF.MtrRadpS_f32 /end SUB_GROUP
 /begin FUNCTION_LIST /end FUNCTION_LIST
 /begin REF_CHARACTERISTIC /end REF_CHARACTERISTIC
 /begin REF_MEASUREMENT /end REF_MEASUREMENT
/end GROUP
/begin GROUP Sa_MtrVel2.SysCDiagHwVel.HwRadpS_f32 "MICROSAR RTE" /begin SUB_GROUP /end SUB_GROUP /begin FUNCTION_LIST /end FUNCTION_LIST /begin REF_CHARACTERISTIC /end REF_CHARACTERISTIC /begin REF_MEASUREMENT Sa_MtrVel2.SysCDiagHwVel.HwRadpS_f32 /end REF_MEASUREMENT /end GROUP
/begin GROUP Sa_MtrVel2.SysCDiagMtrVelMRF.MtrRadpS_f32 "MICROSAR RTE" /begin SUB_GROUP /end SUB_GROUP /begin FUNCTION_LIST /end FUNCTION_LIST /begin REF_CHARACTERISTIC /end REF_CHARACTERISTIC /begin REF_MEASUREMENT Sa_MtrVel2.SysCDiagMtrVelMRF.MtrRadpS_f32 /end REF_MEASUREMENT /end GROUP
/begin GROUP Sa_OvrVoltMon "MICROSAR RTE" /begin SUB_GROUP Sa_OvrVoltMon.ModeRequirePorts Sa_OvrVoltMon.ReceiverPorts /end SUB_GROUP /begin FUNCTION_LIST /end FUNCTION_LIST /begin REF_CHARACTERISTIC /end REF_CHARACTERISTIC /begin REF_MEASUREMENT /end REF_MEASUREMENT /end GROUP
/begin GROUP Sa_OvrVoltMon.ModeRequirePorts "MICROSAR RTE" /begin SUB_GROUP Sa_OvrVoltMon.SystemState.Mode /end SUB_GROUP /begin FUNCTION_LIST /end FUNCTION_LIST /begin REF_CHARACTERISTIC /end REF_CHARACTERISTIC /begin REF_MEASUREMENT /end REF_MEASUREMENT /end GROUP
/begin GROUP Sa_OvrVoltMon.PwrDiscBTestStart.Cnt_lgc "MICROSAR RTE" /begin SUB_GROUP /end SUB_GROUP /begin FUNCTION_LIST /end FUNCTION_LIST /begin REF_CHARACTERISTIC /end REF_CHARACTERISTIC /begin REF_MEASUREMENT Sa_OvrVoltMon.PwrDiscBTestStart.Cnt_lgc /end REF_MEASUREMENT /end GROUP
/begin GROUP Sa_OvrVoltMon.ReceiverPorts "MICROSAR RTE" /begin SUB_GROUP Sa_OvrVoltMon.PwrDiscBTestStart.Cnt_lgc /end SUB_GROUP /begin FUNCTION_LIST /end FUNCTION_LIST /begin REF_CHARACTERISTIC /end REF_CHARACTERISTIC /begin REF_MEASUREMENT /end REF_MEASUREMENT /end GROUP
/begin GROUP Sa_OvrVoltMon.SystemState.Mode "MICROSAR RTE" /begin SUB_GROUP /end SUB_GROUP /begin FUNCTION_LIST /end FUNCTION_LIST /begin REF_CHARACTERISTIC /end REF_CHARACTERISTIC /begin REF_MEASUREMENT Sa_OvrVoltMon.SystemState.Mode /end REF_MEASUREMENT /end GROUP
/begin GROUP SrlComInput "MICROSAR RTE"
 /begin SUB_GROUP SrlComInput.ModeRequirePorts SrlComInput.ReceiverPorts SrlComInput.SenderPorts /end SUB_GROUP
 /begin FUNCTION_LIST /end FUNCTION_LIST
 /begin REF_CHARACTERISTIC /end REF_CHARACTERISTIC
 /begin REF_MEASUREMENT /end REF_MEASUREMENT
/end GROUP
/begin GROUP SrlComInput.APAMfgEnable.Cnt_lgc "MICROSAR RTE" /begin SUB_GROUP /end SUB_GROUP /begin FUNCTION_LIST /end FUNCTION_LIST /begin REF_CHARACTERISTIC /end REF_CHARACTERISTIC /begin REF_MEASUREMENT SrlComInput.APAMfgEnable.Cnt_lgc /end REF_MEASUREMENT /end GROUP
/begin GROUP SrlComInput.APANonRecoverableFaults.Cnt_lgc "MICROSAR RTE" /begin SUB_GROUP /end SUB_GROUP /begin FUNCTION_LIST /end FUNCTION_LIST /begin REF_CHARACTERISTIC /end REF_CHARACTERISTIC /begin REF_MEASUREMENT SrlComInput.APANonRecoverableFaults.Cnt_lgc /end REF_MEASUREMENT /end GROUP
/begin GROUP SrlComInput.APARecoverableFaults.Cnt_lgc "MICROSAR RTE" /begin SUB_GROUP /end SUB_GROUP /begin FUNCTION_LIST /end FUNCTION_LIST /begin REF_CHARACTERISTIC /end REF_CHARACTERISTIC /begin REF_MEASUREMENT SrlComInput.APARecoverableFaults.Cnt_lgc /end REF_MEASUREMENT /end GROUP
/begin GROUP SrlComInput.APARequest.Cnt_lgc "MICROSAR RTE" /begin SUB_GROUP /end SUB_GROUP /begin FUNCTION_LIST /end FUNCTION_LIST /begin REF_CHARACTERISTIC /end REF_CHARACTERISTIC /begin REF_MEASUREMENT SrlComInput.APARequest.Cnt_lgc /end REF_MEASUREMENT /end GROUP
/begin GROUP SrlComInput.BusOffCE.Cnt_lgc "MICROSAR RTE" /begin SUB_GROUP /end SUB_GROUP /begin FUNCTION_LIST /end FUNCTION_LIST /begin REF_CHARACTERISTIC /end REF_CHARACTERISTIC /begin REF_MEASUREMENT SrlComInput.BusOffCE.Cnt_lgc /end REF_MEASUREMENT /end GROUP
/begin GROUP SrlComInput.BusOffHS.Cnt_lgc "MICROSAR RTE" /begin SUB_GROUP /end SUB_GROUP /begin FUNCTION_LIST /end FUNCTION_LIST /begin REF_CHARACTERISTIC /end REF_CHARACTERISTIC /begin REF_MEASUREMENT SrlComInput.BusOffHS.Cnt_lgc /end REF_MEASUREMENT /end GROUP
/begin GROUP SrlComInput.DesiredTunPers.Cnt_u16 "MICROSAR RTE" /begin SUB_GROUP /end SUB_GROUP /begin FUNCTION_LIST /end FUNCTION_LIST /begin REF_CHARACTERISTIC /end REF_CHARACTERISTIC /begin REF_MEASUREMENT SrlComInput.DesiredTunPers.Cnt_u16 /end REF_MEASUREMENT /end GROUP
/begin GROUP SrlComInput.DiagRmpToZeroActive.Cnt_lgc "MICROSAR RTE" /begin SUB_GROUP /end SUB_GROUP /begin FUNCTION_LIST /end FUNCTION_LIST /begin REF_CHARACTERISTIC /end REF_CHARACTERISTIC /begin REF_MEASUREMENT SrlComInput.DiagRmpToZeroActive.Cnt_lgc /end REF_MEASUREMENT /end GROUP
/begin GROUP SrlComInput.DiagStsDefVehSpd.Cnt_lgc "MICROSAR RTE" /begin SUB_GROUP /end SUB_GROUP /begin FUNCTION_LIST /end FUNCTION_LIST /begin REF_CHARACTERISTIC /end REF_CHARACTERISTIC /begin REF_MEASUREMENT SrlComInput.DiagStsDefVehSpd.Cnt_lgc /end REF_MEASUREMENT /end GROUP
/begin GROUP SrlComInput.DiagStsNonRecRmpToZeroFltPres.Cnt_lgc "MICROSAR RTE" /begin SUB_GROUP /end SUB_GROUP /begin FUNCTION_LIST /end FUNCTION_LIST /begin REF_CHARACTERISTIC /end REF_CHARACTERISTIC /begin REF_MEASUREMENT SrlComInput.DiagStsNonRecRmpToZeroFltPres.Cnt_lgc /end REF_MEASUREMENT /end GROUP
/begin GROUP SrlComInput.ESCCmd.HwNm_f32 "MICROSAR RTE" /begin SUB_GROUP /end SUB_GROUP /begin FUNCTION_LIST /end FUNCTION_LIST /begin REF_CHARACTERISTIC /end REF_CHARACTERISTIC /begin REF_MEASUREMENT SrlComInput.ESCCmd.HwNm_f32 /end REF_MEASUREMENT /end GROUP
/begin GROUP SrlComInput.ESCFault.Cnt_lgc "MICROSAR RTE" /begin SUB_GROUP /end SUB_GROUP /begin FUNCTION_LIST /end FUNCTION_LIST /begin REF_CHARACTERISTIC /end REF_CHARACTERISTIC /begin REF_MEASUREMENT SrlComInput.ESCFault.Cnt_lgc /end REF_MEASUREMENT /end GROUP
/begin GROUP SrlComInput.ESCMfgEnable.Cnt_lgc "MICROSAR RTE" /begin SUB_GROUP /end SUB_GROUP /begin FUNCTION_LIST /end FUNCTION_LIST /begin REF_CHARACTERISTIC /end REF_CHARACTERISTIC /begin REF_MEASUREMENT SrlComInput.ESCMfgEnable.Cnt_lgc /end REF_MEASUREMENT /end GROUP
/begin GROUP SrlComInput.ESCRequest.Cnt_lgc "MICROSAR RTE" /begin SUB_GROUP /end SUB_GROUP /begin FUNCTION_LIST /end FUNCTION_LIST /begin REF_CHARACTERISTIC /end REF_CHARACTERISTIC /begin REF_MEASUREMENT SrlComInput.ESCRequest.Cnt_lgc /end REF_MEASUREMENT /end GROUP
/begin GROUP SrlComInput.EngRunAtvForCTCInhibit.Cnt_lgc "MICROSAR RTE" /begin SUB_GROUP /end SUB_GROUP /begin FUNCTION_LIST /end FUNCTION_LIST /begin REF_CHARACTERISTIC /end REF_CHARACTERISTIC /begin REF_MEASUREMENT SrlComInput.EngRunAtvForCTCInhibit.Cnt_lgc /end REF_MEASUREMENT /end GROUP
/begin GROUP SrlComInput.HapticRequest.Cnt_lgc "MICROSAR RTE" /begin SUB_GROUP /end SUB_GROUP /begin FUNCTION_LIST /end FUNCTION_LIST /begin REF_CHARACTERISTIC /end REF_CHARACTERISTIC /begin REF_MEASUREMENT SrlComInput.HapticRequest.Cnt_lgc /end REF_MEASUREMENT /end GROUP
/begin GROUP SrlComInput.LKACmd.HwNm_f32 "MICROSAR RTE" /begin SUB_GROUP /end SUB_GROUP /begin FUNCTION_LIST /end FUNCTION_LIST /begin REF_CHARACTERISTIC /end REF_CHARACTERISTIC /begin REF_MEASUREMENT SrlComInput.LKACmd.HwNm_f32 /end REF_MEASUREMENT /end GROUP
/begin GROUP SrlComInput.LKAFault.Cnt_lgc "MICROSAR RTE" /begin SUB_GROUP /end SUB_GROUP /begin FUNCTION_LIST /end FUNCTION_LIST /begin REF_CHARACTERISTIC /end REF_CHARACTERISTIC /begin REF_MEASUREMENT SrlComInput.LKAFault.Cnt_lgc /end REF_MEASUREMENT /end GROUP
/begin GROUP SrlComInput.LKAInhibit.Cnt_lgc "MICROSAR RTE" /begin SUB_GROUP /end SUB_GROUP /begin FUNCTION_LIST /end FUNCTION_LIST /begin REF_CHARACTERISTIC /end REF_CHARACTERISTIC /begin REF_MEASUREMENT SrlComInput.LKAInhibit.Cnt_lgc /end REF_MEASUREMENT /end GROUP
/begin GROUP SrlComInput.LKAMfgEnable.Cnt_lgc "MICROSAR RTE" /begin SUB_GROUP /end SUB_GROUP /begin FUNCTION_LIST /end FUNCTION_LIST /begin REF_CHARACTERISTIC /end REF_CHARACTERISTIC /begin REF_MEASUREMENT SrlComInput.LKAMfgEnable.Cnt_lgc /end REF_MEASUREMENT /end GROUP
/begin GROUP SrlComInput.LKARequest.Cnt_lgc "MICROSAR RTE" /begin SUB_GROUP /end SUB_GROUP /begin FUNCTION_LIST /end FUNCTION_LIST /begin REF_CHARACTERISTIC /end REF_CHARACTERISTIC /begin REF_MEASUREMENT SrlComInput.LKARequest.Cnt_lgc /end REF_MEASUREMENT /end GROUP
/begin GROUP SrlComInput.MaxSecureVehicleSpeed.Kph_f32 "MICROSAR RTE" /begin SUB_GROUP /end SUB_GROUP /begin FUNCTION_LIST /end FUNCTION_LIST /begin REF_CHARACTERISTIC /end REF_CHARACTERISTIC /begin REF_MEASUREMENT SrlComInput.MaxSecureVehicleSpeed.Kph_f32 /end REF_MEASUREMENT /end GROUP
/begin GROUP SrlComInput.MinSecureVehicleSpeed.Kph_f32 "MICROSAR RTE" /begin SUB_GROUP /end SUB_GROUP /begin FUNCTION_LIST /end FUNCTION_LIST /begin REF_CHARACTERISTIC /end REF_CHARACTERISTIC /begin REF_MEASUREMENT SrlComInput.MinSecureVehicleSpeed.Kph_f32 /end REF_MEASUREMENT /end GROUP
/begin GROUP SrlComInput.ModeRequirePorts "MICROSAR RTE" /begin SUB_GROUP SrlComInput.SystemState.Mode /end SUB_GROUP /begin FUNCTION_LIST /end FUNCTION_LIST /begin REF_CHARACTERISTIC /end REF_CHARACTERISTIC /begin REF_MEASUREMENT /end REF_MEASUREMENT /end GROUP
/begin GROUP SrlComInput.PowertrainCrankActive.Cnt_lgc "MICROSAR RTE" /begin SUB_GROUP /end SUB_GROUP /begin FUNCTION_LIST /end FUNCTION_LIST /begin REF_CHARACTERISTIC /end REF_CHARACTERISTIC /begin REF_MEASUREMENT SrlComInput.PowertrainCrankActive.Cnt_lgc /end REF_MEASUREMENT /end GROUP
/begin GROUP SrlComInput.PrevSrlComEngOn.Cnt_lgc "MICROSAR RTE" /begin SUB_GROUP /end SUB_GROUP /begin FUNCTION_LIST /end FUNCTION_LIST /begin REF_CHARACTERISTIC /end REF_CHARACTERISTIC /begin REF_MEASUREMENT SrlComInput.PrevSrlComEngOn.Cnt_lgc /end REF_MEASUREMENT /end GROUP
/begin GROUP SrlComInput.ReceiverPorts "MICROSAR RTE"
 /begin SUB_GROUP SrlComInput.BusOffCE.Cnt_lgc SrlComInput.BusOffHS.Cnt_lgc SrlComInput.DiagRmpToZeroActive.Cnt_lgc SrlComInput.DiagStsDefVehSpd.Cnt_lgc SrlComInput.DiagStsNonRecRmpToZeroFltPres.Cnt_lgc SrlComInput.PrevSrlComEngOn.Cnt_lgc SrlComInput.RxMsgsSrlComSvcDft.Cnt_lgc SrlComInput.WIREnabled.Cnt_lgc /end SUB_GROUP
 /begin FUNCTION_LIST /end FUNCTION_LIST
 /begin REF_CHARACTERISTIC /end REF_CHARACTERISTIC
 /begin REF_MEASUREMENT /end REF_MEASUREMENT
/end GROUP
/begin GROUP SrlComInput.RxMsgsSrlComSvcDft.Cnt_lgc "MICROSAR RTE" /begin SUB_GROUP /end SUB_GROUP /begin FUNCTION_LIST /end FUNCTION_LIST /begin REF_CHARACTERISTIC /end REF_CHARACTERISTIC /begin REF_MEASUREMENT SrlComInput.RxMsgsSrlComSvcDft.Cnt_lgc /end REF_MEASUREMENT /end GROUP
/begin GROUP SrlComInput.SPMForCTCInhibit.Cnt_lgc "MICROSAR RTE" /begin SUB_GROUP /end SUB_GROUP /begin FUNCTION_LIST /end FUNCTION_LIST /begin REF_CHARACTERISTIC /end REF_CHARACTERISTIC /begin REF_MEASUREMENT SrlComInput.SPMForCTCInhibit.Cnt_lgc /end REF_MEASUREMENT /end GROUP
/begin GROUP SrlComInput.SWARTrgtAngRequest.HwDeg_f32 "MICROSAR RTE" /begin SUB_GROUP /end SUB_GROUP /begin FUNCTION_LIST /end FUNCTION_LIST /begin REF_CHARACTERISTIC /end REF_CHARACTERISTIC /begin REF_MEASUREMENT SrlComInput.SWARTrgtAngRequest.HwDeg_f32 /end REF_MEASUREMENT /end GROUP
/begin GROUP SrlComInput.SenderPorts "MICROSAR RTE"
 /begin SUB_GROUP SrlComInput.APAMfgEnable.Cnt_lgc SrlComInput.APANonRecoverableFaults.Cnt_lgc SrlComInput.APARecoverableFaults.Cnt_lgc SrlComInput.APARequest.Cnt_lgc SrlComInput.DesiredTunPers.Cnt_u16 SrlComInput.ESCCmd.HwNm_f32 SrlComInput.ESCFault.Cnt_lgc SrlComInput.ESCMfgEnable.Cnt_lgc SrlComInput.ESCRequest.Cnt_lgc SrlComInput.EngRunAtvForCTCInhibit.Cnt_lgc SrlComInput.HapticRequest.Cnt_lgc SrlComInput.LKACmd.HwNm_f32 SrlComInput.LKAFault.Cnt_lgc SrlComInput.LKAInhibit.Cnt_lgc SrlComInput.LKAMfgEnable.Cnt_lgc SrlComInput.LKARequest.Cnt_lgc SrlComInput.MaxSecureVehicleSpeed.Kph_f32 SrlComInput.MinSecureVehicleSpeed.Kph_f32 SrlComInput.PowertrainCrankActive.Cnt_lgc SrlComInput.SPMForCTCInhibit.Cnt_lgc SrlComInput.SWARTrgtAngRequest.HwDeg_f32 SrlComInput.ShiftLeverIsInReverse.Cnt_lgc SrlComInput.SrlComABSActive.Cnt_lgc SrlComInput.SrlComAmbTemp.DegC_f32 SrlComInput.SrlComESCActive.Cnt_lgc SrlComInput.SrlComEngOn.Cnt_lgc SrlComInput.SrlComEngTemp.DegC_f32 SrlComInput.SrlComEngineSpeed.Rpm_f32 SrlComInput.SrlComLWhlSpd.Hz_f32 SrlComInput.SrlComLWhlSpdVld.Cnt_lgc SrlComInput.SrlComLatAccel.g_f32 SrlComInput.SrlComRWhlSpd.Hz_f32 SrlComInput.SrlComRWhlSpdVld.Cnt_lgc SrlComInput.SrlComSPMOn.Cnt_lgc SrlComInput.SrlComSysPwrMd.Cnt_enum SrlComInput.SrlComTCSActive.Cnt_lgc SrlComInput.SrlComTSMitDefeat.Cnt_lgc SrlComInput.SrlComVehSpd.Kph_f32 SrlComInput.SrlComVehicleLonAccel.KphpS_f32 SrlComInput.SrlComYawRate.DegpS_f32 SrlComInput.StrtStopFaultActive.Cnt_lgc SrlComInput.VehicleSpeedValid.Cnt_lgc /end SUB_GROUP
 /begin FUNCTION_LIST /end FUNCTION_LIST
 /begin REF_CHARACTERISTIC /end REF_CHARACTERISTIC
 /begin REF_MEASUREMENT /end REF_MEASUREMENT
/end GROUP
/begin GROUP SrlComInput.ShiftLeverIsInReverse.Cnt_lgc "MICROSAR RTE" /begin SUB_GROUP /end SUB_GROUP /begin FUNCTION_LIST /end FUNCTION_LIST /begin REF_CHARACTERISTIC /end REF_CHARACTERISTIC /begin REF_MEASUREMENT SrlComInput.ShiftLeverIsInReverse.Cnt_lgc /end REF_MEASUREMENT /end GROUP
/begin GROUP SrlComInput.SrlComABSActive.Cnt_lgc "MICROSAR RTE" /begin SUB_GROUP /end SUB_GROUP /begin FUNCTION_LIST /end FUNCTION_LIST /begin REF_CHARACTERISTIC /end REF_CHARACTERISTIC /begin REF_MEASUREMENT SrlComInput.SrlComABSActive.Cnt_lgc /end REF_MEASUREMENT /end GROUP
/begin GROUP SrlComInput.SrlComAmbTemp.DegC_f32 "MICROSAR RTE" /begin SUB_GROUP /end SUB_GROUP /begin FUNCTION_LIST /end FUNCTION_LIST /begin REF_CHARACTERISTIC /end REF_CHARACTERISTIC /begin REF_MEASUREMENT SrlComInput.SrlComAmbTemp.DegC_f32 /end REF_MEASUREMENT /end GROUP
/begin GROUP SrlComInput.SrlComESCActive.Cnt_lgc "MICROSAR RTE" /begin SUB_GROUP /end SUB_GROUP /begin FUNCTION_LIST /end FUNCTION_LIST /begin REF_CHARACTERISTIC /end REF_CHARACTERISTIC /begin REF_MEASUREMENT SrlComInput.SrlComESCActive.Cnt_lgc /end REF_MEASUREMENT /end GROUP
/begin GROUP SrlComInput.SrlComEngOn.Cnt_lgc "MICROSAR RTE" /begin SUB_GROUP /end SUB_GROUP /begin FUNCTION_LIST /end FUNCTION_LIST /begin REF_CHARACTERISTIC /end REF_CHARACTERISTIC /begin REF_MEASUREMENT SrlComInput.SrlComEngOn.Cnt_lgc /end REF_MEASUREMENT /end GROUP
/begin GROUP SrlComInput.SrlComEngTemp.DegC_f32 "MICROSAR RTE" /begin SUB_GROUP /end SUB_GROUP /begin FUNCTION_LIST /end FUNCTION_LIST /begin REF_CHARACTERISTIC /end REF_CHARACTERISTIC /begin REF_MEASUREMENT SrlComInput.SrlComEngTemp.DegC_f32 /end REF_MEASUREMENT /end GROUP
/begin GROUP SrlComInput.SrlComEngineSpeed.Rpm_f32 "MICROSAR RTE" /begin SUB_GROUP /end SUB_GROUP /begin FUNCTION_LIST /end FUNCTION_LIST /begin REF_CHARACTERISTIC /end REF_CHARACTERISTIC /begin REF_MEASUREMENT SrlComInput.SrlComEngineSpeed.Rpm_f32 /end REF_MEASUREMENT /end GROUP
/begin GROUP SrlComInput.SrlComLWhlSpd.Hz_f32 "MICROSAR RTE" /begin SUB_GROUP /end SUB_GROUP /begin FUNCTION_LIST /end FUNCTION_LIST /begin REF_CHARACTERISTIC /end REF_CHARACTERISTIC /begin REF_MEASUREMENT SrlComInput.SrlComLWhlSpd.Hz_f32 /end REF_MEASUREMENT /end GROUP
/begin GROUP SrlComInput.SrlComLWhlSpdVld.Cnt_lgc "MICROSAR RTE" /begin SUB_GROUP /end SUB_GROUP /begin FUNCTION_LIST /end FUNCTION_LIST /begin REF_CHARACTERISTIC /end REF_CHARACTERISTIC /begin REF_MEASUREMENT SrlComInput.SrlComLWhlSpdVld.Cnt_lgc /end REF_MEASUREMENT /end GROUP
/begin GROUP SrlComInput.SrlComLatAccel.g_f32 "MICROSAR RTE" /begin SUB_GROUP /end SUB_GROUP /begin FUNCTION_LIST /end FUNCTION_LIST /begin REF_CHARACTERISTIC /end REF_CHARACTERISTIC /begin REF_MEASUREMENT SrlComInput.SrlComLatAccel.g_f32 /end REF_MEASUREMENT /end GROUP
/begin GROUP SrlComInput.SrlComRWhlSpd.Hz_f32 "MICROSAR RTE" /begin SUB_GROUP /end SUB_GROUP /begin FUNCTION_LIST /end FUNCTION_LIST /begin REF_CHARACTERISTIC /end REF_CHARACTERISTIC /begin REF_MEASUREMENT SrlComInput.SrlComRWhlSpd.Hz_f32 /end REF_MEASUREMENT /end GROUP
/begin GROUP SrlComInput.SrlComRWhlSpdVld.Cnt_lgc "MICROSAR RTE" /begin SUB_GROUP /end SUB_GROUP /begin FUNCTION_LIST /end FUNCTION_LIST /begin REF_CHARACTERISTIC /end REF_CHARACTERISTIC /begin REF_MEASUREMENT SrlComInput.SrlComRWhlSpdVld.Cnt_lgc /end REF_MEASUREMENT /end GROUP
/begin GROUP SrlComInput.SrlComSPMOn.Cnt_lgc "MICROSAR RTE" /begin SUB_GROUP /end SUB_GROUP /begin FUNCTION_LIST /end FUNCTION_LIST /begin REF_CHARACTERISTIC /end REF_CHARACTERISTIC /begin REF_MEASUREMENT SrlComInput.SrlComSPMOn.Cnt_lgc /end REF_MEASUREMENT /end GROUP
/begin GROUP SrlComInput.SrlComSysPwrMd.Cnt_enum "MICROSAR RTE" /begin SUB_GROUP /end SUB_GROUP /begin FUNCTION_LIST /end FUNCTION_LIST /begin REF_CHARACTERISTIC /end REF_CHARACTERISTIC /begin REF_MEASUREMENT SrlComInput.SrlComSysPwrMd.Cnt_enum /end REF_MEASUREMENT /end GROUP
/begin GROUP SrlComInput.SrlComTCSActive.Cnt_lgc "MICROSAR RTE" /begin SUB_GROUP /end SUB_GROUP /begin FUNCTION_LIST /end FUNCTION_LIST /begin REF_CHARACTERISTIC /end REF_CHARACTERISTIC /begin REF_MEASUREMENT SrlComInput.SrlComTCSActive.Cnt_lgc /end REF_MEASUREMENT /end GROUP
/begin GROUP SrlComInput.SrlComTSMitDefeat.Cnt_lgc "MICROSAR RTE" /begin SUB_GROUP /end SUB_GROUP /begin FUNCTION_LIST /end FUNCTION_LIST /begin REF_CHARACTERISTIC /end REF_CHARACTERISTIC /begin REF_MEASUREMENT SrlComInput.SrlComTSMitDefeat.Cnt_lgc /end REF_MEASUREMENT /end GROUP
/begin GROUP SrlComInput.SrlComVehSpd.Kph_f32 "MICROSAR RTE" /begin SUB_GROUP /end SUB_GROUP /begin FUNCTION_LIST /end FUNCTION_LIST /begin REF_CHARACTERISTIC /end REF_CHARACTERISTIC /begin REF_MEASUREMENT SrlComInput.SrlComVehSpd.Kph_f32 /end REF_MEASUREMENT /end GROUP
/begin GROUP SrlComInput.SrlComVehicleLonAccel.KphpS_f32 "MICROSAR RTE" /begin SUB_GROUP /end SUB_GROUP /begin FUNCTION_LIST /end FUNCTION_LIST /begin REF_CHARACTERISTIC /end REF_CHARACTERISTIC /begin REF_MEASUREMENT SrlComInput.SrlComVehicleLonAccel.KphpS_f32 /end REF_MEASUREMENT /end GROUP
/begin GROUP SrlComInput.SrlComYawRate.DegpS_f32 "MICROSAR RTE" /begin SUB_GROUP /end SUB_GROUP /begin FUNCTION_LIST /end FUNCTION_LIST /begin REF_CHARACTERISTIC /end REF_CHARACTERISTIC /begin REF_MEASUREMENT SrlComInput.SrlComYawRate.DegpS_f32 /end REF_MEASUREMENT /end GROUP
/begin GROUP SrlComInput.StrtStopFaultActive.Cnt_lgc "MICROSAR RTE" /begin SUB_GROUP /end SUB_GROUP /begin FUNCTION_LIST /end FUNCTION_LIST /begin REF_CHARACTERISTIC /end REF_CHARACTERISTIC /begin REF_MEASUREMENT SrlComInput.StrtStopFaultActive.Cnt_lgc /end REF_MEASUREMENT /end GROUP
/begin GROUP SrlComInput.SystemState.Mode "MICROSAR RTE" /begin SUB_GROUP /end SUB_GROUP /begin FUNCTION_LIST /end FUNCTION_LIST /begin REF_CHARACTERISTIC /end REF_CHARACTERISTIC /begin REF_MEASUREMENT SrlComInput.SystemState.Mode /end REF_MEASUREMENT /end GROUP
/begin GROUP SrlComInput.VehicleSpeedValid.Cnt_lgc "MICROSAR RTE" /begin SUB_GROUP /end SUB_GROUP /begin FUNCTION_LIST /end FUNCTION_LIST /begin REF_CHARACTERISTIC /end REF_CHARACTERISTIC /begin REF_MEASUREMENT SrlComInput.VehicleSpeedValid.Cnt_lgc /end REF_MEASUREMENT /end GROUP
/begin GROUP SrlComInput.WIREnabled.Cnt_lgc "MICROSAR RTE" /begin SUB_GROUP /end SUB_GROUP /begin FUNCTION_LIST /end FUNCTION_LIST /begin REF_CHARACTERISTIC /end REF_CHARACTERISTIC /begin REF_MEASUREMENT SrlComInput.WIREnabled.Cnt_lgc /end REF_MEASUREMENT /end GROUP
/begin GROUP SrlComOutput "MICROSAR RTE"
 /begin SUB_GROUP SrlComOutput.ModeRequirePorts SrlComOutput.PerInstanceMemories SrlComOutput.ReceiverPorts SrlComOutput.SenderPorts /end SUB_GROUP
 /begin FUNCTION_LIST /end FUNCTION_LIST
 /begin REF_CHARACTERISTIC /end REF_CHARACTERISTIC
 /begin REF_MEASUREMENT /end REF_MEASUREMENT
/end GROUP
/begin GROUP SrlComOutput.APADrvrInterventionDetected.Cnt_lgc "MICROSAR RTE" /begin SUB_GROUP /end SUB_GROUP /begin FUNCTION_LIST /end FUNCTION_LIST /begin REF_CHARACTERISTIC /end REF_CHARACTERISTIC /begin REF_MEASUREMENT SrlComOutput.APADrvrInterventionDetected.Cnt_lgc /end REF_MEASUREMENT /end GROUP
/begin GROUP SrlComOutput.APAState.State_enum "MICROSAR RTE" /begin SUB_GROUP /end SUB_GROUP /begin FUNCTION_LIST /end FUNCTION_LIST /begin REF_CHARACTERISTIC /end REF_CHARACTERISTIC /begin REF_MEASUREMENT SrlComOutput.APAState.State_enum /end REF_MEASUREMENT /end GROUP
/begin GROUP SrlComOutput.BusOffCE.Cnt_lgc "MICROSAR RTE" /begin SUB_GROUP /end SUB_GROUP /begin FUNCTION_LIST /end FUNCTION_LIST /begin REF_CHARACTERISTIC /end REF_CHARACTERISTIC /begin REF_MEASUREMENT SrlComOutput.BusOffCE.Cnt_lgc /end REF_MEASUREMENT /end GROUP
/begin GROUP SrlComOutput.BusOffHS.Cnt_lgc "MICROSAR RTE" /begin SUB_GROUP /end SUB_GROUP /begin FUNCTION_LIST /end FUNCTION_LIST /begin REF_CHARACTERISTIC /end REF_CHARACTERISTIC /begin REF_MEASUREMENT SrlComOutput.BusOffHS.Cnt_lgc /end REF_MEASUREMENT /end GROUP
/begin GROUP SrlComOutput.DTCTrigSts "MICROSAR RTE" /begin SUB_GROUP /end SUB_GROUP /begin FUNCTION_LIST /end FUNCTION_LIST /begin REF_CHARACTERISTIC /end REF_CHARACTERISTIC /begin REF_MEASUREMENT SrlComOutput.DTCTrigSts /end REF_MEASUREMENT /end GROUP
/begin GROUP SrlComOutput.DiagRmpToZeroActive.Cnt_lgc "MICROSAR RTE" /begin SUB_GROUP /end SUB_GROUP /begin FUNCTION_LIST /end FUNCTION_LIST /begin REF_CHARACTERISTIC /end REF_CHARACTERISTIC /begin REF_MEASUREMENT SrlComOutput.DiagRmpToZeroActive.Cnt_lgc /end REF_MEASUREMENT /end GROUP
/begin GROUP SrlComOutput.DiagStsHwPosDis.Cnt_lgc "MICROSAR RTE" /begin SUB_GROUP /end SUB_GROUP /begin FUNCTION_LIST /end FUNCTION_LIST /begin REF_CHARACTERISTIC /end REF_CHARACTERISTIC /begin REF_MEASUREMENT SrlComOutput.DiagStsHwPosDis.Cnt_lgc /end REF_MEASUREMENT /end GROUP
/begin GROUP SrlComOutput.ESCState.State_enum "MICROSAR RTE" /begin SUB_GROUP /end SUB_GROUP /begin FUNCTION_LIST /end FUNCTION_LIST /begin REF_CHARACTERISTIC /end REF_CHARACTERISTIC /begin REF_MEASUREMENT SrlComOutput.ESCState.State_enum /end REF_MEASUREMENT /end GROUP
/begin GROUP SrlComOutput.ESCTorqueDelivered.HwNm_f32 "MICROSAR RTE" /begin SUB_GROUP /end SUB_GROUP /begin FUNCTION_LIST /end FUNCTION_LIST /begin REF_CHARACTERISTIC /end REF_CHARACTERISTIC /begin REF_MEASUREMENT SrlComOutput.ESCTorqueDelivered.HwNm_f32 /end REF_MEASUREMENT /end GROUP
/begin GROUP SrlComOutput.HOWEstimate.Uls_f32 "MICROSAR RTE" /begin SUB_GROUP /end SUB_GROUP /begin FUNCTION_LIST /end FUNCTION_LIST /begin REF_CHARACTERISTIC /end REF_CHARACTERISTIC /begin REF_MEASUREMENT SrlComOutput.HOWEstimate.Uls_f32 /end REF_MEASUREMENT /end GROUP
/begin GROUP SrlComOutput.HandwheelVel.HwRadpS_f32 "MICROSAR RTE" /begin SUB_GROUP /end SUB_GROUP /begin FUNCTION_LIST /end FUNCTION_LIST /begin REF_CHARACTERISTIC /end REF_CHARACTERISTIC /begin REF_MEASUREMENT SrlComOutput.HandwheelVel.HwRadpS_f32 /end REF_MEASUREMENT /end GROUP
/begin GROUP SrlComOutput.HwTrq.HwNm_f32 "MICROSAR RTE" /begin SUB_GROUP /end SUB_GROUP /begin FUNCTION_LIST /end FUNCTION_LIST /begin REF_CHARACTERISTIC /end REF_CHARACTERISTIC /begin REF_MEASUREMENT SrlComOutput.HwTrq.HwNm_f32 /end REF_MEASUREMENT /end GROUP
/begin GROUP SrlComOutput.HwVelValid.Cnt_lgc "MICROSAR RTE" /begin SUB_GROUP /end SUB_GROUP /begin FUNCTION_LIST /end FUNCTION_LIST /begin REF_CHARACTERISTIC /end REF_CHARACTERISTIC /begin REF_MEASUREMENT SrlComOutput.HwVelValid.Cnt_lgc /end REF_MEASUREMENT /end GROUP
/begin GROUP SrlComOutput.LKAState.State_enum "MICROSAR RTE" /begin SUB_GROUP /end SUB_GROUP /begin FUNCTION_LIST /end FUNCTION_LIST /begin REF_CHARACTERISTIC /end REF_CHARACTERISTIC /begin REF_MEASUREMENT SrlComOutput.LKAState.State_enum /end REF_MEASUREMENT /end GROUP
/begin GROUP SrlComOutput.LKATrqDelivered.HwNm_f32 "MICROSAR RTE" /begin SUB_GROUP /end SUB_GROUP /begin FUNCTION_LIST /end FUNCTION_LIST /begin REF_CHARACTERISTIC /end REF_CHARACTERISTIC /begin REF_MEASUREMENT SrlComOutput.LKATrqDelivered.HwNm_f32 /end REF_MEASUREMENT /end GROUP
/begin GROUP SrlComOutput.ModeRequirePorts "MICROSAR RTE" /begin SUB_GROUP SrlComOutput.SystemState.Mode /end SUB_GROUP /begin FUNCTION_LIST /end FUNCTION_LIST /begin REF_CHARACTERISTIC /end REF_CHARACTERISTIC /begin REF_MEASUREMENT /end REF_MEASUREMENT /end GROUP
/begin GROUP SrlComOutput.PerInstanceMemories "MICROSAR RTE" /begin SUB_GROUP SrlComOutput.DTCTrigSts /end SUB_GROUP /begin FUNCTION_LIST /end FUNCTION_LIST /begin REF_CHARACTERISTIC /end REF_CHARACTERISTIC /begin REF_MEASUREMENT /end REF_MEASUREMENT /end GROUP
/begin GROUP SrlComOutput.ReceiverPorts "MICROSAR RTE"
 /begin SUB_GROUP SrlComOutput.APADrvrInterventionDetected.Cnt_lgc SrlComOutput.APAState.State_enum SrlComOutput.DiagRmpToZeroActive.Cnt_lgc SrlComOutput.DiagStsHwPosDis.Cnt_lgc SrlComOutput.ESCState.State_enum SrlComOutput.ESCTorqueDelivered.HwNm_f32 SrlComOutput.HOWEstimate.Uls_f32 SrlComOutput.HandwheelVel.HwRadpS_f32 SrlComOutput.HwTrq.HwNm_f32 SrlComOutput.HwVelValid.Cnt_lgc SrlComOutput.LKAState.State_enum SrlComOutput.LKATrqDelivered.HwNm_f32 SrlComOutput.SrlComHwPos.HwDeg_f32 SrlComOutput.SrlComSysPwrMd.Cnt_enum SrlComOutput.TrimCompEOL.Cnt_lgc /end SUB_GROUP
 /begin FUNCTION_LIST /end FUNCTION_LIST
 /begin REF_CHARACTERISTIC /end REF_CHARACTERISTIC
 /begin REF_MEASUREMENT /end REF_MEASUREMENT
/end GROUP
/begin GROUP SrlComOutput.SenderPorts "MICROSAR RTE"
 /begin SUB_GROUP SrlComOutput.BusOffCE.Cnt_lgc SrlComOutput.BusOffHS.Cnt_lgc /end SUB_GROUP
 /begin FUNCTION_LIST /end FUNCTION_LIST
 /begin REF_CHARACTERISTIC /end REF_CHARACTERISTIC
 /begin REF_MEASUREMENT /end REF_MEASUREMENT
/end GROUP
/begin GROUP SrlComOutput.SrlComHwPos.HwDeg_f32 "MICROSAR RTE" /begin SUB_GROUP /end SUB_GROUP /begin FUNCTION_LIST /end FUNCTION_LIST /begin REF_CHARACTERISTIC /end REF_CHARACTERISTIC /begin REF_MEASUREMENT SrlComOutput.SrlComHwPos.HwDeg_f32 /end REF_MEASUREMENT /end GROUP
/begin GROUP SrlComOutput.SrlComSysPwrMd.Cnt_enum "MICROSAR RTE" /begin SUB_GROUP /end SUB_GROUP /begin FUNCTION_LIST /end FUNCTION_LIST /begin REF_CHARACTERISTIC /end REF_CHARACTERISTIC /begin REF_MEASUREMENT SrlComOutput.SrlComSysPwrMd.Cnt_enum /end REF_MEASUREMENT /end GROUP
/begin GROUP SrlComOutput.SystemState.Mode "MICROSAR RTE" /begin SUB_GROUP /end SUB_GROUP /begin FUNCTION_LIST /end FUNCTION_LIST /begin REF_CHARACTERISTIC /end REF_CHARACTERISTIC /begin REF_MEASUREMENT SrlComOutput.SystemState.Mode /end REF_MEASUREMENT /end GROUP
/begin GROUP SrlComOutput.TrimCompEOL.Cnt_lgc "MICROSAR RTE" /begin SUB_GROUP /end SUB_GROUP /begin FUNCTION_LIST /end FUNCTION_LIST /begin REF_CHARACTERISTIC /end REF_CHARACTERISTIC /begin REF_MEASUREMENT SrlComOutput.TrimCompEOL.Cnt_lgc /end REF_MEASUREMENT /end GROUP
/begin GROUP StOpCtrl "MICROSAR RTE" /begin SUB_GROUP StOpCtrl.ReceiverPorts StOpCtrl.SenderPorts /end SUB_GROUP /begin FUNCTION_LIST /end FUNCTION_LIST /begin REF_CHARACTERISTIC /end REF_CHARACTERISTIC /begin REF_MEASUREMENT /end REF_MEASUREMENT /end GROUP
/begin GROUP StOpCtrl.DiagRampRate.XpmS_f32 "MICROSAR RTE" /begin SUB_GROUP /end SUB_GROUP /begin FUNCTION_LIST /end FUNCTION_LIST /begin REF_CHARACTERISTIC /end REF_CHARACTERISTIC /begin REF_MEASUREMENT StOpCtrl.DiagRampRate.XpmS_f32 /end REF_MEASUREMENT /end GROUP
/begin GROUP StOpCtrl.DiagRampValue.Uls_f32 "MICROSAR RTE" /begin SUB_GROUP /end SUB_GROUP /begin FUNCTION_LIST /end FUNCTION_LIST /begin REF_CHARACTERISTIC /end REF_CHARACTERISTIC /begin REF_MEASUREMENT StOpCtrl.DiagRampValue.Uls_f32 /end REF_MEASUREMENT /end GROUP
/begin GROUP StOpCtrl.DiagStsDiagRmpActive.Cnt_lgc "MICROSAR RTE" /begin SUB_GROUP /end SUB_GROUP /begin FUNCTION_LIST /end FUNCTION_LIST /begin REF_CHARACTERISTIC /end REF_CHARACTERISTIC /begin REF_MEASUREMENT StOpCtrl.DiagStsDiagRmpActive.Cnt_lgc /end REF_MEASUREMENT /end GROUP
/begin GROUP StOpCtrl.LoaRateLimit.UlspS_f32 "MICROSAR RTE" /begin SUB_GROUP /end SUB_GROUP /begin FUNCTION_LIST /end FUNCTION_LIST /begin REF_CHARACTERISTIC /end REF_CHARACTERISTIC /begin REF_MEASUREMENT StOpCtrl.LoaRateLimit.UlspS_f32 /end REF_MEASUREMENT /end GROUP
/begin GROUP StOpCtrl.LoaScaleFctr.Uls_f32 "MICROSAR RTE" /begin SUB_GROUP /end SUB_GROUP /begin FUNCTION_LIST /end FUNCTION_LIST /begin REF_CHARACTERISTIC /end REF_CHARACTERISTIC /begin REF_MEASUREMENT StOpCtrl.LoaScaleFctr.Uls_f32 /end REF_MEASUREMENT /end GROUP
/begin GROUP StOpCtrl.OperRampRate.XpmS_f32 "MICROSAR RTE" /begin SUB_GROUP /end SUB_GROUP /begin FUNCTION_LIST /end FUNCTION_LIST /begin REF_CHARACTERISTIC /end REF_CHARACTERISTIC /begin REF_MEASUREMENT StOpCtrl.OperRampRate.XpmS_f32 /end REF_MEASUREMENT /end GROUP
/begin GROUP StOpCtrl.OperRampValue.Uls_f32 "MICROSAR RTE" /begin SUB_GROUP /end SUB_GROUP /begin FUNCTION_LIST /end FUNCTION_LIST /begin REF_CHARACTERISTIC /end REF_CHARACTERISTIC /begin REF_MEASUREMENT StOpCtrl.OperRampValue.Uls_f32 /end REF_MEASUREMENT /end GROUP
/begin GROUP StOpCtrl.OutputRampMult.Uls_f32 "MICROSAR RTE" /begin SUB_GROUP /end SUB_GROUP /begin FUNCTION_LIST /end FUNCTION_LIST /begin REF_CHARACTERISTIC /end REF_CHARACTERISTIC /begin REF_MEASUREMENT StOpCtrl.OutputRampMult.Uls_f32 /end REF_MEASUREMENT /end GROUP
/begin GROUP StOpCtrl.RampSrlComSvcDft.Cnt_lgc "MICROSAR RTE" /begin SUB_GROUP /end SUB_GROUP /begin FUNCTION_LIST /end FUNCTION_LIST /begin REF_CHARACTERISTIC /end REF_CHARACTERISTIC /begin REF_MEASUREMENT StOpCtrl.RampSrlComSvcDft.Cnt_lgc /end REF_MEASUREMENT /end GROUP
/begin GROUP StOpCtrl.ReceiverPorts "MICROSAR RTE"
 /begin SUB_GROUP StOpCtrl.DiagRampRate.XpmS_f32 StOpCtrl.DiagRampValue.Uls_f32 StOpCtrl.DiagStsDiagRmpActive.Cnt_lgc StOpCtrl.LoaRateLimit.UlspS_f32 StOpCtrl.LoaScaleFctr.Uls_f32 StOpCtrl.OperRampRate.XpmS_f32 StOpCtrl.OperRampValue.Uls_f32 StOpCtrl.RampSrlComSvcDft.Cnt_lgc StOpCtrl.StrtStopRateLimit.UlspS_f32 StOpCtrl.StrtStopScaleFctr.Uls_f32 /end SUB_GROUP
 /begin FUNCTION_LIST /end FUNCTION_LIST
 /begin REF_CHARACTERISTIC /end REF_CHARACTERISTIC
 /begin REF_MEASUREMENT /end REF_MEASUREMENT
/end GROUP
/begin GROUP StOpCtrl.SenderPorts "MICROSAR RTE"
 /begin SUB_GROUP StOpCtrl.OutputRampMult.Uls_f32 StOpCtrl.SysStReqDi.Cnt_lgc /end SUB_GROUP
 /begin FUNCTION_LIST /end FUNCTION_LIST
 /begin REF_CHARACTERISTIC /end REF_CHARACTERISTIC
 /begin REF_MEASUREMENT /end REF_MEASUREMENT
/end GROUP
/begin GROUP StOpCtrl.StrtStopRateLimit.UlspS_f32 "MICROSAR RTE" /begin SUB_GROUP /end SUB_GROUP /begin FUNCTION_LIST /end FUNCTION_LIST /begin REF_CHARACTERISTIC /end REF_CHARACTERISTIC /begin REF_MEASUREMENT StOpCtrl.StrtStopRateLimit.UlspS_f32 /end REF_MEASUREMENT /end GROUP
/begin GROUP StOpCtrl.StrtStopScaleFctr.Uls_f32 "MICROSAR RTE" /begin SUB_GROUP /end SUB_GROUP /begin FUNCTION_LIST /end FUNCTION_LIST /begin REF_CHARACTERISTIC /end REF_CHARACTERISTIC /begin REF_MEASUREMENT StOpCtrl.StrtStopScaleFctr.Uls_f32 /end REF_MEASUREMENT /end GROUP
/begin GROUP StOpCtrl.SysStReqDi.Cnt_lgc "MICROSAR RTE" /begin SUB_GROUP /end SUB_GROUP /begin FUNCTION_LIST /end FUNCTION_LIST /begin REF_CHARACTERISTIC /end REF_CHARACTERISTIC /begin REF_MEASUREMENT StOpCtrl.SysStReqDi.Cnt_lgc /end REF_MEASUREMENT /end GROUP
/begin GROUP StaMd "MICROSAR RTE"
 /begin SUB_GROUP StaMd.ModeProvidePorts StaMd.ModeRequirePorts StaMd.ReceiverPorts /end SUB_GROUP
 /begin FUNCTION_LIST /end FUNCTION_LIST
 /begin REF_CHARACTERISTIC /end REF_CHARACTERISTIC
 /begin REF_MEASUREMENT /end REF_MEASUREMENT
/end GROUP
/begin GROUP StaMd.ATerm.Cnt_lgc "MICROSAR RTE" /begin SUB_GROUP /end SUB_GROUP /begin FUNCTION_LIST /end FUNCTION_LIST /begin REF_CHARACTERISTIC /end REF_CHARACTERISTIC /begin REF_MEASUREMENT StaMd.ATerm.Cnt_lgc /end REF_MEASUREMENT /end GROUP
/begin GROUP StaMd.CTerm.Cnt_lgc "MICROSAR RTE" /begin SUB_GROUP /end SUB_GROUP /begin FUNCTION_LIST /end FUNCTION_LIST /begin REF_CHARACTERISTIC /end REF_CHARACTERISTIC /begin REF_MEASUREMENT StaMd.CTerm.Cnt_lgc /end REF_MEASUREMENT /end GROUP
/begin GROUP StaMd.ControlledDampStatusComplete.Cnt_lgc "MICROSAR RTE" /begin SUB_GROUP /end SUB_GROUP /begin FUNCTION_LIST /end FUNCTION_LIST /begin REF_CHARACTERISTIC /end REF_CHARACTERISTIC /begin REF_MEASUREMENT StaMd.ControlledDampStatusComplete.Cnt_lgc /end REF_MEASUREMENT /end GROUP
/begin GROUP StaMd.CurrentSystemState.Mode "MICROSAR RTE" /begin SUB_GROUP /end SUB_GROUP /begin FUNCTION_LIST /end FUNCTION_LIST /begin REF_CHARACTERISTIC /end REF_CHARACTERISTIC /begin REF_MEASUREMENT StaMd.CurrentSystemState.Mode /end REF_MEASUREMENT /end GROUP
/begin GROUP StaMd.FTerm.Cnt_lgc "MICROSAR RTE" /begin SUB_GROUP /end SUB_GROUP /begin FUNCTION_LIST /end FUNCTION_LIST /begin REF_CHARACTERISTIC /end REF_CHARACTERISTIC /begin REF_MEASUREMENT StaMd.FTerm.Cnt_lgc /end REF_MEASUREMENT /end GROUP
/begin GROUP StaMd.ModeProvidePorts "MICROSAR RTE" /begin SUB_GROUP StaMd.SystemState.Mode /end SUB_GROUP /begin FUNCTION_LIST /end FUNCTION_LIST /begin REF_CHARACTERISTIC /end REF_CHARACTERISTIC /begin REF_MEASUREMENT /end REF_MEASUREMENT /end GROUP
/begin GROUP StaMd.ModeRequirePorts "MICROSAR RTE" /begin SUB_GROUP StaMd.CurrentSystemState.Mode /end SUB_GROUP /begin FUNCTION_LIST /end FUNCTION_LIST /begin REF_CHARACTERISTIC /end REF_CHARACTERISTIC /begin REF_MEASUREMENT /end REF_MEASUREMENT /end GROUP
/begin GROUP StaMd.RampStatusComplete.Cnt_lgc "MICROSAR RTE" /begin SUB_GROUP /end SUB_GROUP /begin FUNCTION_LIST /end FUNCTION_LIST /begin REF_CHARACTERISTIC /end REF_CHARACTERISTIC /begin REF_MEASUREMENT StaMd.RampStatusComplete.Cnt_lgc /end REF_MEASUREMENT /end GROUP
/begin GROUP StaMd.ReceiverPorts "MICROSAR RTE"
 /begin SUB_GROUP StaMd.ATerm.Cnt_lgc StaMd.CTerm.Cnt_lgc StaMd.ControlledDampStatusComplete.Cnt_lgc StaMd.FTerm.Cnt_lgc StaMd.RampStatusComplete.Cnt_lgc StaMd.TMFTestComplete.Cnt_lgc /end SUB_GROUP
 /begin FUNCTION_LIST /end FUNCTION_LIST
 /begin REF_CHARACTERISTIC /end REF_CHARACTERISTIC
 /begin REF_MEASUREMENT /end REF_MEASUREMENT
/end GROUP
/begin GROUP StaMd.SystemState.Mode "MICROSAR RTE" /begin SUB_GROUP /end SUB_GROUP /begin FUNCTION_LIST /end FUNCTION_LIST /begin REF_CHARACTERISTIC /end REF_CHARACTERISTIC /begin REF_MEASUREMENT StaMd.SystemState.Mode /end REF_MEASUREMENT /end GROUP
/begin GROUP StaMd.TMFTestComplete.Cnt_lgc "MICROSAR RTE" /begin SUB_GROUP /end SUB_GROUP /begin FUNCTION_LIST /end FUNCTION_LIST /begin REF_CHARACTERISTIC /end REF_CHARACTERISTIC /begin REF_MEASUREMENT StaMd.TMFTestComplete.Cnt_lgc /end REF_MEASUREMENT /end GROUP
/begin GROUP StabilityComp "MICROSAR RTE" /begin SUB_GROUP StabilityComp.ReceiverPorts StabilityComp.SenderPorts /end SUB_GROUP /begin FUNCTION_LIST /end FUNCTION_LIST /begin REF_CHARACTERISTIC /end REF_CHARACTERISTIC /begin REF_MEASUREMENT /end REF_MEASUREMENT /end GROUP
/begin GROUP StabilityComp.AssistCmd.MtrNm_f32 "MICROSAR RTE" /begin SUB_GROUP /end SUB_GROUP /begin FUNCTION_LIST /end FUNCTION_LIST /begin REF_CHARACTERISTIC /end REF_CHARACTERISTIC /begin REF_MEASUREMENT StabilityComp.AssistCmd.MtrNm_f32 /end REF_MEASUREMENT /end GROUP
/begin GROUP StabilityComp.AssistDDFactor.Uls_f32 "MICROSAR RTE" /begin SUB_GROUP /end SUB_GROUP /begin FUNCTION_LIST /end FUNCTION_LIST /begin REF_CHARACTERISTIC /end REF_CHARACTERISTIC /begin REF_MEASUREMENT StabilityComp.AssistDDFactor.Uls_f32 /end REF_MEASUREMENT /end GROUP
/begin GROUP StabilityComp.AsstFWActive.Uls_f32 "MICROSAR RTE" /begin SUB_GROUP /end SUB_GROUP /begin FUNCTION_LIST /end FUNCTION_LIST /begin REF_CHARACTERISTIC /end REF_CHARACTERISTIC /begin REF_MEASUREMENT StabilityComp.AsstFWActive.Uls_f32 /end REF_MEASUREMENT /end GROUP
/begin GROUP StabilityComp.CombinedAssist.MtrNm_f32 "MICROSAR RTE" /begin SUB_GROUP /end SUB_GROUP /begin FUNCTION_LIST /end FUNCTION_LIST /begin REF_CHARACTERISTIC /end REF_CHARACTERISTIC /begin REF_MEASUREMENT StabilityComp.CombinedAssist.MtrNm_f32 /end REF_MEASUREMENT /end GROUP
/begin GROUP StabilityComp.HwTorque.HwNm_f32 "MICROSAR RTE" /begin SUB_GROUP /end SUB_GROUP /begin FUNCTION_LIST /end FUNCTION_LIST /begin REF_CHARACTERISTIC /end REF_CHARACTERISTIC /begin REF_MEASUREMENT StabilityComp.HwTorque.HwNm_f32 /end REF_MEASUREMENT /end GROUP
/begin GROUP StabilityComp.ReceiverPorts "MICROSAR RTE"
 /begin SUB_GROUP StabilityComp.AssistDDFactor.Uls_f32 StabilityComp.AsstFWActive.Uls_f32 StabilityComp.CombinedAssist.MtrNm_f32 StabilityComp.HwTorque.HwNm_f32 StabilityComp.SysAssistCmd_MtrNm.MtrNm_f32 StabilityComp.VehicleSpeed.Kph_f32 /end SUB_GROUP
 /begin FUNCTION_LIST /end FUNCTION_LIST
 /begin REF_CHARACTERISTIC /end REF_CHARACTERISTIC
 /begin REF_MEASUREMENT /end REF_MEASUREMENT
/end GROUP
/begin GROUP StabilityComp.SenderPorts "MICROSAR RTE" /begin SUB_GROUP StabilityComp.AssistCmd.MtrNm_f32 /end SUB_GROUP /begin FUNCTION_LIST /end FUNCTION_LIST /begin REF_CHARACTERISTIC /end REF_CHARACTERISTIC /begin REF_MEASUREMENT /end REF_MEASUREMENT /end GROUP
/begin GROUP StabilityComp.SysAssistCmd_MtrNm.MtrNm_f32 "MICROSAR RTE" /begin SUB_GROUP /end SUB_GROUP /begin FUNCTION_LIST /end FUNCTION_LIST /begin REF_CHARACTERISTIC /end REF_CHARACTERISTIC /begin REF_MEASUREMENT StabilityComp.SysAssistCmd_MtrNm.MtrNm_f32 /end REF_MEASUREMENT /end GROUP
/begin GROUP StabilityComp.VehicleSpeed.Kph_f32 "MICROSAR RTE" /begin SUB_GROUP /end SUB_GROUP /begin FUNCTION_LIST /end FUNCTION_LIST /begin REF_CHARACTERISTIC /end REF_CHARACTERISTIC /begin REF_MEASUREMENT StabilityComp.VehicleSpeed.Kph_f32 /end REF_MEASUREMENT /end GROUP
/begin GROUP TmprlMon "MICROSAR RTE"
 /begin SUB_GROUP TmprlMon.ModeRequirePorts TmprlMon.ReceiverPorts TmprlMon.SenderPorts /end SUB_GROUP
 /begin FUNCTION_LIST /end FUNCTION_LIST
 /begin REF_CHARACTERISTIC /end REF_CHARACTERISTIC
 /begin REF_MEASUREMENT /end REF_MEASUREMENT
/end GROUP
/begin GROUP TmprlMon.ModeRequirePorts "MICROSAR RTE" /begin SUB_GROUP TmprlMon.SystemState.Mode /end SUB_GROUP /begin FUNCTION_LIST /end FUNCTION_LIST /begin REF_CHARACTERISTIC /end REF_CHARACTERISTIC /begin REF_MEASUREMENT /end REF_MEASUREMENT /end GROUP
/begin GROUP TmprlMon.ReceiverPorts "MICROSAR RTE" /begin SUB_GROUP TmprlMon.TMFTestStart.Cnt_lgc /end SUB_GROUP /begin FUNCTION_LIST /end FUNCTION_LIST /begin REF_CHARACTERISTIC /end REF_CHARACTERISTIC /begin REF_MEASUREMENT /end REF_MEASUREMENT /end GROUP
/begin GROUP TmprlMon.SenderPorts "MICROSAR RTE" /begin SUB_GROUP TmprlMon.TMFTestComplete.Cnt_lgc /end SUB_GROUP /begin FUNCTION_LIST /end FUNCTION_LIST /begin REF_CHARACTERISTIC /end REF_CHARACTERISTIC /begin REF_MEASUREMENT /end REF_MEASUREMENT /end GROUP
/begin GROUP TmprlMon.SystemState.Mode "MICROSAR RTE" /begin SUB_GROUP /end SUB_GROUP /begin FUNCTION_LIST /end FUNCTION_LIST /begin REF_CHARACTERISTIC /end REF_CHARACTERISTIC /begin REF_MEASUREMENT TmprlMon.SystemState.Mode /end REF_MEASUREMENT /end GROUP
/begin GROUP TmprlMon.TMFTestComplete.Cnt_lgc "MICROSAR RTE" /begin SUB_GROUP /end SUB_GROUP /begin FUNCTION_LIST /end FUNCTION_LIST /begin REF_CHARACTERISTIC /end REF_CHARACTERISTIC /begin REF_MEASUREMENT TmprlMon.TMFTestComplete.Cnt_lgc /end REF_MEASUREMENT /end GROUP
/begin GROUP TmprlMon.TMFTestStart.Cnt_lgc "MICROSAR RTE" /begin SUB_GROUP /end SUB_GROUP /begin FUNCTION_LIST /end FUNCTION_LIST /begin REF_CHARACTERISTIC /end REF_CHARACTERISTIC /begin REF_MEASUREMENT TmprlMon.TMFTestStart.Cnt_lgc /end REF_MEASUREMENT /end GROUP
/begin GROUP TrqCmdScl "MICROSAR RTE"
 /begin SUB_GROUP TrqCmdScl.PerInstanceMemories TrqCmdScl.ReceiverPorts TrqCmdScl.SenderPorts /end SUB_GROUP
 /begin FUNCTION_LIST /end FUNCTION_LIST
 /begin REF_CHARACTERISTIC /end REF_CHARACTERISTIC
 /begin REF_MEASUREMENT /end REF_MEASUREMENT
/end GROUP
/begin GROUP TrqCmdScl.MRFMtrTrqCmd.MtrNm_f32 "MICROSAR RTE" /begin SUB_GROUP /end SUB_GROUP /begin FUNCTION_LIST /end FUNCTION_LIST /begin REF_CHARACTERISTIC /end REF_CHARACTERISTIC /begin REF_MEASUREMENT TrqCmdScl.MRFMtrTrqCmd.MtrNm_f32 /end REF_MEASUREMENT /end GROUP
/begin GROUP TrqCmdScl.MRFMtrTrqCmdScl.MtrNm_f32 "MICROSAR RTE" /begin SUB_GROUP /end SUB_GROUP /begin FUNCTION_LIST /end FUNCTION_LIST /begin REF_CHARACTERISTIC /end REF_CHARACTERISTIC /begin REF_MEASUREMENT TrqCmdScl.MRFMtrTrqCmdScl.MtrNm_f32 /end REF_MEASUREMENT /end GROUP
/begin GROUP TrqCmdScl.PerInstanceMemories "MICROSAR RTE" /begin SUB_GROUP TrqCmdScl.TorqueCmdSF_Uls_f32 /end SUB_GROUP /begin FUNCTION_LIST /end FUNCTION_LIST /begin REF_CHARACTERISTIC /end REF_CHARACTERISTIC /begin REF_MEASUREMENT /end REF_MEASUREMENT /end GROUP
/begin GROUP TrqCmdScl.ReceiverPorts "MICROSAR RTE" /begin SUB_GROUP TrqCmdScl.MRFMtrTrqCmd.MtrNm_f32 /end SUB_GROUP /begin FUNCTION_LIST /end FUNCTION_LIST /begin REF_CHARACTERISTIC /end REF_CHARACTERISTIC /begin REF_MEASUREMENT /end REF_MEASUREMENT /end GROUP
/begin GROUP TrqCmdScl.SenderPorts "MICROSAR RTE" /begin SUB_GROUP TrqCmdScl.MRFMtrTrqCmdScl.MtrNm_f32 /end SUB_GROUP /begin FUNCTION_LIST /end FUNCTION_LIST /begin REF_CHARACTERISTIC /end REF_CHARACTERISTIC /begin REF_MEASUREMENT /end REF_MEASUREMENT /end GROUP
/begin GROUP TrqCmdScl.TorqueCmdSF_Uls_f32 "MICROSAR RTE" /begin SUB_GROUP /end SUB_GROUP /begin FUNCTION_LIST /end FUNCTION_LIST /begin REF_CHARACTERISTIC /end REF_CHARACTERISTIC /begin REF_MEASUREMENT TrqCmdScl.TorqueCmdSF_Uls_f32 /end REF_MEASUREMENT /end GROUP
/begin GROUP TrqOvlSta "MICROSAR RTE"
 /begin SUB_GROUP TrqOvlSta.ModeRequirePorts TrqOvlSta.ReceiverPorts TrqOvlSta.SenderPorts /end SUB_GROUP
 /begin FUNCTION_LIST /end FUNCTION_LIST
 /begin REF_CHARACTERISTIC /end REF_CHARACTERISTIC
 /begin REF_MEASUREMENT /end REF_MEASUREMENT
/end GROUP
/begin GROUP TrqOvlSta.APADrvrInterventionDetected.Cnt_lgc "MICROSAR RTE" /begin SUB_GROUP /end SUB_GROUP /begin FUNCTION_LIST /end FUNCTION_LIST /begin REF_CHARACTERISTIC /end REF_CHARACTERISTIC /begin REF_MEASUREMENT TrqOvlSta.APADrvrInterventionDetected.Cnt_lgc /end REF_MEASUREMENT /end GROUP
/begin GROUP TrqOvlSta.APANonRecoverableFaults.Cnt_lgc "MICROSAR RTE" /begin SUB_GROUP /end SUB_GROUP /begin FUNCTION_LIST /end FUNCTION_LIST /begin REF_CHARACTERISTIC /end REF_CHARACTERISTIC /begin REF_MEASUREMENT TrqOvlSta.APANonRecoverableFaults.Cnt_lgc /end REF_MEASUREMENT /end GROUP
/begin GROUP TrqOvlSta.APARecoverableFaults.Cnt_lgc "MICROSAR RTE" /begin SUB_GROUP /end SUB_GROUP /begin FUNCTION_LIST /end FUNCTION_LIST /begin REF_CHARACTERISTIC /end REF_CHARACTERISTIC /begin REF_MEASUREMENT TrqOvlSta.APARecoverableFaults.Cnt_lgc /end REF_MEASUREMENT /end GROUP
/begin GROUP TrqOvlSta.APARequest.Cnt_lgc "MICROSAR RTE" /begin SUB_GROUP /end SUB_GROUP /begin FUNCTION_LIST /end FUNCTION_LIST /begin REF_CHARACTERISTIC /end REF_CHARACTERISTIC /begin REF_MEASUREMENT TrqOvlSta.APARequest.Cnt_lgc /end REF_MEASUREMENT /end GROUP
/begin GROUP TrqOvlSta.APAState.State_enum "MICROSAR RTE" /begin SUB_GROUP /end SUB_GROUP /begin FUNCTION_LIST /end FUNCTION_LIST /begin REF_CHARACTERISTIC /end REF_CHARACTERISTIC /begin REF_MEASUREMENT TrqOvlSta.APAState.State_enum /end REF_MEASUREMENT /end GROUP
/begin GROUP TrqOvlSta.CCWPosition.HwDeg_f32 "MICROSAR RTE" /begin SUB_GROUP /end SUB_GROUP /begin FUNCTION_LIST /end FUNCTION_LIST /begin REF_CHARACTERISTIC /end REF_CHARACTERISTIC /begin REF_MEASUREMENT TrqOvlSta.CCWPosition.HwDeg_f32 /end REF_MEASUREMENT /end GROUP
/begin GROUP TrqOvlSta.CWPosition.HwDeg_f32 "MICROSAR RTE" /begin SUB_GROUP /end SUB_GROUP /begin FUNCTION_LIST /end FUNCTION_LIST /begin REF_CHARACTERISTIC /end REF_CHARACTERISTIC /begin REF_MEASUREMENT TrqOvlSta.CWPosition.HwDeg_f32 /end REF_MEASUREMENT /end GROUP
/begin GROUP TrqOvlSta.ESCFault.Cnt_lgc "MICROSAR RTE" /begin SUB_GROUP /end SUB_GROUP /begin FUNCTION_LIST /end FUNCTION_LIST /begin REF_CHARACTERISTIC /end REF_CHARACTERISTIC /begin REF_MEASUREMENT TrqOvlSta.ESCFault.Cnt_lgc /end REF_MEASUREMENT /end GROUP
/begin GROUP TrqOvlSta.ESCIsLimited.Cnt_lgc "MICROSAR RTE" /begin SUB_GROUP /end SUB_GROUP /begin FUNCTION_LIST /end FUNCTION_LIST /begin REF_CHARACTERISTIC /end REF_CHARACTERISTIC /begin REF_MEASUREMENT TrqOvlSta.ESCIsLimited.Cnt_lgc /end REF_MEASUREMENT /end GROUP
/begin GROUP TrqOvlSta.ESCRequest.Cnt_lgc "MICROSAR RTE" /begin SUB_GROUP /end SUB_GROUP /begin FUNCTION_LIST /end FUNCTION_LIST /begin REF_CHARACTERISTIC /end REF_CHARACTERISTIC /begin REF_MEASUREMENT TrqOvlSta.ESCRequest.Cnt_lgc /end REF_MEASUREMENT /end GROUP
/begin GROUP TrqOvlSta.ESCState.State_enum "MICROSAR RTE" /begin SUB_GROUP /end SUB_GROUP /begin FUNCTION_LIST /end FUNCTION_LIST /begin REF_CHARACTERISTIC /end REF_CHARACTERISTIC /begin REF_MEASUREMENT TrqOvlSta.ESCState.State_enum /end REF_MEASUREMENT /end GROUP
/begin GROUP TrqOvlSta.GMOSHOscillateState.State_enum "MICROSAR RTE" /begin SUB_GROUP /end SUB_GROUP /begin FUNCTION_LIST /end FUNCTION_LIST /begin REF_CHARACTERISTIC /end REF_CHARACTERISTIC /begin REF_MEASUREMENT TrqOvlSta.GMOSHOscillateState.State_enum /end REF_MEASUREMENT /end GROUP
/begin GROUP TrqOvlSta.GMOSH_APAMfgEnable.Cnt_lgc "MICROSAR RTE" /begin SUB_GROUP /end SUB_GROUP /begin FUNCTION_LIST /end FUNCTION_LIST /begin REF_CHARACTERISTIC /end REF_CHARACTERISTIC /begin REF_MEASUREMENT TrqOvlSta.GMOSH_APAMfgEnable.Cnt_lgc /end REF_MEASUREMENT /end GROUP
/begin GROUP TrqOvlSta.GMOSH_ESCMfgEnable.Cnt_lgc "MICROSAR RTE" /begin SUB_GROUP /end SUB_GROUP /begin FUNCTION_LIST /end FUNCTION_LIST /begin REF_CHARACTERISTIC /end REF_CHARACTERISTIC /begin REF_MEASUREMENT TrqOvlSta.GMOSH_ESCMfgEnable.Cnt_lgc /end REF_MEASUREMENT /end GROUP
/begin GROUP TrqOvlSta.GMOSH_LKAMfgEnable.Cnt_lgc "MICROSAR RTE" /begin SUB_GROUP /end SUB_GROUP /begin FUNCTION_LIST /end FUNCTION_LIST /begin REF_CHARACTERISTIC /end REF_CHARACTERISTIC /begin REF_MEASUREMENT TrqOvlSta.GMOSH_LKAMfgEnable.Cnt_lgc /end REF_MEASUREMENT /end GROUP
/begin GROUP TrqOvlSta.HapticRequest.Cnt_lgc "MICROSAR RTE" /begin SUB_GROUP /end SUB_GROUP /begin FUNCTION_LIST /end FUNCTION_LIST /begin REF_CHARACTERISTIC /end REF_CHARACTERISTIC /begin REF_MEASUREMENT TrqOvlSta.HapticRequest.Cnt_lgc /end REF_MEASUREMENT /end GROUP
/begin GROUP TrqOvlSta.HwTorque.HwNm_f32 "MICROSAR RTE" /begin SUB_GROUP /end SUB_GROUP /begin FUNCTION_LIST /end FUNCTION_LIST /begin REF_CHARACTERISTIC /end REF_CHARACTERISTIC /begin REF_MEASUREMENT TrqOvlSta.HwTorque.HwNm_f32 /end REF_MEASUREMENT /end GROUP
/begin GROUP TrqOvlSta.LKAFault.Cnt_lgc "MICROSAR RTE" /begin SUB_GROUP /end SUB_GROUP /begin FUNCTION_LIST /end FUNCTION_LIST /begin REF_CHARACTERISTIC /end REF_CHARACTERISTIC /begin REF_MEASUREMENT TrqOvlSta.LKAFault.Cnt_lgc /end REF_MEASUREMENT /end GROUP
/begin GROUP TrqOvlSta.LKAInhibit.Cnt_lgc "MICROSAR RTE" /begin SUB_GROUP /end SUB_GROUP /begin FUNCTION_LIST /end FUNCTION_LIST /begin REF_CHARACTERISTIC /end REF_CHARACTERISTIC /begin REF_MEASUREMENT TrqOvlSta.LKAInhibit.Cnt_lgc /end REF_MEASUREMENT /end GROUP
/begin GROUP TrqOvlSta.LKARequest.Cnt_lgc "MICROSAR RTE" /begin SUB_GROUP /end SUB_GROUP /begin FUNCTION_LIST /end FUNCTION_LIST /begin REF_CHARACTERISTIC /end REF_CHARACTERISTIC /begin REF_MEASUREMENT TrqOvlSta.LKARequest.Cnt_lgc /end REF_MEASUREMENT /end GROUP
/begin GROUP TrqOvlSta.LKAState.State_enum "MICROSAR RTE" /begin SUB_GROUP /end SUB_GROUP /begin FUNCTION_LIST /end FUNCTION_LIST /begin REF_CHARACTERISTIC /end REF_CHARACTERISTIC /begin REF_MEASUREMENT TrqOvlSta.LKAState.State_enum /end REF_MEASUREMENT /end GROUP
/begin GROUP TrqOvlSta.MaxSecureVehicleSpeed.Kph_f32 "MICROSAR RTE" /begin SUB_GROUP /end SUB_GROUP /begin FUNCTION_LIST /end FUNCTION_LIST /begin REF_CHARACTERISTIC /end REF_CHARACTERISTIC /begin REF_MEASUREMENT TrqOvlSta.MaxSecureVehicleSpeed.Kph_f32 /end REF_MEASUREMENT /end GROUP
/begin GROUP TrqOvlSta.MinSecureVehicleSpeed.Kph_f32 "MICROSAR RTE" /begin SUB_GROUP /end SUB_GROUP /begin FUNCTION_LIST /end FUNCTION_LIST /begin REF_CHARACTERISTIC /end REF_CHARACTERISTIC /begin REF_MEASUREMENT TrqOvlSta.MinSecureVehicleSpeed.Kph_f32 /end REF_MEASUREMENT /end GROUP
/begin GROUP TrqOvlSta.ModeRequirePorts "MICROSAR RTE" /begin SUB_GROUP TrqOvlSta.SystemState.Mode /end SUB_GROUP /begin FUNCTION_LIST /end FUNCTION_LIST /begin REF_CHARACTERISTIC /end REF_CHARACTERISTIC /begin REF_MEASUREMENT /end REF_MEASUREMENT /end GROUP
/begin GROUP TrqOvlSta.PosServEnable.Cnt_lgc "MICROSAR RTE" /begin SUB_GROUP /end SUB_GROUP /begin FUNCTION_LIST /end FUNCTION_LIST /begin REF_CHARACTERISTIC /end REF_CHARACTERISTIC /begin REF_MEASUREMENT TrqOvlSta.PosServEnable.Cnt_lgc /end REF_MEASUREMENT /end GROUP
/begin GROUP TrqOvlSta.PosSrvoHwAngle.HwDeg_f32 "MICROSAR RTE" /begin SUB_GROUP /end SUB_GROUP /begin FUNCTION_LIST /end FUNCTION_LIST /begin REF_CHARACTERISTIC /end REF_CHARACTERISTIC /begin REF_MEASUREMENT TrqOvlSta.PosSrvoHwAngle.HwDeg_f32 /end REF_MEASUREMENT /end GROUP
/begin GROUP TrqOvlSta.PosTrajEnable.Cnt_lgc "MICROSAR RTE" /begin SUB_GROUP /end SUB_GROUP /begin FUNCTION_LIST /end FUNCTION_LIST /begin REF_CHARACTERISTIC /end REF_CHARACTERISTIC /begin REF_MEASUREMENT TrqOvlSta.PosTrajEnable.Cnt_lgc /end REF_MEASUREMENT /end GROUP
/begin GROUP TrqOvlSta.PosTrajHwAngle.HwDeg_f32 "MICROSAR RTE" /begin SUB_GROUP /end SUB_GROUP /begin FUNCTION_LIST /end FUNCTION_LIST /begin REF_CHARACTERISTIC /end REF_CHARACTERISTIC /begin REF_MEASUREMENT TrqOvlSta.PosTrajHwAngle.HwDeg_f32 /end REF_MEASUREMENT /end GROUP
/begin GROUP TrqOvlSta.ReceiverPorts "MICROSAR RTE"
 /begin SUB_GROUP TrqOvlSta.APANonRecoverableFaults.Cnt_lgc TrqOvlSta.APARecoverableFaults.Cnt_lgc TrqOvlSta.APARequest.Cnt_lgc TrqOvlSta.CCWPosition.HwDeg_f32 TrqOvlSta.CWPosition.HwDeg_f32 TrqOvlSta.ESCFault.Cnt_lgc TrqOvlSta.ESCIsLimited.Cnt_lgc TrqOvlSta.ESCRequest.Cnt_lgc TrqOvlSta.GMOSH_APAMfgEnable.Cnt_lgc TrqOvlSta.GMOSH_ESCMfgEnable.Cnt_lgc TrqOvlSta.GMOSH_LKAMfgEnable.Cnt_lgc TrqOvlSta.HapticRequest.Cnt_lgc TrqOvlSta.HwTorque.HwNm_f32 TrqOvlSta.LKAFault.Cnt_lgc TrqOvlSta.LKAInhibit.Cnt_lgc TrqOvlSta.LKARequest.Cnt_lgc TrqOvlSta.MaxSecureVehicleSpeed.Kph_f32 TrqOvlSta.MinSecureVehicleSpeed.Kph_f32 TrqOvlSta.PosTrajEnable.Cnt_lgc TrqOvlSta.PosTrajHwAngle.HwDeg_f32 TrqOvlSta.SWARTrgtAngRequest.HwDeg_f32 TrqOvlSta.ShiftLeverIsInReverse.Cnt_lgc /end SUB_GROUP
 /begin FUNCTION_LIST /end FUNCTION_LIST
 /begin REF_CHARACTERISTIC /end REF_CHARACTERISTIC
 /begin REF_MEASUREMENT /end REF_MEASUREMENT
/end GROUP
/begin GROUP TrqOvlSta.SWARTrgtAngRequest.HwDeg_f32 "MICROSAR RTE" /begin SUB_GROUP /end SUB_GROUP /begin FUNCTION_LIST /end FUNCTION_LIST /begin REF_CHARACTERISTIC /end REF_CHARACTERISTIC /begin REF_MEASUREMENT TrqOvlSta.SWARTrgtAngRequest.HwDeg_f32 /end REF_MEASUREMENT /end GROUP
/begin GROUP TrqOvlSta.SenderPorts "MICROSAR RTE"
 /begin SUB_GROUP TrqOvlSta.APADrvrInterventionDetected.Cnt_lgc TrqOvlSta.APAState.State_enum TrqOvlSta.ESCState.State_enum TrqOvlSta.GMOSHOscillateState.State_enum TrqOvlSta.LKAState.State_enum TrqOvlSta.PosServEnable.Cnt_lgc TrqOvlSta.PosSrvoHwAngle.HwDeg_f32 TrqOvlSta.TrqOscAmp.MtrNm_f32 TrqOvlSta.TrqOscEnable.Cnt_lgc TrqOvlSta.TrqOscFreq.Hz_f32 /end SUB_GROUP
 /begin FUNCTION_LIST /end FUNCTION_LIST
 /begin REF_CHARACTERISTIC /end REF_CHARACTERISTIC
 /begin REF_MEASUREMENT /end REF_MEASUREMENT
/end GROUP
/begin GROUP TrqOvlSta.ShiftLeverIsInReverse.Cnt_lgc "MICROSAR RTE" /begin SUB_GROUP /end SUB_GROUP /begin FUNCTION_LIST /end FUNCTION_LIST /begin REF_CHARACTERISTIC /end REF_CHARACTERISTIC /begin REF_MEASUREMENT TrqOvlSta.ShiftLeverIsInReverse.Cnt_lgc /end REF_MEASUREMENT /end GROUP
/begin GROUP TrqOvlSta.SystemState.Mode "MICROSAR RTE" /begin SUB_GROUP /end SUB_GROUP /begin FUNCTION_LIST /end FUNCTION_LIST /begin REF_CHARACTERISTIC /end REF_CHARACTERISTIC /begin REF_MEASUREMENT TrqOvlSta.SystemState.Mode /end REF_MEASUREMENT /end GROUP
/begin GROUP TrqOvlSta.TrqOscAmp.MtrNm_f32 "MICROSAR RTE" /begin SUB_GROUP /end SUB_GROUP /begin FUNCTION_LIST /end FUNCTION_LIST /begin REF_CHARACTERISTIC /end REF_CHARACTERISTIC /begin REF_MEASUREMENT TrqOvlSta.TrqOscAmp.MtrNm_f32 /end REF_MEASUREMENT /end GROUP
/begin GROUP TrqOvlSta.TrqOscEnable.Cnt_lgc "MICROSAR RTE" /begin SUB_GROUP /end SUB_GROUP /begin FUNCTION_LIST /end FUNCTION_LIST /begin REF_CHARACTERISTIC /end REF_CHARACTERISTIC /begin REF_MEASUREMENT TrqOvlSta.TrqOscEnable.Cnt_lgc /end REF_MEASUREMENT /end GROUP
/begin GROUP TrqOvlSta.TrqOscFreq.Hz_f32 "MICROSAR RTE" /begin SUB_GROUP /end SUB_GROUP /begin FUNCTION_LIST /end FUNCTION_LIST /begin REF_CHARACTERISTIC /end REF_CHARACTERISTIC /begin REF_MEASUREMENT TrqOvlSta.TrqOscFreq.Hz_f32 /end REF_MEASUREMENT /end GROUP
/begin GROUP VehDyn "MICROSAR RTE"
 /begin SUB_GROUP VehDyn.ModeRequirePorts VehDyn.PerInstanceMemories VehDyn.ReceiverPorts VehDyn.SenderPorts /end SUB_GROUP
 /begin FUNCTION_LIST /end FUNCTION_LIST
 /begin REF_CHARACTERISTIC /end REF_CHARACTERISTIC
 /begin REF_MEASUREMENT /end REF_MEASUREMENT
/end GROUP
/begin GROUP VehDyn.CcwEOT.HwDeg_f32 "MICROSAR RTE" /begin SUB_GROUP /end SUB_GROUP /begin FUNCTION_LIST /end FUNCTION_LIST /begin REF_CHARACTERISTIC /end REF_CHARACTERISTIC /begin REF_MEASUREMENT VehDyn.CcwEOT.HwDeg_f32 /end REF_MEASUREMENT /end GROUP
/begin GROUP VehDyn.CwEOT.HwDeg_f32 "MICROSAR RTE" /begin SUB_GROUP /end SUB_GROUP /begin FUNCTION_LIST /end FUNCTION_LIST /begin REF_CHARACTERISTIC /end REF_CHARACTERISTIC /begin REF_MEASUREMENT VehDyn.CwEOT.HwDeg_f32 /end REF_MEASUREMENT /end GROUP
/begin GROUP VehDyn.HandwheelPosition.HwDeg_f32 "MICROSAR RTE" /begin SUB_GROUP /end SUB_GROUP /begin FUNCTION_LIST /end FUNCTION_LIST /begin REF_CHARACTERISTIC /end REF_CHARACTERISTIC /begin REF_MEASUREMENT VehDyn.HandwheelPosition.HwDeg_f32 /end REF_MEASUREMENT /end GROUP
/begin GROUP VehDyn.HwAuth.Uls_f32 "MICROSAR RTE" /begin SUB_GROUP /end SUB_GROUP /begin FUNCTION_LIST /end FUNCTION_LIST /begin REF_CHARACTERISTIC /end REF_CHARACTERISTIC /begin REF_MEASUREMENT VehDyn.HwAuth.Uls_f32 /end REF_MEASUREMENT /end GROUP
/begin GROUP VehDyn.HwTorque.HwNm_f32 "MICROSAR RTE" /begin SUB_GROUP /end SUB_GROUP /begin FUNCTION_LIST /end FUNCTION_LIST /begin REF_CHARACTERISTIC /end REF_CHARACTERISTIC /begin REF_MEASUREMENT VehDyn.HwTorque.HwNm_f32 /end REF_MEASUREMENT /end GROUP
/begin GROUP VehDyn.MechMtrPos1.Rev_f32 "MICROSAR RTE" /begin SUB_GROUP /end SUB_GROUP /begin FUNCTION_LIST /end FUNCTION_LIST /begin REF_CHARACTERISTIC /end REF_CHARACTERISTIC /begin REF_MEASUREMENT VehDyn.MechMtrPos1.Rev_f32 /end REF_MEASUREMENT /end GROUP
/begin GROUP VehDyn.ModeRequirePorts "MICROSAR RTE" /begin SUB_GROUP VehDyn.SystemState.Mode /end SUB_GROUP /begin FUNCTION_LIST /end FUNCTION_LIST /begin REF_CHARACTERISTIC /end REF_CHARACTERISTIC /begin REF_MEASUREMENT /end REF_MEASUREMENT /end GROUP
/begin GROUP VehDyn.MotPosReset "MICROSAR RTE" /begin SUB_GROUP /end SUB_GROUP /begin FUNCTION_LIST /end FUNCTION_LIST /begin REF_CHARACTERISTIC /end REF_CHARACTERISTIC
 /begin REF_MEASUREMENT VehDyn.MotPosReset.NVMStoredLastPosValid_Cnt_lgc VehDyn.MotPosReset.NVMStoredLastPos_HwDeg_f32 /end REF_MEASUREMENT
/end GROUP
/begin GROUP VehDyn.MotorVelCRF.MtrRadpS_f32 "MICROSAR RTE" /begin SUB_GROUP /end SUB_GROUP /begin FUNCTION_LIST /end FUNCTION_LIST /begin REF_CHARACTERISTIC /end REF_CHARACTERISTIC /begin REF_MEASUREMENT VehDyn.MotorVelCRF.MtrRadpS_f32 /end REF_MEASUREMENT /end GROUP
/begin GROUP VehDyn.PerInstanceMemories "MICROSAR RTE" /begin SUB_GROUP VehDyn.MotPosReset /end SUB_GROUP /begin FUNCTION_LIST /end FUNCTION_LIST /begin REF_CHARACTERISTIC /end REF_CHARACTERISTIC /begin REF_MEASUREMENT /end REF_MEASUREMENT /end GROUP
/begin GROUP VehDyn.ReceiverPorts "MICROSAR RTE"
 /begin SUB_GROUP VehDyn.CcwEOT.HwDeg_f32 VehDyn.CwEOT.HwDeg_f32 VehDyn.HandwheelPosition.HwDeg_f32 VehDyn.HwAuth.Uls_f32 VehDyn.HwTorque.HwNm_f32 VehDyn.MechMtrPos1.Rev_f32 VehDyn.MotorVelCRF.MtrRadpS_f32 VehDyn.RelHwPos.HwDeg_f32 VehDyn.TorqueCmdCRF.MtrNm_f32 VehDyn.VehicleSpeed.Kph_f32 VehDyn.VehicleSpeedValid.Cnt_lgc /end SUB_GROUP
 /begin FUNCTION_LIST /end FUNCTION_LIST
 /begin REF_CHARACTERISTIC /end REF_CHARACTERISTIC
 /begin REF_MEASUREMENT /end REF_MEASUREMENT
/end GROUP
/begin GROUP VehDyn.RelHwPos.HwDeg_f32 "MICROSAR RTE" /begin SUB_GROUP /end SUB_GROUP /begin FUNCTION_LIST /end FUNCTION_LIST /begin REF_CHARACTERISTIC /end REF_CHARACTERISTIC /begin REF_MEASUREMENT VehDyn.RelHwPos.HwDeg_f32 /end REF_MEASUREMENT /end GROUP
/begin GROUP VehDyn.SenderPorts "MICROSAR RTE"
 /begin SUB_GROUP VehDyn.SensorlessAuthority.Uls_f32 VehDyn.SensorlessHwPos.HwDeg_f32 /end SUB_GROUP
 /begin FUNCTION_LIST /end FUNCTION_LIST
 /begin REF_CHARACTERISTIC /end REF_CHARACTERISTIC
 /begin REF_MEASUREMENT /end REF_MEASUREMENT
/end GROUP
/begin GROUP VehDyn.SensorlessAuthority.Uls_f32 "MICROSAR RTE" /begin SUB_GROUP /end SUB_GROUP /begin FUNCTION_LIST /end FUNCTION_LIST /begin REF_CHARACTERISTIC /end REF_CHARACTERISTIC /begin REF_MEASUREMENT VehDyn.SensorlessAuthority.Uls_f32 /end REF_MEASUREMENT /end GROUP
/begin GROUP VehDyn.SensorlessHwPos.HwDeg_f32 "MICROSAR RTE" /begin SUB_GROUP /end SUB_GROUP /begin FUNCTION_LIST /end FUNCTION_LIST /begin REF_CHARACTERISTIC /end REF_CHARACTERISTIC /begin REF_MEASUREMENT VehDyn.SensorlessHwPos.HwDeg_f32 /end REF_MEASUREMENT /end GROUP
/begin GROUP VehDyn.SystemState.Mode "MICROSAR RTE" /begin SUB_GROUP /end SUB_GROUP /begin FUNCTION_LIST /end FUNCTION_LIST /begin REF_CHARACTERISTIC /end REF_CHARACTERISTIC /begin REF_MEASUREMENT VehDyn.SystemState.Mode /end REF_MEASUREMENT /end GROUP
/begin GROUP VehDyn.TorqueCmdCRF.MtrNm_f32 "MICROSAR RTE" /begin SUB_GROUP /end SUB_GROUP /begin FUNCTION_LIST /end FUNCTION_LIST /begin REF_CHARACTERISTIC /end REF_CHARACTERISTIC /begin REF_MEASUREMENT VehDyn.TorqueCmdCRF.MtrNm_f32 /end REF_MEASUREMENT /end GROUP
/begin GROUP VehDyn.VehicleSpeed.Kph_f32 "MICROSAR RTE" /begin SUB_GROUP /end SUB_GROUP /begin FUNCTION_LIST /end FUNCTION_LIST /begin REF_CHARACTERISTIC /end REF_CHARACTERISTIC /begin REF_MEASUREMENT VehDyn.VehicleSpeed.Kph_f32 /end REF_MEASUREMENT /end GROUP
/begin GROUP VehDyn.VehicleSpeedValid.Cnt_lgc "MICROSAR RTE" /begin SUB_GROUP /end SUB_GROUP /begin FUNCTION_LIST /end FUNCTION_LIST /begin REF_CHARACTERISTIC /end REF_CHARACTERISTIC /begin REF_MEASUREMENT VehDyn.VehicleSpeedValid.Cnt_lgc /end REF_MEASUREMENT /end GROUP
/begin GROUP VehPwrMd "MICROSAR RTE"
 /begin SUB_GROUP VehPwrMd.ModeRequirePorts VehPwrMd.ReceiverPorts VehPwrMd.SenderPorts /end SUB_GROUP
 /begin FUNCTION_LIST /end FUNCTION_LIST
 /begin REF_CHARACTERISTIC /end REF_CHARACTERISTIC
 /begin REF_MEASUREMENT /end REF_MEASUREMENT
/end GROUP
/begin GROUP VehPwrMd.ATermActive.Cnt_lgc "MICROSAR RTE" /begin SUB_GROUP /end SUB_GROUP /begin FUNCTION_LIST /end FUNCTION_LIST /begin REF_CHARACTERISTIC /end REF_CHARACTERISTIC /begin REF_MEASUREMENT VehPwrMd.ATermActive.Cnt_lgc /end REF_MEASUREMENT /end GROUP
/begin GROUP VehPwrMd.CTermActive.Cnt_lgc "MICROSAR RTE" /begin SUB_GROUP /end SUB_GROUP /begin FUNCTION_LIST /end FUNCTION_LIST /begin REF_CHARACTERISTIC /end REF_CHARACTERISTIC /begin REF_MEASUREMENT VehPwrMd.CTermActive.Cnt_lgc /end REF_MEASUREMENT /end GROUP
/begin GROUP VehPwrMd.EngONSrlComSvcDft.Cnt_lgc "MICROSAR RTE" /begin SUB_GROUP /end SUB_GROUP /begin FUNCTION_LIST /end FUNCTION_LIST /begin REF_CHARACTERISTIC /end REF_CHARACTERISTIC /begin REF_MEASUREMENT VehPwrMd.EngONSrlComSvcDft.Cnt_lgc /end REF_MEASUREMENT /end GROUP
/begin GROUP VehPwrMd.ModeRequirePorts "MICROSAR RTE" /begin SUB_GROUP VehPwrMd.SystemState.Mode /end SUB_GROUP /begin FUNCTION_LIST /end FUNCTION_LIST /begin REF_CHARACTERISTIC /end REF_CHARACTERISTIC /begin REF_MEASUREMENT /end REF_MEASUREMENT /end GROUP
/begin GROUP VehPwrMd.OperRampRate.XpmS_f32 "MICROSAR RTE" /begin SUB_GROUP /end SUB_GROUP /begin FUNCTION_LIST /end FUNCTION_LIST /begin REF_CHARACTERISTIC /end REF_CHARACTERISTIC /begin REF_MEASUREMENT VehPwrMd.OperRampRate.XpmS_f32 /end REF_MEASUREMENT /end GROUP
/begin GROUP VehPwrMd.OperRampValue.Uls_f32 "MICROSAR RTE" /begin SUB_GROUP /end SUB_GROUP /begin FUNCTION_LIST /end FUNCTION_LIST /begin REF_CHARACTERISTIC /end REF_CHARACTERISTIC /begin REF_MEASUREMENT VehPwrMd.OperRampValue.Uls_f32 /end REF_MEASUREMENT /end GROUP
/begin GROUP VehPwrMd.ReceiverPorts "MICROSAR RTE"
 /begin SUB_GROUP VehPwrMd.EngONSrlComSvcDft.Cnt_lgc VehPwrMd.SrlComEngOn.Cnt_lgc VehPwrMd.SrlComSPMOn.Cnt_lgc VehPwrMd.VehSpd.Kph_f32 VehPwrMd.VehSpdValid.Cnt_lgc /end SUB_GROUP
 /begin FUNCTION_LIST /end FUNCTION_LIST
 /begin REF_CHARACTERISTIC /end REF_CHARACTERISTIC
 /begin REF_MEASUREMENT /end REF_MEASUREMENT
/end GROUP
/begin GROUP VehPwrMd.SenderPorts "MICROSAR RTE"
 /begin SUB_GROUP VehPwrMd.ATermActive.Cnt_lgc VehPwrMd.CTermActive.Cnt_lgc VehPwrMd.OperRampRate.XpmS_f32 VehPwrMd.OperRampValue.Uls_f32 /end SUB_GROUP
 /begin FUNCTION_LIST /end FUNCTION_LIST
 /begin REF_CHARACTERISTIC /end REF_CHARACTERISTIC
 /begin REF_MEASUREMENT /end REF_MEASUREMENT
/end GROUP
/begin GROUP VehPwrMd.SrlComEngOn.Cnt_lgc "MICROSAR RTE" /begin SUB_GROUP /end SUB_GROUP /begin FUNCTION_LIST /end FUNCTION_LIST /begin REF_CHARACTERISTIC /end REF_CHARACTERISTIC /begin REF_MEASUREMENT VehPwrMd.SrlComEngOn.Cnt_lgc /end REF_MEASUREMENT /end GROUP
/begin GROUP VehPwrMd.SrlComSPMOn.Cnt_lgc "MICROSAR RTE" /begin SUB_GROUP /end SUB_GROUP /begin FUNCTION_LIST /end FUNCTION_LIST /begin REF_CHARACTERISTIC /end REF_CHARACTERISTIC /begin REF_MEASUREMENT VehPwrMd.SrlComSPMOn.Cnt_lgc /end REF_MEASUREMENT /end GROUP
/begin GROUP VehPwrMd.SystemState.Mode "MICROSAR RTE" /begin SUB_GROUP /end SUB_GROUP /begin FUNCTION_LIST /end FUNCTION_LIST /begin REF_CHARACTERISTIC /end REF_CHARACTERISTIC /begin REF_MEASUREMENT VehPwrMd.SystemState.Mode /end REF_MEASUREMENT /end GROUP
/begin GROUP VehPwrMd.VehSpd.Kph_f32 "MICROSAR RTE" /begin SUB_GROUP /end SUB_GROUP /begin FUNCTION_LIST /end FUNCTION_LIST /begin REF_CHARACTERISTIC /end REF_CHARACTERISTIC /begin REF_MEASUREMENT VehPwrMd.VehSpd.Kph_f32 /end REF_MEASUREMENT /end GROUP
/begin GROUP VehPwrMd.VehSpdValid.Cnt_lgc "MICROSAR RTE" /begin SUB_GROUP /end SUB_GROUP /begin FUNCTION_LIST /end FUNCTION_LIST /begin REF_CHARACTERISTIC /end REF_CHARACTERISTIC /begin REF_MEASUREMENT VehPwrMd.VehSpdValid.Cnt_lgc /end REF_MEASUREMENT /end GROUP
/begin GROUP VehSpdLmt "MICROSAR RTE" /begin SUB_GROUP VehSpdLmt.ReceiverPorts VehSpdLmt.SenderPorts /end SUB_GROUP /begin FUNCTION_LIST /end FUNCTION_LIST /begin REF_CHARACTERISTIC /end REF_CHARACTERISTIC /begin REF_MEASUREMENT /end REF_MEASUREMENT /end GROUP
/begin GROUP VehSpdLmt.AstVehSpdLimit.MtrNm_f32 "MICROSAR RTE" /begin SUB_GROUP /end SUB_GROUP /begin FUNCTION_LIST /end FUNCTION_LIST /begin REF_CHARACTERISTIC /end REF_CHARACTERISTIC /begin REF_MEASUREMENT VehSpdLmt.AstVehSpdLimit.MtrNm_f32 /end REF_MEASUREMENT /end GROUP
/begin GROUP VehSpdLmt.CCWPosition.HwDeg_f32 "MICROSAR RTE" /begin SUB_GROUP /end SUB_GROUP /begin FUNCTION_LIST /end FUNCTION_LIST /begin REF_CHARACTERISTIC /end REF_CHARACTERISTIC /begin REF_MEASUREMENT VehSpdLmt.CCWPosition.HwDeg_f32 /end REF_MEASUREMENT /end GROUP
/begin GROUP VehSpdLmt.CWPosition.HwDeg_f32 "MICROSAR RTE" /begin SUB_GROUP /end SUB_GROUP /begin FUNCTION_LIST /end FUNCTION_LIST /begin REF_CHARACTERISTIC /end REF_CHARACTERISTIC /begin REF_MEASUREMENT VehSpdLmt.CWPosition.HwDeg_f32 /end REF_MEASUREMENT /end GROUP
/begin GROUP VehSpdLmt.HwPos.HwDeg_f32 "MICROSAR RTE" /begin SUB_GROUP /end SUB_GROUP /begin FUNCTION_LIST /end FUNCTION_LIST /begin REF_CHARACTERISTIC /end REF_CHARACTERISTIC /begin REF_MEASUREMENT VehSpdLmt.HwPos.HwDeg_f32 /end REF_MEASUREMENT /end GROUP
/begin GROUP VehSpdLmt.HwPosAuth.Uls_f32 "MICROSAR RTE" /begin SUB_GROUP /end SUB_GROUP /begin FUNCTION_LIST /end FUNCTION_LIST /begin REF_CHARACTERISTIC /end REF_CHARACTERISTIC /begin REF_MEASUREMENT VehSpdLmt.HwPosAuth.Uls_f32 /end REF_MEASUREMENT /end GROUP
/begin GROUP VehSpdLmt.ReceiverPorts "MICROSAR RTE"
 /begin SUB_GROUP VehSpdLmt.CCWPosition.HwDeg_f32 VehSpdLmt.CWPosition.HwDeg_f32 VehSpdLmt.HwPos.HwDeg_f32 VehSpdLmt.HwPosAuth.Uls_f32 VehSpdLmt.VehSpd.Kph_f32 /end SUB_GROUP
 /begin FUNCTION_LIST /end FUNCTION_LIST
 /begin REF_CHARACTERISTIC /end REF_CHARACTERISTIC
 /begin REF_MEASUREMENT /end REF_MEASUREMENT
/end GROUP
/begin GROUP VehSpdLmt.SenderPorts "MICROSAR RTE" /begin SUB_GROUP VehSpdLmt.AstVehSpdLimit.MtrNm_f32 /end SUB_GROUP /begin FUNCTION_LIST /end FUNCTION_LIST /begin REF_CHARACTERISTIC /end REF_CHARACTERISTIC /begin REF_MEASUREMENT /end REF_MEASUREMENT /end GROUP
/begin GROUP VehSpdLmt.VehSpd.Kph_f32 "MICROSAR RTE" /begin SUB_GROUP /end SUB_GROUP /begin FUNCTION_LIST /end FUNCTION_LIST /begin REF_CHARACTERISTIC /end REF_CHARACTERISTIC /begin REF_MEASUREMENT VehSpdLmt.VehSpd.Kph_f32 /end REF_MEASUREMENT /end GROUP
/begin GROUP Xcp "MICROSAR RTE" /begin SUB_GROUP Xcp.ReceiverPorts Xcp.SenderPorts /end SUB_GROUP /begin FUNCTION_LIST /end FUNCTION_LIST /begin REF_CHARACTERISTIC /end REF_CHARACTERISTIC /begin REF_MEASUREMENT /end REF_MEASUREMENT /end GROUP
/begin GROUP Xcp.ActiveTunOvrPtrAddr.Cnt_u32 "MICROSAR RTE" /begin SUB_GROUP /end SUB_GROUP /begin FUNCTION_LIST /end FUNCTION_LIST /begin REF_CHARACTERISTIC /end REF_CHARACTERISTIC /begin REF_MEASUREMENT Xcp.ActiveTunOvrPtrAddr.Cnt_u32 /end REF_MEASUREMENT /end GROUP
/begin GROUP Xcp.ActiveTunPers.Cnt_u16 "MICROSAR RTE" /begin SUB_GROUP /end SUB_GROUP /begin FUNCTION_LIST /end FUNCTION_LIST /begin REF_CHARACTERISTIC /end REF_CHARACTERISTIC /begin REF_MEASUREMENT Xcp.ActiveTunPers.Cnt_u16 /end REF_MEASUREMENT /end GROUP
/begin GROUP Xcp.ActiveTunSet.Cnt_u16 "MICROSAR RTE" /begin SUB_GROUP /end SUB_GROUP /begin FUNCTION_LIST /end FUNCTION_LIST /begin REF_CHARACTERISTIC /end REF_CHARACTERISTIC /begin REF_MEASUREMENT Xcp.ActiveTunSet.Cnt_u16 /end REF_MEASUREMENT /end GROUP
/begin GROUP Xcp.DesiredTunPers.Cnt_u16 "MICROSAR RTE" /begin SUB_GROUP /end SUB_GROUP /begin FUNCTION_LIST /end FUNCTION_LIST /begin REF_CHARACTERISTIC /end REF_CHARACTERISTIC /begin REF_MEASUREMENT Xcp.DesiredTunPers.Cnt_u16 /end REF_MEASUREMENT /end GROUP
/begin GROUP Xcp.DesiredTunSet.Cnt_u16 "MICROSAR RTE" /begin SUB_GROUP /end SUB_GROUP /begin FUNCTION_LIST /end FUNCTION_LIST /begin REF_CHARACTERISTIC /end REF_CHARACTERISTIC /begin REF_MEASUREMENT Xcp.DesiredTunSet.Cnt_u16 /end REF_MEASUREMENT /end GROUP
/begin GROUP Xcp.ReceiverPorts "MICROSAR RTE"
 /begin SUB_GROUP Xcp.ActiveTunPers.Cnt_u16 Xcp.ActiveTunSet.Cnt_u16 Xcp.DesiredTunPers.Cnt_u16 Xcp.DesiredTunSet.Cnt_u16 /end SUB_GROUP
 /begin FUNCTION_LIST /end FUNCTION_LIST
 /begin REF_CHARACTERISTIC /end REF_CHARACTERISTIC
 /begin REF_MEASUREMENT /end REF_MEASUREMENT
/end GROUP
/begin GROUP Xcp.SenderPorts "MICROSAR RTE"
 /begin SUB_GROUP Xcp.ActiveTunOvrPtrAddr.Cnt_u32 Xcp.TuningSessionActPtr.Cnt_u8 /end SUB_GROUP
 /begin FUNCTION_LIST /end FUNCTION_LIST
 /begin REF_CHARACTERISTIC /end REF_CHARACTERISTIC
 /begin REF_MEASUREMENT /end REF_MEASUREMENT
/end GROUP
/begin GROUP Xcp.TuningSessionActPtr.Cnt_u8 "MICROSAR RTE" /begin SUB_GROUP /end SUB_GROUP /begin FUNCTION_LIST /end FUNCTION_LIST /begin REF_CHARACTERISTIC /end REF_CHARACTERISTIC /begin REF_MEASUREMENT Xcp.TuningSessionActPtr.Cnt_u8 /end REF_MEASUREMENT /end GROUP
/begin RECORD_LAYOUT RTE_RL_FLOAT64_IEEE FNC_VALUES 1 FLOAT64_IEEE ROW_DIR DIRECT /end RECORD_LAYOUT
/begin RECORD_LAYOUT RTE_RL_BOOLEAN FNC_VALUES 1 UBYTE ROW_DIR DIRECT /end RECORD_LAYOUT
/**********************************************************************************************************************
* COMPU_METHOD / COMPU_VTAB_RANGE
*********************************************************************************************************************/
/begin COMPU_METHOD RTE_CM_BOOLEAN "" TAB_VERB "%3.1" "" COMPU_TAB_REF RTE_CM_BOOLEAN /end COMPU_METHOD
/begin COMPU_VTAB_RANGE RTE_CM_BOOLEAN "" 2 0 0 "false" 1 255 "true" /end COMPU_VTAB_RANGE
/begin COMPU_METHOD RTE_CM_STRING "" TAB_VERB "%.1" "" COMPU_TAB_REF RTE_CM_STRING /end COMPU_METHOD
/begin COMPU_VTAB_RANGE RTE_CM_STRING "" 256 0 31 "UNDEFINED" 32 32 " " 33 33 "!" 34 34 "\"" 35 35 "#" 36 36 "$" 37 37 "%" 38 38 "&" 39 39 "'" 40 40 "(" 41 41 ")" 42 42 "*" 43 43 "+" 44 44 "," 45 45 "-" 46 46 "." 47 47 "/" 48 48 "0" 49 49 "1" 50 50 "2" 51 51 "3" 52 52 "4" 53 53 "5" 54 54 "6" 55 55 "7" 56 56 "8" 57 57 "9" 58 58 ":" 59 59 ";" 60 60 "<" 61 61 "=" 62 62 ">" 63 63 "?" 64 64 "@" 65 65 "A" 66 66 "B" 67 67 "C" 68 68 "D" 69 69 "E" 70 70 "F" 71 71 "G" 72 72 "H" 73 73 "I" 74 74 "J" 75 75 "K" 76 76 "L" 77 77 "M" 78 78 "N" 79 79 "O" 80 80 "P" 81 81 "Q" 82 82 "R" 83 83 "S" 84 84 "T" 85 85 "U" 86 86 "V" 87 87 "W" 88 88 "X" 89 89 "Y" 90 90 "Z" 91 91 "[" 92 92 "\\" 93 93 "]" 94 94 "^" 95 95 "_" 96 96 "`" 97 97 "a" 98 98 "b" 99 99 "c" 100 100 "d" 101 101 "e" 102 102 "f" 103 103 "g" 104 104 "h" 105 105 "i" 106 106 "j" 107 107 "k" 108 108 "l" 109 109 "m" 110 110 "n" 111 111 "o" 112 112 "p" 113 113 "q" 114 114 "r" 115 115 "s" 116 116 "t" 117 117 "u" 118 118 "v" 119 119 "w" 120 120 "x" 121 121 "y" 122 122 "z" 123 123 "{" 124 124 "|" 125 125 "}" 126 126 "~" 127 255 "UNDEFINED" /end COMPU_VTAB_RANGE
/begin COMPU_METHOD RTE_CM_ENUM_ManufModeType "" TAB_VERB "%.1" "" COMPU_TAB_REF RTE_CM_ENUM_ManufModeType /end COMPU_METHOD
/begin COMPU_VTAB_RANGE RTE_CM_ENUM_ManufModeType "" 3 0 0 "ProductionMode" 1 1 "ManufacturingMode" 2 2 "EngineeringMode" /end COMPU_VTAB_RANGE
/begin COMPU_METHOD RTE_CM_ENUM_StaMd_Mode "" TAB_VERB "%.1" "" COMPU_TAB_REF RTE_CM_ENUM_StaMd_Mode /end COMPU_METHOD
/begin COMPU_VTAB_RANGE RTE_CM_ENUM_StaMd_Mode "" 5 0 0 "RTE_MODE_StaMd_Mode_DISABLE" 1 1 "RTE_MODE_StaMd_Mode_OFF" 2 2 "RTE_MODE_StaMd_Mode_OPERATE" 3 3 "RTE_MODE_StaMd_Mode_WARMINIT" 4 4 "RTE_TRANSITION_StaMd_Mode" /end COMPU_VTAB_RANGE
/begin COMPU_METHOD RTE_CM_ENUM_APA_State_enum "" TAB_VERB "%.1" "" COMPU_TAB_REF RTE_CM_ENUM_APA_State_enum /end COMPU_METHOD
/begin COMPU_VTAB_RANGE RTE_CM_ENUM_APA_State_enum "" 5 0 0 "APA_TempInhibit" 1 1 "APA_AvailCntrl" 2 2 "APA_Active" 3 3 "APA_PermanentlyFailed" 4 4 "APA_ManufacturingDisable" /end COMPU_VTAB_RANGE
/begin COMPU_METHOD RTE_CM_ENUM_ESC_State_enum "" TAB_VERB "%.1" "" COMPU_TAB_REF RTE_CM_ENUM_ESC_State_enum /end COMPU_METHOD
/begin COMPU_VTAB_RANGE RTE_CM_ENUM_ESC_State_enum "" 5 0 0 "ESC_Inactive" 1 1 "ESC_Active" 2 2 "ESC_TemporarilyLimited" 3 3 "ESC_PermanentlyFailed" 4 4 "ESC_ManufacturingDisable" /end COMPU_VTAB_RANGE
/begin COMPU_METHOD RTE_CM_ENUM_Haptic_State_enum "" TAB_VERB "%.1" "" COMPU_TAB_REF RTE_CM_ENUM_Haptic_State_enum /end COMPU_METHOD
/begin COMPU_VTAB_RANGE RTE_CM_ENUM_Haptic_State_enum "" 3 0 0 "Haptic_Inactive" 1 1 "Haptic_Active" 2 2 "Haptic_Waiting" /end COMPU_VTAB_RANGE
/begin COMPU_METHOD RTE_CM_ENUM_LKA_State_enum "" TAB_VERB "%.1" "" COMPU_TAB_REF RTE_CM_ENUM_LKA_State_enum /end COMPU_METHOD
/begin COMPU_VTAB_RANGE RTE_CM_ENUM_LKA_State_enum "" 5 0 0 "LKA_Inactive" 1 1 "LKA_Active" 2 2 "LKA_TemporarilyLimited" 3 3 "LKA_PermanentlyFailed" 4 4 "LKA_ManufacturingDisable" /end COMPU_VTAB_RANGE
/begin COMPU_METHOD RTE_CM_ENUM_TuningSessionAddrPtrEnum "" TAB_VERB "%.1" "" COMPU_TAB_REF RTE_CM_ENUM_TuningSessionAddrPtrEnum /end COMPU_METHOD
/begin COMPU_VTAB_RANGE RTE_CM_ENUM_TuningSessionAddrPtrEnum "" 7 0 0 "TUN_SESSION_PTR_PERS" 1 1 "TUN_SESSION_PTR_SETS" 2 2 "TUN_SESSION_PTR_COMMON" 3 3 "TUN_SESSION_PTR_SETANDPER" 4 4 "TUN_SESSION_PTR_SETANDPERANDCOMMON" 16 16 "TUN_SESSION_PTR_CUSTSEG" 255 255 "TUN_SESSION_PTR_DISABLED" /end COMPU_VTAB_RANGE
/begin COMPU_METHOD RTE_CM_ENUM_SysPwrMd "" TAB_VERB "%.1" "" COMPU_TAB_REF RTE_CM_ENUM_SysPwrMd /end COMPU_METHOD
/begin COMPU_VTAB_RANGE RTE_CM_ENUM_SysPwrMd "" 4 0 0 "Off" 1 1 "Accessory" 2 2 "Run" 3 3 "CrankRequest" /end COMPU_VTAB_RANGE
