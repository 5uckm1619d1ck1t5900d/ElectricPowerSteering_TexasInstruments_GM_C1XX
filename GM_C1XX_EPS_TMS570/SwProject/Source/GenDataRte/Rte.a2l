/begin MEASUREMENT Ap_SignlCondn.Vehicle_LonAccel.KphpS_f32 "MICROSAR RTE" FLOAT32_IEEE NO_COMPU_METHOD 0 0 1.175494351e-38 3.402823466e+38 ECU_ADDRESS 0 SYMBOL_LINK "Rte_Ap_SignlCondn_Vehicle_LonAccel_KphpS_f32" 0 DISPLAY_IDENTIFIER Ap_SignlCondn.SenderPorts.Vehicle_LonAccel.KphpS_f32 /end MEASUREMENT
/begin MEASUREMENT Ap_StaMd8.ATerm.Cnt_lgc "MICROSAR RTE" UBYTE RTE_CM_BOOLEAN 0 0 0 255 ECU_ADDRESS 0 SYMBOL_LINK "Rte_VehPwrMd_ATermActive_Cnt_lgc" 0 DISPLAY_IDENTIFIER Ap_StaMd8.ReceiverPorts.ATerm.Cnt_lgc /end MEASUREMENT
/begin MEASUREMENT Ap_StaMd8.CTerm.Cnt_lgc "MICROSAR RTE" UBYTE RTE_CM_BOOLEAN 0 0 0 255 ECU_ADDRESS 0 SYMBOL_LINK "Rte_VehPwrMd_CTermActive_Cnt_lgc" 0 DISPLAY_IDENTIFIER Ap_StaMd8.ReceiverPorts.CTerm.Cnt_lgc /end MEASUREMENT
/begin MEASUREMENT Ap_StaMd8.ControlledDampStatusComplete.Cnt_lgc "MICROSAR RTE" UBYTE RTE_CM_BOOLEAN 0 0 0 255 ECU_ADDRESS 0 SYMBOL_LINK "Rte_CtrldDisShtdn_CtrldDmpStsCmp_Cnt_lgc" 0 DISPLAY_IDENTIFIER Ap_StaMd8.ReceiverPorts.ControlledDampStatusComplete.Cnt_lgc /end MEASUREMENT
/begin MEASUREMENT Ap_StaMd8.FTerm.Cnt_lgc "MICROSAR RTE" UBYTE RTE_CM_BOOLEAN 0 0 0 255 ECU_ADDRESS 0 SYMBOL_LINK "Rte_DiagMgr_DiagRmpToZeroActive_Cnt_lgc" 0 DISPLAY_IDENTIFIER Ap_StaMd8.ReceiverPorts.FTerm.Cnt_lgc /end MEASUREMENT
/begin MEASUREMENT Ap_StaMd8.RampStatusComplete.Cnt_lgc "MICROSAR RTE" UBYTE RTE_CM_BOOLEAN 0 0 0 255 ECU_ADDRESS 0 SYMBOL_LINK "Rte_StOpCtrl_SysStReqDi_Cnt_lgc" 0 DISPLAY_IDENTIFIER Ap_StaMd8.ReceiverPorts.RampStatusComplete.Cnt_lgc /end MEASUREMENT
/begin MEASUREMENT Ap_StaMd8.SystemState8.Mode "MICROSAR RTE" UBYTE RTE_CM_ENUM_StaMd_Mode 0 0 0 255 ECU_ADDRESS 0 SYMBOL_LINK "Rte_ModeMachine_Ap_StaMd8_SystemState8_Mode" 0 DISPLAY_IDENTIFIER Ap_StaMd8.ModeProvidePorts.SystemState8.Mode /end MEASUREMENT
/begin MEASUREMENT Ap_StaMd8.TMFTestComplete.Cnt_lgc "MICROSAR RTE" UBYTE RTE_CM_BOOLEAN 0 0 0 255 ECU_ADDRESS 0 SYMBOL_LINK "Rte_TmprlMon_TMFTestComplete_Cnt_lgc" 0 DISPLAY_IDENTIFIER Ap_StaMd8.ReceiverPorts.TMFTestComplete.Cnt_lgc /end MEASUREMENT
/begin MEASUREMENT Ap_StaMd9.SystemState9.Mode "MICROSAR RTE" UBYTE RTE_CM_ENUM_StaMd_Mode 0 0 0 255 ECU_ADDRESS 0 SYMBOL_LINK "Rte_ModeMachine_Ap_StaMd9_SystemState9_Mode" 0 DISPLAY_IDENTIFIER Ap_StaMd9.ModeProvidePorts.SystemState9.Mode /end MEASUREMENT
/begin MEASUREMENT Ap_StabilityComp2.AssistDDFactor.Uls_f32 "MICROSAR RTE" FLOAT32_IEEE NO_COMPU_METHOD 0 0 1.175494351e-38 3.402823466e+38 ECU_ADDRESS 0 SYMBOL_LINK "Rte_Ap_StabilityComp2_AssistDDFactor_Uls_f32" 0 DISPLAY_IDENTIFIER Ap_StabilityComp2.ReceiverPorts.AssistDDFactor.Uls_f32 /end MEASUREMENT
/begin MEASUREMENT Ap_StabilityComp2.AsstFWActive.Uls_f32 "MICROSAR RTE" FLOAT32_IEEE NO_COMPU_METHOD 0 0 1.175494351e-38 3.402823466e+38 ECU_ADDRESS 0 SYMBOL_LINK "Rte_Ap_AssistFirewall_AsstFirewallActive_Uls_f32" 0 DISPLAY_IDENTIFIER Ap_StabilityComp2.ReceiverPorts.AsstFWActive.Uls_f32 /end MEASUREMENT
/begin MEASUREMENT Ap_StabilityComp2.CombinedAssist.MtrNm_f32 "MICROSAR RTE" FLOAT32_IEEE NO_COMPU_METHOD 0 0 1.175494351e-38 3.402823466e+38 ECU_ADDRESS 0 SYMBOL_LINK "Rte_Ap_AssistFirewall_CombinedAssist_MtrNm_f32" 0 DISPLAY_IDENTIFIER Ap_StabilityComp2.ReceiverPorts.CombinedAssist.MtrNm_f32 /end MEASUREMENT
/begin MEASUREMENT Ap_StabilityComp2.HwTorque.HwNm_f32 "MICROSAR RTE" FLOAT32_IEEE NO_COMPU_METHOD 0 0 1.175494351e-38 3.402823466e+38 ECU_ADDRESS 0 SYMBOL_LINK "Rte_Ap_Sweep_OutputHwTrq_HwNm_f32" 0 DISPLAY_IDENTIFIER Ap_StabilityComp2.ReceiverPorts.HwTorque.HwNm_f32 /end MEASUREMENT
/begin MEASUREMENT Ap_StabilityComp2.SysAssistCmd.MtrNm_f32 "MICROSAR RTE" FLOAT32_IEEE NO_COMPU_METHOD 0 0 1.175494351e-38 3.402823466e+38 ECU_ADDRESS 0 SYMBOL_LINK "Rte_Ap_StabilityComp2_SysAssistCmd_MtrNm_f32" 0 DISPLAY_IDENTIFIER Ap_StabilityComp2.SenderPorts.SysAssistCmd.MtrNm_f32 /end MEASUREMENT
/begin MEASUREMENT Ap_StabilityComp2.VehicleSpeed.Kph_f32 "MICROSAR RTE" FLOAT32_IEEE NO_COMPU_METHOD 0 0 1.175494351e-38 3.402823466e+38 ECU_ADDRESS 0 SYMBOL_LINK "Rte_Ap_SignlCondn_VehicleSpeed_Kph_f32" 0 DISPLAY_IDENTIFIER Ap_StabilityComp2.ReceiverPorts.VehicleSpeed.Kph_f32 /end MEASUREMENT
/begin MEASUREMENT Ap_Sweep.InputHwTrq.HwNm_f32 "MICROSAR RTE" FLOAT32_IEEE NO_COMPU_METHOD 0 0 1.175494351e-38 3.402823466e+38 ECU_ADDRESS 0 SYMBOL_LINK "Rte_Sa_DigHwTrqSENT_HwTorque_HwNm_f32" 0 DISPLAY_IDENTIFIER Ap_Sweep.ReceiverPorts.InputHwTrq.HwNm_f32 /end MEASUREMENT
/begin MEASUREMENT Ap_Sweep.OutputHwTrq.HwNm_f32 "MICROSAR RTE" FLOAT32_IEEE NO_COMPU_METHOD 0 0 1.175494351e-38 3.402823466e+38 ECU_ADDRESS 0 SYMBOL_LINK "Rte_Ap_Sweep_OutputHwTrq_HwNm_f32" 0 DISPLAY_IDENTIFIER Ap_Sweep.SenderPorts.OutputHwTrq.HwNm_f32 /end MEASUREMENT
/begin MEASUREMENT Ap_Sweep.VehSpd.Kph_f32 "MICROSAR RTE" FLOAT32_IEEE NO_COMPU_METHOD 0 0 1.175494351e-38 3.402823466e+38 ECU_ADDRESS 0 SYMBOL_LINK "Rte_Ap_SignlCondn_VehicleSpeed_Kph_f32" 0 DISPLAY_IDENTIFIER Ap_Sweep.ReceiverPorts.VehSpd.Kph_f32 /end MEASUREMENT
/begin MEASUREMENT Ap_Sweep.VehSpdValid.Cnt_lgc "MICROSAR RTE" UBYTE RTE_CM_BOOLEAN 0 0 0 255 ECU_ADDRESS 0 SYMBOL_LINK "Rte_SrlComInput_VehicleSpeedValid_Cnt_lgc" 0 DISPLAY_IDENTIFIER Ap_Sweep.ReceiverPorts.VehSpdValid.Cnt_lgc /end MEASUREMENT
/begin MEASUREMENT Ap_Sweep2.InputMtrTrq.MtrNm_f32 "MICROSAR RTE" FLOAT32_IEEE NO_COMPU_METHOD 0 0 1.175494351e-38 3.402823466e+38 ECU_ADDRESS 0 SYMBOL_LINK "Rte_Ap_AstLmt_SumLimTrqCmd_MtrNm_f32" 0 DISPLAY_IDENTIFIER Ap_Sweep2.ReceiverPorts.InputMtrTrq.MtrNm_f32 /end MEASUREMENT
/begin MEASUREMENT Ap_Sweep2.OutputMtrTrq.MtrNm_f32 "MICROSAR RTE" FLOAT32_IEEE NO_COMPU_METHOD 0 0 1.175494351e-38 3.402823466e+38 ECU_ADDRESS 0 SYMBOL_LINK "Rte_Ap_Sweep2_OutputMtrTrq_MtrNm_f32" 0 DISPLAY_IDENTIFIER Ap_Sweep2.SenderPorts.OutputMtrTrq.MtrNm_f32 /end MEASUREMENT
/begin MEASUREMENT Ap_TSMit.HandwheelAuthority.Uls_f32 "MICROSAR RTE" FLOAT32_IEEE NO_COMPU_METHOD 0 0 1.175494351e-38 3.402823466e+38 ECU_ADDRESS 0 SYMBOL_LINK "Rte_AbsHwPos_HandwheelAuthority_Uls_f32" 0 DISPLAY_IDENTIFIER Ap_TSMit.ReceiverPorts.HandwheelAuthority.Uls_f32 /end MEASUREMENT
/begin MEASUREMENT Ap_TSMit.HandwheelPosition.HwDeg_f32 "MICROSAR RTE" FLOAT32_IEEE NO_COMPU_METHOD 0 0 1.175494351e-38 3.402823466e+38 ECU_ADDRESS 0 SYMBOL_LINK "Rte_AbsHwPos_HandwheelPosition_HwDeg_f32" 0 DISPLAY_IDENTIFIER Ap_TSMit.ReceiverPorts.HandwheelPosition.HwDeg_f32 /end MEASUREMENT
/begin MEASUREMENT Ap_TSMit.HandwheelVelocity.HwRadpS_f32 "MICROSAR RTE" FLOAT32_IEEE NO_COMPU_METHOD 0 0 1.175494351e-38 3.402823466e+38 ECU_ADDRESS 0 SYMBOL_LINK "Rte_Sa_MtrVel_HandwheelVel_HwRadpS_f32" 0 DISPLAY_IDENTIFIER Ap_TSMit.ReceiverPorts.HandwheelVelocity.HwRadpS_f32 /end MEASUREMENT
/begin MEASUREMENT Ap_TSMit.HwTorque.HwNm_f32 "MICROSAR RTE" FLOAT32_IEEE NO_COMPU_METHOD 0 0 1.175494351e-38 3.402823466e+38 ECU_ADDRESS 0 SYMBOL_LINK "Rte_Ap_Sweep_OutputHwTrq_HwNm_f32" 0 DISPLAY_IDENTIFIER Ap_TSMit.ReceiverPorts.HwTorque.HwNm_f32 /end MEASUREMENT
/begin MEASUREMENT Ap_TSMit.PreLimitMtrTrqCmd.MtrNm_f32 "MICROSAR RTE" FLOAT32_IEEE NO_COMPU_METHOD 0 0 1.175494351e-38 3.402823466e+38 ECU_ADDRESS 0 SYMBOL_LINK "Rte_Ap_AstLmt_PreLimitTorque_MtrNm_f32" 0 DISPLAY_IDENTIFIER Ap_TSMit.ReceiverPorts.PreLimitMtrTrqCmd.MtrNm_f32 /end MEASUREMENT
/begin MEASUREMENT Ap_TSMit.SrlComABSActive.Cnt_lgc "MICROSAR RTE" UBYTE RTE_CM_BOOLEAN 0 0 0 255 ECU_ADDRESS 0 SYMBOL_LINK "Rte_SrlComInput_SrlComABSActive_Cnt_lgc" 0 DISPLAY_IDENTIFIER Ap_TSMit.ReceiverPorts.SrlComABSActive.Cnt_lgc /end MEASUREMENT
/begin MEASUREMENT Ap_TSMit.SrlComESCActive.Cnt_lgc "MICROSAR RTE" UBYTE RTE_CM_BOOLEAN 0 0 0 255 ECU_ADDRESS 0 SYMBOL_LINK "Rte_SrlComInput_SrlComESCActive_Cnt_lgc" 0 DISPLAY_IDENTIFIER Ap_TSMit.ReceiverPorts.SrlComESCActive.Cnt_lgc /end MEASUREMENT
/begin MEASUREMENT Ap_TSMit.SrlComTCSActive.Cnt_lgc "MICROSAR RTE" UBYTE RTE_CM_BOOLEAN 0 0 0 255 ECU_ADDRESS 0 SYMBOL_LINK "Rte_SrlComInput_SrlComTCSActive_Cnt_lgc" 0 DISPLAY_IDENTIFIER Ap_TSMit.ReceiverPorts.SrlComTCSActive.Cnt_lgc /end MEASUREMENT
/begin MEASUREMENT Ap_TSMit.SrlComYawRate.DegpS_f32 "MICROSAR RTE" FLOAT32_IEEE NO_COMPU_METHOD 0 0 1.175494351e-38 3.402823466e+38 ECU_ADDRESS 0 SYMBOL_LINK "Rte_SrlComInput_SrlComYawRate_DegpS_f32" 0 DISPLAY_IDENTIFIER Ap_TSMit.ReceiverPorts.SrlComYawRate.DegpS_f32 /end MEASUREMENT
/begin MEASUREMENT Ap_TSMit.TSMitCommand.MtrNm_f32 "MICROSAR RTE" FLOAT32_IEEE NO_COMPU_METHOD 0 0 1.175494351e-38 3.402823466e+38 ECU_ADDRESS 0 SYMBOL_LINK "Rte_Ap_TSMit_TSMitCommand_MtrNm_f32" 0 DISPLAY_IDENTIFIER Ap_TSMit.SenderPorts.TSMitCommand.MtrNm_f32 /end MEASUREMENT
/begin MEASUREMENT Ap_TSMit.TSMitDefeat.Cnt_lgc "MICROSAR RTE" UBYTE RTE_CM_BOOLEAN 0 0 0 255 ECU_ADDRESS 0 SYMBOL_LINK "Rte_SrlComInput_SrlComTSMitDefeat_Cnt_lgc" 0 DISPLAY_IDENTIFIER Ap_TSMit.ReceiverPorts.TSMitDefeat.Cnt_lgc /end MEASUREMENT
/begin MEASUREMENT Ap_TSMit.TSMitDisableEOL.FunctionDisable_Cnt_lgc "MICROSAR RTE" UBYTE RTE_CM_BOOLEAN 0 0 0 255 ECU_ADDRESS 0 SYMBOL_LINK "Rte_Ap_TSMit_TSMitDisableEOL.FunctionDisable_Cnt_lgc" 0 DISPLAY_IDENTIFIER Ap_TSMit.PerInstanceMemories.TSMitDisableEOL.FunctionDisable_Cnt_lgc READ_WRITE /end MEASUREMENT
/begin MEASUREMENT Ap_TSMit.TSMitDisableEOL.GainLearningDisable_Cnt_lgc "MICROSAR RTE" UBYTE RTE_CM_BOOLEAN 0 0 0 255 ECU_ADDRESS 0 SYMBOL_LINK "Rte_Ap_TSMit_TSMitDisableEOL.GainLearningDisable_Cnt_lgc" 0 DISPLAY_IDENTIFIER Ap_TSMit.PerInstanceMemories.TSMitDisableEOL.GainLearningDisable_Cnt_lgc READ_WRITE /end MEASUREMENT
/begin MEASUREMENT Ap_TSMit.TSMitGainLrn.NegTransGainLongTerm_HwNmpTransNm_f32 "MICROSAR RTE" FLOAT32_IEEE NO_COMPU_METHOD 0 0 1.175494351e-38 3.402823466e+38 ECU_ADDRESS 0 SYMBOL_LINK "Rte_Ap_TSMit_TSMitGainLrn.NegTransGainLongTerm_HwNmpTransNm_f32" 0 DISPLAY_IDENTIFIER Ap_TSMit.PerInstanceMemories.TSMitGainLrn.NegTransGainLongTerm_HwNmpTransNm_f32 READ_WRITE /end MEASUREMENT
/begin MEASUREMENT Ap_TSMit.TSMitGainLrn.PosTransGainLongTerm_HwNmpTransNm_f32 "MICROSAR RTE" FLOAT32_IEEE NO_COMPU_METHOD 0 0 1.175494351e-38 3.402823466e+38 ECU_ADDRESS 0 SYMBOL_LINK "Rte_Ap_TSMit_TSMitGainLrn.PosTransGainLongTerm_HwNmpTransNm_f32" 0 DISPLAY_IDENTIFIER Ap_TSMit.PerInstanceMemories.TSMitGainLrn.PosTransGainLongTerm_HwNmpTransNm_f32 READ_WRITE /end MEASUREMENT
/begin MEASUREMENT Ap_TSMit.TSMitLearningEnabled.Cnt_lgc "MICROSAR RTE" UBYTE RTE_CM_BOOLEAN 0 0 0 255 ECU_ADDRESS 0 SYMBOL_LINK "Rte_Ap_TSMit_TSMitLearningEnabled_Cnt_lgc" 0 DISPLAY_IDENTIFIER Ap_TSMit.SenderPorts.TSMitLearningEnabled.Cnt_lgc /end MEASUREMENT
/begin MEASUREMENT Ap_TSMit.VehicleSpeed.Kph_f32 "MICROSAR RTE" FLOAT32_IEEE NO_COMPU_METHOD 0 0 1.175494351e-38 3.402823466e+38 ECU_ADDRESS 0 SYMBOL_LINK "Rte_Ap_SignlCondn_VehicleSpeed_Kph_f32" 0 DISPLAY_IDENTIFIER Ap_TSMit.ReceiverPorts.VehicleSpeed.Kph_f32 /end MEASUREMENT
/begin MEASUREMENT Ap_ThrmlDutyCycle.CuTempEst.DegC_f32 "MICROSAR RTE" FLOAT32_IEEE NO_COMPU_METHOD 0 0 1.175494351e-38 3.402823466e+38 ECU_ADDRESS 0 SYMBOL_LINK "Rte_Ap_MtrTempEst_CuTempEst_DegC_f32" 0 DISPLAY_IDENTIFIER Ap_ThrmlDutyCycle.ReceiverPorts.CuTempEst.DegC_f32 /end MEASUREMENT
/begin MEASUREMENT Ap_ThrmlDutyCycle.DefeatDutySvc.Cnt_lgc "MICROSAR RTE" UBYTE RTE_CM_BOOLEAN 0 0 0 255 ECU_ADDRESS 0 SYMBOL_LINK "Rte_CDDInterface_ThermalDCSrlComSvcDft_Cnt_lgc" 0 DISPLAY_IDENTIFIER Ap_ThrmlDutyCycle.ReceiverPorts.DefeatDutySvc.Cnt_lgc /end MEASUREMENT
/begin MEASUREMENT Ap_ThrmlDutyCycle.DutyCycleLevel.Uls_f32 "MICROSAR RTE" FLOAT32_IEEE NO_COMPU_METHOD 0 0 1.175494351e-38 3.402823466e+38 ECU_ADDRESS 0 SYMBOL_LINK "Rte_Ap_ThrmlDutyCycle_DutyCycleLevel_Uls_f32" 0 DISPLAY_IDENTIFIER Ap_ThrmlDutyCycle.SenderPorts.DutyCycleLevel.Uls_f32 /end MEASUREMENT
/begin MEASUREMENT Ap_ThrmlDutyCycle.FiltMeasTemp.DegC_f32 "MICROSAR RTE" FLOAT32_IEEE NO_COMPU_METHOD 0 0 1.175494351e-38 3.402823466e+38 ECU_ADDRESS 0 SYMBOL_LINK "Rte_CtrlTemp_FiltMeasTemp_DegC_f32" 0 DISPLAY_IDENTIFIER Ap_ThrmlDutyCycle.ReceiverPorts.FiltMeasTemp.DegC_f32 /end MEASUREMENT
/begin MEASUREMENT Ap_ThrmlDutyCycle.FilteredPkCurr.AmpSq_f32 "MICROSAR RTE" FLOAT32_IEEE NO_COMPU_METHOD 0 0 1.175494351e-38 3.402823466e+38 ECU_ADDRESS 0 SYMBOL_LINK "Rte_PeakCurrEst_FiltEstPkCurr_AmpSq_f32" 0 DISPLAY_IDENTIFIER Ap_ThrmlDutyCycle.ReceiverPorts.FilteredPkCurr.AmpSq_f32 /end MEASUREMENT
/begin MEASUREMENT Ap_ThrmlDutyCycle.IgnTimeOff.Cnt_u32 "MICROSAR RTE" ULONG NO_COMPU_METHOD 0 0 0 4294967295 ECU_ADDRESS 0 SYMBOL_LINK "Rte_Ap_ThrmlDutyCycle_IgnTimeOff_Cnt_u32" 0 DISPLAY_IDENTIFIER Ap_ThrmlDutyCycle.ReceiverPorts.IgnTimeOff.Cnt_u32 /end MEASUREMENT
/begin MEASUREMENT Ap_ThrmlDutyCycle.MagTempEst.DegC_f32 "MICROSAR RTE" FLOAT32_IEEE NO_COMPU_METHOD 0 0 1.175494351e-38 3.402823466e+38 ECU_ADDRESS 0 SYMBOL_LINK "Rte_Ap_MtrTempEst_MagTempEst_DegC_f32" 0 DISPLAY_IDENTIFIER Ap_ThrmlDutyCycle.ReceiverPorts.MagTempEst.DegC_f32 /end MEASUREMENT
/begin MEASUREMENT Ap_ThrmlDutyCycle.MotorVelCRF.MtrRadpS_f32 "MICROSAR RTE" FLOAT32_IEEE NO_COMPU_METHOD 0 0 1.175494351e-38 3.402823466e+38 ECU_ADDRESS 0 SYMBOL_LINK "Rte_Sa_MtrVel_MotorVelCRF_MtrRadpS_f32" 0 DISPLAY_IDENTIFIER Ap_ThrmlDutyCycle.ReceiverPorts.MotorVelCRF.MtrRadpS_f32 /end MEASUREMENT
/begin MEASUREMENT Ap_ThrmlDutyCycle.MtrPkCurr.AmpSq_f32 "MICROSAR RTE" FLOAT32_IEEE NO_COMPU_METHOD 0 0 1.175494351e-38 3.402823466e+38 ECU_ADDRESS 0 SYMBOL_LINK "Rte_PeakCurrEst_EstPkCurr_AmpSq_f32" 0 DISPLAY_IDENTIFIER Ap_ThrmlDutyCycle.ReceiverPorts.MtrPkCurr.AmpSq_f32 /end MEASUREMENT
/begin MEASUREMENT Ap_ThrmlDutyCycle.SiTempEst.DegC_f32 "MICROSAR RTE" FLOAT32_IEEE NO_COMPU_METHOD 0 0 1.175494351e-38 3.402823466e+38 ECU_ADDRESS 0 SYMBOL_LINK "Rte_Ap_MtrTempEst_SiTempEst_DegC_f32" 0 DISPLAY_IDENTIFIER Ap_ThrmlDutyCycle.ReceiverPorts.SiTempEst.DegC_f32 /end MEASUREMENT
/begin MEASUREMENT Ap_ThrmlDutyCycle.ThermLimitPerc.Uls_f32 "MICROSAR RTE" FLOAT32_IEEE NO_COMPU_METHOD 0 0 1.175494351e-38 3.402823466e+38 ECU_ADDRESS 0 SYMBOL_LINK "Rte_Ap_ThrmlDutyCycle_ThermLimitPerc_Uls_f32" 0 DISPLAY_IDENTIFIER Ap_ThrmlDutyCycle.SenderPorts.ThermLimitPerc.Uls_f32 /end MEASUREMENT
/begin MEASUREMENT Ap_ThrmlDutyCycle.ThermalLimit.MtrNm_f32 "MICROSAR RTE" FLOAT32_IEEE NO_COMPU_METHOD 0 0 1.175494351e-38 3.402823466e+38 ECU_ADDRESS 0 SYMBOL_LINK "Rte_Ap_ThrmlDutyCycle_ThermalLimit_MtrNm_f32" 0 DISPLAY_IDENTIFIER Ap_ThrmlDutyCycle.SenderPorts.ThermalLimit.MtrNm_f32 /end MEASUREMENT
/begin MEASUREMENT Ap_ThrmlDutyCycle.VehTimeValid.Cnt_lgc "MICROSAR RTE" UBYTE RTE_CM_BOOLEAN 0 0 0 255 ECU_ADDRESS 0 SYMBOL_LINK "Rte_Ap_ThrmlDutyCycle_VehTimeValid_Cnt_lgc" 0 DISPLAY_IDENTIFIER Ap_ThrmlDutyCycle.ReceiverPorts.VehTimeValid.Cnt_lgc /end MEASUREMENT
/begin MEASUREMENT Ap_TqRsDg.DervLambdaAlphaDiag.Volt_f32 "This signal is intended to communicate any type voltage signal measured by the ecu.  This signal has a lower limit of 0 which reequires users of the signal to provide divide by 0 protection if it is used as a denominator in a calculation.  See Vecu port p" FLOAT32_IEEE NO_COMPU_METHOD 0 0 1.175494351e-38 3.402823466e+38 ECU_ADDRESS 0 SYMBOL_LINK "Rte_Ap_PICurrCntrl_DervLambdaAlphaDiag_Volt_f32" 0 DISPLAY_IDENTIFIER Ap_TqRsDg.ReceiverPorts.DervLambdaAlphaDiag.Volt_f32 /end MEASUREMENT
/begin MEASUREMENT Ap_TqRsDg.DervLambdaBetaDiag.Volt_f32 "This signal is intended to communicate any type voltage signal measured by the ecu.  This signal has a lower limit of 0 which reequires users of the signal to provide divide by 0 protection if it is used as a denominator in a calculation.  See Vecu port p" FLOAT32_IEEE NO_COMPU_METHOD 0 0 1.175494351e-38 3.402823466e+38 ECU_ADDRESS 0 SYMBOL_LINK "Rte_Ap_PICurrCntrl_DervLambdaBetaDiag_Volt_f32" 0 DISPLAY_IDENTIFIER Ap_TqRsDg.ReceiverPorts.DervLambdaBetaDiag.Volt_f32 /end MEASUREMENT
/begin MEASUREMENT Ap_TqRsDg.OutputRampMult.Uls_f32 "MICROSAR RTE" FLOAT32_IEEE NO_COMPU_METHOD 0 0 1.175494351e-38 3.402823466e+38 ECU_ADDRESS 0 SYMBOL_LINK "Rte_Ap_LmtCod_OutputRampMultLtd_Uls_f32" 0 DISPLAY_IDENTIFIER Ap_TqRsDg.ReceiverPorts.OutputRampMult.Uls_f32 /end MEASUREMENT
/begin MEASUREMENT Ap_TqRsDg.SystemState.Mode "MICROSAR RTE" UBYTE RTE_CM_ENUM_StaMd_Mode 0 0 0 255 ECU_ADDRESS 0 SYMBOL_LINK "Rte_ModeMachine_StaMd_SystemState_Mode" 0 DISPLAY_IDENTIFIER Ap_TqRsDg.ModeRequirePorts.SystemState.Mode /end MEASUREMENT
/begin MEASUREMENT Ap_TqRsDg.TrqLimitMin.MtrNm_f32 "MICROSAR RTE" FLOAT32_IEEE NO_COMPU_METHOD 0 0 1.175494351e-38 3.402823466e+38 ECU_ADDRESS 0 SYMBOL_LINK "Rte_Ap_AstLmt_TrqLimitMin_MtrNm_f32" 0 DISPLAY_IDENTIFIER Ap_TqRsDg.ReceiverPorts.TrqLimitMin.MtrNm_f32 /end MEASUREMENT
/begin MEASUREMENT Ap_TrqArblim.AssistDDFactor.Uls_f32 "MICROSAR RTE" FLOAT32_IEEE NO_COMPU_METHOD 0 0 1.175494351e-38 3.402823466e+38 ECU_ADDRESS 0 SYMBOL_LINK "Rte_Ap_TrqArblim_AssistDDFactor_Uls_f32" 0 DISPLAY_IDENTIFIER Ap_TrqArblim.SenderPorts.AssistDDFactor.Uls_f32 /end MEASUREMENT
/begin MEASUREMENT Ap_TrqArblim.DampingDDFactor.Uls_f32 "MICROSAR RTE" FLOAT32_IEEE NO_COMPU_METHOD 0 0 1.175494351e-38 3.402823466e+38 ECU_ADDRESS 0 SYMBOL_LINK "Rte_Ap_TrqArblim_DampingDDFactor_Uls_f32" 0 DISPLAY_IDENTIFIER Ap_TrqArblim.SenderPorts.DampingDDFactor.Uls_f32 /end MEASUREMENT
/begin MEASUREMENT Ap_TrqArblim.ESCCmd.HwNm_f32 "MICROSAR RTE" FLOAT32_IEEE NO_COMPU_METHOD 0 0 1.175494351e-38 3.402823466e+38 ECU_ADDRESS 0 SYMBOL_LINK "Rte_SrlComInput_ESCCmd_HwNm_f32" 0 DISPLAY_IDENTIFIER Ap_TrqArblim.ReceiverPorts.ESCCmd.HwNm_f32 /end MEASUREMENT
/begin MEASUREMENT Ap_TrqArblim.ESCIsLimited.Cnt_lgc "MICROSAR RTE" UBYTE RTE_CM_BOOLEAN 0 0 0 255 ECU_ADDRESS 0 SYMBOL_LINK "Rte_Ap_TrqArblim_ESCIsLimited_Cnt_lgc" 0 DISPLAY_IDENTIFIER Ap_TrqArblim.SenderPorts.ESCIsLimited.Cnt_lgc /end MEASUREMENT
/begin MEASUREMENT Ap_TrqArblim.ESCState.State_enum "MICROSAR RTE" UBYTE RTE_CM_ENUM_ESC_State_enum 0 0 0 4 ECU_ADDRESS 0 SYMBOL_LINK "Rte_TrqOvlSta_ESCState_State_enum" 0 DISPLAY_IDENTIFIER Ap_TrqArblim.ReceiverPorts.ESCState.State_enum /end MEASUREMENT
/begin MEASUREMENT Ap_TrqArblim.ESCTorqueDelivered.HwNm_f32 "MICROSAR RTE" FLOAT32_IEEE NO_COMPU_METHOD 0 0 1.175494351e-38 3.402823466e+38 ECU_ADDRESS 0 SYMBOL_LINK "Rte_Ap_TrqArblim_ESCTorqueDelivered_HwNm_f32" 0 DISPLAY_IDENTIFIER Ap_TrqArblim.SenderPorts.ESCTorqueDelivered.HwNm_f32 /end MEASUREMENT
/begin MEASUREMENT Ap_TrqArblim.GMOSHOscillate.State_enum "MICROSAR RTE" UBYTE RTE_CM_ENUM_Haptic_State_enum 0 0 0 2 ECU_ADDRESS 0 SYMBOL_LINK "Rte_TrqOvlSta_GMOSHOscillateState_State_enum" 0 DISPLAY_IDENTIFIER Ap_TrqArblim.ReceiverPorts.GMOSHOscillate.State_enum /end MEASUREMENT
/begin MEASUREMENT Ap_TrqArblim.HwTorque.HwNm_f32 "MICROSAR RTE" FLOAT32_IEEE NO_COMPU_METHOD 0 0 1.175494351e-38 3.402823466e+38 ECU_ADDRESS 0 SYMBOL_LINK "Rte_Ap_Sweep_OutputHwTrq_HwNm_f32" 0 DISPLAY_IDENTIFIER Ap_TrqArblim.ReceiverPorts.HwTorque.HwNm_f32 /end MEASUREMENT
/begin MEASUREMENT Ap_TrqArblim.IqTrqOv.HwNm_f32 "MICROSAR RTE" FLOAT32_IEEE NO_COMPU_METHOD 0 0 1.175494351e-38 3.402823466e+38 ECU_ADDRESS 0 SYMBOL_LINK "Rte_Ap_TrqArblim_IqTrqOv_HwNm_f32" 0 DISPLAY_IDENTIFIER Ap_TrqArblim.SenderPorts.IqTrqOv.HwNm_f32 /end MEASUREMENT
/begin MEASUREMENT Ap_TrqArblim.LKACmd.HwNm_f32 "MICROSAR RTE" FLOAT32_IEEE NO_COMPU_METHOD 0 0 1.175494351e-38 3.402823466e+38 ECU_ADDRESS 0 SYMBOL_LINK "Rte_SrlComInput_LKACmd_HwNm_f32" 0 DISPLAY_IDENTIFIER Ap_TrqArblim.ReceiverPorts.LKACmd.HwNm_f32 /end MEASUREMENT
/begin MEASUREMENT Ap_TrqArblim.LKAState.State_enum "MICROSAR RTE" UBYTE RTE_CM_ENUM_LKA_State_enum 0 0 0 4 ECU_ADDRESS 0 SYMBOL_LINK "Rte_TrqOvlSta_LKAState_State_enum" 0 DISPLAY_IDENTIFIER Ap_TrqArblim.ReceiverPorts.LKAState.State_enum /end MEASUREMENT
/begin MEASUREMENT Ap_TrqArblim.LKATorqueDelivered.HwNm_f32 "MICROSAR RTE" FLOAT32_IEEE NO_COMPU_METHOD 0 0 1.175494351e-38 3.402823466e+38 ECU_ADDRESS 0 SYMBOL_LINK "Rte_Ap_TrqArblim_LKATorqueDelivered_HwNm_f32" 0 DISPLAY_IDENTIFIER Ap_TrqArblim.SenderPorts.LKATorqueDelivered.HwNm_f32 /end MEASUREMENT
/begin MEASUREMENT Ap_TrqArblim.MaxSecureVehicleSpeed.Kph_f32 "MICROSAR RTE" FLOAT32_IEEE NO_COMPU_METHOD 0 0 1.175494351e-38 3.402823466e+38 ECU_ADDRESS 0 SYMBOL_LINK "Rte_SrlComInput_MaxSecureVehicleSpeed_Kph_f32" 0 DISPLAY_IDENTIFIER Ap_TrqArblim.ReceiverPorts.MaxSecureVehicleSpeed.Kph_f32 /end MEASUREMENT
/begin MEASUREMENT Ap_TrqArblim.OpTrqOv.MtrNm_f32 "MICROSAR RTE" FLOAT32_IEEE NO_COMPU_METHOD 0 0 1.175494351e-38 3.402823466e+38 ECU_ADDRESS 0 SYMBOL_LINK "Rte_Ap_TrqArblim_OpTrqOv_MtrNm_f32" 0 DISPLAY_IDENTIFIER Ap_TrqArblim.SenderPorts.OpTrqOv.MtrNm_f32 /end MEASUREMENT
/begin MEASUREMENT Ap_TrqArblim.PosServEnable.Cnt_lgc "MICROSAR RTE" UBYTE RTE_CM_BOOLEAN 0 0 0 255 ECU_ADDRESS 0 SYMBOL_LINK "Rte_TrqOvlSta_PosServEnable_Cnt_lgc" 0 DISPLAY_IDENTIFIER Ap_TrqArblim.ReceiverPorts.PosServEnable.Cnt_lgc /end MEASUREMENT
/begin MEASUREMENT Ap_TrqArblim.PosSrvoCmd.MtrNm_f32 "MICROSAR RTE" FLOAT32_IEEE NO_COMPU_METHOD 0 0 1.175494351e-38 3.402823466e+38 ECU_ADDRESS 0 SYMBOL_LINK "Rte_Ap_PosServo_PosSrvoCmd_MtrNm_f32" 0 DISPLAY_IDENTIFIER Ap_TrqArblim.ReceiverPorts.PosSrvoCmd.MtrNm_f32 /end MEASUREMENT
/begin MEASUREMENT Ap_TrqArblim.ReturnDDFactor.Uls_f32 "MICROSAR RTE" FLOAT32_IEEE NO_COMPU_METHOD 0 0 1.175494351e-38 3.402823466e+38 ECU_ADDRESS 0 SYMBOL_LINK "Rte_Ap_TrqArblim_ReturnDDFactor_Uls_f32" 0 DISPLAY_IDENTIFIER Ap_TrqArblim.SenderPorts.ReturnDDFactor.Uls_f32 /end MEASUREMENT
/begin MEASUREMENT Ap_TrqArblim.SystemState.Mode "MICROSAR RTE" UBYTE RTE_CM_ENUM_StaMd_Mode 0 0 0 255 ECU_ADDRESS 0 SYMBOL_LINK "Rte_ModeMachine_StaMd_SystemState_Mode" 0 DISPLAY_IDENTIFIER Ap_TrqArblim.ModeRequirePorts.SystemState.Mode /end MEASUREMENT
/begin MEASUREMENT Ap_TrqArblim.TrqOscCmd.MtrNm_f32 "MICROSAR RTE" FLOAT32_IEEE NO_COMPU_METHOD 0 0 1.175494351e-38 3.402823466e+38 ECU_ADDRESS 0 SYMBOL_LINK "Rte_Ap_TrqOsc_TrqOscCmd_MtrNm_f32" 0 DISPLAY_IDENTIFIER Ap_TrqArblim.ReceiverPorts.TrqOscCmd.MtrNm_f32 /end MEASUREMENT
/begin MEASUREMENT Ap_TrqCanc.CogTrqCal "MICROSAR RTE" UWORD NO_COMPU_METHOD 0 0 0 65535 MATRIX_DIM 512 1 1 ECU_ADDRESS 0 SYMBOL_LINK "Rte_Ap_TrqCanc_CogTrqCal" 0 DISPLAY_IDENTIFIER Ap_TrqCanc.PerInstanceMemories.CogTrqCal READ_WRITE /end MEASUREMENT
/begin MEASUREMENT Ap_TrqCanc.CogTrqRplComp "MICROSAR RTE" UWORD NO_COMPU_METHOD 0 0 0 65535 MATRIX_DIM 9 1 1 ECU_ADDRESS 0 SYMBOL_LINK "Rte_Ap_TrqCanc_CogTrqRplComp" 0 DISPLAY_IDENTIFIER Ap_TrqCanc.PerInstanceMemories.CogTrqRplComp READ_WRITE /end MEASUREMENT
/begin MEASUREMENT Ap_TrqCanc.EstKe.VpRadpS_f32 "MICROSAR RTE" FLOAT32_IEEE NO_COMPU_METHOD 0 0 1.175494351e-38 3.402823466e+38 ECU_ADDRESS 0 SYMBOL_LINK "Rte_CurrParamComp_EstKe_VpRadpS_f32" 0 DISPLAY_IDENTIFIER Ap_TrqCanc.ReceiverPorts.EstKe.VpRadpS_f32 /end MEASUREMENT
/begin MEASUREMENT Ap_TrqCanc.EstLd.Henry_f32 "MICROSAR RTE" FLOAT32_IEEE NO_COMPU_METHOD 0 0 1.175494351e-38 3.402823466e+38 ECU_ADDRESS 0 SYMBOL_LINK "Rte_CurrParamComp_EstLd_Henry_f32" 0 DISPLAY_IDENTIFIER Ap_TrqCanc.ReceiverPorts.EstLd.Henry_f32 /end MEASUREMENT
/begin MEASUREMENT Ap_TrqCanc.EstLq.Henry_f32 "MICROSAR RTE" FLOAT32_IEEE NO_COMPU_METHOD 0 0 1.175494351e-38 3.402823466e+38 ECU_ADDRESS 0 SYMBOL_LINK "Rte_CurrParamComp_EstLq_Henry_f32" 0 DISPLAY_IDENTIFIER Ap_TrqCanc.ReceiverPorts.EstLq.Henry_f32 /end MEASUREMENT
/begin MEASUREMENT Ap_TrqCanc.MRFMtrVel.MtrRadpS_f32 "MICROSAR RTE" FLOAT32_IEEE NO_COMPU_METHOD 0 0 1.175494351e-38 3.402823466e+38 ECU_ADDRESS 0 SYMBOL_LINK "Rte_Sa_MtrVel_MotorVelMRF_MtrRadpS_f32" 0 DISPLAY_IDENTIFIER Ap_TrqCanc.ReceiverPorts.MRFMtrVel.MtrRadpS_f32 /end MEASUREMENT
/begin MEASUREMENT Ap_TrqCanc.MtrCurrDaxRef.Amp_f32 "MICROSAR RTE" FLOAT32_IEEE NO_COMPU_METHOD 0 0 1.175494351e-38 3.402823466e+38 ECU_ADDRESS 0 SYMBOL_LINK "Rte_CurrCmd_MtrCurrDaxRef_Amp_f32" 0 DISPLAY_IDENTIFIER Ap_TrqCanc.ReceiverPorts.MtrCurrDaxRef.Amp_f32 /end MEASUREMENT
/begin MEASUREMENT Ap_TrqCanc.MtrCurrQaxRef.Amp_f32 "MICROSAR RTE" FLOAT32_IEEE NO_COMPU_METHOD 0 0 1.175494351e-38 3.402823466e+38 ECU_ADDRESS 0 SYMBOL_LINK "Rte_CurrCmd_MtrCurrQaxRef_Amp_f32" 0 DISPLAY_IDENTIFIER Ap_TrqCanc.ReceiverPorts.MtrCurrQaxRef.Amp_f32 /end MEASUREMENT
/begin MEASUREMENT Ap_TrqCanc.MtrTrqCmdMRFScl.MtrNm_f32 "MICROSAR RTE" FLOAT32_IEEE NO_COMPU_METHOD 0 0 1.175494351e-38 3.402823466e+38 ECU_ADDRESS 0 SYMBOL_LINK "Rte_TrqCmdScl_MRFMtrTrqCmdScl_MtrNm_f32" 0 DISPLAY_IDENTIFIER Ap_TrqCanc.ReceiverPorts.MtrTrqCmdMRFScl.MtrNm_f32 /end MEASUREMENT
/begin MEASUREMENT Ap_TrqOsc.TrqOscAmp.MtrNm_f32 "MICROSAR RTE" FLOAT32_IEEE NO_COMPU_METHOD 0 0 1.175494351e-38 3.402823466e+38 ECU_ADDRESS 0 SYMBOL_LINK "Rte_TrqOvlSta_TrqOscAmp_MtrNm_f32" 0 DISPLAY_IDENTIFIER Ap_TrqOsc.ReceiverPorts.TrqOscAmp.MtrNm_f32 /end MEASUREMENT
/begin MEASUREMENT Ap_TrqOsc.TrqOscCmd.MtrNm_f32 "MICROSAR RTE" FLOAT32_IEEE NO_COMPU_METHOD 0 0 1.175494351e-38 3.402823466e+38 ECU_ADDRESS 0 SYMBOL_LINK "Rte_Ap_TrqOsc_TrqOscCmd_MtrNm_f32" 0 DISPLAY_IDENTIFIER Ap_TrqOsc.SenderPorts.TrqOscCmd.MtrNm_f32 /end MEASUREMENT
/begin MEASUREMENT Ap_TrqOsc.TrqOscDCExceeded.Cnt_lgc "MICROSAR RTE" UBYTE RTE_CM_BOOLEAN 0 0 0 255 ECU_ADDRESS 0 SYMBOL_LINK "Rte_Ap_TrqOsc_TrqOscDCExceeded_Cnt_lgc" 0 DISPLAY_IDENTIFIER Ap_TrqOsc.SenderPorts.TrqOscDCExceeded.Cnt_lgc /end MEASUREMENT
/begin MEASUREMENT Ap_TrqOsc.TrqOscEnable.Cnt_lgc "MICROSAR RTE" UBYTE RTE_CM_BOOLEAN 0 0 0 255 ECU_ADDRESS 0 SYMBOL_LINK "Rte_TrqOvlSta_TrqOscEnable_Cnt_lgc" 0 DISPLAY_IDENTIFIER Ap_TrqOsc.ReceiverPorts.TrqOscEnable.Cnt_lgc /end MEASUREMENT
/begin MEASUREMENT Ap_TrqOsc.TrqOscFreq.Hz_f32 "MICROSAR RTE" FLOAT32_IEEE NO_COMPU_METHOD 0 0 1.175494351e-38 3.402823466e+38 ECU_ADDRESS 0 SYMBOL_LINK "Rte_TrqOvlSta_TrqOscFreq_Hz_f32" 0 DISPLAY_IDENTIFIER Ap_TrqOsc.ReceiverPorts.TrqOscFreq.Hz_f32 /end MEASUREMENT
/begin MEASUREMENT Ap_TuningSelAuth.ActiveTunOvrPtrAddr.Cnt_u32 "MICROSAR RTE" ULONG NO_COMPU_METHOD 0 0 0 4294967295 ECU_ADDRESS 0 SYMBOL_LINK "Rte_Xcp_ActiveTunOvrPtrAddr_Cnt_u32" 0 DISPLAY_IDENTIFIER Ap_TuningSelAuth.ReceiverPorts.ActiveTunOvrPtrAddr.Cnt_u32 /end MEASUREMENT
/begin MEASUREMENT Ap_TuningSelAuth.ActiveTunPers.Cnt_u16 "MICROSAR RTE" UWORD NO_COMPU_METHOD 0 0 0 65535 ECU_ADDRESS 0 SYMBOL_LINK "Rte_Ap_TuningSelAuth_ActiveTunPers_Cnt_u16" 0 DISPLAY_IDENTIFIER Ap_TuningSelAuth.SenderPorts.ActiveTunPers.Cnt_u16 /end MEASUREMENT
/begin MEASUREMENT Ap_TuningSelAuth.ActiveTunSet.Cnt_u16 "MICROSAR RTE" UWORD NO_COMPU_METHOD 0 0 0 65535 ECU_ADDRESS 0 SYMBOL_LINK "Rte_Ap_TuningSelAuth_ActiveTunSet_Cnt_u16" 0 DISPLAY_IDENTIFIER Ap_TuningSelAuth.SenderPorts.ActiveTunSet.Cnt_u16 /end MEASUREMENT
/begin MEASUREMENT Ap_TuningSelAuth.DesiredTunPers.Cnt_u16 "MICROSAR RTE" UWORD NO_COMPU_METHOD 0 0 0 65535 ECU_ADDRESS 0 SYMBOL_LINK "Rte_SrlComInput_DesiredTunPers_Cnt_u16" 0 DISPLAY_IDENTIFIER Ap_TuningSelAuth.ReceiverPorts.DesiredTunPers.Cnt_u16 /end MEASUREMENT
/begin MEASUREMENT Ap_TuningSelAuth.DesiredTunSet.Cnt_u16 "MICROSAR RTE" UWORD NO_COMPU_METHOD 0 0 0 65535 ECU_ADDRESS 0 SYMBOL_LINK "Rte_Ap_TuningSelAuth_DesiredTunSet_Cnt_u16" 0 DISPLAY_IDENTIFIER Ap_TuningSelAuth.ReceiverPorts.DesiredTunSet.Cnt_u16 /end MEASUREMENT
/begin MEASUREMENT Ap_TuningSelAuth.HwTorque.HwNm_f32 "MICROSAR RTE" FLOAT32_IEEE NO_COMPU_METHOD 0 0 1.175494351e-38 3.402823466e+38 ECU_ADDRESS 0 SYMBOL_LINK "Rte_Ap_Sweep_OutputHwTrq_HwNm_f32" 0 DISPLAY_IDENTIFIER Ap_TuningSelAuth.ReceiverPorts.HwTorque.HwNm_f32 /end MEASUREMENT
/begin MEASUREMENT Ap_TuningSelAuth.TuningSessionActPtr.Cnt_u8 "MICROSAR RTE" UBYTE RTE_CM_ENUM_TuningSessionAddrPtrEnum 0 0 0 255 ECU_ADDRESS 0 SYMBOL_LINK "Rte_Xcp_TuningSessionActPtr_Cnt_u8" 0 DISPLAY_IDENTIFIER Ap_TuningSelAuth.ReceiverPorts.TuningSessionActPtr.Cnt_u8 /end MEASUREMENT
/begin MEASUREMENT Ap_TuningSelAuth.VehicleSpeed.Kph_f32 "MICROSAR RTE" FLOAT32_IEEE NO_COMPU_METHOD 0 0 1.175494351e-38 3.402823466e+38 ECU_ADDRESS 0 SYMBOL_LINK "Rte_Ap_SignlCondn_VehicleSpeed_Kph_f32" 0 DISPLAY_IDENTIFIER Ap_TuningSelAuth.ReceiverPorts.VehicleSpeed.Kph_f32 /end MEASUREMENT
/begin MEASUREMENT Ap_WIRInputQual.QualWhlFreqL.Hz_f32 "MICROSAR RTE" FLOAT32_IEEE NO_COMPU_METHOD 0 0 1.175494351e-38 3.402823466e+38 ECU_ADDRESS 0 SYMBOL_LINK "Rte_Ap_WIRInputQual_QualWhlFreqL_Hz_f32" 0 DISPLAY_IDENTIFIER Ap_WIRInputQual.SenderPorts.QualWhlFreqL.Hz_f32 /end MEASUREMENT
/begin MEASUREMENT Ap_WIRInputQual.QualWhlFreqR.Hz_f32 "MICROSAR RTE" FLOAT32_IEEE NO_COMPU_METHOD 0 0 1.175494351e-38 3.402823466e+38 ECU_ADDRESS 0 SYMBOL_LINK "Rte_Ap_WIRInputQual_QualWhlFreqR_Hz_f32" 0 DISPLAY_IDENTIFIER Ap_WIRInputQual.SenderPorts.QualWhlFreqR.Hz_f32 /end MEASUREMENT
/begin MEASUREMENT Ap_WIRInputQual.SrlComLWhlSpd.Hz_f32 "MICROSAR RTE" FLOAT32_IEEE NO_COMPU_METHOD 0 0 1.175494351e-38 3.402823466e+38 ECU_ADDRESS 0 SYMBOL_LINK "Rte_SrlComInput_SrlComLWhlSpd_Hz_f32" 0 DISPLAY_IDENTIFIER Ap_WIRInputQual.ReceiverPorts.SrlComLWhlSpd.Hz_f32 /end MEASUREMENT
/begin MEASUREMENT Ap_WIRInputQual.SrlComLWhlSpdVld.Cnt_lgc "MICROSAR RTE" UBYTE RTE_CM_BOOLEAN 0 0 0 255 ECU_ADDRESS 0 SYMBOL_LINK "Rte_SrlComInput_SrlComLWhlSpdVld_Cnt_lgc" 0 DISPLAY_IDENTIFIER Ap_WIRInputQual.ReceiverPorts.SrlComLWhlSpdVld.Cnt_lgc /end MEASUREMENT
/begin MEASUREMENT Ap_WIRInputQual.SrlComRWhlSpd.Hz_f32 "MICROSAR RTE" FLOAT32_IEEE NO_COMPU_METHOD 0 0 1.175494351e-38 3.402823466e+38 ECU_ADDRESS 0 SYMBOL_LINK "Rte_SrlComInput_SrlComRWhlSpd_Hz_f32" 0 DISPLAY_IDENTIFIER Ap_WIRInputQual.ReceiverPorts.SrlComRWhlSpd.Hz_f32 /end MEASUREMENT
/begin MEASUREMENT Ap_WIRInputQual.SrlComRWhlSpdVld.Cnt_lgc "MICROSAR RTE" UBYTE RTE_CM_BOOLEAN 0 0 0 255 ECU_ADDRESS 0 SYMBOL_LINK "Rte_SrlComInput_SrlComRWhlSpdVld_Cnt_lgc" 0 DISPLAY_IDENTIFIER Ap_WIRInputQual.ReceiverPorts.SrlComRWhlSpdVld.Cnt_lgc /end MEASUREMENT
/begin MEASUREMENT Ap_WIRInputQual.WhlFreqQualified.Cnt_lgc "MICROSAR RTE" UBYTE RTE_CM_BOOLEAN 0 0 0 255 ECU_ADDRESS 0 SYMBOL_LINK "Rte_Ap_WIRInputQual_WhlFreqQualified_Cnt_lgc" 0 DISPLAY_IDENTIFIER Ap_WIRInputQual.SenderPorts.WhlFreqQualified.Cnt_lgc /end MEASUREMENT
/begin MEASUREMENT Ap_WhlImbRej.DiagStsWIRDisable.Cnt_lgc "MICROSAR RTE" UBYTE RTE_CM_BOOLEAN 0 0 0 255 ECU_ADDRESS 0 SYMBOL_LINK "Rte_DiagMgr_DiagStsWIRDisable_Cnt_lgc" 0 DISPLAY_IDENTIFIER Ap_WhlImbRej.ReceiverPorts.DiagStsWIRDisable.Cnt_lgc /end MEASUREMENT
/begin MEASUREMENT Ap_WhlImbRej.HwTrq.HwNm_f32 "MICROSAR RTE" FLOAT32_IEEE NO_COMPU_METHOD 0 0 1.175494351e-38 3.402823466e+38 ECU_ADDRESS 0 SYMBOL_LINK "Rte_Ap_Sweep_OutputHwTrq_HwNm_f32" 0 DISPLAY_IDENTIFIER Ap_WhlImbRej.ReceiverPorts.HwTrq.HwNm_f32 /end MEASUREMENT
/begin MEASUREMENT Ap_WhlImbRej.QualWhlFreqL.Hz_f32 "MICROSAR RTE" FLOAT32_IEEE NO_COMPU_METHOD 0 0 1.175494351e-38 3.402823466e+38 ECU_ADDRESS 0 SYMBOL_LINK "Rte_Ap_WIRInputQual_QualWhlFreqL_Hz_f32" 0 DISPLAY_IDENTIFIER Ap_WhlImbRej.ReceiverPorts.QualWhlFreqL.Hz_f32 /end MEASUREMENT
/begin MEASUREMENT Ap_WhlImbRej.QualWhlFreqR.Hz_f32 "MICROSAR RTE" FLOAT32_IEEE NO_COMPU_METHOD 0 0 1.175494351e-38 3.402823466e+38 ECU_ADDRESS 0 SYMBOL_LINK "Rte_Ap_WIRInputQual_QualWhlFreqR_Hz_f32" 0 DISPLAY_IDENTIFIER Ap_WhlImbRej.ReceiverPorts.QualWhlFreqR.Hz_f32 /end MEASUREMENT
/begin MEASUREMENT Ap_WhlImbRej.SystemState.Mode "MICROSAR RTE" UBYTE RTE_CM_ENUM_StaMd_Mode 0 0 0 255 ECU_ADDRESS 0 SYMBOL_LINK "Rte_ModeMachine_StaMd_SystemState_Mode" 0 DISPLAY_IDENTIFIER Ap_WhlImbRej.ModeRequirePorts.SystemState.Mode /end MEASUREMENT
/begin MEASUREMENT Ap_WhlImbRej.VehSpd.Kph_f32 "MICROSAR RTE" FLOAT32_IEEE NO_COMPU_METHOD 0 0 1.175494351e-38 3.402823466e+38 ECU_ADDRESS 0 SYMBOL_LINK "Rte_Ap_SignlCondn_VehicleSpeed_Kph_f32" 0 DISPLAY_IDENTIFIER Ap_WhlImbRej.ReceiverPorts.VehSpd.Kph_f32 /end MEASUREMENT
/begin MEASUREMENT Ap_WhlImbRej.VehSpdValid.Cnt_lgc "MICROSAR RTE" UBYTE RTE_CM_BOOLEAN 0 0 0 255 ECU_ADDRESS 0 SYMBOL_LINK "Rte_SrlComInput_VehicleSpeedValid_Cnt_lgc" 0 DISPLAY_IDENTIFIER Ap_WhlImbRej.ReceiverPorts.VehSpdValid.Cnt_lgc /end MEASUREMENT
/begin MEASUREMENT Ap_WhlImbRej.WIRCmdAmpBlnd.MtrNm_f32 "MICROSAR RTE" FLOAT32_IEEE NO_COMPU_METHOD 0 0 1.175494351e-38 3.402823466e+38 ECU_ADDRESS 0 SYMBOL_LINK "Rte_Ap_WhlImbRej_WIRCmdAmpBlnd_MtrNm_f32" 0 DISPLAY_IDENTIFIER Ap_WhlImbRej.SenderPorts.WIRCmdAmpBlnd.MtrNm_f32 /end MEASUREMENT
/begin MEASUREMENT Ap_WhlImbRej.WIRMfgEnable.Cnt_lgc "MICROSAR RTE" UBYTE RTE_CM_BOOLEAN 0 0 0 255 ECU_ADDRESS 0 SYMBOL_LINK "Rte_CDDInterface_WIRMfgEnabled_Cnt_lgc" 0 DISPLAY_IDENTIFIER Ap_WhlImbRej.ReceiverPorts.WIRMfgEnable.Cnt_lgc /end MEASUREMENT
/begin MEASUREMENT Ap_WhlImbRej.WhlFreqQualified.Cnt_lgc "MICROSAR RTE" UBYTE RTE_CM_BOOLEAN 0 0 0 255 ECU_ADDRESS 0 SYMBOL_LINK "Rte_Ap_WIRInputQual_WhlFreqQualified_Cnt_lgc" 0 DISPLAY_IDENTIFIER Ap_WhlImbRej.ReceiverPorts.WhlFreqQualified.Cnt_lgc /end MEASUREMENT
/begin MEASUREMENT Ap_WhlImbRej.WhlImbRejCmd.MtrNm_f32 "MICROSAR RTE" FLOAT32_IEEE NO_COMPU_METHOD 0 0 1.175494351e-38 3.402823466e+38 ECU_ADDRESS 0 SYMBOL_LINK "Rte_Ap_WhlImbRej_WhlImbRejCmd_MtrNm_f32" 0 DISPLAY_IDENTIFIER Ap_WhlImbRej.SenderPorts.WhlImbRejCmd.MtrNm_f32 /end MEASUREMENT
/begin MEASUREMENT Ap_ePWM2.CtrldDmpStsCmp.Cnt_lgc "MICROSAR RTE" UBYTE RTE_CM_BOOLEAN 0 0 0 255 ECU_ADDRESS 0 SYMBOL_LINK "Rte_CtrldDisShtdn_CtrldDmpStsCmp_Cnt_lgc" 0 DISPLAY_IDENTIFIER Ap_ePWM2.ReceiverPorts.CtrldDmpStsCmp.Cnt_lgc /end MEASUREMENT
/begin MEASUREMENT Ap_ePWM2.DiagStsCtrldDisRmpPres.Cnt_lgc "MICROSAR RTE" UBYTE RTE_CM_BOOLEAN 0 0 0 255 ECU_ADDRESS 0 SYMBOL_LINK "Rte_DiagMgr_DiagStsCtrldDisRmpPres_Cnt_lgc" 0 DISPLAY_IDENTIFIER Ap_ePWM2.ReceiverPorts.DiagStsCtrldDisRmpPres.Cnt_lgc /end MEASUREMENT
/begin MEASUREMENT Ap_ePWM2.DiagStsNonRecRmpToZeroFltPres.Cnt_lgc "MICROSAR RTE" UBYTE RTE_CM_BOOLEAN 0 0 0 255 ECU_ADDRESS 0 SYMBOL_LINK "Rte_DiagMgr_DiagStsNonRecRmpToZeroFltPres_Cnt_lgc" 0 DISPLAY_IDENTIFIER Ap_ePWM2.ReceiverPorts.DiagStsNonRecRmpToZeroFltPres.Cnt_lgc /end MEASUREMENT
/begin MEASUREMENT Ap_ePWM2.RampDwnStatusComplete.Cnt_lgc "MICROSAR RTE" UBYTE RTE_CM_BOOLEAN 0 0 0 255 ECU_ADDRESS 0 SYMBOL_LINK "Rte_StOpCtrl_SysStReqDi_Cnt_lgc" 0 DISPLAY_IDENTIFIER Ap_ePWM2.ReceiverPorts.RampDwnStatusComplete.Cnt_lgc /end MEASUREMENT
/begin MEASUREMENT Ap_ePWM2.SystemState.Mode "MICROSAR RTE" UBYTE RTE_CM_ENUM_StaMd_Mode 0 0 0 255 ECU_ADDRESS 0 SYMBOL_LINK "Rte_ModeMachine_StaMd_SystemState_Mode" 0 DISPLAY_IDENTIFIER Ap_ePWM2.ModeRequirePorts.SystemState.Mode /end MEASUREMENT
/begin MEASUREMENT Assist.AssistDDFactor.Uls_f32 "MICROSAR RTE" FLOAT32_IEEE NO_COMPU_METHOD 0 0 1.175494351e-38 3.402823466e+38 ECU_ADDRESS 0 SYMBOL_LINK "Rte_Ap_TrqArblim_AssistDDFactor_Uls_f32" 0 DISPLAY_IDENTIFIER Assist.ReceiverPorts.AssistDDFactor.Uls_f32 /end MEASUREMENT
/begin MEASUREMENT Assist.BaseAssistCmd.MtrNm_f32 "MICROSAR RTE" FLOAT32_IEEE NO_COMPU_METHOD 0 0 1.175494351e-38 3.402823466e+38 ECU_ADDRESS 0 SYMBOL_LINK "Rte_Assist_BaseAssistCmd_MtrNm_f32" 0 DISPLAY_IDENTIFIER Assist.SenderPorts.BaseAssistCmd.MtrNm_f32 /end MEASUREMENT
/begin MEASUREMENT Assist.DftAsstTbl.Cnt_lgc "MICROSAR RTE" UBYTE RTE_CM_BOOLEAN 0 0 0 255 ECU_ADDRESS 0 SYMBOL_LINK "Rte_CDDInterface_DftAsstTbl_Cnt_lgc" 0 DISPLAY_IDENTIFIER Assist.ReceiverPorts.DftAsstTbl.Cnt_lgc /end MEASUREMENT
/begin MEASUREMENT Assist.DutyCycleLevel.Uls_f32 "MICROSAR RTE" FLOAT32_IEEE NO_COMPU_METHOD 0 0 1.175494351e-38 3.402823466e+38 ECU_ADDRESS 0 SYMBOL_LINK "Rte_Ap_ThrmlDutyCycle_DutyCycleLevel_Uls_f32" 0 DISPLAY_IDENTIFIER Assist.ReceiverPorts.DutyCycleLevel.Uls_f32 /end MEASUREMENT
/begin MEASUREMENT Assist.DwnldAsstGain.Uls_f32 "MICROSAR RTE" FLOAT32_IEEE NO_COMPU_METHOD 0 0 1.175494351e-38 3.402823466e+38 ECU_ADDRESS 0 SYMBOL_LINK "Rte_CDDInterface_DwnldAsstGain_Uls_f32" 0 DISPLAY_IDENTIFIER Assist.ReceiverPorts.DwnldAsstGain.Uls_f32 /end MEASUREMENT
/begin MEASUREMENT Assist.HwTrq.HwNm_f32 "MICROSAR RTE" FLOAT32_IEEE NO_COMPU_METHOD 0 0 1.175494351e-38 3.402823466e+38 ECU_ADDRESS 0 SYMBOL_LINK "Rte_Ap_Sweep_OutputHwTrq_HwNm_f32" 0 DISPLAY_IDENTIFIER Assist.ReceiverPorts.HwTrq.HwNm_f32 /end MEASUREMENT
/begin MEASUREMENT Assist.HwTrqHysAdd.HwNm_f32 "MICROSAR RTE" FLOAT32_IEEE NO_COMPU_METHOD 0 0 1.175494351e-38 3.402823466e+38 ECU_ADDRESS 0 SYMBOL_LINK "Rte_Assist_HwTrqHysAdd_HwNm_f32" 0 DISPLAY_IDENTIFIER Assist.ReceiverPorts.HwTrqHysAdd.HwNm_f32 /end MEASUREMENT
/begin MEASUREMENT Assist.IpTrqOvr.HwNm_f32 "MICROSAR RTE" FLOAT32_IEEE NO_COMPU_METHOD 0 0 1.175494351e-38 3.402823466e+38 ECU_ADDRESS 0 SYMBOL_LINK "Rte_Ap_TrqArblim_IqTrqOv_HwNm_f32" 0 DISPLAY_IDENTIFIER Assist.ReceiverPorts.IpTrqOvr.HwNm_f32 /end MEASUREMENT
/begin MEASUREMENT Assist.VehSpd.Kph_f32 "MICROSAR RTE" FLOAT32_IEEE NO_COMPU_METHOD 0 0 1.175494351e-38 3.402823466e+38 ECU_ADDRESS 0 SYMBOL_LINK "Rte_Ap_SignlCondn_VehicleSpeed_Kph_f32" 0 DISPLAY_IDENTIFIER Assist.ReceiverPorts.VehSpd.Kph_f32 /end MEASUREMENT
/begin MEASUREMENT Assist.WIRCmdAmpBlnd.MtrNm_f32 "MICROSAR RTE" FLOAT32_IEEE NO_COMPU_METHOD 0 0 1.175494351e-38 3.402823466e+38 ECU_ADDRESS 0 SYMBOL_LINK "Rte_Ap_WhlImbRej_WIRCmdAmpBlnd_MtrNm_f32" 0 DISPLAY_IDENTIFIER Assist.ReceiverPorts.WIRCmdAmpBlnd.MtrNm_f32 /end MEASUREMENT
/begin MEASUREMENT BatteryVoltage.Batt.Volt_f32 "This signal is intended to communicate any type voltage signal measured by the ecu.  This signal has a lower limit of 0 which reequires users of the signal to provide divide by 0 protection if it is used as a denominator in a calculation.  See Vecu port p" FLOAT32_IEEE NO_COMPU_METHOD 0 0 1.175494351e-38 3.402823466e+38 ECU_ADDRESS 0 SYMBOL_LINK "Rte_IoHwAbstractionUsr_Batt_Volt_f32" 0 DISPLAY_IDENTIFIER BatteryVoltage.ReceiverPorts.Batt.Volt_f32 /end MEASUREMENT
/begin MEASUREMENT BatteryVoltage.BattSwitched.Volt_f32 "This signal is intended to communicate any type voltage signal measured by the ecu.  This signal has a lower limit of 0 which reequires users of the signal to provide divide by 0 protection if it is used as a denominator in a calculation.  See Vecu port p" FLOAT32_IEEE NO_COMPU_METHOD 0 0 1.175494351e-38 3.402823466e+38 ECU_ADDRESS 0 SYMBOL_LINK "Rte_IoHwAbstractionUsr_BattSwitched_Volt_f32" 0 DISPLAY_IDENTIFIER BatteryVoltage.ReceiverPorts.BattSwitched.Volt_f32 /end MEASUREMENT
/begin MEASUREMENT BatteryVoltage.OvervoltageData.MaxBattVoltage_Volts_f32 "MICROSAR RTE" FLOAT32_IEEE NO_COMPU_METHOD 0 0 1.175494351e-38 3.402823466e+38 ECU_ADDRESS 0 SYMBOL_LINK "Rte_BatteryVoltage_OvervoltageData.MaxBattVoltage_Volts_f32" 0 DISPLAY_IDENTIFIER BatteryVoltage.PerInstanceMemories.OvervoltageData.MaxBattVoltage_Volts_f32 READ_WRITE /end MEASUREMENT
/begin MEASUREMENT BatteryVoltage.OvervoltageData.OvervoltageCounter_Cnt_u16 "MICROSAR RTE" UWORD NO_COMPU_METHOD 0 0 0 65535 ECU_ADDRESS 0 SYMBOL_LINK "Rte_BatteryVoltage_OvervoltageData.OvervoltageCounter_Cnt_u16" 0 DISPLAY_IDENTIFIER BatteryVoltage.PerInstanceMemories.OvervoltageData.OvervoltageCounter_Cnt_u16 READ_WRITE /end MEASUREMENT
/begin MEASUREMENT BatteryVoltage.SysCVSwitch.Volt_f32 "This signal is intended to communicate any type voltage signal measured by the ecu.  This signal has a lower limit of 0 which reequires users of the signal to provide divide by 0 protection if it is used as a denominator in a calculation.  See Vecu port p" FLOAT32_IEEE NO_COMPU_METHOD 0 0 1.175494351e-38 3.402823466e+38 ECU_ADDRESS 0 SYMBOL_LINK "Rte_IoHwAbstractionUsr_SysCVSwitch_Volt_f32" 0 DISPLAY_IDENTIFIER BatteryVoltage.ReceiverPorts.SysCVSwitch.Volt_f32 /end MEASUREMENT
/begin MEASUREMENT BatteryVoltage.SysC_Vecu.Volt_f32 "This port prototype is inteded to communicate voltage signals that represent the ecu supplied voltage.  This signal has a lower limit, which is non-zero, to allow users of the signal to use it as a denominator in an expression without requiring a divide b" FLOAT32_IEEE NO_COMPU_METHOD 0 0 1.175494351e-38 3.402823466e+38 ECU_ADDRESS 0 SYMBOL_LINK "Rte_BatteryVoltage_SysC_Vecu_Volt_f32" 0 DISPLAY_IDENTIFIER BatteryVoltage.SenderPorts.SysC_Vecu.Volt_f32 /end MEASUREMENT
/begin MEASUREMENT BatteryVoltage.SystemState.Mode "MICROSAR RTE" UBYTE RTE_CM_ENUM_StaMd_Mode 0 0 0 255 ECU_ADDRESS 0 SYMBOL_LINK "Rte_ModeMachine_Ap_StaMd9_SystemState9_Mode" 0 DISPLAY_IDENTIFIER BatteryVoltage.ModeRequirePorts.SystemState.Mode /end MEASUREMENT
/begin MEASUREMENT BatteryVoltage.Vecu.Volt_f32 "This port prototype is inteded to communicate voltage signals that represent the ecu supplied voltage.  This signal has a lower limit, which is non-zero, to allow users of the signal to use it as a denominator in an expression without requiring a divide b" FLOAT32_IEEE NO_COMPU_METHOD 0 0 1.175494351e-38 3.402823466e+38 ECU_ADDRESS 0 SYMBOL_LINK "Rte_BatteryVoltage_Vecu_Volt_f32" 0 DISPLAY_IDENTIFIER BatteryVoltage.SenderPorts.Vecu.Volt_f32 /end MEASUREMENT
/begin MEASUREMENT BatteryVoltage.VswitchClosed.Cnt_lgc "MICROSAR RTE" UBYTE RTE_CM_BOOLEAN 0 0 0 255 ECU_ADDRESS 0 SYMBOL_LINK "Rte_BatteryVoltage_VswitchClosed_Cnt_lgc" 0 DISPLAY_IDENTIFIER BatteryVoltage.SenderPorts.VswitchClosed.Cnt_lgc /end MEASUREMENT
/begin MEASUREMENT BkCpPc.Batt.Volt_f32 "This signal is intended to communicate any type voltage signal measured by the ecu.  This signal has a lower limit of 0 which reequires users of the signal to provide divide by 0 protection if it is used as a denominator in a calculation.  See Vecu port p" FLOAT32_IEEE NO_COMPU_METHOD 0 0 1.175494351e-38 3.402823466e+38 ECU_ADDRESS 0 SYMBOL_LINK "Rte_IoHwAbstractionUsr_Batt_Volt_f32" 0 DISPLAY_IDENTIFIER BkCpPc.ReceiverPorts.Batt.Volt_f32 /end MEASUREMENT
/begin MEASUREMENT BkCpPc.BattSwitched.Volt_f32 "This signal is intended to communicate any type voltage signal measured by the ecu.  This signal has a lower limit of 0 which reequires users of the signal to provide divide by 0 protection if it is used as a denominator in a calculation.  See Vecu port p" FLOAT32_IEEE NO_COMPU_METHOD 0 0 1.175494351e-38 3.402823466e+38 ECU_ADDRESS 0 SYMBOL_LINK "Rte_IoHwAbstractionUsr_BattSwitched_Volt_f32" 0 DISPLAY_IDENTIFIER BkCpPc.ReceiverPorts.BattSwitched.Volt_f32 /end MEASUREMENT
/begin MEASUREMENT BkCpPc.MotorVelocityMRFUnfiltered.MtrRadpS_f32 "MICROSAR RTE" FLOAT32_IEEE NO_COMPU_METHOD 0 0 1.175494351e-38 3.402823466e+38 ECU_ADDRESS 0 SYMBOL_LINK "Rte_BkCpPc_MotorVelocityMRFUnfiltered_MtrRadpS_f32" 0 DISPLAY_IDENTIFIER BkCpPc.ReceiverPorts.MotorVelocityMRFUnfiltered.MtrRadpS_f32 /end MEASUREMENT
/begin MEASUREMENT BkCpPc.OVERRIDESIGDIAGADC.Volt_f32 "This signal is intended to communicate any type voltage signal measured by the ecu.  This signal has a lower limit of 0 which reequires users of the signal to provide divide by 0 protection if it is used as a denominator in a calculation.  See Vecu port p" FLOAT32_IEEE NO_COMPU_METHOD 0 0 1.175494351e-38 3.402823466e+38 ECU_ADDRESS 0 SYMBOL_LINK "Rte_BkCpPc_OVERRIDESIGDIAGADC_Volt_f32" 0 DISPLAY_IDENTIFIER BkCpPc.ReceiverPorts.OVERRIDESIGDIAGADC.Volt_f32 /end MEASUREMENT
/begin MEASUREMENT BkCpPc.PMOSDIAGADC.Volt_f32 "This signal is intended to communicate any type voltage signal measured by the ecu.  This signal has a lower limit of 0 which reequires users of the signal to provide divide by 0 protection if it is used as a denominator in a calculation.  See Vecu port p" FLOAT32_IEEE NO_COMPU_METHOD 0 0 1.175494351e-38 3.402823466e+38 ECU_ADDRESS 0 SYMBOL_LINK "Rte_BkCpPc_PMOSDIAGADC_Volt_f32" 0 DISPLAY_IDENTIFIER BkCpPc.ReceiverPorts.PMOSDIAGADC.Volt_f32 /end MEASUREMENT
/begin MEASUREMENT BkCpPc.PwrDiscATestComplete.Cnt_lgc "MICROSAR RTE" UBYTE RTE_CM_BOOLEAN 0 0 0 255 ECU_ADDRESS 0 SYMBOL_LINK "Rte_BkCpPc_PwrDiscATestComplete_Cnt_lgc" 0 DISPLAY_IDENTIFIER BkCpPc.SenderPorts.PwrDiscATestComplete.Cnt_lgc /end MEASUREMENT
/begin MEASUREMENT BkCpPc.PwrDiscATestStart.Cnt_lgc "MICROSAR RTE" UBYTE RTE_CM_BOOLEAN 0 0 0 255 ECU_ADDRESS 0 SYMBOL_LINK "Rte_Ap_HwPwUp_PwrDiscATestStart_Cnt_lgc" 0 DISPLAY_IDENTIFIER BkCpPc.ReceiverPorts.PwrDiscATestStart.Cnt_lgc /end MEASUREMENT
/begin MEASUREMENT BkCpPc.PwrDiscBTestComplete.Cnt_lgc "MICROSAR RTE" UBYTE RTE_CM_BOOLEAN 0 0 0 255 ECU_ADDRESS 0 SYMBOL_LINK "Rte_BkCpPc_PwrDiscBTestComplete_Cnt_lgc" 0 DISPLAY_IDENTIFIER BkCpPc.SenderPorts.PwrDiscBTestComplete.Cnt_lgc /end MEASUREMENT
/begin MEASUREMENT BkCpPc.PwrDiscBTestStart.Cnt_lgc "MICROSAR RTE" UBYTE RTE_CM_BOOLEAN 0 0 0 255 ECU_ADDRESS 0 SYMBOL_LINK "Rte_Ap_HwPwUp_PwrDiscBTestStart_Cnt_lgc" 0 DISPLAY_IDENTIFIER BkCpPc.ReceiverPorts.PwrDiscBTestStart.Cnt_lgc /end MEASUREMENT
/begin MEASUREMENT BkCpPc.PwrDiscClosed.Cnt_lgc "MICROSAR RTE" UBYTE RTE_CM_BOOLEAN 0 0 0 255 ECU_ADDRESS 0 SYMBOL_LINK "Rte_BkCpPc_PwrDiscClosed_Cnt_lgc" 0 DISPLAY_IDENTIFIER BkCpPc.SenderPorts.PwrDiscClosed.Cnt_lgc /end MEASUREMENT
/begin MEASUREMENT BkCpPc.SystemState.Mode "MICROSAR RTE" UBYTE RTE_CM_ENUM_StaMd_Mode 0 0 0 255 ECU_ADDRESS 0 SYMBOL_LINK "Rte_ModeMachine_StaMd_SystemState_Mode" 0 DISPLAY_IDENTIFIER BkCpPc.ModeRequirePorts.SystemState.Mode /end MEASUREMENT
/begin MEASUREMENT CDDInterface.ADCMtrCurr1.Volts_f32 "MICROSAR RTE" FLOAT32_IEEE NO_COMPU_METHOD 0 0 1.175494351e-38 3.402823466e+38 ECU_ADDRESS 0 SYMBOL_LINK "Rte_CDDInterface_ADCMtrCurr1_Volts_f32" 0 DISPLAY_IDENTIFIER CDDInterface.SenderPorts.ADCMtrCurr1.Volts_f32 /end MEASUREMENT
/begin MEASUREMENT CDDInterface.ADCMtrCurr2.Volts_f32 "MICROSAR RTE" FLOAT32_IEEE NO_COMPU_METHOD 0 0 1.175494351e-38 3.402823466e+38 ECU_ADDRESS 0 SYMBOL_LINK "Rte_CDDInterface_ADCMtrCurr2_Volts_f32" 0 DISPLAY_IDENTIFIER CDDInterface.SenderPorts.ADCMtrCurr2.Volts_f32 /end MEASUREMENT
/begin MEASUREMENT CDDInterface.AssistAssemblyPolarity.Cnt_s08 "MICROSAR RTE" SBYTE NO_COMPU_METHOD 0 0 -128 127 ECU_ADDRESS 0 SYMBOL_LINK "Rte_Polarity_AssistAssyPolarity_Cnt_s08" 0 DISPLAY_IDENTIFIER CDDInterface.ReceiverPorts.AssistAssemblyPolarity.Cnt_s08 /end MEASUREMENT
/begin MEASUREMENT CDDInterface.BallNutTempEstSrlComSvcDft.Cnt_lgc "MICROSAR RTE" UBYTE RTE_CM_BOOLEAN 0 0 0 255 ECU_ADDRESS 0 SYMBOL_LINK "Rte_CDDInterface_BallNutTempEstSrlComSvcDft_Cnt_lgc" 0 DISPLAY_IDENTIFIER CDDInterface.SenderPorts.BallNutTempEstSrlComSvcDft.Cnt_lgc /end MEASUREMENT
/begin MEASUREMENT CDDInterface.CommOffset.Cnt_u16 "MICROSAR RTE" UWORD NO_COMPU_METHOD 0 0 0 65535 ECU_ADDRESS 0 SYMBOL_LINK "Rte_CmMtrCurr_ComOffset_Cnt_u16" 0 DISPLAY_IDENTIFIER CDDInterface.ReceiverPorts.CommOffset.Cnt_u16 /end MEASUREMENT
/begin MEASUREMENT CDDInterface.CorrMtrCurrPosition.Rev_f32 "MICROSAR RTE" FLOAT32_IEEE NO_COMPU_METHOD 0 0 1.175494351e-38 3.402823466e+38 ECU_ADDRESS 0 SYMBOL_LINK "Rte_CDDInterface_CorrMtrCurrPosition_Rev_f32" 0 DISPLAY_IDENTIFIER CDDInterface.SenderPorts.CorrMtrCurrPosition.Rev_f32 /end MEASUREMENT
/begin MEASUREMENT CDDInterface.CorrectedElecMtrPos.Rev_u0p16 "MICROSAR RTE" UWORD NO_COMPU_METHOD 0 0 0 65535 ECU_ADDRESS 0 SYMBOL_LINK "Rte_CDDInterface_CorrectedElecMtrPos_Rev_u0p16" 0 DISPLAY_IDENTIFIER CDDInterface.SenderPorts.CorrectedElecMtrPos.Rev_u0p16 /end MEASUREMENT
/begin MEASUREMENT CDDInterface.CorrectedElecMtrPosFloat.Rev_f32 "MICROSAR RTE" FLOAT32_IEEE NO_COMPU_METHOD 0 0 1.175494351e-38 3.402823466e+38 ECU_ADDRESS 0 SYMBOL_LINK "Rte_CDDInterface_CorrectedElecMtrPosFloat_Rev_f32" 0 DISPLAY_IDENTIFIER CDDInterface.SenderPorts.CorrectedElecMtrPosFloat.Rev_f32 /end MEASUREMENT
/begin MEASUREMENT CDDInterface.CumMechMtrPos.Rev_f32 "MICROSAR RTE" FLOAT32_IEEE NO_COMPU_METHOD 0 0 1.175494351e-38 3.402823466e+38 ECU_ADDRESS 0 SYMBOL_LINK "Rte_CDDInterface_CumMechMtrPos_Rev_f32" 0 DISPLAY_IDENTIFIER CDDInterface.SenderPorts.CumMechMtrPos.Rev_f32 /end MEASUREMENT
/begin MEASUREMENT CDDInterface.DampingSrlComSvcDft.Cnt_lgc "MICROSAR RTE" UBYTE RTE_CM_BOOLEAN 0 0 0 255 ECU_ADDRESS 0 SYMBOL_LINK "Rte_CDDInterface_DampingSrlComSvcDft_Cnt_lgc" 0 DISPLAY_IDENTIFIER CDDInterface.SenderPorts.DampingSrlComSvcDft.Cnt_lgc /end MEASUREMENT
/begin MEASUREMENT CDDInterface.DftAsstTbl.Cnt_lgc "MICROSAR RTE" UBYTE RTE_CM_BOOLEAN 0 0 0 255 ECU_ADDRESS 0 SYMBOL_LINK "Rte_CDDInterface_DftAsstTbl_Cnt_lgc" 0 DISPLAY_IDENTIFIER CDDInterface.SenderPorts.DftAsstTbl.Cnt_lgc /end MEASUREMENT
/begin MEASUREMENT CDDInterface.Die1RxError.Cnt_u16 "MICROSAR RTE" UWORD NO_COMPU_METHOD 0 0 0 65535 ECU_ADDRESS 0 SYMBOL_LINK "Rte_CDDInterface_Die1RxError_Cnt_u16" 0 DISPLAY_IDENTIFIER CDDInterface.SenderPorts.Die1RxError.Cnt_u16 /end MEASUREMENT
/begin MEASUREMENT CDDInterface.Die1RxMtrPos.Cnt_u16 "MICROSAR RTE" UWORD NO_COMPU_METHOD 0 0 0 65535 ECU_ADDRESS 0 SYMBOL_LINK "Rte_CDDInterface_Die1RxMtrPos_Cnt_u16" 0 DISPLAY_IDENTIFIER CDDInterface.SenderPorts.Die1RxMtrPos.Cnt_u16 /end MEASUREMENT
/begin MEASUREMENT CDDInterface.Die1RxRevCtr.Cnt_u16 "MICROSAR RTE" UWORD NO_COMPU_METHOD 0 0 0 65535 ECU_ADDRESS 0 SYMBOL_LINK "Rte_CDDInterface_Die1RxRevCtr_Cnt_u16" 0 DISPLAY_IDENTIFIER CDDInterface.SenderPorts.Die1RxRevCtr.Cnt_u16 /end MEASUREMENT
/begin MEASUREMENT CDDInterface.Die1UnderVoltgFltAccum.Cnt_u16 "MICROSAR RTE" UWORD NO_COMPU_METHOD 0 0 0 65535 ECU_ADDRESS 0 SYMBOL_LINK "Rte_CDDInterface_Die1UnderVoltgFltAccum_Cnt_u16" 0 DISPLAY_IDENTIFIER CDDInterface.SenderPorts.Die1UnderVoltgFltAccum.Cnt_u16 /end MEASUREMENT
/begin MEASUREMENT CDDInterface.Die2RxError.Cnt_u16 "MICROSAR RTE" UWORD NO_COMPU_METHOD 0 0 0 65535 ECU_ADDRESS 0 SYMBOL_LINK "Rte_CDDInterface_Die2RxError_Cnt_u16" 0 DISPLAY_IDENTIFIER CDDInterface.SenderPorts.Die2RxError.Cnt_u16 /end MEASUREMENT
/begin MEASUREMENT CDDInterface.Die2RxMtrPos.Cnt_u16 "MICROSAR RTE" UWORD NO_COMPU_METHOD 0 0 0 65535 ECU_ADDRESS 0 SYMBOL_LINK "Rte_CDDInterface_Die2RxMtrPos_Cnt_u16" 0 DISPLAY_IDENTIFIER CDDInterface.SenderPorts.Die2RxMtrPos.Cnt_u16 /end MEASUREMENT
/begin MEASUREMENT CDDInterface.Die2RxRevCtr.Cnt_u16 "MICROSAR RTE" UWORD NO_COMPU_METHOD 0 0 0 65535 ECU_ADDRESS 0 SYMBOL_LINK "Rte_CDDInterface_Die2RxRevCtr_Cnt_u16" 0 DISPLAY_IDENTIFIER CDDInterface.SenderPorts.Die2RxRevCtr.Cnt_u16 /end MEASUREMENT
/begin MEASUREMENT CDDInterface.DisableCEBusNormComm.Cnt_lgc "MICROSAR RTE" UBYTE RTE_CM_BOOLEAN 0 0 0 255 ECU_ADDRESS 0 SYMBOL_LINK "Rte_CDDInterface_DisableCEBusNormComm_Cnt_lgc" 0 DISPLAY_IDENTIFIER CDDInterface.SenderPorts.DisableCEBusNormComm.Cnt_lgc /end MEASUREMENT
/begin MEASUREMENT CDDInterface.DisableHSBusNormComm.Cnt_lgc "MICROSAR RTE" UBYTE RTE_CM_BOOLEAN 0 0 0 255 ECU_ADDRESS 0 SYMBOL_LINK "Rte_CDDInterface_DisableHSBusNormComm_Cnt_lgc" 0 DISPLAY_IDENTIFIER CDDInterface.SenderPorts.DisableHSBusNormComm.Cnt_lgc /end MEASUREMENT
/begin MEASUREMENT CDDInterface.DrivingDynSrlComSvcDft.Cnt_lgc "MICROSAR RTE" UBYTE RTE_CM_BOOLEAN 0 0 0 255 ECU_ADDRESS 0 SYMBOL_LINK "Rte_CDDInterface_DrivingDynSrlComSvcDft_Cnt_lgc" 0 DISPLAY_IDENTIFIER CDDInterface.SenderPorts.DrivingDynSrlComSvcDft.Cnt_lgc /end MEASUREMENT
/begin MEASUREMENT CDDInterface.DwnldAsstGain.Uls_f32 "MICROSAR RTE" FLOAT32_IEEE NO_COMPU_METHOD 0 0 1.175494351e-38 3.402823466e+38 ECU_ADDRESS 0 SYMBOL_LINK "Rte_CDDInterface_DwnldAsstGain_Uls_f32" 0 DISPLAY_IDENTIFIER CDDInterface.SenderPorts.DwnldAsstGain.Uls_f32 /end MEASUREMENT
/begin MEASUREMENT CDDInterface.EOTImpactSrlComSvcDft.Cnt_lgc "MICROSAR RTE" UBYTE RTE_CM_BOOLEAN 0 0 0 255 ECU_ADDRESS 0 SYMBOL_LINK "Rte_CDDInterface_EOTImpactSrlComSvcDft_Cnt_lgc" 0 DISPLAY_IDENTIFIER CDDInterface.SenderPorts.EOTImpactSrlComSvcDft.Cnt_lgc /end MEASUREMENT
/begin MEASUREMENT CDDInterface.EOTThermalSrlComSvcDft.Cnt_lgc "MICROSAR RTE" UBYTE RTE_CM_BOOLEAN 0 0 0 255 ECU_ADDRESS 0 SYMBOL_LINK "Rte_CDDInterface_EOTThermalSrlComSvcDft_Cnt_lgc" 0 DISPLAY_IDENTIFIER CDDInterface.SenderPorts.EOTThermalSrlComSvcDft.Cnt_lgc /end MEASUREMENT
/begin MEASUREMENT CDDInterface.EngONSrlComSvcDft.Cnt_lgc "MICROSAR RTE" UBYTE RTE_CM_BOOLEAN 0 0 0 255 ECU_ADDRESS 0 SYMBOL_LINK "Rte_CDDInterface_EngONSrlComSvcDft_Cnt_lgc" 0 DISPLAY_IDENTIFIER CDDInterface.SenderPorts.EngONSrlComSvcDft.Cnt_lgc /end MEASUREMENT
/begin MEASUREMENT CDDInterface.ExpectedOnTimeA.Cnt_u32 "MICROSAR RTE" ULONG NO_COMPU_METHOD 0 0 0 4294967295 ECU_ADDRESS 0 SYMBOL_LINK "Rte_CDDInterface_ExpectedOnTimeA_Cnt_u32" 0 DISPLAY_IDENTIFIER CDDInterface.SenderPorts.ExpectedOnTimeA.Cnt_u32 /end MEASUREMENT
/begin MEASUREMENT CDDInterface.ExpectedOnTimeB.Cnt_u32 "MICROSAR RTE" ULONG NO_COMPU_METHOD 0 0 0 4294967295 ECU_ADDRESS 0 SYMBOL_LINK "Rte_CDDInterface_ExpectedOnTimeB_Cnt_u32" 0 DISPLAY_IDENTIFIER CDDInterface.SenderPorts.ExpectedOnTimeB.Cnt_u32 /end MEASUREMENT
/begin MEASUREMENT CDDInterface.ExpectedOnTimeC.Cnt_u32 "MICROSAR RTE" ULONG NO_COMPU_METHOD 0 0 0 4294967295 ECU_ADDRESS 0 SYMBOL_LINK "Rte_CDDInterface_ExpectedOnTimeC_Cnt_u32" 0 DISPLAY_IDENTIFIER CDDInterface.SenderPorts.ExpectedOnTimeC.Cnt_u32 /end MEASUREMENT
/begin MEASUREMENT CDDInterface.FreqDepDmpSrlComSvcDft.Cnt_lgc "MICROSAR RTE" UBYTE RTE_CM_BOOLEAN 0 0 0 255 ECU_ADDRESS 0 SYMBOL_LINK "Rte_CDDInterface_FreqDepDmpSrlComSvcDft_Cnt_lgc" 0 DISPLAY_IDENTIFIER CDDInterface.SenderPorts.FreqDepDmpSrlComSvcDft.Cnt_lgc /end MEASUREMENT
/begin MEASUREMENT CDDInterface.FricLrnSrlComSvcDft.Cnt_lgc "MICROSAR RTE" UBYTE RTE_CM_BOOLEAN 0 0 0 255 ECU_ADDRESS 0 SYMBOL_LINK "Rte_CDDInterface_FricLrnSrlComSvcDft_Cnt_lgc" 0 DISPLAY_IDENTIFIER CDDInterface.SenderPorts.FricLrnSrlComSvcDft.Cnt_lgc /end MEASUREMENT
/begin MEASUREMENT CDDInterface.HysAddSrlComSvcDft.Cnt_lgc "MICROSAR RTE" UBYTE RTE_CM_BOOLEAN 0 0 0 255 ECU_ADDRESS 0 SYMBOL_LINK "Rte_CDDInterface_HysAddSrlComSvcDft_Cnt_lgc" 0 DISPLAY_IDENTIFIER CDDInterface.SenderPorts.HysAddSrlComSvcDft.Cnt_lgc /end MEASUREMENT
/begin MEASUREMENT CDDInterface.HystCompSrlComSvcDft.Cnt_lgc "MICROSAR RTE" UBYTE RTE_CM_BOOLEAN 0 0 0 255 ECU_ADDRESS 0 SYMBOL_LINK "Rte_CDDInterface_HystCompSrlComSvcDft_Cnt_lgc" 0 DISPLAY_IDENTIFIER CDDInterface.SenderPorts.HystCompSrlComSvcDft.Cnt_lgc /end MEASUREMENT
/begin MEASUREMENT CDDInterface.IgnCnt.Cnt_u16 "MICROSAR RTE" UWORD NO_COMPU_METHOD 0 0 0 65535 ECU_ADDRESS 0 SYMBOL_LINK "Rte_CDDInterface_IgnCnt_Cnt_u16" 0 DISPLAY_IDENTIFIER CDDInterface.SenderPorts.IgnCnt.Cnt_u16 /end MEASUREMENT
/begin MEASUREMENT CDDInterface.KinIntDiagSrlComSvcDft.Cnt_lgc "MICROSAR RTE" UBYTE RTE_CM_BOOLEAN 0 0 0 255 ECU_ADDRESS 0 SYMBOL_LINK "Rte_CDDInterface_KinIntDiagSrlComSvcDft_Cnt_lgc" 0 DISPLAY_IDENTIFIER CDDInterface.SenderPorts.KinIntDiagSrlComSvcDft.Cnt_lgc /end MEASUREMENT
/begin MEASUREMENT CDDInterface.LRPRPhaseadvanceCaptured.Cnt_s16 "MICROSAR RTE" SWORD NO_COMPU_METHOD 0 0 -32768 32767 ECU_ADDRESS 0 SYMBOL_LINK "Rte_CDDInterface_LRPRPhaseadvanceCaptured_Cnt_s16" 0 DISPLAY_IDENTIFIER CDDInterface.SenderPorts.LRPRPhaseadvanceCaptured.Cnt_s16 /end MEASUREMENT
/begin MEASUREMENT CDDInterface.LimitSrlComSvcDft.Cnt_lgc "MICROSAR RTE" UBYTE RTE_CM_BOOLEAN 0 0 0 255 ECU_ADDRESS 0 SYMBOL_LINK "Rte_CDDInterface_LimitSrlComSvcDft_Cnt_lgc" 0 DISPLAY_IDENTIFIER CDDInterface.SenderPorts.LimitSrlComSvcDft.Cnt_lgc /end MEASUREMENT
/begin MEASUREMENT CDDInterface.MEC.Cnt_enum "MICROSAR RTE" UBYTE RTE_CM_ENUM_ManufModeType 0 0 0 2 ECU_ADDRESS 0 SYMBOL_LINK "Rte_CDDInterface_MEC_Cnt_enum" 0 DISPLAY_IDENTIFIER CDDInterface.SenderPorts.MEC.Cnt_enum /end MEASUREMENT
/begin MEASUREMENT CDDInterface.MRFMtrVel.MtrRadpS_f32 "MICROSAR RTE" FLOAT32_IEEE NO_COMPU_METHOD 0 0 1.175494351e-38 3.402823466e+38 ECU_ADDRESS 0 SYMBOL_LINK "Rte_Sa_MtrVel_MotorVelMRF_MtrRadpS_f32" 0 DISPLAY_IDENTIFIER CDDInterface.ReceiverPorts.MRFMtrVel.MtrRadpS_f32 /end MEASUREMENT
/begin MEASUREMENT CDDInterface.MeasuredOnTimeA.Cnt_u32 "MICROSAR RTE" ULONG NO_COMPU_METHOD 0 0 0 4294967295 ECU_ADDRESS 0 SYMBOL_LINK "Rte_CDDInterface_MeasuredOnTimeA_Cnt_u32" 0 DISPLAY_IDENTIFIER CDDInterface.SenderPorts.MeasuredOnTimeA.Cnt_u32 /end MEASUREMENT
/begin MEASUREMENT CDDInterface.MeasuredOnTimeB.Cnt_u32 "MICROSAR RTE" ULONG NO_COMPU_METHOD 0 0 0 4294967295 ECU_ADDRESS 0 SYMBOL_LINK "Rte_CDDInterface_MeasuredOnTimeB_Cnt_u32" 0 DISPLAY_IDENTIFIER CDDInterface.SenderPorts.MeasuredOnTimeB.Cnt_u32 /end MEASUREMENT
/begin MEASUREMENT CDDInterface.MeasuredOnTimeC.Cnt_u32 "MICROSAR RTE" ULONG NO_COMPU_METHOD 0 0 0 4294967295 ECU_ADDRESS 0 SYMBOL_LINK "Rte_CDDInterface_MeasuredOnTimeC_Cnt_u32" 0 DISPLAY_IDENTIFIER CDDInterface.SenderPorts.MeasuredOnTimeC.Cnt_u32 /end MEASUREMENT
/begin MEASUREMENT CDDInterface.MechMtrPos1TimeStamp.USec_u32 "MICROSAR RTE" ULONG NO_COMPU_METHOD 0 0 0 4294967295 ECU_ADDRESS 0 SYMBOL_LINK "Rte_CDDInterface_MechMtrPos1TimeStamp_USec_u32" 0 DISPLAY_IDENTIFIER CDDInterface.SenderPorts.MechMtrPos1TimeStamp.USec_u32 /end MEASUREMENT
/begin MEASUREMENT CDDInterface.MechMtrPos2TimeStamp.USec_u32 "MICROSAR RTE" ULONG NO_COMPU_METHOD 0 0 0 4294967295 ECU_ADDRESS 0 SYMBOL_LINK "Rte_CDDInterface_MechMtrPos2TimeStamp_USec_u32" 0 DISPLAY_IDENTIFIER CDDInterface.SenderPorts.MechMtrPos2TimeStamp.USec_u32 /end MEASUREMENT
/begin MEASUREMENT CDDInterface.MfgDiagInhibit.Cnt_lgc "MICROSAR RTE" UBYTE RTE_CM_BOOLEAN 0 0 0 255 ECU_ADDRESS 0 SYMBOL_LINK "Rte_CDDInterface_MfgDiagInhibit_Cnt_lgc" 0 DISPLAY_IDENTIFIER CDDInterface.SenderPorts.MfgDiagInhibit.Cnt_lgc /end MEASUREMENT
/begin MEASUREMENT CDDInterface.ModIdxFinal.Uls_f32 "MICROSAR RTE" FLOAT32_IEEE NO_COMPU_METHOD 0 0 1.175494351e-38 3.402823466e+38 ECU_ADDRESS 0 SYMBOL_LINK "Rte_CDDInterface_ModIdxFinal_Uls_f32" 0 DISPLAY_IDENTIFIER CDDInterface.SenderPorts.ModIdxFinal.Uls_f32 /end MEASUREMENT
/begin MEASUREMENT CDDInterface.ModIdxSrlComSvcDft.Cnt_lgc "MICROSAR RTE" UBYTE RTE_CM_BOOLEAN 0 0 0 255 ECU_ADDRESS 0 SYMBOL_LINK "Rte_CDDInterface_ModIdxSrlComSvcDft_Cnt_lgc" 0 DISPLAY_IDENTIFIER CDDInterface.SenderPorts.ModIdxSrlComSvcDft.Cnt_lgc /end MEASUREMENT
/begin MEASUREMENT CDDInterface.MtrCurr1TempOffset.Volt_f32 "This signal is intended to communicate any type voltage signal measured by the ecu.  This signal has a lower limit of 0 which reequires users of the signal to provide divide by 0 protection if it is used as a denominator in a calculation.  See Vecu port p" FLOAT32_IEEE NO_COMPU_METHOD 0 0 1.175494351e-38 3.402823466e+38 ECU_ADDRESS 0 SYMBOL_LINK "Rte_CmMtrCurr_MtrCurr1TempOffset_Volt_f32" 0 DISPLAY_IDENTIFIER CDDInterface.ReceiverPorts.MtrCurr1TempOffset.Volt_f32 /end MEASUREMENT
/begin MEASUREMENT CDDInterface.MtrCurr2TempOffset.Volt_f32 "This signal is intended to communicate any type voltage signal measured by the ecu.  This signal has a lower limit of 0 which reequires users of the signal to provide divide by 0 protection if it is used as a denominator in a calculation.  See Vecu port p" FLOAT32_IEEE NO_COMPU_METHOD 0 0 1.175494351e-38 3.402823466e+38 ECU_ADDRESS 0 SYMBOL_LINK "Rte_CmMtrCurr_MtrCurr2TempOffset_Volt_f32" 0 DISPLAY_IDENTIFIER CDDInterface.ReceiverPorts.MtrCurr2TempOffset.Volt_f32 /end MEASUREMENT
/begin MEASUREMENT CDDInterface.MtrCurrDax.Amp_f32 "MICROSAR RTE" FLOAT32_IEEE NO_COMPU_METHOD 0 0 1.175494351e-38 3.402823466e+38 ECU_ADDRESS 0 SYMBOL_LINK "Rte_CDDInterface_MtrCurrDax_Amp_f32" 0 DISPLAY_IDENTIFIER CDDInterface.SenderPorts.MtrCurrDax.Amp_f32 /end MEASUREMENT
/begin MEASUREMENT CDDInterface.MtrCurrK1.Amp_f32 "MICROSAR RTE" FLOAT32_IEEE NO_COMPU_METHOD 0 0 1.175494351e-38 3.402823466e+38 ECU_ADDRESS 0 SYMBOL_LINK "Rte_CDDInterface_MtrCurrK1_Amp_f32" 0 DISPLAY_IDENTIFIER CDDInterface.SenderPorts.MtrCurrK1.Amp_f32 /end MEASUREMENT
/begin MEASUREMENT CDDInterface.MtrCurrK2.Amp_f32 "MICROSAR RTE" FLOAT32_IEEE NO_COMPU_METHOD 0 0 1.175494351e-38 3.402823466e+38 ECU_ADDRESS 0 SYMBOL_LINK "Rte_CDDInterface_MtrCurrK2_Amp_f32" 0 DISPLAY_IDENTIFIER CDDInterface.SenderPorts.MtrCurrK2.Amp_f32 /end MEASUREMENT
/begin MEASUREMENT CDDInterface.MtrCurrQax.Amp_f32 "MICROSAR RTE" FLOAT32_IEEE NO_COMPU_METHOD 0 0 1.175494351e-38 3.402823466e+38 ECU_ADDRESS 0 SYMBOL_LINK "Rte_CDDInterface_MtrCurrQax_Amp_f32" 0 DISPLAY_IDENTIFIER CDDInterface.SenderPorts.MtrCurrQax.Amp_f32 /end MEASUREMENT
/begin MEASUREMENT CDDInterface.MtrCurrQaxFinalRef.Amp_f32 "MICROSAR RTE" FLOAT32_IEEE NO_COMPU_METHOD 0 0 1.175494351e-38 3.402823466e+38 ECU_ADDRESS 0 SYMBOL_LINK "Rte_CDDInterface_MtrCurrQaxFinalRef_Amp_f32" 0 DISPLAY_IDENTIFIER CDDInterface.SenderPorts.MtrCurrQaxFinalRef.Amp_f32 /end MEASUREMENT
/begin MEASUREMENT CDDInterface.MtrElecMechPolarity.Cnt_s08 "MICROSAR RTE" SBYTE NO_COMPU_METHOD 0 0 -128 127 ECU_ADDRESS 0 SYMBOL_LINK "Rte_Polarity_MtrElecMechPolarity_Cnt_s08" 0 DISPLAY_IDENTIFIER CDDInterface.ReceiverPorts.MtrElecMechPolarity.Cnt_s08 /end MEASUREMENT
/begin MEASUREMENT CDDInterface.MtrParmNrmLrnSrlComSvcDft.Cnt_lgc "MICROSAR RTE" UBYTE RTE_CM_BOOLEAN 0 0 0 255 ECU_ADDRESS 0 SYMBOL_LINK "Rte_CDDInterface_MtrParmNrmLrnSrlComSvcDft_Cnt_lgc" 0 DISPLAY_IDENTIFIER CDDInterface.SenderPorts.MtrParmNrmLrnSrlComSvcDft.Cnt_lgc /end MEASUREMENT
/begin MEASUREMENT CDDInterface.MtrPosPolarity.Cnt_s08 "MICROSAR RTE" SBYTE NO_COMPU_METHOD 0 0 -128 127 ECU_ADDRESS 0 SYMBOL_LINK "Rte_Polarity_MtrPosPolarity_Cnt_s08" 0 DISPLAY_IDENTIFIER CDDInterface.ReceiverPorts.MtrPosPolarity.Cnt_s08 /end MEASUREMENT
/begin MEASUREMENT CDDInterface.MtrTrqCmdSign.Cnt_s16 "MICROSAR RTE" SWORD NO_COMPU_METHOD 0 0 -32768 32767 ECU_ADDRESS 0 SYMBOL_LINK "Rte_CDDInterface_MtrTrqCmdSign_Cnt_s16" 0 DISPLAY_IDENTIFIER CDDInterface.ReceiverPorts.MtrTrqCmdSign.Cnt_s16 /end MEASUREMENT
/begin MEASUREMENT CDDInterface.MtrVelNrmLrnSrlComSvcDft.Cnt_lgc "MICROSAR RTE" UBYTE RTE_CM_BOOLEAN 0 0 0 255 ECU_ADDRESS 0 SYMBOL_LINK "Rte_CDDInterface_MtrVelNrmLrnSrlComSvcDft_Cnt_lgc" 0 DISPLAY_IDENTIFIER CDDInterface.SenderPorts.MtrVelNrmLrnSrlComSvcDft.Cnt_lgc /end MEASUREMENT
/begin MEASUREMENT CDDInterface.MultIgnSrlComSvcDft.Cnt_lgc "MICROSAR RTE" UBYTE RTE_CM_BOOLEAN 0 0 0 255 ECU_ADDRESS 0 SYMBOL_LINK "Rte_CDDInterface_MultIgnSrlComSvcDft_Cnt_lgc" 0 DISPLAY_IDENTIFIER CDDInterface.SenderPorts.MultIgnSrlComSvcDft.Cnt_lgc /end MEASUREMENT
/begin MEASUREMENT CDDInterface.ParkAstSrlComSvcDft.Cnt_lgc "MICROSAR RTE" UBYTE RTE_CM_BOOLEAN 0 0 0 255 ECU_ADDRESS 0 SYMBOL_LINK "Rte_CDDInterface_ParkAstSrlComSvcDft_Cnt_lgc" 0 DISPLAY_IDENTIFIER CDDInterface.SenderPorts.ParkAstSrlComSvcDft.Cnt_lgc /end MEASUREMENT
/begin MEASUREMENT CDDInterface.PosTrajEnable.Cnt_lgc "MICROSAR RTE" UBYTE RTE_CM_BOOLEAN 0 0 0 255 ECU_ADDRESS 0 SYMBOL_LINK "Rte_CDDInterface_PosTrajEnable_Cnt_lgc" 0 DISPLAY_IDENTIFIER CDDInterface.SenderPorts.PosTrajEnable.Cnt_lgc /end MEASUREMENT
/begin MEASUREMENT CDDInterface.PullCompLrnSrlComSvcDft.Cnt_lgc "MICROSAR RTE" UBYTE RTE_CM_BOOLEAN 0 0 0 255 ECU_ADDRESS 0 SYMBOL_LINK "Rte_CDDInterface_PullCompLrnSrlComSvcDft_Cnt_lgc" 0 DISPLAY_IDENTIFIER CDDInterface.SenderPorts.PullCompLrnSrlComSvcDft.Cnt_lgc /end MEASUREMENT
/begin MEASUREMENT CDDInterface.PullCompSrlComSvcDft.Cnt_lgc "MICROSAR RTE" UBYTE RTE_CM_BOOLEAN 0 0 0 255 ECU_ADDRESS 0 SYMBOL_LINK "Rte_CDDInterface_PullCompSrlComSvcDft_Cnt_lgc" 0 DISPLAY_IDENTIFIER CDDInterface.SenderPorts.PullCompSrlComSvcDft.Cnt_lgc /end MEASUREMENT
/begin MEASUREMENT CDDInterface.ReturnSrlComSvcDft.Cnt_lgc "MICROSAR RTE" UBYTE RTE_CM_BOOLEAN 0 0 0 255 ECU_ADDRESS 0 SYMBOL_LINK "Rte_CDDInterface_ReturnSrlComSvcDft_Cnt_lgc" 0 DISPLAY_IDENTIFIER CDDInterface.SenderPorts.ReturnSrlComSvcDft.Cnt_lgc /end MEASUREMENT
/begin MEASUREMENT CDDInterface.RxMsgsSrlComSvcDft.Cnt_lgc "MICROSAR RTE" UBYTE RTE_CM_BOOLEAN 0 0 0 255 ECU_ADDRESS 0 SYMBOL_LINK "Rte_CDDInterface_RxMsgsSrlComSvcDft_Cnt_lgc" 0 DISPLAY_IDENTIFIER CDDInterface.SenderPorts.RxMsgsSrlComSvcDft.Cnt_lgc /end MEASUREMENT
/begin MEASUREMENT CDDInterface.RxMtrPos1ParityAccum.Cnt_u16 "MICROSAR RTE" UWORD NO_COMPU_METHOD 0 0 0 65535 ECU_ADDRESS 0 SYMBOL_LINK "Rte_CDDInterface_RxMtrPos1ParityAccum_Cnt_u16" 0 DISPLAY_IDENTIFIER CDDInterface.SenderPorts.RxMtrPos1ParityAccum.Cnt_u16 /end MEASUREMENT
/begin MEASUREMENT CDDInterface.SftEndStpSrlComSvcDft.Cnt_lgc "MICROSAR RTE" UBYTE RTE_CM_BOOLEAN 0 0 0 255 ECU_ADDRESS 0 SYMBOL_LINK "Rte_CDDInterface_SftEndStpSrlComSvcDft_Cnt_lgc" 0 DISPLAY_IDENTIFIER CDDInterface.SenderPorts.SftEndStpSrlComSvcDft.Cnt_lgc /end MEASUREMENT
/begin MEASUREMENT CDDInterface.SrlComSvcDft.Cnt_b32 "MICROSAR RTE" ULONG NO_COMPU_METHOD 0 0 0 4294967295 ECU_ADDRESS 0 SYMBOL_LINK "Rte_CDDInterface_SrlComSvcDft_Cnt_b32" 0 DISPLAY_IDENTIFIER CDDInterface.SenderPorts.SrlComSvcDft.Cnt_b32 /end MEASUREMENT
/begin MEASUREMENT CDDInterface.SysCVSwitchADC.Cnt_u16 "MICROSAR RTE" UWORD NO_COMPU_METHOD 0 0 0 65535 ECU_ADDRESS 0 SYMBOL_LINK "Rte_CDDInterface_SysCVSwitchADC_Cnt_u16" 0 DISPLAY_IDENTIFIER CDDInterface.SenderPorts.SysCVSwitchADC.Cnt_u16 /end MEASUREMENT
/begin MEASUREMENT CDDInterface.SysCorrectedElecMtrPos.Rev_f32 "MICROSAR RTE" FLOAT32_IEEE NO_COMPU_METHOD 0 0 1.175494351e-38 3.402823466e+38 ECU_ADDRESS 0 SYMBOL_LINK "Rte_CDDInterface_SysCorrectedElecMtrPos_Rev_f32" 0 DISPLAY_IDENTIFIER CDDInterface.SenderPorts.SysCorrectedElecMtrPos.Rev_f32 /end MEASUREMENT
/begin MEASUREMENT CDDInterface.SystemState.Mode "MICROSAR RTE" UBYTE RTE_CM_ENUM_StaMd_Mode 0 0 0 255 ECU_ADDRESS 0 SYMBOL_LINK "Rte_ModeMachine_StaMd_SystemState_Mode" 0 DISPLAY_IDENTIFIER CDDInterface.ModeRequirePorts.SystemState.Mode /end MEASUREMENT
/begin MEASUREMENT CDDInterface.ThermalDCSrlComSvcDft.Cnt_lgc "MICROSAR RTE" UBYTE RTE_CM_BOOLEAN 0 0 0 255 ECU_ADDRESS 0 SYMBOL_LINK "Rte_CDDInterface_ThermalDCSrlComSvcDft_Cnt_lgc" 0 DISPLAY_IDENTIFIER CDDInterface.SenderPorts.ThermalDCSrlComSvcDft.Cnt_lgc /end MEASUREMENT
/begin MEASUREMENT CDDInterface.TrqRmpSrlComSvcDft.Cnt_lgc "MICROSAR RTE" UBYTE RTE_CM_BOOLEAN 0 0 0 255 ECU_ADDRESS 0 SYMBOL_LINK "Rte_CDDInterface_TrqRmpSrlComSvcDft_Cnt_lgc" 0 DISPLAY_IDENTIFIER CDDInterface.SenderPorts.TrqRmpSrlComSvcDft.Cnt_lgc /end MEASUREMENT
/begin MEASUREMENT CDDInterface.UncorrMechMtrPos1.Rev_u0p16 "MICROSAR RTE" UWORD NO_COMPU_METHOD 0 0 0 65535 ECU_ADDRESS 0 SYMBOL_LINK "Rte_CDDInterface_UncorrMechMtrPos1_Rev_u0p16" 0 DISPLAY_IDENTIFIER CDDInterface.SenderPorts.UncorrMechMtrPos1.Rev_u0p16 /end MEASUREMENT
/begin MEASUREMENT CDDInterface.Vecu.Volt_f32 "This port prototype is inteded to communicate voltage signals that represent the ecu supplied voltage.  This signal has a lower limit, which is non-zero, to allow users of the signal to use it as a denominator in an expression without requiring a divide b" FLOAT32_IEEE NO_COMPU_METHOD 0 0 1.175494351e-38 3.402823466e+38 ECU_ADDRESS 0 SYMBOL_LINK "Rte_BatteryVoltage_Vecu_Volt_f32" 0 DISPLAY_IDENTIFIER CDDInterface.ReceiverPorts.Vecu.Volt_f32 /end MEASUREMENT
/begin MEASUREMENT CDDInterface.WIRMfgEnabled.Cnt_lgc "MICROSAR RTE" UBYTE RTE_CM_BOOLEAN 0 0 0 255 ECU_ADDRESS 0 SYMBOL_LINK "Rte_CDDInterface_WIRMfgEnabled_Cnt_lgc" 0 DISPLAY_IDENTIFIER CDDInterface.SenderPorts.WIRMfgEnabled.Cnt_lgc /end MEASUREMENT
/begin MEASUREMENT Cd_Nhet1.DigHwTrqT1.HwNm_f32 "MICROSAR RTE" FLOAT32_IEEE NO_COMPU_METHOD 0 0 1.175494351e-38 3.402823466e+38 ECU_ADDRESS 0 SYMBOL_LINK "Rte_Cd_Nhet1_DigHwTrqT1_HwNm_f32" 0 DISPLAY_IDENTIFIER Cd_Nhet1.SenderPorts.DigHwTrqT1.HwNm_f32 /end MEASUREMENT
/begin MEASUREMENT Cd_Nhet1.DigHwTrqT2.HwNm_f32 "MICROSAR RTE" FLOAT32_IEEE NO_COMPU_METHOD 0 0 1.175494351e-38 3.402823466e+38 ECU_ADDRESS 0 SYMBOL_LINK "Rte_Cd_Nhet1_DigHwTrqT2_HwNm_f32" 0 DISPLAY_IDENTIFIER Cd_Nhet1.SenderPorts.DigHwTrqT2.HwNm_f32 /end MEASUREMENT
/begin MEASUREMENT CmMtrCurr.ADCMtrCurr1.Volts_f32 "MICROSAR RTE" FLOAT32_IEEE NO_COMPU_METHOD 0 0 1.175494351e-38 3.402823466e+38 ECU_ADDRESS 0 SYMBOL_LINK "Rte_CDDInterface_ADCMtrCurr1_Volts_f32" 0 DISPLAY_IDENTIFIER CmMtrCurr.ReceiverPorts.ADCMtrCurr1.Volts_f32 /end MEASUREMENT
/begin GROUP Ap_SignlCondn.Vehicle_LonAccel.KphpS_f32 "MICROSAR RTE" /begin SUB_GROUP /end SUB_GROUP /begin FUNCTION_LIST /end FUNCTION_LIST /begin REF_CHARACTERISTIC /end REF_CHARACTERISTIC /begin REF_MEASUREMENT Ap_SignlCondn.Vehicle_LonAccel.KphpS_f32 /end REF_MEASUREMENT /end GROUP
/begin GROUP Ap_StaMd8 "MICROSAR RTE" /begin SUB_GROUP Ap_StaMd8.ModeProvidePorts Ap_StaMd8.ReceiverPorts /end SUB_GROUP /begin FUNCTION_LIST /end FUNCTION_LIST /begin REF_CHARACTERISTIC /end REF_CHARACTERISTIC /begin REF_MEASUREMENT /end REF_MEASUREMENT /end GROUP
/begin GROUP Ap_StaMd8.ATerm.Cnt_lgc "MICROSAR RTE" /begin SUB_GROUP /end SUB_GROUP /begin FUNCTION_LIST /end FUNCTION_LIST /begin REF_CHARACTERISTIC /end REF_CHARACTERISTIC /begin REF_MEASUREMENT Ap_StaMd8.ATerm.Cnt_lgc /end REF_MEASUREMENT /end GROUP
/begin GROUP Ap_StaMd8.CTerm.Cnt_lgc "MICROSAR RTE" /begin SUB_GROUP /end SUB_GROUP /begin FUNCTION_LIST /end FUNCTION_LIST /begin REF_CHARACTERISTIC /end REF_CHARACTERISTIC /begin REF_MEASUREMENT Ap_StaMd8.CTerm.Cnt_lgc /end REF_MEASUREMENT /end GROUP
/begin GROUP Ap_StaMd8.ControlledDampStatusComplete.Cnt_lgc "MICROSAR RTE" /begin SUB_GROUP /end SUB_GROUP /begin FUNCTION_LIST /end FUNCTION_LIST /begin REF_CHARACTERISTIC /end REF_CHARACTERISTIC /begin REF_MEASUREMENT Ap_StaMd8.ControlledDampStatusComplete.Cnt_lgc /end REF_MEASUREMENT /end GROUP
/begin GROUP Ap_StaMd8.FTerm.Cnt_lgc "MICROSAR RTE" /begin SUB_GROUP /end SUB_GROUP /begin FUNCTION_LIST /end FUNCTION_LIST /begin REF_CHARACTERISTIC /end REF_CHARACTERISTIC /begin REF_MEASUREMENT Ap_StaMd8.FTerm.Cnt_lgc /end REF_MEASUREMENT /end GROUP
/begin GROUP Ap_StaMd8.ModeProvidePorts "MICROSAR RTE" /begin SUB_GROUP Ap_StaMd8.SystemState8.Mode /end SUB_GROUP /begin FUNCTION_LIST /end FUNCTION_LIST /begin REF_CHARACTERISTIC /end REF_CHARACTERISTIC /begin REF_MEASUREMENT /end REF_MEASUREMENT /end GROUP
/begin GROUP Ap_StaMd8.RampStatusComplete.Cnt_lgc "MICROSAR RTE" /begin SUB_GROUP /end SUB_GROUP /begin FUNCTION_LIST /end FUNCTION_LIST /begin REF_CHARACTERISTIC /end REF_CHARACTERISTIC /begin REF_MEASUREMENT Ap_StaMd8.RampStatusComplete.Cnt_lgc /end REF_MEASUREMENT /end GROUP
/begin GROUP Ap_StaMd8.ReceiverPorts "MICROSAR RTE"
 /begin SUB_GROUP Ap_StaMd8.ATerm.Cnt_lgc Ap_StaMd8.CTerm.Cnt_lgc Ap_StaMd8.ControlledDampStatusComplete.Cnt_lgc Ap_StaMd8.FTerm.Cnt_lgc Ap_StaMd8.RampStatusComplete.Cnt_lgc Ap_StaMd8.TMFTestComplete.Cnt_lgc /end SUB_GROUP
 /begin FUNCTION_LIST /end FUNCTION_LIST
 /begin REF_CHARACTERISTIC /end REF_CHARACTERISTIC
 /begin REF_MEASUREMENT /end REF_MEASUREMENT
/end GROUP
/begin GROUP Ap_StaMd8.SystemState8.Mode "MICROSAR RTE" /begin SUB_GROUP /end SUB_GROUP /begin FUNCTION_LIST /end FUNCTION_LIST /begin REF_CHARACTERISTIC /end REF_CHARACTERISTIC /begin REF_MEASUREMENT Ap_StaMd8.SystemState8.Mode /end REF_MEASUREMENT /end GROUP
/begin GROUP Ap_StaMd8.TMFTestComplete.Cnt_lgc "MICROSAR RTE" /begin SUB_GROUP /end SUB_GROUP /begin FUNCTION_LIST /end FUNCTION_LIST /begin REF_CHARACTERISTIC /end REF_CHARACTERISTIC /begin REF_MEASUREMENT Ap_StaMd8.TMFTestComplete.Cnt_lgc /end REF_MEASUREMENT /end GROUP
/begin GROUP Ap_StaMd9 "MICROSAR RTE" /begin SUB_GROUP Ap_StaMd9.ModeProvidePorts /end SUB_GROUP /begin FUNCTION_LIST /end FUNCTION_LIST /begin REF_CHARACTERISTIC /end REF_CHARACTERISTIC /begin REF_MEASUREMENT /end REF_MEASUREMENT /end GROUP
/begin GROUP Ap_StaMd9.ModeProvidePorts "MICROSAR RTE" /begin SUB_GROUP Ap_StaMd9.SystemState9.Mode /end SUB_GROUP /begin FUNCTION_LIST /end FUNCTION_LIST /begin REF_CHARACTERISTIC /end REF_CHARACTERISTIC /begin REF_MEASUREMENT /end REF_MEASUREMENT /end GROUP
/begin GROUP Ap_StaMd9.SystemState9.Mode "MICROSAR RTE" /begin SUB_GROUP /end SUB_GROUP /begin FUNCTION_LIST /end FUNCTION_LIST /begin REF_CHARACTERISTIC /end REF_CHARACTERISTIC /begin REF_MEASUREMENT Ap_StaMd9.SystemState9.Mode /end REF_MEASUREMENT /end GROUP
/begin GROUP Ap_StabilityComp2 "MICROSAR RTE"
 /begin SUB_GROUP Ap_StabilityComp2.ReceiverPorts Ap_StabilityComp2.SenderPorts /end SUB_GROUP
 /begin FUNCTION_LIST /end FUNCTION_LIST
 /begin REF_CHARACTERISTIC /end REF_CHARACTERISTIC
 /begin REF_MEASUREMENT /end REF_MEASUREMENT
/end GROUP
/begin GROUP Ap_StabilityComp2.AssistDDFactor.Uls_f32 "MICROSAR RTE" /begin SUB_GROUP /end SUB_GROUP /begin FUNCTION_LIST /end FUNCTION_LIST /begin REF_CHARACTERISTIC /end REF_CHARACTERISTIC /begin REF_MEASUREMENT Ap_StabilityComp2.AssistDDFactor.Uls_f32 /end REF_MEASUREMENT /end GROUP
/begin GROUP Ap_StabilityComp2.AsstFWActive.Uls_f32 "MICROSAR RTE" /begin SUB_GROUP /end SUB_GROUP /begin FUNCTION_LIST /end FUNCTION_LIST /begin REF_CHARACTERISTIC /end REF_CHARACTERISTIC /begin REF_MEASUREMENT Ap_StabilityComp2.AsstFWActive.Uls_f32 /end REF_MEASUREMENT /end GROUP
/begin GROUP Ap_StabilityComp2.CombinedAssist.MtrNm_f32 "MICROSAR RTE" /begin SUB_GROUP /end SUB_GROUP /begin FUNCTION_LIST /end FUNCTION_LIST /begin REF_CHARACTERISTIC /end REF_CHARACTERISTIC /begin REF_MEASUREMENT Ap_StabilityComp2.CombinedAssist.MtrNm_f32 /end REF_MEASUREMENT /end GROUP
/begin GROUP Ap_StabilityComp2.HwTorque.HwNm_f32 "MICROSAR RTE" /begin SUB_GROUP /end SUB_GROUP /begin FUNCTION_LIST /end FUNCTION_LIST /begin REF_CHARACTERISTIC /end REF_CHARACTERISTIC /begin REF_MEASUREMENT Ap_StabilityComp2.HwTorque.HwNm_f32 /end REF_MEASUREMENT /end GROUP
/begin GROUP Ap_StabilityComp2.ReceiverPorts "MICROSAR RTE"
 /begin SUB_GROUP Ap_StabilityComp2.AssistDDFactor.Uls_f32 Ap_StabilityComp2.AsstFWActive.Uls_f32 Ap_StabilityComp2.CombinedAssist.MtrNm_f32 Ap_StabilityComp2.HwTorque.HwNm_f32 Ap_StabilityComp2.VehicleSpeed.Kph_f32 /end SUB_GROUP
 /begin FUNCTION_LIST /end FUNCTION_LIST
 /begin REF_CHARACTERISTIC /end REF_CHARACTERISTIC
 /begin REF_MEASUREMENT /end REF_MEASUREMENT
/end GROUP
/begin GROUP Ap_StabilityComp2.SenderPorts "MICROSAR RTE" /begin SUB_GROUP Ap_StabilityComp2.SysAssistCmd.MtrNm_f32 /end SUB_GROUP /begin FUNCTION_LIST /end FUNCTION_LIST /begin REF_CHARACTERISTIC /end REF_CHARACTERISTIC /begin REF_MEASUREMENT /end REF_MEASUREMENT /end GROUP
/begin GROUP Ap_StabilityComp2.SysAssistCmd.MtrNm_f32 "MICROSAR RTE" /begin SUB_GROUP /end SUB_GROUP /begin FUNCTION_LIST /end FUNCTION_LIST /begin REF_CHARACTERISTIC /end REF_CHARACTERISTIC /begin REF_MEASUREMENT Ap_StabilityComp2.SysAssistCmd.MtrNm_f32 /end REF_MEASUREMENT /end GROUP
/begin GROUP Ap_StabilityComp2.VehicleSpeed.Kph_f32 "MICROSAR RTE" /begin SUB_GROUP /end SUB_GROUP /begin FUNCTION_LIST /end FUNCTION_LIST /begin REF_CHARACTERISTIC /end REF_CHARACTERISTIC /begin REF_MEASUREMENT Ap_StabilityComp2.VehicleSpeed.Kph_f32 /end REF_MEASUREMENT /end GROUP
/begin GROUP Ap_Sweep "MICROSAR RTE" /begin SUB_GROUP Ap_Sweep.ReceiverPorts Ap_Sweep.SenderPorts /end SUB_GROUP /begin FUNCTION_LIST /end FUNCTION_LIST /begin REF_CHARACTERISTIC /end REF_CHARACTERISTIC /begin REF_MEASUREMENT /end REF_MEASUREMENT /end GROUP
/begin GROUP Ap_Sweep.InputHwTrq.HwNm_f32 "MICROSAR RTE" /begin SUB_GROUP /end SUB_GROUP /begin FUNCTION_LIST /end FUNCTION_LIST /begin REF_CHARACTERISTIC /end REF_CHARACTERISTIC /begin REF_MEASUREMENT Ap_Sweep.InputHwTrq.HwNm_f32 /end REF_MEASUREMENT /end GROUP
/begin GROUP Ap_Sweep.OutputHwTrq.HwNm_f32 "MICROSAR RTE" /begin SUB_GROUP /end SUB_GROUP /begin FUNCTION_LIST /end FUNCTION_LIST /begin REF_CHARACTERISTIC /end REF_CHARACTERISTIC /begin REF_MEASUREMENT Ap_Sweep.OutputHwTrq.HwNm_f32 /end REF_MEASUREMENT /end GROUP
/begin GROUP Ap_Sweep.ReceiverPorts "MICROSAR RTE"
 /begin SUB_GROUP Ap_Sweep.InputHwTrq.HwNm_f32 Ap_Sweep.VehSpd.Kph_f32 Ap_Sweep.VehSpdValid.Cnt_lgc /end SUB_GROUP
 /begin FUNCTION_LIST /end FUNCTION_LIST
 /begin REF_CHARACTERISTIC /end REF_CHARACTERISTIC
 /begin REF_MEASUREMENT /end REF_MEASUREMENT
/end GROUP
/begin GROUP Ap_Sweep.SenderPorts "MICROSAR RTE" /begin SUB_GROUP Ap_Sweep.OutputHwTrq.HwNm_f32 /end SUB_GROUP /begin FUNCTION_LIST /end FUNCTION_LIST /begin REF_CHARACTERISTIC /end REF_CHARACTERISTIC /begin REF_MEASUREMENT /end REF_MEASUREMENT /end GROUP
/begin GROUP Ap_Sweep.VehSpd.Kph_f32 "MICROSAR RTE" /begin SUB_GROUP /end SUB_GROUP /begin FUNCTION_LIST /end FUNCTION_LIST /begin REF_CHARACTERISTIC /end REF_CHARACTERISTIC /begin REF_MEASUREMENT Ap_Sweep.VehSpd.Kph_f32 /end REF_MEASUREMENT /end GROUP
/begin GROUP Ap_Sweep.VehSpdValid.Cnt_lgc "MICROSAR RTE" /begin SUB_GROUP /end SUB_GROUP /begin FUNCTION_LIST /end FUNCTION_LIST /begin REF_CHARACTERISTIC /end REF_CHARACTERISTIC /begin REF_MEASUREMENT Ap_Sweep.VehSpdValid.Cnt_lgc /end REF_MEASUREMENT /end GROUP
/begin GROUP Ap_Sweep2 "MICROSAR RTE" /begin SUB_GROUP Ap_Sweep2.ReceiverPorts Ap_Sweep2.SenderPorts /end SUB_GROUP /begin FUNCTION_LIST /end FUNCTION_LIST /begin REF_CHARACTERISTIC /end REF_CHARACTERISTIC /begin REF_MEASUREMENT /end REF_MEASUREMENT /end GROUP
/begin GROUP Ap_Sweep2.InputMtrTrq.MtrNm_f32 "MICROSAR RTE" /begin SUB_GROUP /end SUB_GROUP /begin FUNCTION_LIST /end FUNCTION_LIST /begin REF_CHARACTERISTIC /end REF_CHARACTERISTIC /begin REF_MEASUREMENT Ap_Sweep2.InputMtrTrq.MtrNm_f32 /end REF_MEASUREMENT /end GROUP
/begin GROUP Ap_Sweep2.OutputMtrTrq.MtrNm_f32 "MICROSAR RTE" /begin SUB_GROUP /end SUB_GROUP /begin FUNCTION_LIST /end FUNCTION_LIST /begin REF_CHARACTERISTIC /end REF_CHARACTERISTIC /begin REF_MEASUREMENT Ap_Sweep2.OutputMtrTrq.MtrNm_f32 /end REF_MEASUREMENT /end GROUP
/begin GROUP Ap_Sweep2.ReceiverPorts "MICROSAR RTE" /begin SUB_GROUP Ap_Sweep2.InputMtrTrq.MtrNm_f32 /end SUB_GROUP /begin FUNCTION_LIST /end FUNCTION_LIST /begin REF_CHARACTERISTIC /end REF_CHARACTERISTIC /begin REF_MEASUREMENT /end REF_MEASUREMENT /end GROUP
/begin GROUP Ap_Sweep2.SenderPorts "MICROSAR RTE" /begin SUB_GROUP Ap_Sweep2.OutputMtrTrq.MtrNm_f32 /end SUB_GROUP /begin FUNCTION_LIST /end FUNCTION_LIST /begin REF_CHARACTERISTIC /end REF_CHARACTERISTIC /begin REF_MEASUREMENT /end REF_MEASUREMENT /end GROUP
/begin GROUP Ap_TSMit "MICROSAR RTE"
 /begin SUB_GROUP Ap_TSMit.PerInstanceMemories Ap_TSMit.ReceiverPorts Ap_TSMit.SenderPorts /end SUB_GROUP
 /begin FUNCTION_LIST /end FUNCTION_LIST
 /begin REF_CHARACTERISTIC /end REF_CHARACTERISTIC
 /begin REF_MEASUREMENT /end REF_MEASUREMENT
/end GROUP
/begin GROUP Ap_TSMit.HandwheelAuthority.Uls_f32 "MICROSAR RTE" /begin SUB_GROUP /end SUB_GROUP /begin FUNCTION_LIST /end FUNCTION_LIST /begin REF_CHARACTERISTIC /end REF_CHARACTERISTIC /begin REF_MEASUREMENT Ap_TSMit.HandwheelAuthority.Uls_f32 /end REF_MEASUREMENT /end GROUP
/begin GROUP Ap_TSMit.HandwheelPosition.HwDeg_f32 "MICROSAR RTE" /begin SUB_GROUP /end SUB_GROUP /begin FUNCTION_LIST /end FUNCTION_LIST /begin REF_CHARACTERISTIC /end REF_CHARACTERISTIC /begin REF_MEASUREMENT Ap_TSMit.HandwheelPosition.HwDeg_f32 /end REF_MEASUREMENT /end GROUP
/begin GROUP Ap_TSMit.HandwheelVelocity.HwRadpS_f32 "MICROSAR RTE" /begin SUB_GROUP /end SUB_GROUP /begin FUNCTION_LIST /end FUNCTION_LIST /begin REF_CHARACTERISTIC /end REF_CHARACTERISTIC /begin REF_MEASUREMENT Ap_TSMit.HandwheelVelocity.HwRadpS_f32 /end REF_MEASUREMENT /end GROUP
/begin GROUP Ap_TSMit.HwTorque.HwNm_f32 "MICROSAR RTE" /begin SUB_GROUP /end SUB_GROUP /begin FUNCTION_LIST /end FUNCTION_LIST /begin REF_CHARACTERISTIC /end REF_CHARACTERISTIC /begin REF_MEASUREMENT Ap_TSMit.HwTorque.HwNm_f32 /end REF_MEASUREMENT /end GROUP
/begin GROUP Ap_TSMit.PerInstanceMemories "MICROSAR RTE" /begin SUB_GROUP Ap_TSMit.TSMitDisableEOL Ap_TSMit.TSMitGainLrn /end SUB_GROUP /begin FUNCTION_LIST /end FUNCTION_LIST /begin REF_CHARACTERISTIC /end REF_CHARACTERISTIC /begin REF_MEASUREMENT /end REF_MEASUREMENT /end GROUP
/begin GROUP Ap_TSMit.PreLimitMtrTrqCmd.MtrNm_f32 "MICROSAR RTE" /begin SUB_GROUP /end SUB_GROUP /begin FUNCTION_LIST /end FUNCTION_LIST /begin REF_CHARACTERISTIC /end REF_CHARACTERISTIC /begin REF_MEASUREMENT Ap_TSMit.PreLimitMtrTrqCmd.MtrNm_f32 /end REF_MEASUREMENT /end GROUP
/begin GROUP Ap_TSMit.ReceiverPorts "MICROSAR RTE"
 /begin SUB_GROUP Ap_TSMit.HandwheelAuthority.Uls_f32 Ap_TSMit.HandwheelPosition.HwDeg_f32 Ap_TSMit.HandwheelVelocity.HwRadpS_f32 Ap_TSMit.HwTorque.HwNm_f32 Ap_TSMit.PreLimitMtrTrqCmd.MtrNm_f32 Ap_TSMit.SrlComABSActive.Cnt_lgc Ap_TSMit.SrlComESCActive.Cnt_lgc Ap_TSMit.SrlComTCSActive.Cnt_lgc Ap_TSMit.SrlComYawRate.DegpS_f32 Ap_TSMit.TSMitDefeat.Cnt_lgc Ap_TSMit.VehicleSpeed.Kph_f32 /end SUB_GROUP
 /begin FUNCTION_LIST /end FUNCTION_LIST
 /begin REF_CHARACTERISTIC /end REF_CHARACTERISTIC
 /begin REF_MEASUREMENT /end REF_MEASUREMENT
/end GROUP
/begin GROUP Ap_TSMit.SenderPorts "MICROSAR RTE"
 /begin SUB_GROUP Ap_TSMit.TSMitCommand.MtrNm_f32 Ap_TSMit.TSMitLearningEnabled.Cnt_lgc /end SUB_GROUP
 /begin FUNCTION_LIST /end FUNCTION_LIST
 /begin REF_CHARACTERISTIC /end REF_CHARACTERISTIC
 /begin REF_MEASUREMENT /end REF_MEASUREMENT
/end GROUP
/begin GROUP Ap_TSMit.SrlComABSActive.Cnt_lgc "MICROSAR RTE" /begin SUB_GROUP /end SUB_GROUP /begin FUNCTION_LIST /end FUNCTION_LIST /begin REF_CHARACTERISTIC /end REF_CHARACTERISTIC /begin REF_MEASUREMENT Ap_TSMit.SrlComABSActive.Cnt_lgc /end REF_MEASUREMENT /end GROUP
/begin GROUP Ap_TSMit.SrlComESCActive.Cnt_lgc "MICROSAR RTE" /begin SUB_GROUP /end SUB_GROUP /begin FUNCTION_LIST /end FUNCTION_LIST /begin REF_CHARACTERISTIC /end REF_CHARACTERISTIC /begin REF_MEASUREMENT Ap_TSMit.SrlComESCActive.Cnt_lgc /end REF_MEASUREMENT /end GROUP
/begin GROUP Ap_TSMit.SrlComTCSActive.Cnt_lgc "MICROSAR RTE" /begin SUB_GROUP /end SUB_GROUP /begin FUNCTION_LIST /end FUNCTION_LIST /begin REF_CHARACTERISTIC /end REF_CHARACTERISTIC /begin REF_MEASUREMENT Ap_TSMit.SrlComTCSActive.Cnt_lgc /end REF_MEASUREMENT /end GROUP
/begin GROUP Ap_TSMit.SrlComYawRate.DegpS_f32 "MICROSAR RTE" /begin SUB_GROUP /end SUB_GROUP /begin FUNCTION_LIST /end FUNCTION_LIST /begin REF_CHARACTERISTIC /end REF_CHARACTERISTIC /begin REF_MEASUREMENT Ap_TSMit.SrlComYawRate.DegpS_f32 /end REF_MEASUREMENT /end GROUP
/begin GROUP Ap_TSMit.TSMitCommand.MtrNm_f32 "MICROSAR RTE" /begin SUB_GROUP /end SUB_GROUP /begin FUNCTION_LIST /end FUNCTION_LIST /begin REF_CHARACTERISTIC /end REF_CHARACTERISTIC /begin REF_MEASUREMENT Ap_TSMit.TSMitCommand.MtrNm_f32 /end REF_MEASUREMENT /end GROUP
/begin GROUP Ap_TSMit.TSMitDefeat.Cnt_lgc "MICROSAR RTE" /begin SUB_GROUP /end SUB_GROUP /begin FUNCTION_LIST /end FUNCTION_LIST /begin REF_CHARACTERISTIC /end REF_CHARACTERISTIC /begin REF_MEASUREMENT Ap_TSMit.TSMitDefeat.Cnt_lgc /end REF_MEASUREMENT /end GROUP
/begin GROUP Ap_TSMit.TSMitDisableEOL "MICROSAR RTE" /begin SUB_GROUP /end SUB_GROUP /begin FUNCTION_LIST /end FUNCTION_LIST /begin REF_CHARACTERISTIC /end REF_CHARACTERISTIC
 /begin REF_MEASUREMENT Ap_TSMit.TSMitDisableEOL.FunctionDisable_Cnt_lgc Ap_TSMit.TSMitDisableEOL.GainLearningDisable_Cnt_lgc /end REF_MEASUREMENT
/end GROUP
/begin GROUP Ap_TSMit.TSMitGainLrn "MICROSAR RTE" /begin SUB_GROUP /end SUB_GROUP /begin FUNCTION_LIST /end FUNCTION_LIST /begin REF_CHARACTERISTIC /end REF_CHARACTERISTIC
 /begin REF_MEASUREMENT Ap_TSMit.TSMitGainLrn.NegTransGainLongTerm_HwNmpTransNm_f32 Ap_TSMit.TSMitGainLrn.PosTransGainLongTerm_HwNmpTransNm_f32 /end REF_MEASUREMENT
/end GROUP
/begin GROUP Ap_TSMit.TSMitLearningEnabled.Cnt_lgc "MICROSAR RTE" /begin SUB_GROUP /end SUB_GROUP /begin FUNCTION_LIST /end FUNCTION_LIST /begin REF_CHARACTERISTIC /end REF_CHARACTERISTIC /begin REF_MEASUREMENT Ap_TSMit.TSMitLearningEnabled.Cnt_lgc /end REF_MEASUREMENT /end GROUP
/begin GROUP Ap_TSMit.VehicleSpeed.Kph_f32 "MICROSAR RTE" /begin SUB_GROUP /end SUB_GROUP /begin FUNCTION_LIST /end FUNCTION_LIST /begin REF_CHARACTERISTIC /end REF_CHARACTERISTIC /begin REF_MEASUREMENT Ap_TSMit.VehicleSpeed.Kph_f32 /end REF_MEASUREMENT /end GROUP
/begin GROUP Ap_ThrmlDutyCycle "MICROSAR RTE"
 /begin SUB_GROUP Ap_ThrmlDutyCycle.ReceiverPorts Ap_ThrmlDutyCycle.SenderPorts /end SUB_GROUP
 /begin FUNCTION_LIST /end FUNCTION_LIST
 /begin REF_CHARACTERISTIC /end REF_CHARACTERISTIC
 /begin REF_MEASUREMENT /end REF_MEASUREMENT
/end GROUP
/begin GROUP Ap_ThrmlDutyCycle.CuTempEst.DegC_f32 "MICROSAR RTE" /begin SUB_GROUP /end SUB_GROUP /begin FUNCTION_LIST /end FUNCTION_LIST /begin REF_CHARACTERISTIC /end REF_CHARACTERISTIC /begin REF_MEASUREMENT Ap_ThrmlDutyCycle.CuTempEst.DegC_f32 /end REF_MEASUREMENT /end GROUP
/begin GROUP Ap_ThrmlDutyCycle.DefeatDutySvc.Cnt_lgc "MICROSAR RTE" /begin SUB_GROUP /end SUB_GROUP /begin FUNCTION_LIST /end FUNCTION_LIST /begin REF_CHARACTERISTIC /end REF_CHARACTERISTIC /begin REF_MEASUREMENT Ap_ThrmlDutyCycle.DefeatDutySvc.Cnt_lgc /end REF_MEASUREMENT /end GROUP
/begin GROUP Ap_ThrmlDutyCycle.DutyCycleLevel.Uls_f32 "MICROSAR RTE" /begin SUB_GROUP /end SUB_GROUP /begin FUNCTION_LIST /end FUNCTION_LIST /begin REF_CHARACTERISTIC /end REF_CHARACTERISTIC /begin REF_MEASUREMENT Ap_ThrmlDutyCycle.DutyCycleLevel.Uls_f32 /end REF_MEASUREMENT /end GROUP
/begin GROUP Ap_ThrmlDutyCycle.FiltMeasTemp.DegC_f32 "MICROSAR RTE" /begin SUB_GROUP /end SUB_GROUP /begin FUNCTION_LIST /end FUNCTION_LIST /begin REF_CHARACTERISTIC /end REF_CHARACTERISTIC /begin REF_MEASUREMENT Ap_ThrmlDutyCycle.FiltMeasTemp.DegC_f32 /end REF_MEASUREMENT /end GROUP
/begin GROUP Ap_ThrmlDutyCycle.FilteredPkCurr.AmpSq_f32 "MICROSAR RTE" /begin SUB_GROUP /end SUB_GROUP /begin FUNCTION_LIST /end FUNCTION_LIST /begin REF_CHARACTERISTIC /end REF_CHARACTERISTIC /begin REF_MEASUREMENT Ap_ThrmlDutyCycle.FilteredPkCurr.AmpSq_f32 /end REF_MEASUREMENT /end GROUP
/begin GROUP Ap_ThrmlDutyCycle.IgnTimeOff.Cnt_u32 "MICROSAR RTE" /begin SUB_GROUP /end SUB_GROUP /begin FUNCTION_LIST /end FUNCTION_LIST /begin REF_CHARACTERISTIC /end REF_CHARACTERISTIC /begin REF_MEASUREMENT Ap_ThrmlDutyCycle.IgnTimeOff.Cnt_u32 /end REF_MEASUREMENT /end GROUP
/begin GROUP Ap_ThrmlDutyCycle.MagTempEst.DegC_f32 "MICROSAR RTE" /begin SUB_GROUP /end SUB_GROUP /begin FUNCTION_LIST /end FUNCTION_LIST /begin REF_CHARACTERISTIC /end REF_CHARACTERISTIC /begin REF_MEASUREMENT Ap_ThrmlDutyCycle.MagTempEst.DegC_f32 /end REF_MEASUREMENT /end GROUP
/begin GROUP Ap_ThrmlDutyCycle.MotorVelCRF.MtrRadpS_f32 "MICROSAR RTE" /begin SUB_GROUP /end SUB_GROUP /begin FUNCTION_LIST /end FUNCTION_LIST /begin REF_CHARACTERISTIC /end REF_CHARACTERISTIC /begin REF_MEASUREMENT Ap_ThrmlDutyCycle.MotorVelCRF.MtrRadpS_f32 /end REF_MEASUREMENT /end GROUP
/begin GROUP Ap_ThrmlDutyCycle.MtrPkCurr.AmpSq_f32 "MICROSAR RTE" /begin SUB_GROUP /end SUB_GROUP /begin FUNCTION_LIST /end FUNCTION_LIST /begin REF_CHARACTERISTIC /end REF_CHARACTERISTIC /begin REF_MEASUREMENT Ap_ThrmlDutyCycle.MtrPkCurr.AmpSq_f32 /end REF_MEASUREMENT /end GROUP
/begin GROUP Ap_ThrmlDutyCycle.ReceiverPorts "MICROSAR RTE"
 /begin SUB_GROUP Ap_ThrmlDutyCycle.CuTempEst.DegC_f32 Ap_ThrmlDutyCycle.DefeatDutySvc.Cnt_lgc Ap_ThrmlDutyCycle.FiltMeasTemp.DegC_f32 Ap_ThrmlDutyCycle.FilteredPkCurr.AmpSq_f32 Ap_ThrmlDutyCycle.IgnTimeOff.Cnt_u32 Ap_ThrmlDutyCycle.MagTempEst.DegC_f32 Ap_ThrmlDutyCycle.MotorVelCRF.MtrRadpS_f32 Ap_ThrmlDutyCycle.MtrPkCurr.AmpSq_f32 Ap_ThrmlDutyCycle.SiTempEst.DegC_f32 Ap_ThrmlDutyCycle.VehTimeValid.Cnt_lgc /end SUB_GROUP
 /begin FUNCTION_LIST /end FUNCTION_LIST
 /begin REF_CHARACTERISTIC /end REF_CHARACTERISTIC
 /begin REF_MEASUREMENT /end REF_MEASUREMENT
/end GROUP
/begin GROUP Ap_ThrmlDutyCycle.SenderPorts "MICROSAR RTE"
 /begin SUB_GROUP Ap_ThrmlDutyCycle.DutyCycleLevel.Uls_f32 Ap_ThrmlDutyCycle.ThermLimitPerc.Uls_f32 Ap_ThrmlDutyCycle.ThermalLimit.MtrNm_f32 /end SUB_GROUP
 /begin FUNCTION_LIST /end FUNCTION_LIST
 /begin REF_CHARACTERISTIC /end REF_CHARACTERISTIC
 /begin REF_MEASUREMENT /end REF_MEASUREMENT
/end GROUP
/begin GROUP Ap_ThrmlDutyCycle.SiTempEst.DegC_f32 "MICROSAR RTE" /begin SUB_GROUP /end SUB_GROUP /begin FUNCTION_LIST /end FUNCTION_LIST /begin REF_CHARACTERISTIC /end REF_CHARACTERISTIC /begin REF_MEASUREMENT Ap_ThrmlDutyCycle.SiTempEst.DegC_f32 /end REF_MEASUREMENT /end GROUP
/begin GROUP Ap_ThrmlDutyCycle.ThermLimitPerc.Uls_f32 "MICROSAR RTE" /begin SUB_GROUP /end SUB_GROUP /begin FUNCTION_LIST /end FUNCTION_LIST /begin REF_CHARACTERISTIC /end REF_CHARACTERISTIC /begin REF_MEASUREMENT Ap_ThrmlDutyCycle.ThermLimitPerc.Uls_f32 /end REF_MEASUREMENT /end GROUP
/begin GROUP Ap_ThrmlDutyCycle.ThermalLimit.MtrNm_f32 "MICROSAR RTE" /begin SUB_GROUP /end SUB_GROUP /begin FUNCTION_LIST /end FUNCTION_LIST /begin REF_CHARACTERISTIC /end REF_CHARACTERISTIC /begin REF_MEASUREMENT Ap_ThrmlDutyCycle.ThermalLimit.MtrNm_f32 /end REF_MEASUREMENT /end GROUP
/begin GROUP Ap_ThrmlDutyCycle.VehTimeValid.Cnt_lgc "MICROSAR RTE" /begin SUB_GROUP /end SUB_GROUP /begin FUNCTION_LIST /end FUNCTION_LIST /begin REF_CHARACTERISTIC /end REF_CHARACTERISTIC /begin REF_MEASUREMENT Ap_ThrmlDutyCycle.VehTimeValid.Cnt_lgc /end REF_MEASUREMENT /end GROUP
/begin GROUP Ap_TqRsDg "MICROSAR RTE" /begin SUB_GROUP Ap_TqRsDg.ModeRequirePorts Ap_TqRsDg.ReceiverPorts /end SUB_GROUP /begin FUNCTION_LIST /end FUNCTION_LIST /begin REF_CHARACTERISTIC /end REF_CHARACTERISTIC /begin REF_MEASUREMENT /end REF_MEASUREMENT /end GROUP
/begin GROUP Ap_TqRsDg.DervLambdaAlphaDiag.Volt_f32 "MICROSAR RTE" /begin SUB_GROUP /end SUB_GROUP /begin FUNCTION_LIST /end FUNCTION_LIST /begin REF_CHARACTERISTIC /end REF_CHARACTERISTIC /begin REF_MEASUREMENT Ap_TqRsDg.DervLambdaAlphaDiag.Volt_f32 /end REF_MEASUREMENT /end GROUP
/begin GROUP Ap_TqRsDg.DervLambdaBetaDiag.Volt_f32 "MICROSAR RTE" /begin SUB_GROUP /end SUB_GROUP /begin FUNCTION_LIST /end FUNCTION_LIST /begin REF_CHARACTERISTIC /end REF_CHARACTERISTIC /begin REF_MEASUREMENT Ap_TqRsDg.DervLambdaBetaDiag.Volt_f32 /end REF_MEASUREMENT /end GROUP
/begin GROUP Ap_TqRsDg.ModeRequirePorts "MICROSAR RTE" /begin SUB_GROUP Ap_TqRsDg.SystemState.Mode /end SUB_GROUP /begin FUNCTION_LIST /end FUNCTION_LIST /begin REF_CHARACTERISTIC /end REF_CHARACTERISTIC /begin REF_MEASUREMENT /end REF_MEASUREMENT /end GROUP
/begin GROUP Ap_TqRsDg.OutputRampMult.Uls_f32 "MICROSAR RTE" /begin SUB_GROUP /end SUB_GROUP /begin FUNCTION_LIST /end FUNCTION_LIST /begin REF_CHARACTERISTIC /end REF_CHARACTERISTIC /begin REF_MEASUREMENT Ap_TqRsDg.OutputRampMult.Uls_f32 /end REF_MEASUREMENT /end GROUP
/begin GROUP Ap_TqRsDg.ReceiverPorts "MICROSAR RTE"
 /begin SUB_GROUP Ap_TqRsDg.DervLambdaAlphaDiag.Volt_f32 Ap_TqRsDg.DervLambdaBetaDiag.Volt_f32 Ap_TqRsDg.OutputRampMult.Uls_f32 Ap_TqRsDg.TrqLimitMin.MtrNm_f32 /end SUB_GROUP
 /begin FUNCTION_LIST /end FUNCTION_LIST
 /begin REF_CHARACTERISTIC /end REF_CHARACTERISTIC
 /begin REF_MEASUREMENT /end REF_MEASUREMENT
/end GROUP
/begin GROUP Ap_TqRsDg.SystemState.Mode "MICROSAR RTE" /begin SUB_GROUP /end SUB_GROUP /begin FUNCTION_LIST /end FUNCTION_LIST /begin REF_CHARACTERISTIC /end REF_CHARACTERISTIC /begin REF_MEASUREMENT Ap_TqRsDg.SystemState.Mode /end REF_MEASUREMENT /end GROUP
/begin GROUP Ap_TqRsDg.TrqLimitMin.MtrNm_f32 "MICROSAR RTE" /begin SUB_GROUP /end SUB_GROUP /begin FUNCTION_LIST /end FUNCTION_LIST /begin REF_CHARACTERISTIC /end REF_CHARACTERISTIC /begin REF_MEASUREMENT Ap_TqRsDg.TrqLimitMin.MtrNm_f32 /end REF_MEASUREMENT /end GROUP
/begin GROUP Ap_TrqArblim "MICROSAR RTE"
 /begin SUB_GROUP Ap_TrqArblim.ModeRequirePorts Ap_TrqArblim.ReceiverPorts Ap_TrqArblim.SenderPorts /end SUB_GROUP
 /begin FUNCTION_LIST /end FUNCTION_LIST
 /begin REF_CHARACTERISTIC /end REF_CHARACTERISTIC
 /begin REF_MEASUREMENT /end REF_MEASUREMENT
/end GROUP
/begin GROUP Ap_TrqArblim.AssistDDFactor.Uls_f32 "MICROSAR RTE" /begin SUB_GROUP /end SUB_GROUP /begin FUNCTION_LIST /end FUNCTION_LIST /begin REF_CHARACTERISTIC /end REF_CHARACTERISTIC /begin REF_MEASUREMENT Ap_TrqArblim.AssistDDFactor.Uls_f32 /end REF_MEASUREMENT /end GROUP
/begin GROUP Ap_TrqArblim.DampingDDFactor.Uls_f32 "MICROSAR RTE" /begin SUB_GROUP /end SUB_GROUP /begin FUNCTION_LIST /end FUNCTION_LIST /begin REF_CHARACTERISTIC /end REF_CHARACTERISTIC /begin REF_MEASUREMENT Ap_TrqArblim.DampingDDFactor.Uls_f32 /end REF_MEASUREMENT /end GROUP
/begin GROUP Ap_TrqArblim.ESCCmd.HwNm_f32 "MICROSAR RTE" /begin SUB_GROUP /end SUB_GROUP /begin FUNCTION_LIST /end FUNCTION_LIST /begin REF_CHARACTERISTIC /end REF_CHARACTERISTIC /begin REF_MEASUREMENT Ap_TrqArblim.ESCCmd.HwNm_f32 /end REF_MEASUREMENT /end GROUP
/begin GROUP Ap_TrqArblim.ESCIsLimited.Cnt_lgc "MICROSAR RTE" /begin SUB_GROUP /end SUB_GROUP /begin FUNCTION_LIST /end FUNCTION_LIST /begin REF_CHARACTERISTIC /end REF_CHARACTERISTIC /begin REF_MEASUREMENT Ap_TrqArblim.ESCIsLimited.Cnt_lgc /end REF_MEASUREMENT /end GROUP
/begin GROUP Ap_TrqArblim.ESCState.State_enum "MICROSAR RTE" /begin SUB_GROUP /end SUB_GROUP /begin FUNCTION_LIST /end FUNCTION_LIST /begin REF_CHARACTERISTIC /end REF_CHARACTERISTIC /begin REF_MEASUREMENT Ap_TrqArblim.ESCState.State_enum /end REF_MEASUREMENT /end GROUP
/begin GROUP Ap_TrqArblim.ESCTorqueDelivered.HwNm_f32 "MICROSAR RTE" /begin SUB_GROUP /end SUB_GROUP /begin FUNCTION_LIST /end FUNCTION_LIST /begin REF_CHARACTERISTIC /end REF_CHARACTERISTIC /begin REF_MEASUREMENT Ap_TrqArblim.ESCTorqueDelivered.HwNm_f32 /end REF_MEASUREMENT /end GROUP
/begin GROUP Ap_TrqArblim.GMOSHOscillate.State_enum "MICROSAR RTE" /begin SUB_GROUP /end SUB_GROUP /begin FUNCTION_LIST /end FUNCTION_LIST /begin REF_CHARACTERISTIC /end REF_CHARACTERISTIC /begin REF_MEASUREMENT Ap_TrqArblim.GMOSHOscillate.State_enum /end REF_MEASUREMENT /end GROUP
/begin GROUP Ap_TrqArblim.HwTorque.HwNm_f32 "MICROSAR RTE" /begin SUB_GROUP /end SUB_GROUP /begin FUNCTION_LIST /end FUNCTION_LIST /begin REF_CHARACTERISTIC /end REF_CHARACTERISTIC /begin REF_MEASUREMENT Ap_TrqArblim.HwTorque.HwNm_f32 /end REF_MEASUREMENT /end GROUP
/begin GROUP Ap_TrqArblim.IqTrqOv.HwNm_f32 "MICROSAR RTE" /begin SUB_GROUP /end SUB_GROUP /begin FUNCTION_LIST /end FUNCTION_LIST /begin REF_CHARACTERISTIC /end REF_CHARACTERISTIC /begin REF_MEASUREMENT Ap_TrqArblim.IqTrqOv.HwNm_f32 /end REF_MEASUREMENT /end GROUP
/begin GROUP Ap_TrqArblim.LKACmd.HwNm_f32 "MICROSAR RTE" /begin SUB_GROUP /end SUB_GROUP /begin FUNCTION_LIST /end FUNCTION_LIST /begin REF_CHARACTERISTIC /end REF_CHARACTERISTIC /begin REF_MEASUREMENT Ap_TrqArblim.LKACmd.HwNm_f32 /end REF_MEASUREMENT /end GROUP
/begin GROUP Ap_TrqArblim.LKAState.State_enum "MICROSAR RTE" /begin SUB_GROUP /end SUB_GROUP /begin FUNCTION_LIST /end FUNCTION_LIST /begin REF_CHARACTERISTIC /end REF_CHARACTERISTIC /begin REF_MEASUREMENT Ap_TrqArblim.LKAState.State_enum /end REF_MEASUREMENT /end GROUP
/begin GROUP Ap_TrqArblim.LKATorqueDelivered.HwNm_f32 "MICROSAR RTE" /begin SUB_GROUP /end SUB_GROUP /begin FUNCTION_LIST /end FUNCTION_LIST /begin REF_CHARACTERISTIC /end REF_CHARACTERISTIC /begin REF_MEASUREMENT Ap_TrqArblim.LKATorqueDelivered.HwNm_f32 /end REF_MEASUREMENT /end GROUP
/begin GROUP Ap_TrqArblim.MaxSecureVehicleSpeed.Kph_f32 "MICROSAR RTE" /begin SUB_GROUP /end SUB_GROUP /begin FUNCTION_LIST /end FUNCTION_LIST /begin REF_CHARACTERISTIC /end REF_CHARACTERISTIC /begin REF_MEASUREMENT Ap_TrqArblim.MaxSecureVehicleSpeed.Kph_f32 /end REF_MEASUREMENT /end GROUP
/begin GROUP Ap_TrqArblim.ModeRequirePorts "MICROSAR RTE" /begin SUB_GROUP Ap_TrqArblim.SystemState.Mode /end SUB_GROUP /begin FUNCTION_LIST /end FUNCTION_LIST /begin REF_CHARACTERISTIC /end REF_CHARACTERISTIC /begin REF_MEASUREMENT /end REF_MEASUREMENT /end GROUP
/begin GROUP Ap_TrqArblim.OpTrqOv.MtrNm_f32 "MICROSAR RTE" /begin SUB_GROUP /end SUB_GROUP /begin FUNCTION_LIST /end FUNCTION_LIST /begin REF_CHARACTERISTIC /end REF_CHARACTERISTIC /begin REF_MEASUREMENT Ap_TrqArblim.OpTrqOv.MtrNm_f32 /end REF_MEASUREMENT /end GROUP
/begin GROUP Ap_TrqArblim.PosServEnable.Cnt_lgc "MICROSAR RTE" /begin SUB_GROUP /end SUB_GROUP /begin FUNCTION_LIST /end FUNCTION_LIST /begin REF_CHARACTERISTIC /end REF_CHARACTERISTIC /begin REF_MEASUREMENT Ap_TrqArblim.PosServEnable.Cnt_lgc /end REF_MEASUREMENT /end GROUP
/begin GROUP Ap_TrqArblim.PosSrvoCmd.MtrNm_f32 "MICROSAR RTE" /begin SUB_GROUP /end SUB_GROUP /begin FUNCTION_LIST /end FUNCTION_LIST /begin REF_CHARACTERISTIC /end REF_CHARACTERISTIC /begin REF_MEASUREMENT Ap_TrqArblim.PosSrvoCmd.MtrNm_f32 /end REF_MEASUREMENT /end GROUP
/begin GROUP Ap_TrqArblim.ReceiverPorts "MICROSAR RTE"
 /begin SUB_GROUP Ap_TrqArblim.ESCCmd.HwNm_f32 Ap_TrqArblim.ESCState.State_enum Ap_TrqArblim.GMOSHOscillate.State_enum Ap_TrqArblim.HwTorque.HwNm_f32 Ap_TrqArblim.LKACmd.HwNm_f32 Ap_TrqArblim.LKAState.State_enum Ap_TrqArblim.MaxSecureVehicleSpeed.Kph_f32 Ap_TrqArblim.PosServEnable.Cnt_lgc Ap_TrqArblim.PosSrvoCmd.MtrNm_f32 Ap_TrqArblim.TrqOscCmd.MtrNm_f32 /end SUB_GROUP
 /begin FUNCTION_LIST /end FUNCTION_LIST
 /begin REF_CHARACTERISTIC /end REF_CHARACTERISTIC
 /begin REF_MEASUREMENT /end REF_MEASUREMENT
/end GROUP
/begin GROUP Ap_TrqArblim.ReturnDDFactor.Uls_f32 "MICROSAR RTE" /begin SUB_GROUP /end SUB_GROUP /begin FUNCTION_LIST /end FUNCTION_LIST /begin REF_CHARACTERISTIC /end REF_CHARACTERISTIC /begin REF_MEASUREMENT Ap_TrqArblim.ReturnDDFactor.Uls_f32 /end REF_MEASUREMENT /end GROUP
/begin GROUP Ap_TrqArblim.SenderPorts "MICROSAR RTE"
 /begin SUB_GROUP Ap_TrqArblim.AssistDDFactor.Uls_f32 Ap_TrqArblim.DampingDDFactor.Uls_f32 Ap_TrqArblim.ESCIsLimited.Cnt_lgc Ap_TrqArblim.ESCTorqueDelivered.HwNm_f32 Ap_TrqArblim.IqTrqOv.HwNm_f32 Ap_TrqArblim.LKATorqueDelivered.HwNm_f32 Ap_TrqArblim.OpTrqOv.MtrNm_f32 Ap_TrqArblim.ReturnDDFactor.Uls_f32 /end SUB_GROUP
 /begin FUNCTION_LIST /end FUNCTION_LIST
 /begin REF_CHARACTERISTIC /end REF_CHARACTERISTIC
 /begin REF_MEASUREMENT /end REF_MEASUREMENT
/end GROUP
/begin GROUP Ap_TrqArblim.SystemState.Mode "MICROSAR RTE" /begin SUB_GROUP /end SUB_GROUP /begin FUNCTION_LIST /end FUNCTION_LIST /begin REF_CHARACTERISTIC /end REF_CHARACTERISTIC /begin REF_MEASUREMENT Ap_TrqArblim.SystemState.Mode /end REF_MEASUREMENT /end GROUP
/begin GROUP Ap_TrqArblim.TrqOscCmd.MtrNm_f32 "MICROSAR RTE" /begin SUB_GROUP /end SUB_GROUP /begin FUNCTION_LIST /end FUNCTION_LIST /begin REF_CHARACTERISTIC /end REF_CHARACTERISTIC /begin REF_MEASUREMENT Ap_TrqArblim.TrqOscCmd.MtrNm_f32 /end REF_MEASUREMENT /end GROUP
/begin GROUP Ap_TrqCanc "MICROSAR RTE" /begin SUB_GROUP Ap_TrqCanc.PerInstanceMemories Ap_TrqCanc.ReceiverPorts /end SUB_GROUP /begin FUNCTION_LIST /end FUNCTION_LIST /begin REF_CHARACTERISTIC /end REF_CHARACTERISTIC /begin REF_MEASUREMENT /end REF_MEASUREMENT /end GROUP
/begin GROUP Ap_TrqCanc.CogTrqCal "MICROSAR RTE" /begin SUB_GROUP /end SUB_GROUP /begin FUNCTION_LIST /end FUNCTION_LIST /begin REF_CHARACTERISTIC /end REF_CHARACTERISTIC /begin REF_MEASUREMENT Ap_TrqCanc.CogTrqCal /end REF_MEASUREMENT /end GROUP
/begin GROUP Ap_TrqCanc.CogTrqRplComp "MICROSAR RTE" /begin SUB_GROUP /end SUB_GROUP /begin FUNCTION_LIST /end FUNCTION_LIST /begin REF_CHARACTERISTIC /end REF_CHARACTERISTIC /begin REF_MEASUREMENT Ap_TrqCanc.CogTrqRplComp /end REF_MEASUREMENT /end GROUP
/begin GROUP Ap_TrqCanc.EstKe.VpRadpS_f32 "MICROSAR RTE" /begin SUB_GROUP /end SUB_GROUP /begin FUNCTION_LIST /end FUNCTION_LIST /begin REF_CHARACTERISTIC /end REF_CHARACTERISTIC /begin REF_MEASUREMENT Ap_TrqCanc.EstKe.VpRadpS_f32 /end REF_MEASUREMENT /end GROUP
/begin GROUP Ap_TrqCanc.EstLd.Henry_f32 "MICROSAR RTE" /begin SUB_GROUP /end SUB_GROUP /begin FUNCTION_LIST /end FUNCTION_LIST /begin REF_CHARACTERISTIC /end REF_CHARACTERISTIC /begin REF_MEASUREMENT Ap_TrqCanc.EstLd.Henry_f32 /end REF_MEASUREMENT /end GROUP
/begin GROUP Ap_TrqCanc.EstLq.Henry_f32 "MICROSAR RTE" /begin SUB_GROUP /end SUB_GROUP /begin FUNCTION_LIST /end FUNCTION_LIST /begin REF_CHARACTERISTIC /end REF_CHARACTERISTIC /begin REF_MEASUREMENT Ap_TrqCanc.EstLq.Henry_f32 /end REF_MEASUREMENT /end GROUP
/begin GROUP Ap_TrqCanc.MRFMtrVel.MtrRadpS_f32 "MICROSAR RTE" /begin SUB_GROUP /end SUB_GROUP /begin FUNCTION_LIST /end FUNCTION_LIST /begin REF_CHARACTERISTIC /end REF_CHARACTERISTIC /begin REF_MEASUREMENT Ap_TrqCanc.MRFMtrVel.MtrRadpS_f32 /end REF_MEASUREMENT /end GROUP
/begin GROUP Ap_TrqCanc.MtrCurrDaxRef.Amp_f32 "MICROSAR RTE" /begin SUB_GROUP /end SUB_GROUP /begin FUNCTION_LIST /end FUNCTION_LIST /begin REF_CHARACTERISTIC /end REF_CHARACTERISTIC /begin REF_MEASUREMENT Ap_TrqCanc.MtrCurrDaxRef.Amp_f32 /end REF_MEASUREMENT /end GROUP
/begin GROUP Ap_TrqCanc.MtrCurrQaxRef.Amp_f32 "MICROSAR RTE" /begin SUB_GROUP /end SUB_GROUP /begin FUNCTION_LIST /end FUNCTION_LIST /begin REF_CHARACTERISTIC /end REF_CHARACTERISTIC /begin REF_MEASUREMENT Ap_TrqCanc.MtrCurrQaxRef.Amp_f32 /end REF_MEASUREMENT /end GROUP
/begin GROUP Ap_TrqCanc.MtrTrqCmdMRFScl.MtrNm_f32 "MICROSAR RTE" /begin SUB_GROUP /end SUB_GROUP /begin FUNCTION_LIST /end FUNCTION_LIST /begin REF_CHARACTERISTIC /end REF_CHARACTERISTIC /begin REF_MEASUREMENT Ap_TrqCanc.MtrTrqCmdMRFScl.MtrNm_f32 /end REF_MEASUREMENT /end GROUP
/begin GROUP Ap_TrqCanc.PerInstanceMemories "MICROSAR RTE" /begin SUB_GROUP Ap_TrqCanc.CogTrqCal Ap_TrqCanc.CogTrqRplComp /end SUB_GROUP /begin FUNCTION_LIST /end FUNCTION_LIST /begin REF_CHARACTERISTIC /end REF_CHARACTERISTIC /begin REF_MEASUREMENT /end REF_MEASUREMENT /end GROUP
/begin GROUP Ap_TrqCanc.ReceiverPorts "MICROSAR RTE"
 /begin SUB_GROUP Ap_TrqCanc.EstKe.VpRadpS_f32 Ap_TrqCanc.EstLd.Henry_f32 Ap_TrqCanc.EstLq.Henry_f32 Ap_TrqCanc.MRFMtrVel.MtrRadpS_f32 Ap_TrqCanc.MtrCurrDaxRef.Amp_f32 Ap_TrqCanc.MtrCurrQaxRef.Amp_f32 Ap_TrqCanc.MtrTrqCmdMRFScl.MtrNm_f32 /end SUB_GROUP
 /begin FUNCTION_LIST /end FUNCTION_LIST
 /begin REF_CHARACTERISTIC /end REF_CHARACTERISTIC
 /begin REF_MEASUREMENT /end REF_MEASUREMENT
/end GROUP
/begin GROUP Ap_TrqOsc "MICROSAR RTE" /begin SUB_GROUP Ap_TrqOsc.ReceiverPorts Ap_TrqOsc.SenderPorts /end SUB_GROUP /begin FUNCTION_LIST /end FUNCTION_LIST /begin REF_CHARACTERISTIC /end REF_CHARACTERISTIC /begin REF_MEASUREMENT /end REF_MEASUREMENT /end GROUP
/begin GROUP Ap_TrqOsc.ReceiverPorts "MICROSAR RTE"
 /begin SUB_GROUP Ap_TrqOsc.TrqOscAmp.MtrNm_f32 Ap_TrqOsc.TrqOscEnable.Cnt_lgc Ap_TrqOsc.TrqOscFreq.Hz_f32 /end SUB_GROUP
 /begin FUNCTION_LIST /end FUNCTION_LIST
 /begin REF_CHARACTERISTIC /end REF_CHARACTERISTIC
 /begin REF_MEASUREMENT /end REF_MEASUREMENT
/end GROUP
/begin GROUP Ap_TrqOsc.SenderPorts "MICROSAR RTE"
 /begin SUB_GROUP Ap_TrqOsc.TrqOscCmd.MtrNm_f32 Ap_TrqOsc.TrqOscDCExceeded.Cnt_lgc /end SUB_GROUP
 /begin FUNCTION_LIST /end FUNCTION_LIST
 /begin REF_CHARACTERISTIC /end REF_CHARACTERISTIC
 /begin REF_MEASUREMENT /end REF_MEASUREMENT
/end GROUP
/begin GROUP Ap_TrqOsc.TrqOscAmp.MtrNm_f32 "MICROSAR RTE" /begin SUB_GROUP /end SUB_GROUP /begin FUNCTION_LIST /end FUNCTION_LIST /begin REF_CHARACTERISTIC /end REF_CHARACTERISTIC /begin REF_MEASUREMENT Ap_TrqOsc.TrqOscAmp.MtrNm_f32 /end REF_MEASUREMENT /end GROUP
/begin GROUP Ap_TrqOsc.TrqOscCmd.MtrNm_f32 "MICROSAR RTE" /begin SUB_GROUP /end SUB_GROUP /begin FUNCTION_LIST /end FUNCTION_LIST /begin REF_CHARACTERISTIC /end REF_CHARACTERISTIC /begin REF_MEASUREMENT Ap_TrqOsc.TrqOscCmd.MtrNm_f32 /end REF_MEASUREMENT /end GROUP
/begin GROUP Ap_TrqOsc.TrqOscDCExceeded.Cnt_lgc "MICROSAR RTE" /begin SUB_GROUP /end SUB_GROUP /begin FUNCTION_LIST /end FUNCTION_LIST /begin REF_CHARACTERISTIC /end REF_CHARACTERISTIC /begin REF_MEASUREMENT Ap_TrqOsc.TrqOscDCExceeded.Cnt_lgc /end REF_MEASUREMENT /end GROUP
/begin GROUP Ap_TrqOsc.TrqOscEnable.Cnt_lgc "MICROSAR RTE" /begin SUB_GROUP /end SUB_GROUP /begin FUNCTION_LIST /end FUNCTION_LIST /begin REF_CHARACTERISTIC /end REF_CHARACTERISTIC /begin REF_MEASUREMENT Ap_TrqOsc.TrqOscEnable.Cnt_lgc /end REF_MEASUREMENT /end GROUP
/begin GROUP Ap_TrqOsc.TrqOscFreq.Hz_f32 "MICROSAR RTE" /begin SUB_GROUP /end SUB_GROUP /begin FUNCTION_LIST /end FUNCTION_LIST /begin REF_CHARACTERISTIC /end REF_CHARACTERISTIC /begin REF_MEASUREMENT Ap_TrqOsc.TrqOscFreq.Hz_f32 /end REF_MEASUREMENT /end GROUP
/begin GROUP Ap_TuningSelAuth "MICROSAR RTE"
 /begin SUB_GROUP Ap_TuningSelAuth.ReceiverPorts Ap_TuningSelAuth.SenderPorts /end SUB_GROUP
 /begin FUNCTION_LIST /end FUNCTION_LIST
 /begin REF_CHARACTERISTIC /end REF_CHARACTERISTIC
 /begin REF_MEASUREMENT /end REF_MEASUREMENT
/end GROUP
/begin GROUP Ap_TuningSelAuth.ActiveTunOvrPtrAddr.Cnt_u32 "MICROSAR RTE" /begin SUB_GROUP /end SUB_GROUP /begin FUNCTION_LIST /end FUNCTION_LIST /begin REF_CHARACTERISTIC /end REF_CHARACTERISTIC /begin REF_MEASUREMENT Ap_TuningSelAuth.ActiveTunOvrPtrAddr.Cnt_u32 /end REF_MEASUREMENT /end GROUP
/begin GROUP Ap_TuningSelAuth.ActiveTunPers.Cnt_u16 "MICROSAR RTE" /begin SUB_GROUP /end SUB_GROUP /begin FUNCTION_LIST /end FUNCTION_LIST /begin REF_CHARACTERISTIC /end REF_CHARACTERISTIC /begin REF_MEASUREMENT Ap_TuningSelAuth.ActiveTunPers.Cnt_u16 /end REF_MEASUREMENT /end GROUP
/begin GROUP Ap_TuningSelAuth.ActiveTunSet.Cnt_u16 "MICROSAR RTE" /begin SUB_GROUP /end SUB_GROUP /begin FUNCTION_LIST /end FUNCTION_LIST /begin REF_CHARACTERISTIC /end REF_CHARACTERISTIC /begin REF_MEASUREMENT Ap_TuningSelAuth.ActiveTunSet.Cnt_u16 /end REF_MEASUREMENT /end GROUP
/begin GROUP Ap_TuningSelAuth.DesiredTunPers.Cnt_u16 "MICROSAR RTE" /begin SUB_GROUP /end SUB_GROUP /begin FUNCTION_LIST /end FUNCTION_LIST /begin REF_CHARACTERISTIC /end REF_CHARACTERISTIC /begin REF_MEASUREMENT Ap_TuningSelAuth.DesiredTunPers.Cnt_u16 /end REF_MEASUREMENT /end GROUP
/begin GROUP Ap_TuningSelAuth.DesiredTunSet.Cnt_u16 "MICROSAR RTE" /begin SUB_GROUP /end SUB_GROUP /begin FUNCTION_LIST /end FUNCTION_LIST /begin REF_CHARACTERISTIC /end REF_CHARACTERISTIC /begin REF_MEASUREMENT Ap_TuningSelAuth.DesiredTunSet.Cnt_u16 /end REF_MEASUREMENT /end GROUP
/begin GROUP Ap_TuningSelAuth.HwTorque.HwNm_f32 "MICROSAR RTE" /begin SUB_GROUP /end SUB_GROUP /begin FUNCTION_LIST /end FUNCTION_LIST /begin REF_CHARACTERISTIC /end REF_CHARACTERISTIC /begin REF_MEASUREMENT Ap_TuningSelAuth.HwTorque.HwNm_f32 /end REF_MEASUREMENT /end GROUP
/begin GROUP Ap_TuningSelAuth.ReceiverPorts "MICROSAR RTE"
 /begin SUB_GROUP Ap_TuningSelAuth.ActiveTunOvrPtrAddr.Cnt_u32 Ap_TuningSelAuth.DesiredTunPers.Cnt_u16 Ap_TuningSelAuth.DesiredTunSet.Cnt_u16 Ap_TuningSelAuth.HwTorque.HwNm_f32 Ap_TuningSelAuth.TuningSessionActPtr.Cnt_u8 Ap_TuningSelAuth.VehicleSpeed.Kph_f32 /end SUB_GROUP
 /begin FUNCTION_LIST /end FUNCTION_LIST
 /begin REF_CHARACTERISTIC /end REF_CHARACTERISTIC
 /begin REF_MEASUREMENT /end REF_MEASUREMENT
/end GROUP
/begin GROUP Ap_TuningSelAuth.SenderPorts "MICROSAR RTE"
 /begin SUB_GROUP Ap_TuningSelAuth.ActiveTunPers.Cnt_u16 Ap_TuningSelAuth.ActiveTunSet.Cnt_u16 /end SUB_GROUP
 /begin FUNCTION_LIST /end FUNCTION_LIST
 /begin REF_CHARACTERISTIC /end REF_CHARACTERISTIC
 /begin REF_MEASUREMENT /end REF_MEASUREMENT
/end GROUP
/begin GROUP Ap_TuningSelAuth.TuningSessionActPtr.Cnt_u8 "MICROSAR RTE" /begin SUB_GROUP /end SUB_GROUP /begin FUNCTION_LIST /end FUNCTION_LIST /begin REF_CHARACTERISTIC /end REF_CHARACTERISTIC /begin REF_MEASUREMENT Ap_TuningSelAuth.TuningSessionActPtr.Cnt_u8 /end REF_MEASUREMENT /end GROUP
/begin GROUP Ap_TuningSelAuth.VehicleSpeed.Kph_f32 "MICROSAR RTE" /begin SUB_GROUP /end SUB_GROUP /begin FUNCTION_LIST /end FUNCTION_LIST /begin REF_CHARACTERISTIC /end REF_CHARACTERISTIC /begin REF_MEASUREMENT Ap_TuningSelAuth.VehicleSpeed.Kph_f32 /end REF_MEASUREMENT /end GROUP
/begin GROUP Ap_WIRInputQual "MICROSAR RTE" /begin SUB_GROUP Ap_WIRInputQual.ReceiverPorts Ap_WIRInputQual.SenderPorts /end SUB_GROUP /begin FUNCTION_LIST /end FUNCTION_LIST /begin REF_CHARACTERISTIC /end REF_CHARACTERISTIC /begin REF_MEASUREMENT /end REF_MEASUREMENT /end GROUP
/begin GROUP Ap_WIRInputQual.QualWhlFreqL.Hz_f32 "MICROSAR RTE" /begin SUB_GROUP /end SUB_GROUP /begin FUNCTION_LIST /end FUNCTION_LIST /begin REF_CHARACTERISTIC /end REF_CHARACTERISTIC /begin REF_MEASUREMENT Ap_WIRInputQual.QualWhlFreqL.Hz_f32 /end REF_MEASUREMENT /end GROUP
/begin GROUP Ap_WIRInputQual.QualWhlFreqR.Hz_f32 "MICROSAR RTE" /begin SUB_GROUP /end SUB_GROUP /begin FUNCTION_LIST /end FUNCTION_LIST /begin REF_CHARACTERISTIC /end REF_CHARACTERISTIC /begin REF_MEASUREMENT Ap_WIRInputQual.QualWhlFreqR.Hz_f32 /end REF_MEASUREMENT /end GROUP
/begin GROUP Ap_WIRInputQual.ReceiverPorts "MICROSAR RTE"
 /begin SUB_GROUP Ap_WIRInputQual.SrlComLWhlSpd.Hz_f32 Ap_WIRInputQual.SrlComLWhlSpdVld.Cnt_lgc Ap_WIRInputQual.SrlComRWhlSpd.Hz_f32 Ap_WIRInputQual.SrlComRWhlSpdVld.Cnt_lgc /end SUB_GROUP
 /begin FUNCTION_LIST /end FUNCTION_LIST
 /begin REF_CHARACTERISTIC /end REF_CHARACTERISTIC
 /begin REF_MEASUREMENT /end REF_MEASUREMENT
/end GROUP
/begin GROUP Ap_WIRInputQual.SenderPorts "MICROSAR RTE"
 /begin SUB_GROUP Ap_WIRInputQual.QualWhlFreqL.Hz_f32 Ap_WIRInputQual.QualWhlFreqR.Hz_f32 Ap_WIRInputQual.WhlFreqQualified.Cnt_lgc /end SUB_GROUP
 /begin FUNCTION_LIST /end FUNCTION_LIST
 /begin REF_CHARACTERISTIC /end REF_CHARACTERISTIC
 /begin REF_MEASUREMENT /end REF_MEASUREMENT
/end GROUP
/begin GROUP Ap_WIRInputQual.SrlComLWhlSpd.Hz_f32 "MICROSAR RTE" /begin SUB_GROUP /end SUB_GROUP /begin FUNCTION_LIST /end FUNCTION_LIST /begin REF_CHARACTERISTIC /end REF_CHARACTERISTIC /begin REF_MEASUREMENT Ap_WIRInputQual.SrlComLWhlSpd.Hz_f32 /end REF_MEASUREMENT /end GROUP
/begin GROUP Ap_WIRInputQual.SrlComLWhlSpdVld.Cnt_lgc "MICROSAR RTE" /begin SUB_GROUP /end SUB_GROUP /begin FUNCTION_LIST /end FUNCTION_LIST /begin REF_CHARACTERISTIC /end REF_CHARACTERISTIC /begin REF_MEASUREMENT Ap_WIRInputQual.SrlComLWhlSpdVld.Cnt_lgc /end REF_MEASUREMENT /end GROUP
/begin GROUP Ap_WIRInputQual.SrlComRWhlSpd.Hz_f32 "MICROSAR RTE" /begin SUB_GROUP /end SUB_GROUP /begin FUNCTION_LIST /end FUNCTION_LIST /begin REF_CHARACTERISTIC /end REF_CHARACTERISTIC /begin REF_MEASUREMENT Ap_WIRInputQual.SrlComRWhlSpd.Hz_f32 /end REF_MEASUREMENT /end GROUP
/begin GROUP Ap_WIRInputQual.SrlComRWhlSpdVld.Cnt_lgc "MICROSAR RTE" /begin SUB_GROUP /end SUB_GROUP /begin FUNCTION_LIST /end FUNCTION_LIST /begin REF_CHARACTERISTIC /end REF_CHARACTERISTIC /begin REF_MEASUREMENT Ap_WIRInputQual.SrlComRWhlSpdVld.Cnt_lgc /end REF_MEASUREMENT /end GROUP
/begin GROUP Ap_WIRInputQual.WhlFreqQualified.Cnt_lgc "MICROSAR RTE" /begin SUB_GROUP /end SUB_GROUP /begin FUNCTION_LIST /end FUNCTION_LIST /begin REF_CHARACTERISTIC /end REF_CHARACTERISTIC /begin REF_MEASUREMENT Ap_WIRInputQual.WhlFreqQualified.Cnt_lgc /end REF_MEASUREMENT /end GROUP
/begin GROUP Ap_WhlImbRej "MICROSAR RTE"
 /begin SUB_GROUP Ap_WhlImbRej.ModeRequirePorts Ap_WhlImbRej.ReceiverPorts Ap_WhlImbRej.SenderPorts /end SUB_GROUP
 /begin FUNCTION_LIST /end FUNCTION_LIST
 /begin REF_CHARACTERISTIC /end REF_CHARACTERISTIC
 /begin REF_MEASUREMENT /end REF_MEASUREMENT
/end GROUP
/begin GROUP Ap_WhlImbRej.DiagStsWIRDisable.Cnt_lgc "MICROSAR RTE" /begin SUB_GROUP /end SUB_GROUP /begin FUNCTION_LIST /end FUNCTION_LIST /begin REF_CHARACTERISTIC /end REF_CHARACTERISTIC /begin REF_MEASUREMENT Ap_WhlImbRej.DiagStsWIRDisable.Cnt_lgc /end REF_MEASUREMENT /end GROUP
/begin GROUP Ap_WhlImbRej.HwTrq.HwNm_f32 "MICROSAR RTE" /begin SUB_GROUP /end SUB_GROUP /begin FUNCTION_LIST /end FUNCTION_LIST /begin REF_CHARACTERISTIC /end REF_CHARACTERISTIC /begin REF_MEASUREMENT Ap_WhlImbRej.HwTrq.HwNm_f32 /end REF_MEASUREMENT /end GROUP
/begin GROUP Ap_WhlImbRej.ModeRequirePorts "MICROSAR RTE" /begin SUB_GROUP Ap_WhlImbRej.SystemState.Mode /end SUB_GROUP /begin FUNCTION_LIST /end FUNCTION_LIST /begin REF_CHARACTERISTIC /end REF_CHARACTERISTIC /begin REF_MEASUREMENT /end REF_MEASUREMENT /end GROUP
/begin GROUP Ap_WhlImbRej.QualWhlFreqL.Hz_f32 "MICROSAR RTE" /begin SUB_GROUP /end SUB_GROUP /begin FUNCTION_LIST /end FUNCTION_LIST /begin REF_CHARACTERISTIC /end REF_CHARACTERISTIC /begin REF_MEASUREMENT Ap_WhlImbRej.QualWhlFreqL.Hz_f32 /end REF_MEASUREMENT /end GROUP
/begin GROUP Ap_WhlImbRej.QualWhlFreqR.Hz_f32 "MICROSAR RTE" /begin SUB_GROUP /end SUB_GROUP /begin FUNCTION_LIST /end FUNCTION_LIST /begin REF_CHARACTERISTIC /end REF_CHARACTERISTIC /begin REF_MEASUREMENT Ap_WhlImbRej.QualWhlFreqR.Hz_f32 /end REF_MEASUREMENT /end GROUP
/begin GROUP Ap_WhlImbRej.ReceiverPorts "MICROSAR RTE"
 /begin SUB_GROUP Ap_WhlImbRej.DiagStsWIRDisable.Cnt_lgc Ap_WhlImbRej.HwTrq.HwNm_f32 Ap_WhlImbRej.QualWhlFreqL.Hz_f32 Ap_WhlImbRej.QualWhlFreqR.Hz_f32 Ap_WhlImbRej.VehSpd.Kph_f32 Ap_WhlImbRej.VehSpdValid.Cnt_lgc Ap_WhlImbRej.WIRMfgEnable.Cnt_lgc Ap_WhlImbRej.WhlFreqQualified.Cnt_lgc /end SUB_GROUP
 /begin FUNCTION_LIST /end FUNCTION_LIST
 /begin REF_CHARACTERISTIC /end REF_CHARACTERISTIC
 /begin REF_MEASUREMENT /end REF_MEASUREMENT
/end GROUP
/begin GROUP Ap_WhlImbRej.SenderPorts "MICROSAR RTE"
 /begin SUB_GROUP Ap_WhlImbRej.WIRCmdAmpBlnd.MtrNm_f32 Ap_WhlImbRej.WhlImbRejCmd.MtrNm_f32 /end SUB_GROUP
 /begin FUNCTION_LIST /end FUNCTION_LIST
 /begin REF_CHARACTERISTIC /end REF_CHARACTERISTIC
 /begin REF_MEASUREMENT /end REF_MEASUREMENT
/end GROUP
/begin GROUP Ap_WhlImbRej.SystemState.Mode "MICROSAR RTE" /begin SUB_GROUP /end SUB_GROUP /begin FUNCTION_LIST /end FUNCTION_LIST /begin REF_CHARACTERISTIC /end REF_CHARACTERISTIC /begin REF_MEASUREMENT Ap_WhlImbRej.SystemState.Mode /end REF_MEASUREMENT /end GROUP
/begin GROUP Ap_WhlImbRej.VehSpd.Kph_f32 "MICROSAR RTE" /begin SUB_GROUP /end SUB_GROUP /begin FUNCTION_LIST /end FUNCTION_LIST /begin REF_CHARACTERISTIC /end REF_CHARACTERISTIC /begin REF_MEASUREMENT Ap_WhlImbRej.VehSpd.Kph_f32 /end REF_MEASUREMENT /end GROUP
/begin GROUP Ap_WhlImbRej.VehSpdValid.Cnt_lgc "MICROSAR RTE" /begin SUB_GROUP /end SUB_GROUP /begin FUNCTION_LIST /end FUNCTION_LIST /begin REF_CHARACTERISTIC /end REF_CHARACTERISTIC /begin REF_MEASUREMENT Ap_WhlImbRej.VehSpdValid.Cnt_lgc /end REF_MEASUREMENT /end GROUP
/begin GROUP Ap_WhlImbRej.WIRCmdAmpBlnd.MtrNm_f32 "MICROSAR RTE" /begin SUB_GROUP /end SUB_GROUP /begin FUNCTION_LIST /end FUNCTION_LIST /begin REF_CHARACTERISTIC /end REF_CHARACTERISTIC /begin REF_MEASUREMENT Ap_WhlImbRej.WIRCmdAmpBlnd.MtrNm_f32 /end REF_MEASUREMENT /end GROUP
/begin GROUP Ap_WhlImbRej.WIRMfgEnable.Cnt_lgc "MICROSAR RTE" /begin SUB_GROUP /end SUB_GROUP /begin FUNCTION_LIST /end FUNCTION_LIST /begin REF_CHARACTERISTIC /end REF_CHARACTERISTIC /begin REF_MEASUREMENT Ap_WhlImbRej.WIRMfgEnable.Cnt_lgc /end REF_MEASUREMENT /end GROUP
/begin GROUP Ap_WhlImbRej.WhlFreqQualified.Cnt_lgc "MICROSAR RTE" /begin SUB_GROUP /end SUB_GROUP /begin FUNCTION_LIST /end FUNCTION_LIST /begin REF_CHARACTERISTIC /end REF_CHARACTERISTIC /begin REF_MEASUREMENT Ap_WhlImbRej.WhlFreqQualified.Cnt_lgc /end REF_MEASUREMENT /end GROUP
/begin GROUP Ap_WhlImbRej.WhlImbRejCmd.MtrNm_f32 "MICROSAR RTE" /begin SUB_GROUP /end SUB_GROUP /begin FUNCTION_LIST /end FUNCTION_LIST /begin REF_CHARACTERISTIC /end REF_CHARACTERISTIC /begin REF_MEASUREMENT Ap_WhlImbRej.WhlImbRejCmd.MtrNm_f32 /end REF_MEASUREMENT /end GROUP
/begin GROUP Ap_ePWM2 "MICROSAR RTE" /begin SUB_GROUP Ap_ePWM2.ModeRequirePorts Ap_ePWM2.ReceiverPorts /end SUB_GROUP /begin FUNCTION_LIST /end FUNCTION_LIST /begin REF_CHARACTERISTIC /end REF_CHARACTERISTIC /begin REF_MEASUREMENT /end REF_MEASUREMENT /end GROUP
/begin GROUP Ap_ePWM2.CtrldDmpStsCmp.Cnt_lgc "MICROSAR RTE" /begin SUB_GROUP /end SUB_GROUP /begin FUNCTION_LIST /end FUNCTION_LIST /begin REF_CHARACTERISTIC /end REF_CHARACTERISTIC /begin REF_MEASUREMENT Ap_ePWM2.CtrldDmpStsCmp.Cnt_lgc /end REF_MEASUREMENT /end GROUP
/begin GROUP Ap_ePWM2.DiagStsCtrldDisRmpPres.Cnt_lgc "MICROSAR RTE" /begin SUB_GROUP /end SUB_GROUP /begin FUNCTION_LIST /end FUNCTION_LIST /begin REF_CHARACTERISTIC /end REF_CHARACTERISTIC /begin REF_MEASUREMENT Ap_ePWM2.DiagStsCtrldDisRmpPres.Cnt_lgc /end REF_MEASUREMENT /end GROUP
/begin GROUP Ap_ePWM2.DiagStsNonRecRmpToZeroFltPres.Cnt_lgc "MICROSAR RTE" /begin SUB_GROUP /end SUB_GROUP /begin FUNCTION_LIST /end FUNCTION_LIST /begin REF_CHARACTERISTIC /end REF_CHARACTERISTIC /begin REF_MEASUREMENT Ap_ePWM2.DiagStsNonRecRmpToZeroFltPres.Cnt_lgc /end REF_MEASUREMENT /end GROUP
/begin GROUP Ap_ePWM2.ModeRequirePorts "MICROSAR RTE" /begin SUB_GROUP Ap_ePWM2.SystemState.Mode /end SUB_GROUP /begin FUNCTION_LIST /end FUNCTION_LIST /begin REF_CHARACTERISTIC /end REF_CHARACTERISTIC /begin REF_MEASUREMENT /end REF_MEASUREMENT /end GROUP
/begin GROUP Ap_ePWM2.RampDwnStatusComplete.Cnt_lgc "MICROSAR RTE" /begin SUB_GROUP /end SUB_GROUP /begin FUNCTION_LIST /end FUNCTION_LIST /begin REF_CHARACTERISTIC /end REF_CHARACTERISTIC /begin REF_MEASUREMENT Ap_ePWM2.RampDwnStatusComplete.Cnt_lgc /end REF_MEASUREMENT /end GROUP
/begin GROUP Ap_ePWM2.ReceiverPorts "MICROSAR RTE"
 /begin SUB_GROUP Ap_ePWM2.CtrldDmpStsCmp.Cnt_lgc Ap_ePWM2.DiagStsCtrldDisRmpPres.Cnt_lgc Ap_ePWM2.DiagStsNonRecRmpToZeroFltPres.Cnt_lgc Ap_ePWM2.RampDwnStatusComplete.Cnt_lgc /end SUB_GROUP
 /begin FUNCTION_LIST /end FUNCTION_LIST
 /begin REF_CHARACTERISTIC /end REF_CHARACTERISTIC
 /begin REF_MEASUREMENT /end REF_MEASUREMENT
/end GROUP
/begin GROUP Ap_ePWM2.SystemState.Mode "MICROSAR RTE" /begin SUB_GROUP /end SUB_GROUP /begin FUNCTION_LIST /end FUNCTION_LIST /begin REF_CHARACTERISTIC /end REF_CHARACTERISTIC /begin REF_MEASUREMENT Ap_ePWM2.SystemState.Mode /end REF_MEASUREMENT /end GROUP
/begin GROUP Assist "MICROSAR RTE" /begin SUB_GROUP Assist.ReceiverPorts Assist.SenderPorts /end SUB_GROUP /begin FUNCTION_LIST /end FUNCTION_LIST /begin REF_CHARACTERISTIC /end REF_CHARACTERISTIC /begin REF_MEASUREMENT /end REF_MEASUREMENT /end GROUP
/begin GROUP Assist.AssistDDFactor.Uls_f32 "MICROSAR RTE" /begin SUB_GROUP /end SUB_GROUP /begin FUNCTION_LIST /end FUNCTION_LIST /begin REF_CHARACTERISTIC /end REF_CHARACTERISTIC /begin REF_MEASUREMENT Assist.AssistDDFactor.Uls_f32 /end REF_MEASUREMENT /end GROUP
/begin GROUP Assist.BaseAssistCmd.MtrNm_f32 "MICROSAR RTE" /begin SUB_GROUP /end SUB_GROUP /begin FUNCTION_LIST /end FUNCTION_LIST /begin REF_CHARACTERISTIC /end REF_CHARACTERISTIC /begin REF_MEASUREMENT Assist.BaseAssistCmd.MtrNm_f32 /end REF_MEASUREMENT /end GROUP
/begin GROUP Assist.DftAsstTbl.Cnt_lgc "MICROSAR RTE" /begin SUB_GROUP /end SUB_GROUP /begin FUNCTION_LIST /end FUNCTION_LIST /begin REF_CHARACTERISTIC /end REF_CHARACTERISTIC /begin REF_MEASUREMENT Assist.DftAsstTbl.Cnt_lgc /end REF_MEASUREMENT /end GROUP
/begin GROUP Assist.DutyCycleLevel.Uls_f32 "MICROSAR RTE" /begin SUB_GROUP /end SUB_GROUP /begin FUNCTION_LIST /end FUNCTION_LIST /begin REF_CHARACTERISTIC /end REF_CHARACTERISTIC /begin REF_MEASUREMENT Assist.DutyCycleLevel.Uls_f32 /end REF_MEASUREMENT /end GROUP
/begin GROUP Assist.DwnldAsstGain.Uls_f32 "MICROSAR RTE" /begin SUB_GROUP /end SUB_GROUP /begin FUNCTION_LIST /end FUNCTION_LIST /begin REF_CHARACTERISTIC /end REF_CHARACTERISTIC /begin REF_MEASUREMENT Assist.DwnldAsstGain.Uls_f32 /end REF_MEASUREMENT /end GROUP
/begin GROUP Assist.HwTrq.HwNm_f32 "MICROSAR RTE" /begin SUB_GROUP /end SUB_GROUP /begin FUNCTION_LIST /end FUNCTION_LIST /begin REF_CHARACTERISTIC /end REF_CHARACTERISTIC /begin REF_MEASUREMENT Assist.HwTrq.HwNm_f32 /end REF_MEASUREMENT /end GROUP
/begin GROUP Assist.HwTrqHysAdd.HwNm_f32 "MICROSAR RTE" /begin SUB_GROUP /end SUB_GROUP /begin FUNCTION_LIST /end FUNCTION_LIST /begin REF_CHARACTERISTIC /end REF_CHARACTERISTIC /begin REF_MEASUREMENT Assist.HwTrqHysAdd.HwNm_f32 /end REF_MEASUREMENT /end GROUP
/begin GROUP Assist.IpTrqOvr.HwNm_f32 "MICROSAR RTE" /begin SUB_GROUP /end SUB_GROUP /begin FUNCTION_LIST /end FUNCTION_LIST /begin REF_CHARACTERISTIC /end REF_CHARACTERISTIC /begin REF_MEASUREMENT Assist.IpTrqOvr.HwNm_f32 /end REF_MEASUREMENT /end GROUP
/begin GROUP Assist.ReceiverPorts "MICROSAR RTE"
 /begin SUB_GROUP Assist.AssistDDFactor.Uls_f32 Assist.DftAsstTbl.Cnt_lgc Assist.DutyCycleLevel.Uls_f32 Assist.DwnldAsstGain.Uls_f32 Assist.HwTrq.HwNm_f32 Assist.HwTrqHysAdd.HwNm_f32 Assist.IpTrqOvr.HwNm_f32 Assist.VehSpd.Kph_f32 Assist.WIRCmdAmpBlnd.MtrNm_f32 /end SUB_GROUP
 /begin FUNCTION_LIST /end FUNCTION_LIST
 /begin REF_CHARACTERISTIC /end REF_CHARACTERISTIC
 /begin REF_MEASUREMENT /end REF_MEASUREMENT
/end GROUP
/begin GROUP Assist.SenderPorts "MICROSAR RTE" /begin SUB_GROUP Assist.BaseAssistCmd.MtrNm_f32 /end SUB_GROUP /begin FUNCTION_LIST /end FUNCTION_LIST /begin REF_CHARACTERISTIC /end REF_CHARACTERISTIC /begin REF_MEASUREMENT /end REF_MEASUREMENT /end GROUP
/begin GROUP Assist.VehSpd.Kph_f32 "MICROSAR RTE" /begin SUB_GROUP /end SUB_GROUP /begin FUNCTION_LIST /end FUNCTION_LIST /begin REF_CHARACTERISTIC /end REF_CHARACTERISTIC /begin REF_MEASUREMENT Assist.VehSpd.Kph_f32 /end REF_MEASUREMENT /end GROUP
/begin GROUP Assist.WIRCmdAmpBlnd.MtrNm_f32 "MICROSAR RTE" /begin SUB_GROUP /end SUB_GROUP /begin FUNCTION_LIST /end FUNCTION_LIST /begin REF_CHARACTERISTIC /end REF_CHARACTERISTIC /begin REF_MEASUREMENT Assist.WIRCmdAmpBlnd.MtrNm_f32 /end REF_MEASUREMENT /end GROUP
/begin GROUP BatteryVoltage "MICROSAR RTE"
 /begin SUB_GROUP BatteryVoltage.ModeRequirePorts BatteryVoltage.PerInstanceMemories BatteryVoltage.ReceiverPorts BatteryVoltage.SenderPorts /end SUB_GROUP
 /begin FUNCTION_LIST /end FUNCTION_LIST
 /begin REF_CHARACTERISTIC /end REF_CHARACTERISTIC
 /begin REF_MEASUREMENT /end REF_MEASUREMENT
/end GROUP
/begin GROUP BatteryVoltage.Batt.Volt_f32 "MICROSAR RTE" /begin SUB_GROUP /end SUB_GROUP /begin FUNCTION_LIST /end FUNCTION_LIST /begin REF_CHARACTERISTIC /end REF_CHARACTERISTIC /begin REF_MEASUREMENT BatteryVoltage.Batt.Volt_f32 /end REF_MEASUREMENT /end GROUP
/begin GROUP BatteryVoltage.BattSwitched.Volt_f32 "MICROSAR RTE" /begin SUB_GROUP /end SUB_GROUP /begin FUNCTION_LIST /end FUNCTION_LIST /begin REF_CHARACTERISTIC /end REF_CHARACTERISTIC /begin REF_MEASUREMENT BatteryVoltage.BattSwitched.Volt_f32 /end REF_MEASUREMENT /end GROUP
/begin GROUP BatteryVoltage.ModeRequirePorts "MICROSAR RTE" /begin SUB_GROUP BatteryVoltage.SystemState.Mode /end SUB_GROUP /begin FUNCTION_LIST /end FUNCTION_LIST /begin REF_CHARACTERISTIC /end REF_CHARACTERISTIC /begin REF_MEASUREMENT /end REF_MEASUREMENT /end GROUP
/begin GROUP BatteryVoltage.OvervoltageData "MICROSAR RTE" /begin SUB_GROUP /end SUB_GROUP /begin FUNCTION_LIST /end FUNCTION_LIST /begin REF_CHARACTERISTIC /end REF_CHARACTERISTIC
 /begin REF_MEASUREMENT BatteryVoltage.OvervoltageData.MaxBattVoltage_Volts_f32 BatteryVoltage.OvervoltageData.OvervoltageCounter_Cnt_u16 /end REF_MEASUREMENT
/end GROUP
/begin GROUP BatteryVoltage.PerInstanceMemories "MICROSAR RTE" /begin SUB_GROUP BatteryVoltage.OvervoltageData /end SUB_GROUP /begin FUNCTION_LIST /end FUNCTION_LIST /begin REF_CHARACTERISTIC /end REF_CHARACTERISTIC /begin REF_MEASUREMENT /end REF_MEASUREMENT /end GROUP
/begin GROUP BatteryVoltage.ReceiverPorts "MICROSAR RTE"
 /begin SUB_GROUP BatteryVoltage.Batt.Volt_f32 BatteryVoltage.BattSwitched.Volt_f32 BatteryVoltage.SysCVSwitch.Volt_f32 /end SUB_GROUP
 /begin FUNCTION_LIST /end FUNCTION_LIST
 /begin REF_CHARACTERISTIC /end REF_CHARACTERISTIC
 /begin REF_MEASUREMENT /end REF_MEASUREMENT
/end GROUP
/begin GROUP BatteryVoltage.SenderPorts "MICROSAR RTE"
 /begin SUB_GROUP BatteryVoltage.SysC_Vecu.Volt_f32 BatteryVoltage.Vecu.Volt_f32 BatteryVoltage.VswitchClosed.Cnt_lgc /end SUB_GROUP
 /begin FUNCTION_LIST /end FUNCTION_LIST
 /begin REF_CHARACTERISTIC /end REF_CHARACTERISTIC
 /begin REF_MEASUREMENT /end REF_MEASUREMENT
/end GROUP
/begin GROUP BatteryVoltage.SysCVSwitch.Volt_f32 "MICROSAR RTE" /begin SUB_GROUP /end SUB_GROUP /begin FUNCTION_LIST /end FUNCTION_LIST /begin REF_CHARACTERISTIC /end REF_CHARACTERISTIC /begin REF_MEASUREMENT BatteryVoltage.SysCVSwitch.Volt_f32 /end REF_MEASUREMENT /end GROUP
/begin GROUP BatteryVoltage.SysC_Vecu.Volt_f32 "MICROSAR RTE" /begin SUB_GROUP /end SUB_GROUP /begin FUNCTION_LIST /end FUNCTION_LIST /begin REF_CHARACTERISTIC /end REF_CHARACTERISTIC /begin REF_MEASUREMENT BatteryVoltage.SysC_Vecu.Volt_f32 /end REF_MEASUREMENT /end GROUP
/begin GROUP BatteryVoltage.SystemState.Mode "MICROSAR RTE" /begin SUB_GROUP /end SUB_GROUP /begin FUNCTION_LIST /end FUNCTION_LIST /begin REF_CHARACTERISTIC /end REF_CHARACTERISTIC /begin REF_MEASUREMENT BatteryVoltage.SystemState.Mode /end REF_MEASUREMENT /end GROUP
/begin GROUP BatteryVoltage.Vecu.Volt_f32 "MICROSAR RTE" /begin SUB_GROUP /end SUB_GROUP /begin FUNCTION_LIST /end FUNCTION_LIST /begin REF_CHARACTERISTIC /end REF_CHARACTERISTIC /begin REF_MEASUREMENT BatteryVoltage.Vecu.Volt_f32 /end REF_MEASUREMENT /end GROUP
/begin GROUP BatteryVoltage.VswitchClosed.Cnt_lgc "MICROSAR RTE" /begin SUB_GROUP /end SUB_GROUP /begin FUNCTION_LIST /end FUNCTION_LIST /begin REF_CHARACTERISTIC /end REF_CHARACTERISTIC /begin REF_MEASUREMENT BatteryVoltage.VswitchClosed.Cnt_lgc /end REF_MEASUREMENT /end GROUP
/begin GROUP BkCpPc "MICROSAR RTE"
 /begin SUB_GROUP BkCpPc.ModeRequirePorts BkCpPc.ReceiverPorts BkCpPc.SenderPorts /end SUB_GROUP
 /begin FUNCTION_LIST /end FUNCTION_LIST
 /begin REF_CHARACTERISTIC /end REF_CHARACTERISTIC
 /begin REF_MEASUREMENT /end REF_MEASUREMENT
/end GROUP
/begin GROUP BkCpPc.Batt.Volt_f32 "MICROSAR RTE" /begin SUB_GROUP /end SUB_GROUP /begin FUNCTION_LIST /end FUNCTION_LIST /begin REF_CHARACTERISTIC /end REF_CHARACTERISTIC /begin REF_MEASUREMENT BkCpPc.Batt.Volt_f32 /end REF_MEASUREMENT /end GROUP
/begin GROUP BkCpPc.BattSwitched.Volt_f32 "MICROSAR RTE" /begin SUB_GROUP /end SUB_GROUP /begin FUNCTION_LIST /end FUNCTION_LIST /begin REF_CHARACTERISTIC /end REF_CHARACTERISTIC /begin REF_MEASUREMENT BkCpPc.BattSwitched.Volt_f32 /end REF_MEASUREMENT /end GROUP
/begin GROUP BkCpPc.ModeRequirePorts "MICROSAR RTE" /begin SUB_GROUP BkCpPc.SystemState.Mode /end SUB_GROUP /begin FUNCTION_LIST /end FUNCTION_LIST /begin REF_CHARACTERISTIC /end REF_CHARACTERISTIC /begin REF_MEASUREMENT /end REF_MEASUREMENT /end GROUP
/begin GROUP BkCpPc.MotorVelocityMRFUnfiltered.MtrRadpS_f32 "MICROSAR RTE" /begin SUB_GROUP /end SUB_GROUP /begin FUNCTION_LIST /end FUNCTION_LIST /begin REF_CHARACTERISTIC /end REF_CHARACTERISTIC /begin REF_MEASUREMENT BkCpPc.MotorVelocityMRFUnfiltered.MtrRadpS_f32 /end REF_MEASUREMENT /end GROUP
/begin GROUP BkCpPc.OVERRIDESIGDIAGADC.Volt_f32 "MICROSAR RTE" /begin SUB_GROUP /end SUB_GROUP /begin FUNCTION_LIST /end FUNCTION_LIST /begin REF_CHARACTERISTIC /end REF_CHARACTERISTIC /begin REF_MEASUREMENT BkCpPc.OVERRIDESIGDIAGADC.Volt_f32 /end REF_MEASUREMENT /end GROUP
/begin GROUP BkCpPc.PMOSDIAGADC.Volt_f32 "MICROSAR RTE" /begin SUB_GROUP /end SUB_GROUP /begin FUNCTION_LIST /end FUNCTION_LIST /begin REF_CHARACTERISTIC /end REF_CHARACTERISTIC /begin REF_MEASUREMENT BkCpPc.PMOSDIAGADC.Volt_f32 /end REF_MEASUREMENT /end GROUP
/begin GROUP BkCpPc.PwrDiscATestComplete.Cnt_lgc "MICROSAR RTE" /begin SUB_GROUP /end SUB_GROUP /begin FUNCTION_LIST /end FUNCTION_LIST /begin REF_CHARACTERISTIC /end REF_CHARACTERISTIC /begin REF_MEASUREMENT BkCpPc.PwrDiscATestComplete.Cnt_lgc /end REF_MEASUREMENT /end GROUP
/begin GROUP BkCpPc.PwrDiscATestStart.Cnt_lgc "MICROSAR RTE" /begin SUB_GROUP /end SUB_GROUP /begin FUNCTION_LIST /end FUNCTION_LIST /begin REF_CHARACTERISTIC /end REF_CHARACTERISTIC /begin REF_MEASUREMENT BkCpPc.PwrDiscATestStart.Cnt_lgc /end REF_MEASUREMENT /end GROUP
/begin GROUP BkCpPc.PwrDiscBTestComplete.Cnt_lgc "MICROSAR RTE" /begin SUB_GROUP /end SUB_GROUP /begin FUNCTION_LIST /end FUNCTION_LIST /begin REF_CHARACTERISTIC /end REF_CHARACTERISTIC /begin REF_MEASUREMENT BkCpPc.PwrDiscBTestComplete.Cnt_lgc /end REF_MEASUREMENT /end GROUP
/begin GROUP BkCpPc.PwrDiscBTestStart.Cnt_lgc "MICROSAR RTE" /begin SUB_GROUP /end SUB_GROUP /begin FUNCTION_LIST /end FUNCTION_LIST /begin REF_CHARACTERISTIC /end REF_CHARACTERISTIC /begin REF_MEASUREMENT BkCpPc.PwrDiscBTestStart.Cnt_lgc /end REF_MEASUREMENT /end GROUP
/begin GROUP BkCpPc.PwrDiscClosed.Cnt_lgc "MICROSAR RTE" /begin SUB_GROUP /end SUB_GROUP /begin FUNCTION_LIST /end FUNCTION_LIST /begin REF_CHARACTERISTIC /end REF_CHARACTERISTIC /begin REF_MEASUREMENT BkCpPc.PwrDiscClosed.Cnt_lgc /end REF_MEASUREMENT /end GROUP
/begin GROUP BkCpPc.ReceiverPorts "MICROSAR RTE"
 /begin SUB_GROUP BkCpPc.Batt.Volt_f32 BkCpPc.BattSwitched.Volt_f32 BkCpPc.MotorVelocityMRFUnfiltered.MtrRadpS_f32 BkCpPc.OVERRIDESIGDIAGADC.Volt_f32 BkCpPc.PMOSDIAGADC.Volt_f32 BkCpPc.PwrDiscATestStart.Cnt_lgc BkCpPc.PwrDiscBTestStart.Cnt_lgc /end SUB_GROUP
 /begin FUNCTION_LIST /end FUNCTION_LIST
 /begin REF_CHARACTERISTIC /end REF_CHARACTERISTIC
 /begin REF_MEASUREMENT /end REF_MEASUREMENT
/end GROUP
/begin GROUP BkCpPc.SenderPorts "MICROSAR RTE"
 /begin SUB_GROUP BkCpPc.PwrDiscATestComplete.Cnt_lgc BkCpPc.PwrDiscBTestComplete.Cnt_lgc BkCpPc.PwrDiscClosed.Cnt_lgc /end SUB_GROUP
 /begin FUNCTION_LIST /end FUNCTION_LIST
 /begin REF_CHARACTERISTIC /end REF_CHARACTERISTIC
 /begin REF_MEASUREMENT /end REF_MEASUREMENT
/end GROUP
/begin GROUP BkCpPc.SystemState.Mode "MICROSAR RTE" /begin SUB_GROUP /end SUB_GROUP /begin FUNCTION_LIST /end FUNCTION_LIST /begin REF_CHARACTERISTIC /end REF_CHARACTERISTIC /begin REF_MEASUREMENT BkCpPc.SystemState.Mode /end REF_MEASUREMENT /end GROUP
/begin GROUP CDDInterface "MICROSAR RTE"
 /begin SUB_GROUP CDDInterface.ModeRequirePorts CDDInterface.ReceiverPorts CDDInterface.SenderPorts /end SUB_GROUP
 /begin FUNCTION_LIST /end FUNCTION_LIST
 /begin REF_CHARACTERISTIC /end REF_CHARACTERISTIC
 /begin REF_MEASUREMENT /end REF_MEASUREMENT
/end GROUP
/begin GROUP CDDInterface.ADCMtrCurr1.Volts_f32 "MICROSAR RTE" /begin SUB_GROUP /end SUB_GROUP /begin FUNCTION_LIST /end FUNCTION_LIST /begin REF_CHARACTERISTIC /end REF_CHARACTERISTIC /begin REF_MEASUREMENT CDDInterface.ADCMtrCurr1.Volts_f32 /end REF_MEASUREMENT /end GROUP
/begin GROUP CDDInterface.ADCMtrCurr2.Volts_f32 "MICROSAR RTE" /begin SUB_GROUP /end SUB_GROUP /begin FUNCTION_LIST /end FUNCTION_LIST /begin REF_CHARACTERISTIC /end REF_CHARACTERISTIC /begin REF_MEASUREMENT CDDInterface.ADCMtrCurr2.Volts_f32 /end REF_MEASUREMENT /end GROUP
/begin GROUP CDDInterface.AssistAssemblyPolarity.Cnt_s08 "MICROSAR RTE" /begin SUB_GROUP /end SUB_GROUP /begin FUNCTION_LIST /end FUNCTION_LIST /begin REF_CHARACTERISTIC /end REF_CHARACTERISTIC /begin REF_MEASUREMENT CDDInterface.AssistAssemblyPolarity.Cnt_s08 /end REF_MEASUREMENT /end GROUP
/begin GROUP CDDInterface.BallNutTempEstSrlComSvcDft.Cnt_lgc "MICROSAR RTE" /begin SUB_GROUP /end SUB_GROUP /begin FUNCTION_LIST /end FUNCTION_LIST /begin REF_CHARACTERISTIC /end REF_CHARACTERISTIC /begin REF_MEASUREMENT CDDInterface.BallNutTempEstSrlComSvcDft.Cnt_lgc /end REF_MEASUREMENT /end GROUP
/begin GROUP CDDInterface.CommOffset.Cnt_u16 "MICROSAR RTE" /begin SUB_GROUP /end SUB_GROUP /begin FUNCTION_LIST /end FUNCTION_LIST /begin REF_CHARACTERISTIC /end REF_CHARACTERISTIC /begin REF_MEASUREMENT CDDInterface.CommOffset.Cnt_u16 /end REF_MEASUREMENT /end GROUP
/begin GROUP CDDInterface.CorrMtrCurrPosition.Rev_f32 "MICROSAR RTE" /begin SUB_GROUP /end SUB_GROUP /begin FUNCTION_LIST /end FUNCTION_LIST /begin REF_CHARACTERISTIC /end REF_CHARACTERISTIC /begin REF_MEASUREMENT CDDInterface.CorrMtrCurrPosition.Rev_f32 /end REF_MEASUREMENT /end GROUP
/begin GROUP CDDInterface.CorrectedElecMtrPos.Rev_u0p16 "MICROSAR RTE" /begin SUB_GROUP /end SUB_GROUP /begin FUNCTION_LIST /end FUNCTION_LIST /begin REF_CHARACTERISTIC /end REF_CHARACTERISTIC /begin REF_MEASUREMENT CDDInterface.CorrectedElecMtrPos.Rev_u0p16 /end REF_MEASUREMENT /end GROUP
/begin GROUP CDDInterface.CorrectedElecMtrPosFloat.Rev_f32 "MICROSAR RTE" /begin SUB_GROUP /end SUB_GROUP /begin FUNCTION_LIST /end FUNCTION_LIST /begin REF_CHARACTERISTIC /end REF_CHARACTERISTIC /begin REF_MEASUREMENT CDDInterface.CorrectedElecMtrPosFloat.Rev_f32 /end REF_MEASUREMENT /end GROUP
/begin GROUP CDDInterface.CumMechMtrPos.Rev_f32 "MICROSAR RTE" /begin SUB_GROUP /end SUB_GROUP /begin FUNCTION_LIST /end FUNCTION_LIST /begin REF_CHARACTERISTIC /end REF_CHARACTERISTIC /begin REF_MEASUREMENT CDDInterface.CumMechMtrPos.Rev_f32 /end REF_MEASUREMENT /end GROUP
/begin GROUP CDDInterface.DampingSrlComSvcDft.Cnt_lgc "MICROSAR RTE" /begin SUB_GROUP /end SUB_GROUP /begin FUNCTION_LIST /end FUNCTION_LIST /begin REF_CHARACTERISTIC /end REF_CHARACTERISTIC /begin REF_MEASUREMENT CDDInterface.DampingSrlComSvcDft.Cnt_lgc /end REF_MEASUREMENT /end GROUP
/begin GROUP CDDInterface.DftAsstTbl.Cnt_lgc "MICROSAR RTE" /begin SUB_GROUP /end SUB_GROUP /begin FUNCTION_LIST /end FUNCTION_LIST /begin REF_CHARACTERISTIC /end REF_CHARACTERISTIC /begin REF_MEASUREMENT CDDInterface.DftAsstTbl.Cnt_lgc /end REF_MEASUREMENT /end GROUP
/begin GROUP CDDInterface.Die1RxError.Cnt_u16 "MICROSAR RTE" /begin SUB_GROUP /end SUB_GROUP /begin FUNCTION_LIST /end FUNCTION_LIST /begin REF_CHARACTERISTIC /end REF_CHARACTERISTIC /begin REF_MEASUREMENT CDDInterface.Die1RxError.Cnt_u16 /end REF_MEASUREMENT /end GROUP
/begin GROUP CDDInterface.Die1RxMtrPos.Cnt_u16 "MICROSAR RTE" /begin SUB_GROUP /end SUB_GROUP /begin FUNCTION_LIST /end FUNCTION_LIST /begin REF_CHARACTERISTIC /end REF_CHARACTERISTIC /begin REF_MEASUREMENT CDDInterface.Die1RxMtrPos.Cnt_u16 /end REF_MEASUREMENT /end GROUP
/begin GROUP CDDInterface.Die1RxRevCtr.Cnt_u16 "MICROSAR RTE" /begin SUB_GROUP /end SUB_GROUP /begin FUNCTION_LIST /end FUNCTION_LIST /begin REF_CHARACTERISTIC /end REF_CHARACTERISTIC /begin REF_MEASUREMENT CDDInterface.Die1RxRevCtr.Cnt_u16 /end REF_MEASUREMENT /end GROUP
/begin GROUP CDDInterface.Die1UnderVoltgFltAccum.Cnt_u16 "MICROSAR RTE" /begin SUB_GROUP /end SUB_GROUP /begin FUNCTION_LIST /end FUNCTION_LIST /begin REF_CHARACTERISTIC /end REF_CHARACTERISTIC /begin REF_MEASUREMENT CDDInterface.Die1UnderVoltgFltAccum.Cnt_u16 /end REF_MEASUREMENT /end GROUP
/begin GROUP CDDInterface.Die2RxError.Cnt_u16 "MICROSAR RTE" /begin SUB_GROUP /end SUB_GROUP /begin FUNCTION_LIST /end FUNCTION_LIST /begin REF_CHARACTERISTIC /end REF_CHARACTERISTIC /begin REF_MEASUREMENT CDDInterface.Die2RxError.Cnt_u16 /end REF_MEASUREMENT /end GROUP
/begin GROUP CDDInterface.Die2RxMtrPos.Cnt_u16 "MICROSAR RTE" /begin SUB_GROUP /end SUB_GROUP /begin FUNCTION_LIST /end FUNCTION_LIST /begin REF_CHARACTERISTIC /end REF_CHARACTERISTIC /begin REF_MEASUREMENT CDDInterface.Die2RxMtrPos.Cnt_u16 /end REF_MEASUREMENT /end GROUP
/begin GROUP CDDInterface.Die2RxRevCtr.Cnt_u16 "MICROSAR RTE" /begin SUB_GROUP /end SUB_GROUP /begin FUNCTION_LIST /end FUNCTION_LIST /begin REF_CHARACTERISTIC /end REF_CHARACTERISTIC /begin REF_MEASUREMENT CDDInterface.Die2RxRevCtr.Cnt_u16 /end REF_MEASUREMENT /end GROUP
/begin GROUP CDDInterface.DisableCEBusNormComm.Cnt_lgc "MICROSAR RTE" /begin SUB_GROUP /end SUB_GROUP /begin FUNCTION_LIST /end FUNCTION_LIST /begin REF_CHARACTERISTIC /end REF_CHARACTERISTIC /begin REF_MEASUREMENT CDDInterface.DisableCEBusNormComm.Cnt_lgc /end REF_MEASUREMENT /end GROUP
/begin GROUP CDDInterface.DisableHSBusNormComm.Cnt_lgc "MICROSAR RTE" /begin SUB_GROUP /end SUB_GROUP /begin FUNCTION_LIST /end FUNCTION_LIST /begin REF_CHARACTERISTIC /end REF_CHARACTERISTIC /begin REF_MEASUREMENT CDDInterface.DisableHSBusNormComm.Cnt_lgc /end REF_MEASUREMENT /end GROUP
/begin GROUP CDDInterface.DrivingDynSrlComSvcDft.Cnt_lgc "MICROSAR RTE" /begin SUB_GROUP /end SUB_GROUP /begin FUNCTION_LIST /end FUNCTION_LIST /begin REF_CHARACTERISTIC /end REF_CHARACTERISTIC /begin REF_MEASUREMENT CDDInterface.DrivingDynSrlComSvcDft.Cnt_lgc /end REF_MEASUREMENT /end GROUP
/begin GROUP CDDInterface.DwnldAsstGain.Uls_f32 "MICROSAR RTE" /begin SUB_GROUP /end SUB_GROUP /begin FUNCTION_LIST /end FUNCTION_LIST /begin REF_CHARACTERISTIC /end REF_CHARACTERISTIC /begin REF_MEASUREMENT CDDInterface.DwnldAsstGain.Uls_f32 /end REF_MEASUREMENT /end GROUP
/begin GROUP CDDInterface.EOTImpactSrlComSvcDft.Cnt_lgc "MICROSAR RTE" /begin SUB_GROUP /end SUB_GROUP /begin FUNCTION_LIST /end FUNCTION_LIST /begin REF_CHARACTERISTIC /end REF_CHARACTERISTIC /begin REF_MEASUREMENT CDDInterface.EOTImpactSrlComSvcDft.Cnt_lgc /end REF_MEASUREMENT /end GROUP
/begin GROUP CDDInterface.EOTThermalSrlComSvcDft.Cnt_lgc "MICROSAR RTE" /begin SUB_GROUP /end SUB_GROUP /begin FUNCTION_LIST /end FUNCTION_LIST /begin REF_CHARACTERISTIC /end REF_CHARACTERISTIC /begin REF_MEASUREMENT CDDInterface.EOTThermalSrlComSvcDft.Cnt_lgc /end REF_MEASUREMENT /end GROUP
/begin GROUP CDDInterface.EngONSrlComSvcDft.Cnt_lgc "MICROSAR RTE" /begin SUB_GROUP /end SUB_GROUP /begin FUNCTION_LIST /end FUNCTION_LIST /begin REF_CHARACTERISTIC /end REF_CHARACTERISTIC /begin REF_MEASUREMENT CDDInterface.EngONSrlComSvcDft.Cnt_lgc /end REF_MEASUREMENT /end GROUP
/begin GROUP CDDInterface.ExpectedOnTimeA.Cnt_u32 "MICROSAR RTE" /begin SUB_GROUP /end SUB_GROUP /begin FUNCTION_LIST /end FUNCTION_LIST /begin REF_CHARACTERISTIC /end REF_CHARACTERISTIC /begin REF_MEASUREMENT CDDInterface.ExpectedOnTimeA.Cnt_u32 /end REF_MEASUREMENT /end GROUP
/begin GROUP CDDInterface.ExpectedOnTimeB.Cnt_u32 "MICROSAR RTE" /begin SUB_GROUP /end SUB_GROUP /begin FUNCTION_LIST /end FUNCTION_LIST /begin REF_CHARACTERISTIC /end REF_CHARACTERISTIC /begin REF_MEASUREMENT CDDInterface.ExpectedOnTimeB.Cnt_u32 /end REF_MEASUREMENT /end GROUP
/begin GROUP CDDInterface.ExpectedOnTimeC.Cnt_u32 "MICROSAR RTE" /begin SUB_GROUP /end SUB_GROUP /begin FUNCTION_LIST /end FUNCTION_LIST /begin REF_CHARACTERISTIC /end REF_CHARACTERISTIC /begin REF_MEASUREMENT CDDInterface.ExpectedOnTimeC.Cnt_u32 /end REF_MEASUREMENT /end GROUP
/begin GROUP CDDInterface.FreqDepDmpSrlComSvcDft.Cnt_lgc "MICROSAR RTE" /begin SUB_GROUP /end SUB_GROUP /begin FUNCTION_LIST /end FUNCTION_LIST /begin REF_CHARACTERISTIC /end REF_CHARACTERISTIC /begin REF_MEASUREMENT CDDInterface.FreqDepDmpSrlComSvcDft.Cnt_lgc /end REF_MEASUREMENT /end GROUP
/begin GROUP CDDInterface.FricLrnSrlComSvcDft.Cnt_lgc "MICROSAR RTE" /begin SUB_GROUP /end SUB_GROUP /begin FUNCTION_LIST /end FUNCTION_LIST /begin REF_CHARACTERISTIC /end REF_CHARACTERISTIC /begin REF_MEASUREMENT CDDInterface.FricLrnSrlComSvcDft.Cnt_lgc /end REF_MEASUREMENT /end GROUP
/begin GROUP CDDInterface.HysAddSrlComSvcDft.Cnt_lgc "MICROSAR RTE" /begin SUB_GROUP /end SUB_GROUP /begin FUNCTION_LIST /end FUNCTION_LIST /begin REF_CHARACTERISTIC /end REF_CHARACTERISTIC /begin REF_MEASUREMENT CDDInterface.HysAddSrlComSvcDft.Cnt_lgc /end REF_MEASUREMENT /end GROUP
/begin GROUP CDDInterface.HystCompSrlComSvcDft.Cnt_lgc "MICROSAR RTE" /begin SUB_GROUP /end SUB_GROUP /begin FUNCTION_LIST /end FUNCTION_LIST /begin REF_CHARACTERISTIC /end REF_CHARACTERISTIC /begin REF_MEASUREMENT CDDInterface.HystCompSrlComSvcDft.Cnt_lgc /end REF_MEASUREMENT /end GROUP
/begin GROUP CDDInterface.IgnCnt.Cnt_u16 "MICROSAR RTE" /begin SUB_GROUP /end SUB_GROUP /begin FUNCTION_LIST /end FUNCTION_LIST /begin REF_CHARACTERISTIC /end REF_CHARACTERISTIC /begin REF_MEASUREMENT CDDInterface.IgnCnt.Cnt_u16 /end REF_MEASUREMENT /end GROUP
/begin GROUP CDDInterface.KinIntDiagSrlComSvcDft.Cnt_lgc "MICROSAR RTE" /begin SUB_GROUP /end SUB_GROUP /begin FUNCTION_LIST /end FUNCTION_LIST /begin REF_CHARACTERISTIC /end REF_CHARACTERISTIC /begin REF_MEASUREMENT CDDInterface.KinIntDiagSrlComSvcDft.Cnt_lgc /end REF_MEASUREMENT /end GROUP
/begin GROUP CDDInterface.LRPRPhaseadvanceCaptured.Cnt_s16 "MICROSAR RTE" /begin SUB_GROUP /end SUB_GROUP /begin FUNCTION_LIST /end FUNCTION_LIST /begin REF_CHARACTERISTIC /end REF_CHARACTERISTIC /begin REF_MEASUREMENT CDDInterface.LRPRPhaseadvanceCaptured.Cnt_s16 /end REF_MEASUREMENT /end GROUP
/begin GROUP CDDInterface.LimitSrlComSvcDft.Cnt_lgc "MICROSAR RTE" /begin SUB_GROUP /end SUB_GROUP /begin FUNCTION_LIST /end FUNCTION_LIST /begin REF_CHARACTERISTIC /end REF_CHARACTERISTIC /begin REF_MEASUREMENT CDDInterface.LimitSrlComSvcDft.Cnt_lgc /end REF_MEASUREMENT /end GROUP
/begin GROUP CDDInterface.MEC.Cnt_enum "MICROSAR RTE" /begin SUB_GROUP /end SUB_GROUP /begin FUNCTION_LIST /end FUNCTION_LIST /begin REF_CHARACTERISTIC /end REF_CHARACTERISTIC /begin REF_MEASUREMENT CDDInterface.MEC.Cnt_enum /end REF_MEASUREMENT /end GROUP
/begin GROUP CDDInterface.MRFMtrVel.MtrRadpS_f32 "MICROSAR RTE" /begin SUB_GROUP /end SUB_GROUP /begin FUNCTION_LIST /end FUNCTION_LIST /begin REF_CHARACTERISTIC /end REF_CHARACTERISTIC /begin REF_MEASUREMENT CDDInterface.MRFMtrVel.MtrRadpS_f32 /end REF_MEASUREMENT /end GROUP
/begin GROUP CDDInterface.MeasuredOnTimeA.Cnt_u32 "MICROSAR RTE" /begin SUB_GROUP /end SUB_GROUP /begin FUNCTION_LIST /end FUNCTION_LIST /begin REF_CHARACTERISTIC /end REF_CHARACTERISTIC /begin REF_MEASUREMENT CDDInterface.MeasuredOnTimeA.Cnt_u32 /end REF_MEASUREMENT /end GROUP
/begin GROUP CDDInterface.MeasuredOnTimeB.Cnt_u32 "MICROSAR RTE" /begin SUB_GROUP /end SUB_GROUP /begin FUNCTION_LIST /end FUNCTION_LIST /begin REF_CHARACTERISTIC /end REF_CHARACTERISTIC /begin REF_MEASUREMENT CDDInterface.MeasuredOnTimeB.Cnt_u32 /end REF_MEASUREMENT /end GROUP
/begin GROUP CDDInterface.MeasuredOnTimeC.Cnt_u32 "MICROSAR RTE" /begin SUB_GROUP /end SUB_GROUP /begin FUNCTION_LIST /end FUNCTION_LIST /begin REF_CHARACTERISTIC /end REF_CHARACTERISTIC /begin REF_MEASUREMENT CDDInterface.MeasuredOnTimeC.Cnt_u32 /end REF_MEASUREMENT /end GROUP
/begin GROUP CDDInterface.MechMtrPos1TimeStamp.USec_u32 "MICROSAR RTE" /begin SUB_GROUP /end SUB_GROUP /begin FUNCTION_LIST /end FUNCTION_LIST /begin REF_CHARACTERISTIC /end REF_CHARACTERISTIC /begin REF_MEASUREMENT CDDInterface.MechMtrPos1TimeStamp.USec_u32 /end REF_MEASUREMENT /end GROUP
/begin GROUP CDDInterface.MechMtrPos2TimeStamp.USec_u32 "MICROSAR RTE" /begin SUB_GROUP /end SUB_GROUP /begin FUNCTION_LIST /end FUNCTION_LIST /begin REF_CHARACTERISTIC /end REF_CHARACTERISTIC /begin REF_MEASUREMENT CDDInterface.MechMtrPos2TimeStamp.USec_u32 /end REF_MEASUREMENT /end GROUP
/begin GROUP CDDInterface.MfgDiagInhibit.Cnt_lgc "MICROSAR RTE" /begin SUB_GROUP /end SUB_GROUP /begin FUNCTION_LIST /end FUNCTION_LIST /begin REF_CHARACTERISTIC /end REF_CHARACTERISTIC /begin REF_MEASUREMENT CDDInterface.MfgDiagInhibit.Cnt_lgc /end REF_MEASUREMENT /end GROUP
/begin GROUP CDDInterface.ModIdxFinal.Uls_f32 "MICROSAR RTE" /begin SUB_GROUP /end SUB_GROUP /begin FUNCTION_LIST /end FUNCTION_LIST /begin REF_CHARACTERISTIC /end REF_CHARACTERISTIC /begin REF_MEASUREMENT CDDInterface.ModIdxFinal.Uls_f32 /end REF_MEASUREMENT /end GROUP
/begin GROUP CDDInterface.ModIdxSrlComSvcDft.Cnt_lgc "MICROSAR RTE" /begin SUB_GROUP /end SUB_GROUP /begin FUNCTION_LIST /end FUNCTION_LIST /begin REF_CHARACTERISTIC /end REF_CHARACTERISTIC /begin REF_MEASUREMENT CDDInterface.ModIdxSrlComSvcDft.Cnt_lgc /end REF_MEASUREMENT /end GROUP
/begin GROUP CDDInterface.ModeRequirePorts "MICROSAR RTE" /begin SUB_GROUP CDDInterface.SystemState.Mode /end SUB_GROUP /begin FUNCTION_LIST /end FUNCTION_LIST /begin REF_CHARACTERISTIC /end REF_CHARACTERISTIC /begin REF_MEASUREMENT /end REF_MEASUREMENT /end GROUP
/begin GROUP CDDInterface.MtrCurr1TempOffset.Volt_f32 "MICROSAR RTE" /begin SUB_GROUP /end SUB_GROUP /begin FUNCTION_LIST /end FUNCTION_LIST /begin REF_CHARACTERISTIC /end REF_CHARACTERISTIC /begin REF_MEASUREMENT CDDInterface.MtrCurr1TempOffset.Volt_f32 /end REF_MEASUREMENT /end GROUP
/begin GROUP CDDInterface.MtrCurr2TempOffset.Volt_f32 "MICROSAR RTE" /begin SUB_GROUP /end SUB_GROUP /begin FUNCTION_LIST /end FUNCTION_LIST /begin REF_CHARACTERISTIC /end REF_CHARACTERISTIC /begin REF_MEASUREMENT CDDInterface.MtrCurr2TempOffset.Volt_f32 /end REF_MEASUREMENT /end GROUP
/begin GROUP CDDInterface.MtrCurrDax.Amp_f32 "MICROSAR RTE" /begin SUB_GROUP /end SUB_GROUP /begin FUNCTION_LIST /end FUNCTION_LIST /begin REF_CHARACTERISTIC /end REF_CHARACTERISTIC /begin REF_MEASUREMENT CDDInterface.MtrCurrDax.Amp_f32 /end REF_MEASUREMENT /end GROUP
/begin GROUP CDDInterface.MtrCurrK1.Amp_f32 "MICROSAR RTE" /begin SUB_GROUP /end SUB_GROUP /begin FUNCTION_LIST /end FUNCTION_LIST /begin REF_CHARACTERISTIC /end REF_CHARACTERISTIC /begin REF_MEASUREMENT CDDInterface.MtrCurrK1.Amp_f32 /end REF_MEASUREMENT /end GROUP
/begin GROUP CDDInterface.MtrCurrK2.Amp_f32 "MICROSAR RTE" /begin SUB_GROUP /end SUB_GROUP /begin FUNCTION_LIST /end FUNCTION_LIST /begin REF_CHARACTERISTIC /end REF_CHARACTERISTIC /begin REF_MEASUREMENT CDDInterface.MtrCurrK2.Amp_f32 /end REF_MEASUREMENT /end GROUP
/begin GROUP CDDInterface.MtrCurrQax.Amp_f32 "MICROSAR RTE" /begin SUB_GROUP /end SUB_GROUP /begin FUNCTION_LIST /end FUNCTION_LIST /begin REF_CHARACTERISTIC /end REF_CHARACTERISTIC /begin REF_MEASUREMENT CDDInterface.MtrCurrQax.Amp_f32 /end REF_MEASUREMENT /end GROUP
/begin GROUP CDDInterface.MtrCurrQaxFinalRef.Amp_f32 "MICROSAR RTE" /begin SUB_GROUP /end SUB_GROUP /begin FUNCTION_LIST /end FUNCTION_LIST /begin REF_CHARACTERISTIC /end REF_CHARACTERISTIC /begin REF_MEASUREMENT CDDInterface.MtrCurrQaxFinalRef.Amp_f32 /end REF_MEASUREMENT /end GROUP
/begin GROUP CDDInterface.MtrElecMechPolarity.Cnt_s08 "MICROSAR RTE" /begin SUB_GROUP /end SUB_GROUP /begin FUNCTION_LIST /end FUNCTION_LIST /begin REF_CHARACTERISTIC /end REF_CHARACTERISTIC /begin REF_MEASUREMENT CDDInterface.MtrElecMechPolarity.Cnt_s08 /end REF_MEASUREMENT /end GROUP
/begin GROUP CDDInterface.MtrParmNrmLrnSrlComSvcDft.Cnt_lgc "MICROSAR RTE" /begin SUB_GROUP /end SUB_GROUP /begin FUNCTION_LIST /end FUNCTION_LIST /begin REF_CHARACTERISTIC /end REF_CHARACTERISTIC /begin REF_MEASUREMENT CDDInterface.MtrParmNrmLrnSrlComSvcDft.Cnt_lgc /end REF_MEASUREMENT /end GROUP
/begin GROUP CDDInterface.MtrPosPolarity.Cnt_s08 "MICROSAR RTE" /begin SUB_GROUP /end SUB_GROUP /begin FUNCTION_LIST /end FUNCTION_LIST /begin REF_CHARACTERISTIC /end REF_CHARACTERISTIC /begin REF_MEASUREMENT CDDInterface.MtrPosPolarity.Cnt_s08 /end REF_MEASUREMENT /end GROUP
/begin GROUP CDDInterface.MtrTrqCmdSign.Cnt_s16 "MICROSAR RTE" /begin SUB_GROUP /end SUB_GROUP /begin FUNCTION_LIST /end FUNCTION_LIST /begin REF_CHARACTERISTIC /end REF_CHARACTERISTIC /begin REF_MEASUREMENT CDDInterface.MtrTrqCmdSign.Cnt_s16 /end REF_MEASUREMENT /end GROUP
/begin GROUP CDDInterface.MtrVelNrmLrnSrlComSvcDft.Cnt_lgc "MICROSAR RTE" /begin SUB_GROUP /end SUB_GROUP /begin FUNCTION_LIST /end FUNCTION_LIST /begin REF_CHARACTERISTIC /end REF_CHARACTERISTIC /begin REF_MEASUREMENT CDDInterface.MtrVelNrmLrnSrlComSvcDft.Cnt_lgc /end REF_MEASUREMENT /end GROUP
/begin GROUP CDDInterface.MultIgnSrlComSvcDft.Cnt_lgc "MICROSAR RTE" /begin SUB_GROUP /end SUB_GROUP /begin FUNCTION_LIST /end FUNCTION_LIST /begin REF_CHARACTERISTIC /end REF_CHARACTERISTIC /begin REF_MEASUREMENT CDDInterface.MultIgnSrlComSvcDft.Cnt_lgc /end REF_MEASUREMENT /end GROUP
/begin GROUP CDDInterface.ParkAstSrlComSvcDft.Cnt_lgc "MICROSAR RTE" /begin SUB_GROUP /end SUB_GROUP /begin FUNCTION_LIST /end FUNCTION_LIST /begin REF_CHARACTERISTIC /end REF_CHARACTERISTIC /begin REF_MEASUREMENT CDDInterface.ParkAstSrlComSvcDft.Cnt_lgc /end REF_MEASUREMENT /end GROUP
/begin GROUP CDDInterface.PosTrajEnable.Cnt_lgc "MICROSAR RTE" /begin SUB_GROUP /end SUB_GROUP /begin FUNCTION_LIST /end FUNCTION_LIST /begin REF_CHARACTERISTIC /end REF_CHARACTERISTIC /begin REF_MEASUREMENT CDDInterface.PosTrajEnable.Cnt_lgc /end REF_MEASUREMENT /end GROUP
/begin GROUP CDDInterface.PullCompLrnSrlComSvcDft.Cnt_lgc "MICROSAR RTE" /begin SUB_GROUP /end SUB_GROUP /begin FUNCTION_LIST /end FUNCTION_LIST /begin REF_CHARACTERISTIC /end REF_CHARACTERISTIC /begin REF_MEASUREMENT CDDInterface.PullCompLrnSrlComSvcDft.Cnt_lgc /end REF_MEASUREMENT /end GROUP
/begin GROUP CDDInterface.PullCompSrlComSvcDft.Cnt_lgc "MICROSAR RTE" /begin SUB_GROUP /end SUB_GROUP /begin FUNCTION_LIST /end FUNCTION_LIST /begin REF_CHARACTERISTIC /end REF_CHARACTERISTIC /begin REF_MEASUREMENT CDDInterface.PullCompSrlComSvcDft.Cnt_lgc /end REF_MEASUREMENT /end GROUP
/begin GROUP CDDInterface.ReceiverPorts "MICROSAR RTE"
 /begin SUB_GROUP CDDInterface.AssistAssemblyPolarity.Cnt_s08 CDDInterface.CommOffset.Cnt_u16 CDDInterface.MRFMtrVel.MtrRadpS_f32 CDDInterface.MtrCurr1TempOffset.Volt_f32 CDDInterface.MtrCurr2TempOffset.Volt_f32 CDDInterface.MtrElecMechPolarity.Cnt_s08 CDDInterface.MtrPosPolarity.Cnt_s08 CDDInterface.MtrTrqCmdSign.Cnt_s16 CDDInterface.Vecu.Volt_f32 /end SUB_GROUP
 /begin FUNCTION_LIST /end FUNCTION_LIST
 /begin REF_CHARACTERISTIC /end REF_CHARACTERISTIC
 /begin REF_MEASUREMENT /end REF_MEASUREMENT
/end GROUP
/begin GROUP CDDInterface.ReturnSrlComSvcDft.Cnt_lgc "MICROSAR RTE" /begin SUB_GROUP /end SUB_GROUP /begin FUNCTION_LIST /end FUNCTION_LIST /begin REF_CHARACTERISTIC /end REF_CHARACTERISTIC /begin REF_MEASUREMENT CDDInterface.ReturnSrlComSvcDft.Cnt_lgc /end REF_MEASUREMENT /end GROUP
/begin GROUP CDDInterface.RxMsgsSrlComSvcDft.Cnt_lgc "MICROSAR RTE" /begin SUB_GROUP /end SUB_GROUP /begin FUNCTION_LIST /end FUNCTION_LIST /begin REF_CHARACTERISTIC /end REF_CHARACTERISTIC /begin REF_MEASUREMENT CDDInterface.RxMsgsSrlComSvcDft.Cnt_lgc /end REF_MEASUREMENT /end GROUP
/begin GROUP CDDInterface.RxMtrPos1ParityAccum.Cnt_u16 "MICROSAR RTE" /begin SUB_GROUP /end SUB_GROUP /begin FUNCTION_LIST /end FUNCTION_LIST /begin REF_CHARACTERISTIC /end REF_CHARACTERISTIC /begin REF_MEASUREMENT CDDInterface.RxMtrPos1ParityAccum.Cnt_u16 /end REF_MEASUREMENT /end GROUP
/begin GROUP CDDInterface.SenderPorts "MICROSAR RTE"
 /begin SUB_GROUP CDDInterface.ADCMtrCurr1.Volts_f32 CDDInterface.ADCMtrCurr2.Volts_f32 CDDInterface.BallNutTempEstSrlComSvcDft.Cnt_lgc CDDInterface.CorrMtrCurrPosition.Rev_f32 CDDInterface.CorrectedElecMtrPos.Rev_u0p16 CDDInterface.CorrectedElecMtrPosFloat.Rev_f32 CDDInterface.CumMechMtrPos.Rev_f32 CDDInterface.DampingSrlComSvcDft.Cnt_lgc CDDInterface.DftAsstTbl.Cnt_lgc CDDInterface.Die1RxError.Cnt_u16 CDDInterface.Die1RxMtrPos.Cnt_u16 CDDInterface.Die1RxRevCtr.Cnt_u16 CDDInterface.Die1UnderVoltgFltAccum.Cnt_u16 CDDInterface.Die2RxError.Cnt_u16 CDDInterface.Die2RxMtrPos.Cnt_u16 CDDInterface.Die2RxRevCtr.Cnt_u16 CDDInterface.DisableCEBusNormComm.Cnt_lgc CDDInterface.DisableHSBusNormComm.Cnt_lgc CDDInterface.DrivingDynSrlComSvcDft.Cnt_lgc CDDInterface.DwnldAsstGain.Uls_f32 CDDInterface.EOTImpactSrlComSvcDft.Cnt_lgc CDDInterface.EOTThermalSrlComSvcDft.Cnt_lgc CDDInterface.EngONSrlComSvcDft.Cnt_lgc CDDInterface.ExpectedOnTimeA.Cnt_u32 CDDInterface.ExpectedOnTimeB.Cnt_u32 CDDInterface.ExpectedOnTimeC.Cnt_u32 CDDInterface.FreqDepDmpSrlComSvcDft.Cnt_lgc CDDInterface.FricLrnSrlComSvcDft.Cnt_lgc CDDInterface.HysAddSrlComSvcDft.Cnt_lgc CDDInterface.HystCompSrlComSvcDft.Cnt_lgc CDDInterface.IgnCnt.Cnt_u16 CDDInterface.KinIntDiagSrlComSvcDft.Cnt_lgc CDDInterface.LRPRPhaseadvanceCaptured.Cnt_s16 CDDInterface.LimitSrlComSvcDft.Cnt_lgc CDDInterface.MEC.Cnt_enum CDDInterface.MeasuredOnTimeA.Cnt_u32 CDDInterface.MeasuredOnTimeB.Cnt_u32 CDDInterface.MeasuredOnTimeC.Cnt_u32 CDDInterface.MechMtrPos1TimeStamp.USec_u32 CDDInterface.MechMtrPos2TimeStamp.USec_u32 CDDInterface.MfgDiagInhibit.Cnt_lgc CDDInterface.ModIdxFinal.Uls_f32 CDDInterface.ModIdxSrlComSvcDft.Cnt_lgc CDDInterface.MtrCurrDax.Amp_f32 CDDInterface.MtrCurrK1.Amp_f32 CDDInterface.MtrCurrK2.Amp_f32 CDDInterface.MtrCurrQax.Amp_f32 CDDInterface.MtrCurrQaxFinalRef.Amp_f32 CDDInterface.MtrParmNrmLrnSrlComSvcDft.Cnt_lgc CDDInterface.MtrVelNrmLrnSrlComSvcDft.Cnt_lgc CDDInterface.MultIgnSrlComSvcDft.Cnt_lgc CDDInterface.ParkAstSrlComSvcDft.Cnt_lgc CDDInterface.PosTrajEnable.Cnt_lgc CDDInterface.PullCompLrnSrlComSvcDft.Cnt_lgc CDDInterface.PullCompSrlComSvcDft.Cnt_lgc CDDInterface.ReturnSrlComSvcDft.Cnt_lgc CDDInterface.RxMsgsSrlComSvcDft.Cnt_lgc CDDInterface.RxMtrPos1ParityAccum.Cnt_u16 CDDInterface.SftEndStpSrlComSvcDft.Cnt_lgc CDDInterface.SrlComSvcDft.Cnt_b32 CDDInterface.SysCVSwitchADC.Cnt_u16 CDDInterface.SysCorrectedElecMtrPos.Rev_f32 CDDInterface.ThermalDCSrlComSvcDft.Cnt_lgc CDDInterface.TrqRmpSrlComSvcDft.Cnt_lgc CDDInterface.UncorrMechMtrPos1.Rev_u0p16 CDDInterface.WIRMfgEnabled.Cnt_lgc /end SUB_GROUP
 /begin FUNCTION_LIST /end FUNCTION_LIST
 /begin REF_CHARACTERISTIC /end REF_CHARACTERISTIC
 /begin REF_MEASUREMENT /end REF_MEASUREMENT
/end GROUP
/begin GROUP CDDInterface.SftEndStpSrlComSvcDft.Cnt_lgc "MICROSAR RTE" /begin SUB_GROUP /end SUB_GROUP /begin FUNCTION_LIST /end FUNCTION_LIST /begin REF_CHARACTERISTIC /end REF_CHARACTERISTIC /begin REF_MEASUREMENT CDDInterface.SftEndStpSrlComSvcDft.Cnt_lgc /end REF_MEASUREMENT /end GROUP
/begin GROUP CDDInterface.SrlComSvcDft.Cnt_b32 "MICROSAR RTE" /begin SUB_GROUP /end SUB_GROUP /begin FUNCTION_LIST /end FUNCTION_LIST /begin REF_CHARACTERISTIC /end REF_CHARACTERISTIC /begin REF_MEASUREMENT CDDInterface.SrlComSvcDft.Cnt_b32 /end REF_MEASUREMENT /end GROUP
/begin GROUP CDDInterface.SysCVSwitchADC.Cnt_u16 "MICROSAR RTE" /begin SUB_GROUP /end SUB_GROUP /begin FUNCTION_LIST /end FUNCTION_LIST /begin REF_CHARACTERISTIC /end REF_CHARACTERISTIC /begin REF_MEASUREMENT CDDInterface.SysCVSwitchADC.Cnt_u16 /end REF_MEASUREMENT /end GROUP
/begin GROUP CDDInterface.SysCorrectedElecMtrPos.Rev_f32 "MICROSAR RTE" /begin SUB_GROUP /end SUB_GROUP /begin FUNCTION_LIST /end FUNCTION_LIST /begin REF_CHARACTERISTIC /end REF_CHARACTERISTIC /begin REF_MEASUREMENT CDDInterface.SysCorrectedElecMtrPos.Rev_f32 /end REF_MEASUREMENT /end GROUP
/begin GROUP CDDInterface.SystemState.Mode "MICROSAR RTE" /begin SUB_GROUP /end SUB_GROUP /begin FUNCTION_LIST /end FUNCTION_LIST /begin REF_CHARACTERISTIC /end REF_CHARACTERISTIC /begin REF_MEASUREMENT CDDInterface.SystemState.Mode /end REF_MEASUREMENT /end GROUP
/begin GROUP CDDInterface.ThermalDCSrlComSvcDft.Cnt_lgc "MICROSAR RTE" /begin SUB_GROUP /end SUB_GROUP /begin FUNCTION_LIST /end FUNCTION_LIST /begin REF_CHARACTERISTIC /end REF_CHARACTERISTIC /begin REF_MEASUREMENT CDDInterface.ThermalDCSrlComSvcDft.Cnt_lgc /end REF_MEASUREMENT /end GROUP
/begin GROUP CDDInterface.TrqRmpSrlComSvcDft.Cnt_lgc "MICROSAR RTE" /begin SUB_GROUP /end SUB_GROUP /begin FUNCTION_LIST /end FUNCTION_LIST /begin REF_CHARACTERISTIC /end REF_CHARACTERISTIC /begin REF_MEASUREMENT CDDInterface.TrqRmpSrlComSvcDft.Cnt_lgc /end REF_MEASUREMENT /end GROUP
/begin GROUP CDDInterface.UncorrMechMtrPos1.Rev_u0p16 "MICROSAR RTE" /begin SUB_GROUP /end SUB_GROUP /begin FUNCTION_LIST /end FUNCTION_LIST /begin REF_CHARACTERISTIC /end REF_CHARACTERISTIC /begin REF_MEASUREMENT CDDInterface.UncorrMechMtrPos1.Rev_u0p16 /end REF_MEASUREMENT /end GROUP
/begin GROUP CDDInterface.Vecu.Volt_f32 "MICROSAR RTE" /begin SUB_GROUP /end SUB_GROUP /begin FUNCTION_LIST /end FUNCTION_LIST /begin REF_CHARACTERISTIC /end REF_CHARACTERISTIC /begin REF_MEASUREMENT CDDInterface.Vecu.Volt_f32 /end REF_MEASUREMENT /end GROUP
/begin GROUP CDDInterface.WIRMfgEnabled.Cnt_lgc "MICROSAR RTE" /begin SUB_GROUP /end SUB_GROUP /begin FUNCTION_LIST /end FUNCTION_LIST /begin REF_CHARACTERISTIC /end REF_CHARACTERISTIC /begin REF_MEASUREMENT CDDInterface.WIRMfgEnabled.Cnt_lgc /end REF_MEASUREMENT /end GROUP
/begin GROUP Cd_Nhet1 "MICROSAR RTE" /begin SUB_GROUP Cd_Nhet1.SenderPorts /end SUB_GROUP /begin FUNCTION_LIST /end FUNCTION_LIST /begin REF_CHARACTERISTIC /end REF_CHARACTERISTIC /begin REF_MEASUREMENT /end REF_MEASUREMENT /end GROUP
/begin GROUP Cd_Nhet1.DigHwTrqT1.HwNm_f32 "MICROSAR RTE" /begin SUB_GROUP /end SUB_GROUP /begin FUNCTION_LIST /end FUNCTION_LIST /begin REF_CHARACTERISTIC /end REF_CHARACTERISTIC /begin REF_MEASUREMENT Cd_Nhet1.DigHwTrqT1.HwNm_f32 /end REF_MEASUREMENT /end GROUP
/begin GROUP Cd_Nhet1.DigHwTrqT2.HwNm_f32 "MICROSAR RTE" /begin SUB_GROUP /end SUB_GROUP /begin FUNCTION_LIST /end FUNCTION_LIST /begin REF_CHARACTERISTIC /end REF_CHARACTERISTIC /begin REF_MEASUREMENT Cd_Nhet1.DigHwTrqT2.HwNm_f32 /end REF_MEASUREMENT /end GROUP
/begin GROUP Cd_Nhet1.SenderPorts "MICROSAR RTE" /begin SUB_GROUP Cd_Nhet1.DigHwTrqT1.HwNm_f32 Cd_Nhet1.DigHwTrqT2.HwNm_f32 /end SUB_GROUP /begin FUNCTION_LIST /end FUNCTION_LIST /begin REF_CHARACTERISTIC /end REF_CHARACTERISTIC /begin REF_MEASUREMENT /end REF_MEASUREMENT /end GROUP
/begin GROUP CmMtrCurr "MICROSAR RTE"
 /begin SUB_GROUP CmMtrCurr.ModeRequirePorts CmMtrCurr.PerInstanceMemories CmMtrCurr.ReceiverPorts CmMtrCurr.SenderPorts /end SUB_GROUP
 /begin FUNCTION_LIST /end FUNCTION_LIST
 /begin REF_CHARACTERISTIC /end REF_CHARACTERISTIC
 /begin REF_MEASUREMENT /end REF_MEASUREMENT
/end GROUP
/begin GROUP CmMtrCurr.ADCMtrCurr1.Volts_f32 "MICROSAR RTE" /begin SUB_GROUP /end SUB_GROUP /begin FUNCTION_LIST /end FUNCTION_LIST /begin REF_CHARACTERISTIC /end REF_CHARACTERISTIC /begin REF_MEASUREMENT CmMtrCurr.ADCMtrCurr1.Volts_f32 /end REF_MEASUREMENT /end GROUP
/begin RECORD_LAYOUT RTE_RL_ULONG FNC_VALUES 1 ULONG ROW_DIR DIRECT /end RECORD_LAYOUT
/begin RECORD_LAYOUT RTE_RL_SBYTE FNC_VALUES 1 SBYTE ROW_DIR DIRECT /end RECORD_LAYOUT
/**********************************************************************************************************************
* COMPU_METHOD / COMPU_VTAB_RANGE
*********************************************************************************************************************/
/begin COMPU_METHOD RTE_CM_BOOLEAN "" TAB_VERB "%3.1" "" COMPU_TAB_REF RTE_CM_BOOLEAN /end COMPU_METHOD
/begin COMPU_VTAB_RANGE RTE_CM_BOOLEAN "" 2 0 0 "false" 1 255 "true" /end COMPU_VTAB_RANGE
/begin COMPU_METHOD RTE_CM_ENUM_ManufModeType "" TAB_VERB "%.1" "" COMPU_TAB_REF RTE_CM_ENUM_ManufModeType /end COMPU_METHOD
/begin COMPU_VTAB_RANGE RTE_CM_ENUM_ManufModeType "" 3 0 0 "ProductionMode" 1 1 "ManufacturingMode" 2 2 "EngineeringMode" /end COMPU_VTAB_RANGE
/begin COMPU_METHOD RTE_CM_ENUM_StaMd_Mode "" TAB_VERB "%.1" "" COMPU_TAB_REF RTE_CM_ENUM_StaMd_Mode /end COMPU_METHOD
/begin COMPU_VTAB_RANGE RTE_CM_ENUM_StaMd_Mode "" 5 0 0 "RTE_MODE_StaMd_Mode_DISABLE" 1 1 "RTE_MODE_StaMd_Mode_OFF" 2 2 "RTE_MODE_StaMd_Mode_OPERATE" 3 3 "RTE_MODE_StaMd_Mode_WARMINIT" 4 4 "RTE_TRANSITION_StaMd_Mode" /end COMPU_VTAB_RANGE
/begin COMPU_METHOD RTE_CM_ENUM_ESC_State_enum "" TAB_VERB "%.1" "" COMPU_TAB_REF RTE_CM_ENUM_ESC_State_enum /end COMPU_METHOD
/begin COMPU_VTAB_RANGE RTE_CM_ENUM_ESC_State_enum "" 5 0 0 "ESC_Inactive" 1 1 "ESC_Active" 2 2 "ESC_TemporarilyLimited" 3 3 "ESC_PermanentlyFailed" 4 4 "ESC_ManufacturingDisable" /end COMPU_VTAB_RANGE
/begin COMPU_METHOD RTE_CM_ENUM_Haptic_State_enum "" TAB_VERB "%.1" "" COMPU_TAB_REF RTE_CM_ENUM_Haptic_State_enum /end COMPU_METHOD
/begin COMPU_VTAB_RANGE RTE_CM_ENUM_Haptic_State_enum "" 3 0 0 "Haptic_Inactive" 1 1 "Haptic_Active" 2 2 "Haptic_Waiting" /end COMPU_VTAB_RANGE
/begin COMPU_METHOD RTE_CM_ENUM_LKA_State_enum "" TAB_VERB "%.1" "" COMPU_TAB_REF RTE_CM_ENUM_LKA_State_enum /end COMPU_METHOD
/begin COMPU_VTAB_RANGE RTE_CM_ENUM_LKA_State_enum "" 5 0 0 "LKA_Inactive" 1 1 "LKA_Active" 2 2 "LKA_TemporarilyLimited" 3 3 "LKA_PermanentlyFailed" 4 4 "LKA_ManufacturingDisable" /end COMPU_VTAB_RANGE
/begin COMPU_METHOD RTE_CM_ENUM_TuningSessionAddrPtrEnum "" TAB_VERB "%.1" "" COMPU_TAB_REF RTE_CM_ENUM_TuningSessionAddrPtrEnum /end COMPU_METHOD
/begin COMPU_VTAB_RANGE RTE_CM_ENUM_TuningSessionAddrPtrEnum "" 7 0 0 "TUN_SESSION_PTR_PERS" 1 1 "TUN_SESSION_PTR_SETS" 2 2 "TUN_SESSION_PTR_COMMON" 3 3 "TUN_SESSION_PTR_SETANDPER" 4 4 "TUN_SESSION_PTR_SETANDPERANDCOMMON" 16 16 "TUN_SESSION_PTR_CUSTSEG" 255 255 "TUN_SESSION_PTR_DISABLED" /end COMPU_VTAB_RANGE
