AUTOSAR XML (schema 321)
package /Constant
  4 x constant specification:
    D_FALSE_CNT_LGC
      value:
        boolean literal D_FALSE_CNT_LGC: type=Boolean, value=false
    D_ONE_ULS_F32
      value:
        real literal D_ONE_ULS_F32: type=Float, value=1
    D_TRUE_CNT_LGC
      value:
        boolean literal D_TRUE_CNT_LGC: type=Boolean, value=true
    D_ZERO_ULS_F32
      value:
        real literal D_ZERO_ULS_F32: type=Float, value=0
