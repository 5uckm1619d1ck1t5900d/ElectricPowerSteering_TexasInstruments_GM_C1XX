AUTOSAR XML (schema 314)
standard types defined: Boolean, SInt16, SInt8, UInt16, UInt32, Float
package /DataType
  integer type ManufModeType: compu {0=ProductionMode, 1=ManufacturingMode, 2=EngineeringMode}, lower-limit=0, upper-limit=2
