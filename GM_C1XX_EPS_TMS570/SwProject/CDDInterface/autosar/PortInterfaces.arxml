AUTOSAR XML (schema 314)
package /ModeDclrGroup
  mode declaration group StaMd_Mode: initial-mode=WARMINIT  # EPS System State mode declaration
    4 x mode:
      DISABLE
      OFF
      OPERATE
      WARMINIT
package /PortInterface
  client server interface CDDPorts: is-service=true
    operation ApplyMtrElecMechPol
      arg MtrElecMechPol_Cnt_s8: type=SInt8, direction=IN
    operation ClearPhsReasSum
      arg DataAccessBfr_Cnt_T_u16: type=UInt16, direction=IN
  client server interface SystemTime: is-service=true
    6 x operation:
      DtrmnElapsedTime_mS_u16  # Nexteer SystemTime Service
        arg InitialTime: type=UInt32, direction=IN
        arg ElapsedTime: type=UInt16, direction=OUT
      DtrmnElapsedTime_mS_u32
        arg InitialTime: type=UInt32, direction=IN
        arg ElapsedTime: type=UInt32, direction=OUT
      DtrmnElapsedTime_uS_u16
        arg InitialTime: type=UInt32, direction=IN
        arg ElapsedTime: type=UInt16, direction=OUT
      DtrmnElapsedTime_uS_u32
        arg InitialTime: type=UInt32, direction=IN
        arg ElapsedTime: type=UInt32, direction=OUT
      GetSystemTime_mS_u32
        arg CurrentTime: type=UInt32, direction=OUT
      GetSystemTime_uS_u32
        arg CurrentTime: type=UInt32, direction=OUT
  19 x sender receiver interface:
    BoolStatusFlag_Cnt_lgc
      data Cnt_lgc: sw-calibration-access=READ-ONLY, type=Boolean
    Count_Cnt_s16
      data Cnt_s16: sw-calibration-access=READ-ONLY, type=SInt16
    Count_Cnt_u16
      data Cnt_u16: sw-calibration-access=READ-ONLY, type=UInt16
    Count_Cnt_u32
      data Cnt_u32: sw-calibration-access=READ-ONLY, type=UInt32
    Current_Amp_f32
      data Amp_f32: sw-calibration-access=READ-ONLY, type=Float
    Direction_Cnt_s08
      data Cnt_s08: sw-calibration-access=READ-ONLY, type=SInt8
    Enable_Cnt_lgc
      data Cnt_lgc: sw-calibration-access=READ-ONLY, type=Boolean
    ManufModes_Cnt_enum
      data Cnt_enum: sw-calibration-access=READ-ONLY, type=ManufModeType
    MtrPos_Rev_f32
      data Rev_f32: sw-calibration-access=READ-ONLY, type=Float
    MtrPos_Rev_u0p16
      data Rev_u0p16: sw-calibration-access=READ-ONLY, type=UInt16
    MtrVel_MtrRadpS_f32
      data MtrRadpS_f32: sw-calibration-access=READ-ONLY, type=Float
    ScaleFactor_Uls_f32
      data Uls_f32: sw-calibration-access=READ-ONLY, type=Float
    SrlComSvcDft
      data Cnt_b32: sw-calibration-access=READ-ONLY, type=UInt32
    SystemState
      mode declaration group prototype Mode: type=StaMd_Mode
    Time_USec_u32
      data USec_u32: sw-calibration-access=READ-ONLY, type=UInt32
    UnityScalar_Uls_f32
      data Uls_f32: sw-calibration-access=READ-ONLY, type=Float
    Vecu_Volt_f32
      data Volt_f32: sw-calibration-access=READ-ONLY, range raw >5..<31, type=Float  # This port prototype is inteded to communicate voltage signals that represent the ecu supplied voltage. This signal has a lower limit, which is non-zero, to allow users of the signal to use it as a denominator in an expression without requiring a divide by 0 check.
    Voltage_Volt_f32
      data Volt_f32: sw-calibration-access=READ-ONLY, range raw >0..<31, type=Float  # This signal is intended to communicate any type voltage signal measured by the ecu. This signal has a lower limit of 0 which reequires users of the signal to provide divide by 0 protection if it is used as a denominator in a calculation. See Vecu port prototype if a port with a lower limit is desired.
    Voltage_Volts_f32
      data Volts_f32: sw-calibration-access=READ-ONLY, type=Float
