AUTOSAR XML (schema 314)
package /PortInterface
  client server interface NxtrDiagMgr
    4 x operation, all with possible-error=E_NOT_OK:
      GetNTCActive
        arg NTC_Cnt_T_enum: type=NTCNumber, direction=IN
        arg NTCActive_Ptr_T_lgc: type=Boolean, direction=OUT
      GetNTCFailed
        arg NTC_Cnt_T_enum: type=NTCNumber, direction=IN
        arg NTCFailed_Ptr_T_lgc: type=Boolean, direction=OUT
      GetNTCStatus
        arg NTC_Cnt_T_enum: type=NTCNumber, direction=IN
        arg Status_Ptr_T_u08: type=UInt8, direction=OUT
      SetNTCStatus
        arg NTC_Cnt_T_enum: type=NTCNumber, direction=IN
        arg Param_Cnt_T_u08: type=UInt8, direction=IN
        arg Status_Cnt_T_enum: type=NxtrDiagMgrStatus, direction=IN
    error E_NOT_OK: error-code=1
  sender receiver interface Authority_Uls_f32
    data Uls_f32: sw-calibration-access=READ-ONLY, type=Float
  sender receiver interface HwPos_HwDeg_f32
    data HwDeg_f32: sw-calibration-access=READ-ONLY, type=Float
  sender receiver interface Validity_Cnt_lgc
    data Cnt_lgc: sw-calibration-access=READ-ONLY, type=Boolean
