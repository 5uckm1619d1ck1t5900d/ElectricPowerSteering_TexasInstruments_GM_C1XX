AUTOSAR XML (schema 314)
package /PortInterface
  client server interface GeneratePosTraj_SCom  # Serial communication port for setting and getting a sdoftware component parameter. The parameter is typically an EOL parameter.
    operation SetInputParam
      arg PosServHwAngle_HwDeg_f32: type=Float, direction=IN
      arg TargetVelocity_HwDegpSec_f32: type=Float, direction=IN
      arg TargetAcceleration_HwDegpSecSqr_f32: type=Float, direction=IN
  sender receiver interface Enable
    data Cnt_lgc: sw-calibration-access=READ-ONLY, type=Boolean
  sender receiver interface HwPos
    data HwDeg_f32: sw-calibration-access=READ-ONLY, type=Float
