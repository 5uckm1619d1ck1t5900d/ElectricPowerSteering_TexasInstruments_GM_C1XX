AUTOSAR XML (schema 314)
standard types defined: Boolean, Float
package /DataType
  integer type APA_State_enum: compu {0=APA_TempInhibit, 1=APA_AvailCntrl, 2=APA_Active, 3=APA_PermanentlyFailed, 4=APA_ManufacturingDisable}, lower-limit=0, upper-limit=4
  integer type SS_State_enum: compu {0=SS_Normal, 1=SS_Intermediate1, 2=SS_Stop, 3=SS_Intermediate2, 4=SS_Fault, 5=SS_Disable}, lower-limit=0, upper-limit=5
