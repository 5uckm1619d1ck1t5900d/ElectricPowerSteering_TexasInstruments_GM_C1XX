AUTOSAR XML (schema 314)
package /Constant
  7 x constant specification:
    D_180OVRPI_ULS_F32
      value:
        real literal D_180OVRPI_ULS_F32: type=Float, value=57.295779513082
    D_APASTATEINIT_CNT_U08
      value:
        integer literal D_APASTATEINIT_CNT_U08: type=APA_State_enum, value=0
    D_FALSE_CNT_LGC
      value:
        boolean literal D_FALSE_CNT_LGC: type=Boolean, value=false
    D_MSECPERSEC_ULS_F32
      value:
        real literal D_MSECPERSEC_ULS_F32: type=Float, value=1000
    D_ONE_ULS_F32
      value:
        real literal D_ONE_ULS_F32: type=Float, value=1
    D_SSSTATEINIT_CNT_U08
      value:
        integer literal D_SSSTATEINIT_CNT_U08: type=SS_State_enum, value=0
    D_ZERO_ULS_F32
      value:
        real literal D_ZERO_ULS_F32: type=Float, value=0
