AUTOSAR XML (schema 314)
package /Constant
  8 x constant specification:
    D_180OVRPI_ULS_F32
      value:
        real literal D_180OVRPI_ULS_F32: type=Float, value=57.295779513082
    D_APASTATEINIT_CNT_U08
      value:
        integer literal D_APASTATEINIT_CNT_U08: type=APA_State_enum, value=0
    D_ESCSTATEINIT_CNT_U08
      value:
        integer literal D_ESCSTATEINIT_CNT_U08: type=ESC_State_enum, value=0
    D_FALSE_CNT_LGC
      value:
        boolean literal D_FALSE_CNT_LGC: type=Boolean, value=false
    D_LKASTATEINIT_CNT_U08
      value:
        integer literal D_LKASTATEINIT_CNT_U08: type=LKA_State_enum, value=0
    D_SYSPWRMODESTATEINIT_CNT_ENUM
      value:
        integer literal D_SYSPWRMODESTATEINIT_CNT_ENUM: type=SysPwrMd, value=0
    D_ZERO_CNT_U16
      value:
        integer literal D_ZERO_CNT_U16: type=UInt16, value=0
    D_ZERO_ULS_F32
      value:
        real literal D_ZERO_ULS_F32: type=Float, value=0
