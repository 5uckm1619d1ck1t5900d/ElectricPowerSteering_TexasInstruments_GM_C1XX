AUTOSAR XML (schema 314)
package /Constant
  7 x constant specification:
    D_2MS_SEC_F32
      value:
        real literal D_2MS_SEC_F32: type=Float, value=0.002
    D_APASTATEINIT_CNT_U08
      value:
        integer literal D_APASTATEINIT_CNT_U08: type=APA_State_enum, value=0
    D_ESCSTATEINIT_CNT_U08
      value:
        integer literal D_ESCSTATEINIT_CNT_U08: type=ESC_State_enum, value=0
    D_FALSE_CNT_LGC
      value:
        boolean literal D_FALSE_CNT_LGC: type=Boolean, value=false
    D_HAPTICSTATEINIT_CNT_U08
      value:
        integer literal D_HAPTICSTATEINIT_CNT_U08: type=Haptic_State_enum, value=1
    D_LKASTATEINIT_CNT_U08
      value:
        integer literal D_LKASTATEINIT_CNT_U08: type=LKA_State_enum, value=0
    D_ZERO_ULS_F32
      value:
        real literal D_ZERO_ULS_F32: type=Float, value=0
